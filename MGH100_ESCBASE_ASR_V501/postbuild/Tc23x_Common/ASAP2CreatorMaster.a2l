/* @@@@ File written by CANAPE_VERSION 13 0 20 @@@@ */ ASAP2_VERSION 1 61
/begin PROJECT Master ""
/begin MODULE CPP ""
/begin MOD_COMMON "" BYTE_ORDER MSB_LAST ALIGNMENT_BYTE 1 ALIGNMENT_WORD 1 ALIGNMENT_LONG 1 ALIGNMENT_INT64 1 ALIGNMENT_FLOAT32_IEEE 1 ALIGNMENT_FLOAT64_IEEE 1 /end MOD_COMMON
/begin IF_DATA XCP
 /begin PROTOCOL_LAYER 0x0101 0x07D0 0x2710 0x00 0x00 0x00 0x00 0x00 0xFF 0xFA BYTE_ORDER_MSB_LAST ADDRESS_GRANULARITY_BYTE OPTIONAL_CMD ALLOC_ODT_ENTRY OPTIONAL_CMD ALLOC_ODT OPTIONAL_CMD ALLOC_DAQ OPTIONAL_CMD FREE_DAQ OPTIONAL_CMD GET_DAQ_EVENT_INFO OPTIONAL_CMD GET_DAQ_LIST_INFO OPTIONAL_CMD GET_DAQ_RESOLUTION_INFO OPTIONAL_CMD GET_DAQ_PROCESSOR_INFO OPTIONAL_CMD GET_DAQ_CLOCK OPTIONAL_CMD START_STOP_SYNCH OPTIONAL_CMD START_STOP_DAQ_LIST OPTIONAL_CMD GET_DAQ_LIST_MODE OPTIONAL_CMD SET_DAQ_LIST_MODE OPTIONAL_CMD WRITE_DAQ OPTIONAL_CMD SET_DAQ_PTR OPTIONAL_CMD CLEAR_DAQ_LIST OPTIONAL_CMD SHORT_DOWNLOAD OPTIONAL_CMD DOWNLOAD OPTIONAL_CMD SHORT_UPLOAD OPTIONAL_CMD UPLOAD OPTIONAL_CMD SET_MTA OPTIONAL_CMD GET_COMM_MODE_INFO /end PROTOCOL_LAYER
 /begin DAQ DYNAMIC 0x00 0x02 0x00 OPTIMISATION_TYPE_DEFAULT ADDRESS_EXTENSION_FREE IDENTIFICATION_FIELD_TYPE_RELATIVE_BYTE GRANULARITY_ODT_ENTRY_SIZE_DAQ_BYTE 0xF8 OVERLOAD_INDICATION_PID /begin STIM GRANULARITY_ODT_ENTRY_SIZE_STIM_BYTE 0xF8 /end STIM /begin TIMESTAMP_SUPPORTED 0x01 SIZE_DWORD UNIT_10NS /end TIMESTAMP_SUPPORTED
  /begin DAQ_LIST 0x00 DAQ_LIST_TYPE DAQ MAX_ODT 0x01 MAX_ODT_ENTRIES 0x96 FIRST_PID 0x00 EVENT_FIXED 0x00 /end DAQ_LIST
  /begin DAQ_LIST 0x01 DAQ_LIST_TYPE DAQ MAX_ODT 0x01 MAX_ODT_ENTRIES 0x96 FIRST_PID 0x00 EVENT_FIXED 0x01 /end DAQ_LIST
  /begin DAQ_LIST 0x02 DAQ_LIST_TYPE DAQ MAX_ODT 0x01 MAX_ODT_ENTRIES 0x96 EVENT_FIXED 0x02 /end DAQ_LIST
  /begin DAQ_LIST 0x03 DAQ_LIST_TYPE DAQ MAX_ODT 0x01 MAX_ODT_ENTRIES 0x96 EVENT_FIXED 0x03 /end DAQ_LIST
  /begin DAQ_LIST 0x04 DAQ_LIST_TYPE DAQ MAX_ODT 0x01 MAX_ODT_ENTRIES 0x96 EVENT_FIXED 0x04 /end DAQ_LIST
  /begin DAQ_LIST 0x05 DAQ_LIST_TYPE DAQ MAX_ODT 0x01 MAX_ODT_ENTRIES 0x96 EVENT_FIXED 0x05 /end DAQ_LIST
  /begin DAQ_LIST 0x06 DAQ_LIST_TYPE DAQ MAX_ODT 0x01 MAX_ODT_ENTRIES 0x96 EVENT_FIXED 0x06 /end DAQ_LIST
  /begin DAQ_LIST 0x07 DAQ_LIST_TYPE DAQ MAX_ODT 0x01 MAX_ODT_ENTRIES 0x96 EVENT_FIXED 0x07 /end DAQ_LIST
  /begin DAQ_LIST 0x08 DAQ_LIST_TYPE DAQ MAX_ODT 0x01 MAX_ODT_ENTRIES 0x96 EVENT_FIXED 0x08 /end DAQ_LIST
  /begin DAQ_LIST 0x09 DAQ_LIST_TYPE DAQ MAX_ODT 0x01 MAX_ODT_ENTRIES 0x96 EVENT_FIXED 0x09 /end DAQ_LIST
  /begin DAQ_LIST 0x0A DAQ_LIST_TYPE DAQ MAX_ODT 0x01 MAX_ODT_ENTRIES 0x64 EVENT_FIXED 0x10 /end DAQ_LIST
  /begin DAQ_LIST 0x0B DAQ_LIST_TYPE DAQ MAX_ODT 0x01 MAX_ODT_ENTRIES 0x64 EVENT_FIXED 0x11 /end DAQ_LIST
  /begin DAQ_LIST 0x0C DAQ_LIST_TYPE DAQ MAX_ODT 0x01 MAX_ODT_ENTRIES 0x64 EVENT_FIXED 0x12 /end DAQ_LIST
  /begin DAQ_LIST 0x0D DAQ_LIST_TYPE DAQ MAX_ODT 0x01 MAX_ODT_ENTRIES 0x64 EVENT_FIXED 0x13 /end DAQ_LIST
  /begin DAQ_LIST 0x0E DAQ_LIST_TYPE DAQ MAX_ODT 0x01 MAX_ODT_ENTRIES 0x64 EVENT_FIXED 0x14 /end DAQ_LIST
  /begin DAQ_LIST 0x0F DAQ_LIST_TYPE DAQ MAX_ODT 0x01 MAX_ODT_ENTRIES 0x64 EVENT_FIXED 0x15 /end DAQ_LIST
  /begin DAQ_LIST 0x10 DAQ_LIST_TYPE DAQ MAX_ODT 0x01 MAX_ODT_ENTRIES 0x64 EVENT_FIXED 0x16 /end DAQ_LIST
  /begin DAQ_LIST 0x11 DAQ_LIST_TYPE DAQ MAX_ODT 0x01 MAX_ODT_ENTRIES 0x64 EVENT_FIXED 0x17 /end DAQ_LIST
  /begin DAQ_LIST 0x12 DAQ_LIST_TYPE DAQ MAX_ODT 0x01 MAX_ODT_ENTRIES 0x64 EVENT_FIXED 0x18 /end DAQ_LIST
  /begin DAQ_LIST 0x13 DAQ_LIST_TYPE DAQ MAX_ODT 0x01 MAX_ODT_ENTRIES 0x64 EVENT_FIXED 0x19 /end DAQ_LIST
  /begin DAQ_LIST 0x14 DAQ_LIST_TYPE DAQ MAX_ODT 0x01 MAX_ODT_ENTRIES 0x96 EVENT_FIXED 0x1A /end DAQ_LIST
  /begin DAQ_LIST 0x15 DAQ_LIST_TYPE DAQ MAX_ODT 0x01 MAX_ODT_ENTRIES 0x96 EVENT_FIXED 0x1B /end DAQ_LIST
  /begin EVENT "1ms" "1ms" 0x00 DAQ 0xFF 0x01 0x06 0x00 /end EVENT
  /begin EVENT "5ms" "5ms" 0x01 DAQ 0xFF 0x05 0x06 0x00 /end EVENT
 /end DAQ
 /begin PAG 0x00 /end PAG
 /begin PGM PGM_MODE_ABSOLUTE 0x00 0x00 /end PGM
 /begin XCP_ON_TCP_IP 0x0100 0x15B3 ADDRESS "192.168.0.2" /end XCP_ON_TCP_IP
/end IF_DATA
/begin MOD_PAR ""
 /begin MEMORY_SEGMENT Calibration "" DATA FLASH INTERN 0x80010000 0x5FFC0 -1 -1 -1 -1 -1 /end MEMORY_SEGMENT
/end MOD_PAR
/begin COMPU_VTAB ActiveTable "" TAB_VERB 2 0 "NotActive" 1 "Active" DEFAULT_VALUE "" /end COMPU_VTAB
/begin COMPU_VTAB ActvSts1 "ACtive Status" TAB_VERB 2 0 "Not Active" 1 "Active" DEFAULT_VALUE "" /end COMPU_VTAB
/begin COMPU_VTAB BrkActTable "" TAB_VERB 2 0 "BrakeOff" 1 "BrakeOn" DEFAULT_VALUE "" /end COMPU_VTAB
/begin COMPU_VTAB CompleTable "" TAB_VERB 2 0 "NotCompletion" 1 "Completion" DEFAULT_VALUE "" /end COMPU_VTAB
/begin COMPU_VTAB CtrlStsReqTable "" TAB_VERB 4 0 "Undefined" 1 "Hold" 2 "Hold, Apply" 3 "Hold, Apply, Soft_stop" DEFAULT_VALUE "" /end COMPU_VTAB
/begin COMPU_VTAB CtrlTable "" TAB_VERB 40 0 "NoCtrl" 10 "ROP" 11 "ESC" 12 "TVBB" 13 "CRAM" 14 "ABSD" 15 "LDP" 16 "IVSS" 20 "PBA" 21 "FBS" 22 "FCC" 23 "LVBA" 24 "HBOB" 30 "EBD" 31 "ABS" 32 "CBC" 33 "SLS" 34 "PAC" 35 "RBB" 36 "EDC" 40 "BTCS" 41 "ETCS" 42 "ETSC" 50 "AVH" 51 "HSA" 52 "ISG" 53 "EPB" 60 "ACC" 61 "AEB" 62 "TJA" 63 "PIB" 64 "HBP" 70 "HDC" 71 "ADC" 72 "HRC" 73 "TSP" 74 "DPB" 80 "EBP" 81 "CCM" 82 "BDW" DEFAULT_VALUE "" /end COMPU_VTAB
/begin COMPU_VTAB DetTable "" TAB_VERB 2 0 "NotDetected" 1 "Detected" DEFAULT_VALUE "" /end COMPU_VTAB
/begin COMPU_VTAB DiagTable "" TAB_VERB 3 0 "NoDiag" 1 "StandardDiag" 2 "ExtendedDiag" DEFAULT_VALUE "" /end COMPU_VTAB
/begin COMPU_VTAB DrvgModTable "" TAB_VERB 6 0 "Normal" 1 "TractionControl" 2 "EscOff" 3 "Comport" 4 "Sport" 5 "SportPlus" DEFAULT_VALUE "" /end COMPU_VTAB
/begin COMPU_VTAB DrvMod1 "" TAB_VERB 2 0 "2WD" 1 "4WD" DEFAULT_VALUE "" /end COMPU_VTAB
/begin COMPU_VTAB DrvnAxleTqCtrlFct1 "" TAB_VERB 22 0 "no control" 10 "ROP" 11 "ESC" 12 "TVBB" 13 "TSP" 20 "PBA" 30 "EBD" 31 "ABS" 32 "CBC" 33 "SLS" 34 "PAC" 35 "RBB" 36 "EDC" 40 "TCS" 50 "AVH" 51 "HAS" 52 "ISG" 60 "AEB" 61 "SCC" 70 "EBP" 80 "TSP" 81 "HDC" DEFAULT_VALUE "" /end COMPU_VTAB
/begin COMPU_VTAB EpbSwtTypTable "" TAB_VERB 3 0 "None" 1 "6 wire push push" 2 "4 wire push pull" DEFAULT_VALUE "" /end COMPU_VTAB
/begin COMPU_VTAB EsvVlvModTable "" TAB_VERB 3 0 "Not control" 1 "Pattern control" 2 "Max current control" DEFAULT_VALUE "" /end COMPU_VTAB
/begin COMPU_VTAB FuncEnaTable "" TAB_VERB 2 0 "DISABLE" 1 "ENABLE" DEFAULT_VALUE "" /end COMPU_VTAB
/begin COMPU_VTAB HwTestModTable "" TAB_VERB 16 0 "Not control" 1 "1wheel and 2wheel rise rate performance test" 2 "4wheel rise rate performance test" 3 "TC valve current hold performance and noise check test" 4 "TC valve current relief performance test" 5 "NO valve current and pressure gradient mapping test with suction" 6 "NO valve current and pressure gradient mapping test without suction" 7 "NC valve open pressure and pressure gradient mapping test" 8 "TC valve current and pressure mapping test" 9 "Motor voltage and pressure gradient mapping test" 10 "Second circuit bleeding mode" 11 "DVT test mode" 101 "1wheel TCMF confirm test" 102 "4wheel TCMF confirm test" 103 "4wheel TCMF compensation confirm test" 104 "LFC confirm test" DEFAULT_VALUE "" /end COMPU_VTAB
/begin COMPU_VTAB InCtrlTable "" TAB_VERB 2 0 "NotInControl" 1 "InControl" DEFAULT_VALUE "" /end COMPU_VTAB
/begin COMPU_VTAB InstTable "" TAB_VERB 3 0 "Unknown" 1 "Uninstall" 2 "Install" DEFAULT_VALUE "" /end COMPU_VTAB
/begin COMPU_VTAB InvldVld2 "Validity status" TAB_VERB 2 0 "Invalid" 1 "Valid" DEFAULT_VALUE "" /end COMPU_VTAB
/begin COMPU_VTAB IsgTable "" TAB_VERB 8 0 "IsgNoActv" 1 "IsgActv" 2 "AutStrtByEcu" 3 "IsgProhb" 4 "FltInIsg" 5 "IsgInhbBySys" 6 "IsgDeactvt" 7 "NoBrkForIsg" DEFAULT_VALUE "" /end COMPU_VTAB
/begin COMPU_VTAB LampTable "" TAB_VERB 7 0 "Off" 1 "YellowOn" 2 "GreenOn" 3 "WhiteOn" 4 "YellowBlinking" 5 "GreenBlinking" 6 "WhiteBlinking" DEFAULT_VALUE "" /end COMPU_VTAB
/begin COMPU_VTAB LockTable "" TAB_VERB 2 0 "Unlock" 1 "Lock" DEFAULT_VALUE "" /end COMPU_VTAB
/begin COMPU_VTAB MotModNotWslcTable "" TAB_VERB 6 0 "Not control" 1 "TCMF initial rise control" 2 "TCMF rise control" 3 "TCMF rise pattern control" 4 "TCMF hold or dump control" 5 "Not TCMF control" DEFAULT_VALUE "" /end COMPU_VTAB
/begin COMPU_VTAB MotModWslcTable "" TAB_VERB 5 0 "Not control" 1 "ABS initial control" 2 "ABS control initial finished" 3 "ABS control finished" 4 "Not ABS control finished (EBD or CBC or SLS)" DEFAULT_VALUE "" /end COMPU_VTAB
/begin COMPU_VTAB MsgTable "" TAB_VERB 6 0 "None" 1 "ReadyToRlease" 2 "CloseBltDoorHoodTr" 3 "AutomaticallyEpbClamped" 4 "PressBrk" 5 "CloseDoorHoodTr" DEFAULT_VALUE "" /end COMPU_VTAB
/begin COMPU_VTAB NcVlvModTable "" TAB_VERB 4 0 "Not control" 1 "TCMF control" 2 "On-Off control" 3 "WSLC control" DEFAULT_VALUE "" /end COMPU_VTAB
/begin COMPU_VTAB No1VlvModTable "" TAB_VERB 7 0 "Not control" 1 "TCMF control" 2 "LFC rise control" 3 "Pulse-up rise control" 4 "Hold or Dump control" 5 "WSLC only control" 6 "WSLC with ESC combination control" DEFAULT_VALUE "" /end COMPU_VTAB
/begin COMPU_VTAB OffVldTable "" TAB_VERB 2 0 "Invalid" 1 "Valid" DEFAULT_VALUE "" /end COMPU_VTAB
/begin COMPU_VTAB OnOff1 "" TAB_VERB 2 0 "off" 1 "on" DEFAULT_VALUE "" /end COMPU_VTAB
/begin COMPU_VTAB OnOffTable "" TAB_VERB 2 0 "Off" 1 "On" DEFAULT_VALUE "" /end COMPU_VTAB
/begin COMPU_VTAB OpenTable "" TAB_VERB 2 0 "Closed" 1 "Opened" DEFAULT_VALUE "" /end COMPU_VTAB
/begin COMPU_VTAB OverStrTable "" TAB_VERB 2 0 "NotInOversteer" 1 "InOversteer" DEFAULT_VALUE "" /end COMPU_VTAB
/begin COMPU_VTAB PCtrlModNotTcmfTable "" TAB_VERB 7 0 "Not control" 1 "LFC rise control" 2 "Pulse-up rise control" 3 "Hold control" 4 "Dump control" 5 "WSLC control" 6 "TCMF control" DEFAULT_VALUE "" /end COMPU_VTAB
/begin COMPU_VTAB PCtrlModTable "" TAB_VERB 12 0 "Not control" 1 "TCMF initial rise control" 2 "TCMF rise control" 3 "TCMF hold control" 4 "TCMF dump control" 5 "TCMF initial hold control" 6 "TCMF compensation hold control" 7 "TCMF compensation dump control" 8 "LFC rise control" 9 "Pulse-up rise control" 10 "Hold control" 11 "Dump control" DEFAULT_VALUE "" /end COMPU_VTAB
/begin COMPU_VTAB PCtrlModTcmfCmpTable "" TAB_VERB 3 0 "Not control" 1 "TCMF compensation hold control" 2 "TCMF compensation dump control" DEFAULT_VALUE "" /end COMPU_VTAB
/begin COMPU_VTAB PCtrlModTcmfIniTable "" TAB_VERB 3 0 "Not control" 1 "TCMF initial rise control" 2 "TCMF Initial hold control" DEFAULT_VALUE "" /end COMPU_VTAB
/begin COMPU_VTAB PCtrlModTcmfNormTable "" TAB_VERB 4 0 "Not control" 1 "TCMF rise control" 2 "TCMF hold control" 3 "TCMF dump control" DEFAULT_VALUE "" /end COMPU_VTAB
/begin COMPU_VTAB PCtrlModTcmfTable "" TAB_VERB 8 0 "Not TCMF control" 1 "TCMF initial rise control" 2 "TCMF rise control" 3 "TCMF hold control" 4 "TCMF dump control" 5 "TCMF initial hold control" 6 "TCMF compensation hold control" 7 "TCMF compensation dump control" DEFAULT_VALUE "" /end COMPU_VTAB
/begin COMPU_VTAB PdlTable "" TAB_VERB 2 0 "PedalNotPressed" 1 "PedalPressed" DEFAULT_VALUE "" /end COMPU_VTAB
/begin COMPU_VTAB PrkBrkReqTable "" TAB_VERB 7 5 "None" 27 "ParkApply" 40 "HoldApply" 54 "Release" 66 "DynamicApply" 92 "RollerbenchApply" 111 "PadAdjustment" DEFAULT_VALUE "" /end COMPU_VTAB
/begin COMPU_VTAB PrkBrkStsTable "" TAB_VERB 7 27 "ParkApplied" 40 "HoldApplied" 54 "Released" 113 "Applying" 142 "Releasing" 144 "CompletelyReleased" 163 "Unknown" DEFAULT_VALUE "" /end COMPU_VTAB
/begin COMPU_VTAB RelsTable "" TAB_VERB 5 0 "NoReq" 1 "ApplyReq" 2 "RelsReq" 3 "Actvd" 4 "Unknown" DEFAULT_VALUE "" /end COMPU_VTAB
/begin COMPU_VTAB ReqSts1 "Request status" TAB_VERB 2 0 "not requested" 1 "requested" DEFAULT_VALUE "" /end COMPU_VTAB
/begin COMPU_VTAB ReqStsTable "" TAB_VERB 2 0 "NotRequested" 1 "Requested" DEFAULT_VALUE "" /end COMPU_VTAB
/begin COMPU_VTAB RollBenchStsTable "" TAB_VERB 2 5 "RollerbenchActive" 27 "RollerbenchInactive" DEFAULT_VALUE "" /end COMPU_VTAB
/begin COMPU_VTAB RvsGearTable "" TAB_VERB 2 0 "ReversedGearNotUsed" 1 "ReversedGearUsed" DEFAULT_VALUE "" /end COMPU_VTAB
/begin COMPU_VTAB SetResetState "" TAB_VERB 2 0 "Reset" 1 "Set" DEFAULT_VALUE "" /end COMPU_VTAB
/begin COMPU_VTAB ShiftStsTable "" TAB_VERB 2 0 "NoShiftInProgs" 1 "ShiftInProgs" DEFAULT_VALUE "" /end COMPU_VTAB
/begin COMPU_VTAB SolenoidTable "" TAB_VERB 2 0 "SolenoidOff" 1 "SolenoidOn" DEFAULT_VALUE "" /end COMPU_VTAB
/begin COMPU_VTAB SusDetTable "" TAB_VERB 2 0 "SuspectNotDetected" 1 "SuspectDetected" DEFAULT_VALUE "" /end COMPU_VTAB
/begin COMPU_VTAB TcVlvModTable "" TAB_VERB 9 0 "Not control" 1 "TCMF initial rise control" 2 "TCMF rise control" 3 "TCMF rise pattern control" 4 "TCMF hold/dump control" 5 "TCMF initial hold control" 6 "TCMF compensation hold control" 7 "TCMF compensation dump control" 8 "Not TCMF and only suction control" DEFAULT_VALUE "" /end COMPU_VTAB
/begin COMPU_VTAB TrsmGearReqTable "" TAB_VERB 4 0 "NoActn" 1 "MaxGearReq" 2 "MinGearReq" 3 "HldGearReq" DEFAULT_VALUE "" /end COMPU_VTAB
/begin COMPU_VTAB TrsmGearTar1 "Transmission Gear" TAB_VERB 10 0 "P" 1 "1st" 2 "2nd" 3 "3rd" 4 "4th" 5 "5th" 6 "6th" 7 "7th" 8 "8th" 14 "R" DEFAULT_VALUE "" /end COMPU_VTAB
/begin COMPU_VTAB TrsmGearTarTable "" TAB_VERB 10 0 "PN" 1 "1stSpeed" 2 "2ndSpeed" 3 "3rdSpeed" 4 "4thSpeed" 5 "5thSpeed" 6 "6thSpeed" 7 "7thSpeed" 8 "8thSpeed" 14 "R" DEFAULT_VALUE "" /end COMPU_VTAB
/begin COMPU_VTAB TrsmStGearLvr1 "" TAB_VERB 9 0 "P" 1 "L" 2 "2" 3 "3" 4 "DS Mode" 5 "D" 6 "N" 7 "R" 8 "Sports Mode" DEFAULT_VALUE "" /end COMPU_VTAB
/begin COMPU_VTAB TrsmStGearLvrTable "" TAB_VERB 9 0 "P" 1 "L" 2 "2" 3 "3" 4 "DSMode" 5 "D" 6 "N" 7 "R" 8 "SportsMode" DEFAULT_VALUE "" /end COMPU_VTAB
/begin COMPU_VTAB TrsmTypTable "" TAB_VERB 9 0 "Not used" 1 "AT" 2 "MT" 3 "CVT" 4 "DCT" 5 "HEV_AT" 6 "HEV_DCT" 7 "EV_AT" 8 "AMT" DEFAULT_VALUE "" /end COMPU_VTAB
/begin COMPU_VTAB UnderStrTable "" TAB_VERB 2 0 "NotInUndersteer" 1 "InUndersteer" DEFAULT_VALUE "" /end COMPU_VTAB
/begin COMPU_VTAB VacPmpRlyTypTable "" TAB_VERB 3 0 "None" 1 "Analogue" 2 "CAN" DEFAULT_VALUE "" /end COMPU_VTAB
/begin COMPU_VTAB VacSnsrTypTable "" TAB_VERB 3 0 "None" 1 "Analogue" 2 "CAN" DEFAULT_VALUE "" /end COMPU_VTAB
/begin COMPU_VTAB VldTable "" TAB_VERB 2 0 "Valid" 1 "InValid" DEFAULT_VALUE "" /end COMPU_VTAB
/begin COMPU_VTAB WhlRotlDirStdTable "" TAB_VERB 4 0 "Undefined" 1 "Standstill" 2 "Forward" 3 "Backward" DEFAULT_VALUE "" /end COMPU_VTAB
/begin COMPU_VTAB WhlSpdTypTable "" TAB_VERB 4 0 "None" 1 "Active" 2 "Smart" 3 "VDA" DEFAULT_VALUE "" /end COMPU_VTAB
/begin COMPU_METHOD A20 "" LINEAR "%.15" "g" COEFFS_LINEAR 0.25 0 /end COMPU_METHOD
/begin COMPU_METHOD A21 "" LINEAR "%.15" "g" COEFFS_LINEAR 0.25 0 /end COMPU_METHOD
/begin COMPU_METHOD A41 "" LINEAR "%.15" "g" COEFFS_LINEAR 0.001 0 /end COMPU_METHOD
/begin COMPU_METHOD A42 "" LINEAR "%.15" "g" COEFFS_LINEAR 0.01 0 /end COMPU_METHOD
/begin COMPU_METHOD A43 "" LINEAR "%.15" "g" COEFFS_LINEAR 0.1 0 /end COMPU_METHOD
/begin COMPU_METHOD A46 "" LINEAR "%.15" "g" COEFFS_LINEAR 0.03125 0 /end COMPU_METHOD
/begin COMPU_METHOD A47 "" LINEAR "%.15" "g" COEFFS_LINEAR 0.005 0 /end COMPU_METHOD
/begin COMPU_METHOD A48 "" LINEAR "%.15" "g" COEFFS_LINEAR 0.0001 0 /end COMPU_METHOD
/begin COMPU_METHOD acc_0p1_m_s_s "" LINEAR "%.15" "m/s^2" COEFFS_LINEAR 0.1 0 /end COMPU_METHOD
/begin COMPU_METHOD accgrdt_1_m_s_s_s "" LINEAR "%.15" "m/s^3" COEFFS_LINEAR 1 0 /end COMPU_METHOD
/begin COMPU_METHOD ActvSts1 "" LINEAR "%.15" "NA" COEFFS_LINEAR 1 0 STATUS_STRING_REF ActiveTable /end COMPU_METHOD
/begin COMPU_METHOD Ag41 "" LINEAR "%.15" "deg" COEFFS_LINEAR 0.1 0 /end COMPU_METHOD
/begin COMPU_METHOD Ag42 "" LINEAR "%.15" "deg" COEFFS_LINEAR 0.01 0 /end COMPU_METHOD
/begin COMPU_METHOD Ag43 "" LINEAR "%.15" "deg" COEFFS_LINEAR 10 0 /end COMPU_METHOD
/begin COMPU_METHOD AgSpd21 "" LINEAR "%.15" "DegPerSec" COEFFS_LINEAR 0.001 0 /end COMPU_METHOD
/begin COMPU_METHOD AgSpd31 "" LINEAR "%.15" "DegPerSec" COEFFS_LINEAR 0.01 0 /end COMPU_METHOD
/begin COMPU_METHOD AgSpd41 "" LINEAR "%.15" "DegPerSec" COEFFS_LINEAR 0.1 0 /end COMPU_METHOD
/begin COMPU_METHOD AgSpd42 "" LINEAR "%.15" "DegPerSec" COEFFS_LINEAR 0.1 0 /end COMPU_METHOD
/begin COMPU_METHOD AgSpdGrdt11 "" LINEAR "%.15" "DegPerSec2" COEFFS_LINEAR 0.01 0 /end COMPU_METHOD
/begin COMPU_METHOD Amp1 "" LINEAR "%.15" "A" COEFFS_LINEAR 0.01 0 /end COMPU_METHOD
/begin COMPU_METHOD Amp2 "" LINEAR "%.15" "A" COEFFS_LINEAR 0.001 0 /end COMPU_METHOD
/begin COMPU_METHOD Ar11 "" LINEAR "%.15" "m2" COEFFS_LINEAR 0.1 0 /end COMPU_METHOD
/begin COMPU_METHOD Ar21 "" LINEAR "%.15" "cm2" COEFFS_LINEAR 1 0 /end COMPU_METHOD
/begin COMPU_METHOD BltLockSt1 "" LINEAR "%.15" "NA" COEFFS_LINEAR 1 0 STATUS_STRING_REF LockTable /end COMPU_METHOD
/begin COMPU_METHOD BrkCoeff_q1 "" LINEAR "%.15" "N/bar" COEFFS_LINEAR 1 0 /end COMPU_METHOD
/begin COMPU_METHOD BrkCtrlFct1 "" LINEAR "%.15" "NA" COEFFS_LINEAR 1 0 STATUS_STRING_REF CtrlTable /end COMPU_METHOD
/begin COMPU_METHOD BrkDskHeatgCoeff1 "" LINEAR "%.15" "NmPerKgDegc" COEFFS_LINEAR 1 0 /end COMPU_METHOD
/begin COMPU_METHOD BrkOnOff1 "" LINEAR "%.15" "NA" COEFFS_LINEAR 1 0 STATUS_STRING_REF BrkActTable /end COMPU_METHOD
/begin COMPU_METHOD CmdSolnOnOff1 "" LINEAR "%.15" "NA" COEFFS_LINEAR 1 0 STATUS_STRING_REF SolenoidTable /end COMPU_METHOD
/begin COMPU_METHOD CmplnSts1 "" LINEAR "%.15" "NA" COEFFS_LINEAR 1 0 STATUS_STRING_REF CompleTable /end COMPU_METHOD
/begin COMPU_METHOD cnt "" LINEAR "%.15" "cnt" COEFFS_LINEAR 1 0 /end COMPU_METHOD
/begin COMPU_METHOD CtrlStsReq "" LINEAR "%.15" "NA" COEFFS_LINEAR 1 0 STATUS_STRING_REF CtrlStsReqTable /end COMPU_METHOD
/begin COMPU_METHOD Dens11 "" LINEAR "%.15" "KgPerm3" COEFFS_LINEAR 0.1 0 /end COMPU_METHOD
/begin COMPU_METHOD DetnSts1 "" LINEAR "%.15" "NA" COEFFS_LINEAR 1 0 STATUS_STRING_REF DetTable /end COMPU_METHOD
/begin COMPU_METHOD DiagSts1 "" LINEAR "%.15" "NA" COEFFS_LINEAR 1 0 STATUS_STRING_REF DiagTable /end COMPU_METHOD
/begin COMPU_METHOD DrvgMod1 "" LINEAR "%.15" "NA" COEFFS_LINEAR 1 0 STATUS_STRING_REF DrvgModTable /end COMPU_METHOD
/begin COMPU_METHOD DrvMod1 "" LINEAR "%.15" "NA" COEFFS_LINEAR 1 0 STATUS_STRING_REF DrvMod1 /end COMPU_METHOD
/begin COMPU_METHOD DrvnAxleTqCtrlFct1 "" LINEAR "%.15" "NA" COEFFS_LINEAR 1 0 STATUS_STRING_REF CtrlTable /end COMPU_METHOD
/begin COMPU_METHOD EpbBtnCtrlSts1 "" LINEAR "%.15" "NA" COEFFS_LINEAR 1 0 STATUS_STRING_REF RelsTable /end COMPU_METHOD
/begin COMPU_METHOD EpbSwtTyp1 "" LINEAR "%.15" "NA" COEFFS_LINEAR 1 0 STATUS_STRING_REF EpbSwtTypTable /end COMPU_METHOD
/begin COMPU_METHOD EsvVlvMod "" LINEAR "%.15" "NA" COEFFS_LINEAR 1 0 STATUS_STRING_REF EsvVlvModTable /end COMPU_METHOD
/begin COMPU_METHOD Fac11 "" LINEAR "%.15" "NA" COEFFS_LINEAR 0.001 0 /end COMPU_METHOD
/begin COMPU_METHOD Fac31 "" LINEAR "%.15" "NA" COEFFS_LINEAR 1 0 /end COMPU_METHOD
/begin COMPU_METHOD Fac81 "" LINEAR "%.15" "NA" COEFFS_LINEAR 5 0 /end COMPU_METHOD
/begin COMPU_METHOD Fac91 "" LINEAR "%.15" "NA" COEFFS_LINEAR 0.1 0 /end COMPU_METHOD
/begin COMPU_METHOD fac_0p05 "" LINEAR "%.15" "NA" COEFFS_LINEAR 0.05 0 /end COMPU_METHOD
/begin COMPU_METHOD FuncEna "" LINEAR "%.15" "NA" COEFFS_LINEAR 1 0 STATUS_STRING_REF FuncEnaTable /end COMPU_METHOD
/begin COMPU_METHOD Gain "" LINEAR "%.15" "NA" COEFFS_LINEAR 1 0 /end COMPU_METHOD
/begin COMPU_METHOD Gain21 "" LINEAR "%.15" "NA" COEFFS_LINEAR 10 0 /end COMPU_METHOD
/begin COMPU_METHOD HwTestMod "" LINEAR "%.15" "NA" COEFFS_LINEAR 1 0 STATUS_STRING_REF HwTestModTable /end COMPU_METHOD
/begin COMPU_METHOD InvldVld2 "" LINEAR "%.15" "NA" COEFFS_LINEAR 1 0 STATUS_STRING_REF VldTable /end COMPU_METHOD
/begin COMPU_METHOD IsgSts1 "" LINEAR "%.15" "NA" COEFFS_LINEAR 1 0 STATUS_STRING_REF IsgTable /end COMPU_METHOD
/begin COMPU_METHOD LampReq1 "" LINEAR "%.15" "NA" COEFFS_LINEAR 1 0 STATUS_STRING_REF LampTable /end COMPU_METHOD
/begin COMPU_METHOD Len21 "" LINEAR "%.15" "m" COEFFS_LINEAR 0.1 0 /end COMPU_METHOD
/begin COMPU_METHOD Len41 "" LINEAR "%.15" "m" COEFFS_LINEAR 0.0001 0 /end COMPU_METHOD
/begin COMPU_METHOD Len51 "" LINEAR "%.15" "m" COEFFS_LINEAR 0.001 0 /end COMPU_METHOD
/begin COMPU_METHOD Len71 "" LINEAR "%.15" "m" COEFFS_LINEAR 1e-005 0 /end COMPU_METHOD
/begin COMPU_METHOD Len81 "" LINEAR "%.15" "cm" COEFFS_LINEAR 0.1 0 /end COMPU_METHOD
/begin COMPU_METHOD Len91 "" LINEAR "%.15" "cm" COEFFS_LINEAR 1 0 /end COMPU_METHOD
/begin COMPU_METHOD len_0p01_mm "" LINEAR "%.15" "mm" COEFFS_LINEAR 0.01 0 /end COMPU_METHOD
/begin COMPU_METHOD M1 "" LINEAR "%.15" "kg" COEFFS_LINEAR 1 0 /end COMPU_METHOD
/begin COMPU_METHOD MiniTireDetnSt1 "" LINEAR "%.15" "NA" COEFFS_LINEAR 1 0 STATUS_STRING_REF InstTable /end COMPU_METHOD
/begin COMPU_METHOD MotModNotWslc "" LINEAR "%.15" "NA" COEFFS_LINEAR 1 0 STATUS_STRING_REF MotModNotWslcTable /end COMPU_METHOD
/begin COMPU_METHOD MotModWslc "" LINEAR "%.15" "NA" COEFFS_LINEAR 1 0 STATUS_STRING_REF MotModWslcTable /end COMPU_METHOD
/begin COMPU_METHOD MotTqCurCoeff1 "" LINEAR "%.15" "NmPerA" COEFFS_LINEAR 0.001 0 /end COMPU_METHOD
/begin COMPU_METHOD MotVolRpmCoeff1 "" LINEAR "%.15" "VPerRPM" COEFFS_LINEAR 0.0001 0 /end COMPU_METHOD
/begin COMPU_METHOD MsgReq1 "" LINEAR "%.15" "NA" COEFFS_LINEAR 1 0 STATUS_STRING_REF MsgTable /end COMPU_METHOD
/begin COMPU_METHOD N10 "" LINEAR "%.15" "RPM" COEFFS_LINEAR 1 0 /end COMPU_METHOD
/begin COMPU_METHOD N13 "" LINEAR "%.15" "RPM" COEFFS_LINEAR 100 0 /end COMPU_METHOD
/begin COMPU_METHOD NcVlvMod "" LINEAR "%.15" "NA" COEFFS_LINEAR 1 0 STATUS_STRING_REF NcVlvModTable /end COMPU_METHOD
/begin COMPU_METHOD No1VlvMod "" LINEAR "%.15" "NA" COEFFS_LINEAR 1 0 STATUS_STRING_REF No1VlvModTable /end COMPU_METHOD
/begin COMPU_METHOD Nr2 "" LINEAR "%.15" "NA" COEFFS_LINEAR 1 0 /end COMPU_METHOD
/begin COMPU_METHOD OffsVldyIndcr1 "" LINEAR "%.15" "NA" COEFFS_LINEAR 1 0 STATUS_STRING_REF OffVldTable /end COMPU_METHOD
/begin COMPU_METHOD OnOff1 "" LINEAR "%.15" "NA" COEFFS_LINEAR 1 0 STATUS_STRING_REF OnOffTable /end COMPU_METHOD
/begin COMPU_METHOD OpendClsd2 "" LINEAR "%.15" "NA" COEFFS_LINEAR 1 0 STATUS_STRING_REF OpenTable /end COMPU_METHOD
/begin COMPU_METHOD OperModSts1 "" LINEAR "%.15" "NA" COEFFS_LINEAR 1 0 /end COMPU_METHOD
/begin COMPU_METHOD OverSteerSts1 "" LINEAR "%.15" "NA" COEFFS_LINEAR 1 0 STATUS_STRING_REF OverStrTable /end COMPU_METHOD
/begin COMPU_METHOD P32 "" LINEAR "%.15" "bar" COEFFS_LINEAR 0.01 0 /end COMPU_METHOD
/begin COMPU_METHOD P34 "" LINEAR "%.15" "bar" COEFFS_LINEAR 0.1 0 /end COMPU_METHOD
/begin COMPU_METHOD P35 "" LINEAR "%.15" "bar" COEFFS_LINEAR 1 0 /end COMPU_METHOD
/begin COMPU_METHOD P41 "" LINEAR "%.15" "hPa" COEFFS_LINEAR 1 0 /end COMPU_METHOD
/begin COMPU_METHOD PCtrlMod "" LINEAR "%.15" "NA" COEFFS_LINEAR 1 0 STATUS_STRING_REF PCtrlModTable /end COMPU_METHOD
/begin COMPU_METHOD PCtrlModNotTcmf "" LINEAR "%.15" "NA" COEFFS_LINEAR 1 0 STATUS_STRING_REF PCtrlModNotTcmfTable /end COMPU_METHOD
/begin COMPU_METHOD PCtrlModTcmf "" LINEAR "%.15" "NA" COEFFS_LINEAR 1 0 STATUS_STRING_REF PCtrlModTcmfTable /end COMPU_METHOD
/begin COMPU_METHOD PCtrlModTcmfCmp "" LINEAR "%.15" "NA" COEFFS_LINEAR 1 0 STATUS_STRING_REF PCtrlModTcmfCmpTable /end COMPU_METHOD
/begin COMPU_METHOD PCtrlModTcmfIni "" LINEAR "%.15" "NA" COEFFS_LINEAR 1 0 STATUS_STRING_REF PCtrlModTcmfIniTable /end COMPU_METHOD
/begin COMPU_METHOD PCtrlModTcmfNorm "" LINEAR "%.15" "NA" COEFFS_LINEAR 1 0 STATUS_STRING_REF PCtrlModTcmfNormTable /end COMPU_METHOD
/begin COMPU_METHOD PdlPsd1 "" LINEAR "%.15" "NA" COEFFS_LINEAR 1 0 STATUS_STRING_REF PdlTable /end COMPU_METHOD
/begin COMPU_METHOD Perc10 "" LINEAR "%.15" "Percentage" COEFFS_LINEAR 0.3906 0 /end COMPU_METHOD
/begin COMPU_METHOD Perc2 "" LINEAR "%.15" "Percentage" COEFFS_LINEAR 0.5 0 /end COMPU_METHOD
/begin COMPU_METHOD Perc3 "" LINEAR "%.15" "Percentage" COEFFS_LINEAR 10 0 /end COMPU_METHOD
/begin COMPU_METHOD Perc6 "" LINEAR "%.15" "Percentage" COEFFS_LINEAR 1 0 /end COMPU_METHOD
/begin COMPU_METHOD Perc9 "" LINEAR "%.15" "Percentage" COEFFS_LINEAR 0.1 0 /end COMPU_METHOD
/begin COMPU_METHOD PercGrdt94 "" LINEAR "%.15" "Percentage/50ms" COEFFS_LINEAR 0.1 0 /end COMPU_METHOD
/begin COMPU_METHOD PGrdt11 "" LINEAR "%.15" "barPersec" COEFFS_LINEAR 0.1 0 /end COMPU_METHOD
/begin COMPU_METHOD PGrdt12 "" LINEAR "%.15" "barPersec" COEFFS_LINEAR 1 0 /end COMPU_METHOD
/begin COMPU_METHOD PGrdt13 "" LINEAR "%.15" "bar/30ms" COEFFS_LINEAR 0.1 0 /end COMPU_METHOD
/begin COMPU_METHOD PGrdt14 "" LINEAR "%.15" "bar/50ms" COEFFS_LINEAR 0.1 0 /end COMPU_METHOD
/begin COMPU_METHOD PGrdt15 "" LINEAR "%.15" "bar/10ms" COEFFS_LINEAR 0.1 0 /end COMPU_METHOD
/begin COMPU_METHOD PGrdt16 "" LINEAR "%.15" "bar/20ms" COEFFS_LINEAR 0.1 0 /end COMPU_METHOD
/begin COMPU_METHOD PrkgBrkReq1 "" LINEAR "%.15" "NA" COEFFS_LINEAR 1 0 STATUS_STRING_REF PrkBrkReqTable /end COMPU_METHOD
/begin COMPU_METHOD PrkgBrkSts1 "" LINEAR "%.15" "NA" COEFFS_LINEAR 1 0 STATUS_STRING_REF PrkBrkStsTable /end COMPU_METHOD
/begin COMPU_METHOD R11 "" LINEAR "%.15" "ohm" COEFFS_LINEAR 0.001 0 /end COMPU_METHOD
/begin COMPU_METHOD Ratio1 "" LINEAR "%.15" "NA" COEFFS_LINEAR 0.01 0 /end COMPU_METHOD
/begin COMPU_METHOD ReqSts1 "" LINEAR "%.15" "NA" COEFFS_LINEAR 1 0 STATUS_STRING_REF ReqStsTable /end COMPU_METHOD
/begin COMPU_METHOD RollrBench1 "" LINEAR "%.15" "NA" COEFFS_LINEAR 1 0 STATUS_STRING_REF RollBenchStsTable /end COMPU_METHOD
/begin COMPU_METHOD RvsGear1 "" LINEAR "%.15" "NA" COEFFS_LINEAR 1 0 STATUS_STRING_REF RvsGearTable /end COMPU_METHOD
/begin COMPU_METHOD SetReset1 "" LINEAR "%.15" "NA" COEFFS_LINEAR 1 0 STATUS_STRING_REF SetResetState /end COMPU_METHOD
/begin COMPU_METHOD ShiftSts1 "" LINEAR "%.15" "NA" COEFFS_LINEAR 1 0 STATUS_STRING_REF ShiftStsTable /end COMPU_METHOD
/begin COMPU_METHOD Spd11 "" LINEAR "%.15" "kph" COEFFS_LINEAR 0.015625 0 /end COMPU_METHOD
/begin COMPU_METHOD Spd12 "" LINEAR "%.15" "kph" COEFFS_LINEAR 0.125 0 /end COMPU_METHOD
/begin COMPU_METHOD Spd21 "" LINEAR "%.15" "kph" COEFFS_LINEAR 0.01 0 /end COMPU_METHOD
/begin COMPU_METHOD Spd31 "" LINEAR "%.15" "kph" COEFFS_LINEAR 0.1 0 /end COMPU_METHOD
/begin COMPU_METHOD Spd41 "" LINEAR "%.15" "kph" COEFFS_LINEAR 1 0 /end COMPU_METHOD
/begin COMPU_METHOD spd_1_m_s "" LINEAR "%.15" "m/s" COEFFS_LINEAR 1 0 /end COMPU_METHOD
/begin COMPU_METHOD Strk11 "" LINEAR "%.15" "mm" COEFFS_LINEAR 0.1 0 /end COMPU_METHOD
/begin COMPU_METHOD StrkGrdt11 "" LINEAR "%.15" "mm/50ms" COEFFS_LINEAR 0.1 0 /end COMPU_METHOD
/begin COMPU_METHOD SusptDetnSts1 "" LINEAR "%.15" "NA" COEFFS_LINEAR 1 0 STATUS_STRING_REF SusDetTable /end COMPU_METHOD
/begin COMPU_METHOD T31 "" LINEAR "%.15" "degC" COEFFS_LINEAR 1 0 /end COMPU_METHOD
/begin COMPU_METHOD T32 "" LINEAR "%.15" "degC" COEFFS_LINEAR 0.031225 0 /end COMPU_METHOD
/begin COMPU_METHOD T51 "" LINEAR "%.15" "degC" COEFFS_LINEAR 5 0 /end COMPU_METHOD
/begin COMPU_METHOD TcVlvMod "" LINEAR "%.15" "NA" COEFFS_LINEAR 1 0 STATUS_STRING_REF TcVlvModTable /end COMPU_METHOD
/begin COMPU_METHOD ThermCndctvtyOfAir1 "" LINEAR "%.15" "WPermK" COEFFS_LINEAR 0.0001 0 /end COMPU_METHOD
/begin COMPU_METHOD Ti11 "" LINEAR "%.15" "sec" COEFFS_LINEAR 1 0 /end COMPU_METHOD
/begin COMPU_METHOD Ti21 "" LINEAR "%.15" "sec" COEFFS_LINEAR 0.01 0 /end COMPU_METHOD
/begin COMPU_METHOD Ti31 "" LINEAR "%.15" "sec" COEFFS_LINEAR 0.001 0 /end COMPU_METHOD
/begin COMPU_METHOD Ti41 "" LINEAR "%.15" "sec" COEFFS_LINEAR 0.005 0 /end COMPU_METHOD
/begin COMPU_METHOD Ti51 "" LINEAR "%.15" "sec" COEFFS_LINEAR 0.02 0 /end COMPU_METHOD
/begin COMPU_METHOD Ti61 "" LINEAR "%.15" "sec" COEFFS_LINEAR 0.5 0 /end COMPU_METHOD
/begin COMPU_METHOD Ti71 "" LINEAR "%.15" "sec" COEFFS_LINEAR 0.1 0 /end COMPU_METHOD
/begin COMPU_METHOD Ti81 "" LINEAR "%.15" "sec" COEFFS_LINEAR 0.2 0 /end COMPU_METHOD
/begin COMPU_METHOD ti_0p05_sec "" LINEAR "%.15" "m/s" COEFFS_LINEAR 0.05 0 /end COMPU_METHOD
/begin COMPU_METHOD Tq2 "" LINEAR "%.15" "Nm" COEFFS_LINEAR 1 0 /end COMPU_METHOD
/begin COMPU_METHOD Tq31 "" LINEAR "%.15" "Nm" COEFFS_LINEAR 10 0 /end COMPU_METHOD
/begin COMPU_METHOD Tq51 "" LINEAR "%.15" "Nm" COEFFS_LINEAR 0.1 0 /end COMPU_METHOD
/begin COMPU_METHOD Tq61 "" LINEAR "%.15" "Nm" COEFFS_LINEAR 0.01 0 /end COMPU_METHOD
/begin COMPU_METHOD TqGrdt10 "" LINEAR "%.15" "Nm/10ms" COEFFS_LINEAR 1 0 /end COMPU_METHOD
/begin COMPU_METHOD TqGrdt11 "" LINEAR "%.15" "Nm/100ms" COEFFS_LINEAR 1 0 /end COMPU_METHOD
/begin COMPU_METHOD TqGrdt8 "" LINEAR "%.15" "NmPersec" COEFFS_LINEAR 8 0 /end COMPU_METHOD
/begin COMPU_METHOD TqGrdt_1_Nps "" LINEAR "%.15" "Nm/s" COEFFS_LINEAR 1 0 /end COMPU_METHOD
/begin COMPU_METHOD TqRatio21 "" LINEAR "%.15" "NA" COEFFS_LINEAR 0.01 0 /end COMPU_METHOD
/begin COMPU_METHOD TrqRatioEst1 "" LINEAR "%.15" "NA" COEFFS_LINEAR 0.1 0 /end COMPU_METHOD
/begin COMPU_METHOD TrsmGearReqTyp1 "" LINEAR "%.15" "NA" COEFFS_LINEAR 1 0 STATUS_STRING_REF TrsmGearReqTable /end COMPU_METHOD
/begin COMPU_METHOD TrsmGearTar1 "" LINEAR "%.15" "NA" COEFFS_LINEAR 1 0 STATUS_STRING_REF TrsmGearTarTable /end COMPU_METHOD
/begin COMPU_METHOD TrsmStGearLvr1 "" LINEAR "%.15" "NA" COEFFS_LINEAR 1 0 STATUS_STRING_REF TrsmStGearLvrTable /end COMPU_METHOD
/begin COMPU_METHOD TrsmTyp1 "" LINEAR "%.15" "NA" COEFFS_LINEAR 1 0 STATUS_STRING_REF TrsmTypTable /end COMPU_METHOD
/begin COMPU_METHOD U11 "" LINEAR "%.15" "V" COEFFS_LINEAR 0.001 0 /end COMPU_METHOD
/begin COMPU_METHOD U13 "" LINEAR "%.15" "V" COEFFS_LINEAR 0.1 0 /end COMPU_METHOD
/begin COMPU_METHOD UnderSteerSts1 "" LINEAR "%.15" "NA" COEFFS_LINEAR 1 0 STATUS_STRING_REF UnderStrTable /end COMPU_METHOD
/begin COMPU_METHOD VacPmpRlyTyp1 "" LINEAR "%.15" "NA" COEFFS_LINEAR 1 0 STATUS_STRING_REF VacPmpRlyTypTable /end COMPU_METHOD
/begin COMPU_METHOD VacSnsrTyp1 "" LINEAR "%.15" "NA" COEFFS_LINEAR 1 0 STATUS_STRING_REF VacSnsrTypTable /end COMPU_METHOD
/begin COMPU_METHOD Vol11 "" LINEAR "%.15" "cc" COEFFS_LINEAR 0.001 0 /end COMPU_METHOD
/begin COMPU_METHOD WhlRotlDirStd1 "" LINEAR "%.15" "NA" COEFFS_LINEAR 1 0 STATUS_STRING_REF WhlRotlDirStdTable /end COMPU_METHOD
/begin COMPU_METHOD WhlSpdTyp1 "" LINEAR "%.15" "NA" COEFFS_LINEAR 1 0 STATUS_STRING_REF WhlSpdTypTable /end COMPU_METHOD
/begin RECORD_LAYOUT CalPrmAutoBrkCoorrBrk_SBYTE FNC_VALUES 1 SBYTE COLUMN_DIR DIRECT ALIGNMENT_BYTE 1 ALIGNMENT_WORD 1 ALIGNMENT_LONG 1 ALIGNMENT_FLOAT32_IEEE 1 ALIGNMENT_FLOAT64_IEEE 1 ALIGNMENT_INT64 1 /end RECORD_LAYOUT
/begin RECORD_LAYOUT CalPrmAutoBrkCoorrBrk_SWORD FNC_VALUES 1 SWORD COLUMN_DIR DIRECT ALIGNMENT_BYTE 1 ALIGNMENT_WORD 1 ALIGNMENT_LONG 1 ALIGNMENT_FLOAT32_IEEE 1 ALIGNMENT_FLOAT64_IEEE 1 ALIGNMENT_INT64 1 /end RECORD_LAYOUT
/begin RECORD_LAYOUT CalPrmAutoBrkCoorrBrk_UBYTE FNC_VALUES 1 UBYTE COLUMN_DIR DIRECT ALIGNMENT_BYTE 1 ALIGNMENT_WORD 1 ALIGNMENT_LONG 1 ALIGNMENT_FLOAT32_IEEE 1 ALIGNMENT_FLOAT64_IEEE 1 ALIGNMENT_INT64 1 /end RECORD_LAYOUT
/begin RECORD_LAYOUT CalPrmAutoBrkCoorrBrk_ULONG FNC_VALUES 1 ULONG COLUMN_DIR DIRECT ALIGNMENT_BYTE 1 ALIGNMENT_WORD 1 ALIGNMENT_LONG 1 ALIGNMENT_FLOAT32_IEEE 1 ALIGNMENT_FLOAT64_IEEE 1 ALIGNMENT_INT64 1 /end RECORD_LAYOUT
/begin RECORD_LAYOUT CalPrmAutoBrkCoorrBrk_UWORD FNC_VALUES 1 UWORD COLUMN_DIR DIRECT ALIGNMENT_BYTE 1 ALIGNMENT_WORD 1 ALIGNMENT_LONG 1 ALIGNMENT_FLOAT32_IEEE 1 ALIGNMENT_FLOAT64_IEEE 1 ALIGNMENT_INT64 1 /end RECORD_LAYOUT
/begin RECORD_LAYOUT CalPrmAutoBrkCoorrEng_SBYTE FNC_VALUES 1 SBYTE COLUMN_DIR DIRECT ALIGNMENT_BYTE 1 ALIGNMENT_WORD 1 ALIGNMENT_LONG 1 ALIGNMENT_FLOAT32_IEEE 1 ALIGNMENT_FLOAT64_IEEE 1 ALIGNMENT_INT64 1 /end RECORD_LAYOUT
/begin RECORD_LAYOUT CalPrmAutoBrkCoorrEng_SWORD FNC_VALUES 1 SWORD COLUMN_DIR DIRECT ALIGNMENT_BYTE 1 ALIGNMENT_WORD 1 ALIGNMENT_LONG 1 ALIGNMENT_FLOAT32_IEEE 1 ALIGNMENT_FLOAT64_IEEE 1 ALIGNMENT_INT64 1 /end RECORD_LAYOUT
/begin RECORD_LAYOUT CalPrmAutoBrkCoorrEng_UBYTE FNC_VALUES 1 UBYTE COLUMN_DIR DIRECT ALIGNMENT_BYTE 1 ALIGNMENT_WORD 1 ALIGNMENT_LONG 1 ALIGNMENT_FLOAT32_IEEE 1 ALIGNMENT_FLOAT64_IEEE 1 ALIGNMENT_INT64 1 /end RECORD_LAYOUT
/begin RECORD_LAYOUT CalPrmAutoBrkCoorrEng_ULONG FNC_VALUES 1 ULONG COLUMN_DIR DIRECT ALIGNMENT_BYTE 1 ALIGNMENT_WORD 1 ALIGNMENT_LONG 1 ALIGNMENT_FLOAT32_IEEE 1 ALIGNMENT_FLOAT64_IEEE 1 ALIGNMENT_INT64 1 /end RECORD_LAYOUT
/begin RECORD_LAYOUT CalPrmAutoBrkCoorrEng_UWORD FNC_VALUES 1 UWORD COLUMN_DIR DIRECT ALIGNMENT_BYTE 1 ALIGNMENT_WORD 1 ALIGNMENT_LONG 1 ALIGNMENT_FLOAT32_IEEE 1 ALIGNMENT_FLOAT64_IEEE 1 ALIGNMENT_INT64 1 /end RECORD_LAYOUT
/begin RECORD_LAYOUT CalPrmAwdCtrlrEng_SBYTE FNC_VALUES 1 SBYTE COLUMN_DIR DIRECT ALIGNMENT_BYTE 1 ALIGNMENT_WORD 1 ALIGNMENT_LONG 1 ALIGNMENT_FLOAT32_IEEE 1 ALIGNMENT_FLOAT64_IEEE 1 ALIGNMENT_INT64 1 /end RECORD_LAYOUT
/begin RECORD_LAYOUT CalPrmAwdCtrlrEng_SWORD FNC_VALUES 1 SWORD COLUMN_DIR DIRECT ALIGNMENT_BYTE 1 ALIGNMENT_WORD 1 ALIGNMENT_LONG 1 ALIGNMENT_FLOAT32_IEEE 1 ALIGNMENT_FLOAT64_IEEE 1 ALIGNMENT_INT64 1 /end RECORD_LAYOUT
/begin RECORD_LAYOUT CalPrmAwdCtrlrEng_UBYTE FNC_VALUES 1 UBYTE COLUMN_DIR DIRECT ALIGNMENT_BYTE 1 ALIGNMENT_WORD 1 ALIGNMENT_LONG 1 ALIGNMENT_FLOAT32_IEEE 1 ALIGNMENT_FLOAT64_IEEE 1 ALIGNMENT_INT64 1 /end RECORD_LAYOUT
/begin RECORD_LAYOUT CalPrmAwdCtrlrEng_UWORD FNC_VALUES 1 UWORD COLUMN_DIR DIRECT ALIGNMENT_BYTE 1 ALIGNMENT_WORD 1 ALIGNMENT_LONG 1 ALIGNMENT_FLOAT32_IEEE 1 ALIGNMENT_FLOAT64_IEEE 1 ALIGNMENT_INT64 1 /end RECORD_LAYOUT
/begin RECORD_LAYOUT CalPrmBrkAssisCoorrBrk_SBYTE FNC_VALUES 1 SBYTE COLUMN_DIR DIRECT ALIGNMENT_BYTE 1 ALIGNMENT_WORD 1 ALIGNMENT_LONG 1 ALIGNMENT_FLOAT32_IEEE 1 ALIGNMENT_FLOAT64_IEEE 1 ALIGNMENT_INT64 1 /end RECORD_LAYOUT
/begin RECORD_LAYOUT CalPrmBrkAssisCoorrBrk_SWORD FNC_VALUES 1 SWORD COLUMN_DIR DIRECT ALIGNMENT_BYTE 1 ALIGNMENT_WORD 1 ALIGNMENT_LONG 1 ALIGNMENT_FLOAT32_IEEE 1 ALIGNMENT_FLOAT64_IEEE 1 ALIGNMENT_INT64 1 /end RECORD_LAYOUT
/begin RECORD_LAYOUT CalPrmBrkAssisCoorrBrk_UBYTE FNC_VALUES 1 UBYTE COLUMN_DIR DIRECT ALIGNMENT_BYTE 1 ALIGNMENT_WORD 1 ALIGNMENT_LONG 1 ALIGNMENT_FLOAT32_IEEE 1 ALIGNMENT_FLOAT64_IEEE 1 ALIGNMENT_INT64 1 /end RECORD_LAYOUT
/begin RECORD_LAYOUT CalPrmBrkAssisCoorrBrk_UWORD FNC_VALUES 1 UWORD COLUMN_DIR DIRECT ALIGNMENT_BYTE 1 ALIGNMENT_WORD 1 ALIGNMENT_LONG 1 ALIGNMENT_FLOAT32_IEEE 1 ALIGNMENT_FLOAT64_IEEE 1 ALIGNMENT_INT64 1 /end RECORD_LAYOUT
/begin RECORD_LAYOUT CalPrmBrkAssisCoorrEng_SBYTE FNC_VALUES 1 SBYTE COLUMN_DIR DIRECT ALIGNMENT_BYTE 1 ALIGNMENT_WORD 1 ALIGNMENT_LONG 1 ALIGNMENT_FLOAT32_IEEE 1 ALIGNMENT_FLOAT64_IEEE 1 ALIGNMENT_INT64 1 /end RECORD_LAYOUT
/begin RECORD_LAYOUT CalPrmBrkAssisCoorrEng_SWORD FNC_VALUES 1 SWORD COLUMN_DIR DIRECT ALIGNMENT_BYTE 1 ALIGNMENT_WORD 1 ALIGNMENT_LONG 1 ALIGNMENT_FLOAT32_IEEE 1 ALIGNMENT_FLOAT64_IEEE 1 ALIGNMENT_INT64 1 /end RECORD_LAYOUT
/begin RECORD_LAYOUT CalPrmBrkAssisCoorrEng_UBYTE FNC_VALUES 1 UBYTE COLUMN_DIR DIRECT ALIGNMENT_BYTE 1 ALIGNMENT_WORD 1 ALIGNMENT_LONG 1 ALIGNMENT_FLOAT32_IEEE 1 ALIGNMENT_FLOAT64_IEEE 1 ALIGNMENT_INT64 1 /end RECORD_LAYOUT
/begin RECORD_LAYOUT CalPrmBrkAssisCoorrEng_UWORD FNC_VALUES 1 UWORD COLUMN_DIR DIRECT ALIGNMENT_BYTE 1 ALIGNMENT_WORD 1 ALIGNMENT_LONG 1 ALIGNMENT_FLOAT32_IEEE 1 ALIGNMENT_FLOAT64_IEEE 1 ALIGNMENT_INT64 1 /end RECORD_LAYOUT
/begin RECORD_LAYOUT CalPrmBrkTqCtrlrBrk_SBYTE FNC_VALUES 1 SBYTE COLUMN_DIR DIRECT ALIGNMENT_BYTE 1 ALIGNMENT_WORD 1 ALIGNMENT_LONG 1 ALIGNMENT_FLOAT32_IEEE 1 ALIGNMENT_FLOAT64_IEEE 1 ALIGNMENT_INT64 1 /end RECORD_LAYOUT
/begin RECORD_LAYOUT CalPrmBrkTqCtrlrBrk_SWORD FNC_VALUES 1 SWORD COLUMN_DIR DIRECT ALIGNMENT_BYTE 1 ALIGNMENT_WORD 1 ALIGNMENT_LONG 1 ALIGNMENT_FLOAT32_IEEE 1 ALIGNMENT_FLOAT64_IEEE 1 ALIGNMENT_INT64 1 /end RECORD_LAYOUT
/begin RECORD_LAYOUT CalPrmBrkTqCtrlrBrk_UBYTE FNC_VALUES 1 UBYTE COLUMN_DIR DIRECT ALIGNMENT_BYTE 1 ALIGNMENT_WORD 1 ALIGNMENT_LONG 1 ALIGNMENT_FLOAT32_IEEE 1 ALIGNMENT_FLOAT64_IEEE 1 ALIGNMENT_INT64 1 /end RECORD_LAYOUT
/begin RECORD_LAYOUT CalPrmBrkTqCtrlrBrk_ULONG FNC_VALUES 1 ULONG COLUMN_DIR DIRECT ALIGNMENT_BYTE 1 ALIGNMENT_WORD 1 ALIGNMENT_LONG 1 ALIGNMENT_FLOAT32_IEEE 1 ALIGNMENT_FLOAT64_IEEE 1 ALIGNMENT_INT64 1 /end RECORD_LAYOUT
/begin RECORD_LAYOUT CalPrmBrkTqCtrlrBrk_UWORD FNC_VALUES 1 UWORD COLUMN_DIR DIRECT ALIGNMENT_BYTE 1 ALIGNMENT_WORD 1 ALIGNMENT_LONG 1 ALIGNMENT_FLOAT32_IEEE 1 ALIGNMENT_FLOAT64_IEEE 1 ALIGNMENT_INT64 1 /end RECORD_LAYOUT
/begin RECORD_LAYOUT CalPrmCmnBrk_SBYTE FNC_VALUES 1 SBYTE COLUMN_DIR DIRECT ALIGNMENT_BYTE 1 ALIGNMENT_WORD 1 ALIGNMENT_LONG 1 ALIGNMENT_FLOAT32_IEEE 1 ALIGNMENT_FLOAT64_IEEE 1 ALIGNMENT_INT64 1 /end RECORD_LAYOUT
/begin RECORD_LAYOUT CalPrmCmnBrk_SWORD FNC_VALUES 1 SWORD COLUMN_DIR DIRECT ALIGNMENT_BYTE 1 ALIGNMENT_WORD 1 ALIGNMENT_LONG 1 ALIGNMENT_FLOAT32_IEEE 1 ALIGNMENT_FLOAT64_IEEE 1 ALIGNMENT_INT64 1 /end RECORD_LAYOUT
/begin RECORD_LAYOUT CalPrmCmnBrk_UBYTE FNC_VALUES 1 UBYTE COLUMN_DIR DIRECT ALIGNMENT_BYTE 1 ALIGNMENT_WORD 1 ALIGNMENT_LONG 1 ALIGNMENT_FLOAT32_IEEE 1 ALIGNMENT_FLOAT64_IEEE 1 ALIGNMENT_INT64 1 /end RECORD_LAYOUT
/begin RECORD_LAYOUT CalPrmCmnBrk_UWORD FNC_VALUES 1 UWORD COLUMN_DIR DIRECT ALIGNMENT_BYTE 1 ALIGNMENT_WORD 1 ALIGNMENT_LONG 1 ALIGNMENT_FLOAT32_IEEE 1 ALIGNMENT_FLOAT64_IEEE 1 ALIGNMENT_INT64 1 /end RECORD_LAYOUT
/begin RECORD_LAYOUT CalPrmCmnEng_SBYTE FNC_VALUES 1 SBYTE COLUMN_DIR DIRECT ALIGNMENT_BYTE 1 ALIGNMENT_WORD 1 ALIGNMENT_LONG 1 ALIGNMENT_FLOAT32_IEEE 1 ALIGNMENT_FLOAT64_IEEE 1 ALIGNMENT_INT64 1 /end RECORD_LAYOUT
/begin RECORD_LAYOUT CalPrmCmnEng_SWORD FNC_VALUES 1 SWORD COLUMN_DIR DIRECT ALIGNMENT_BYTE 1 ALIGNMENT_WORD 1 ALIGNMENT_LONG 1 ALIGNMENT_FLOAT32_IEEE 1 ALIGNMENT_FLOAT64_IEEE 1 ALIGNMENT_INT64 1 /end RECORD_LAYOUT
/begin RECORD_LAYOUT CalPrmCmnEng_UBYTE FNC_VALUES 1 UBYTE COLUMN_DIR DIRECT ALIGNMENT_BYTE 1 ALIGNMENT_WORD 1 ALIGNMENT_LONG 1 ALIGNMENT_FLOAT32_IEEE 1 ALIGNMENT_FLOAT64_IEEE 1 ALIGNMENT_INT64 1 /end RECORD_LAYOUT
/begin RECORD_LAYOUT CalPrmCmnEng_UWORD FNC_VALUES 1 UWORD COLUMN_DIR DIRECT ALIGNMENT_BYTE 1 ALIGNMENT_WORD 1 ALIGNMENT_LONG 1 ALIGNMENT_FLOAT32_IEEE 1 ALIGNMENT_FLOAT64_IEEE 1 ALIGNMENT_INT64 1 /end RECORD_LAYOUT
/begin RECORD_LAYOUT CalPrmDiag_SBYTE FNC_VALUES 1 SBYTE COLUMN_DIR DIRECT ALIGNMENT_BYTE 1 ALIGNMENT_WORD 1 ALIGNMENT_LONG 1 ALIGNMENT_FLOAT32_IEEE 1 ALIGNMENT_FLOAT64_IEEE 1 ALIGNMENT_INT64 1 /end RECORD_LAYOUT
/begin RECORD_LAYOUT CalPrmDiag_SWORD FNC_VALUES 1 SWORD COLUMN_DIR DIRECT ALIGNMENT_BYTE 1 ALIGNMENT_WORD 1 ALIGNMENT_LONG 1 ALIGNMENT_FLOAT32_IEEE 1 ALIGNMENT_FLOAT64_IEEE 1 ALIGNMENT_INT64 1 /end RECORD_LAYOUT
/begin RECORD_LAYOUT CalPrmDiag_UBYTE FNC_VALUES 1 UBYTE COLUMN_DIR DIRECT ALIGNMENT_BYTE 1 ALIGNMENT_WORD 1 ALIGNMENT_LONG 1 ALIGNMENT_FLOAT32_IEEE 1 ALIGNMENT_FLOAT64_IEEE 1 ALIGNMENT_INT64 1 /end RECORD_LAYOUT
/begin RECORD_LAYOUT CalPrmDiag_ULONG FNC_VALUES 1 ULONG COLUMN_DIR DIRECT ALIGNMENT_BYTE 1 ALIGNMENT_WORD 1 ALIGNMENT_LONG 1 ALIGNMENT_FLOAT32_IEEE 1 ALIGNMENT_FLOAT64_IEEE 1 ALIGNMENT_INT64 1 /end RECORD_LAYOUT
/begin RECORD_LAYOUT CalPrmDiag_UWORD FNC_VALUES 1 UWORD COLUMN_DIR DIRECT ALIGNMENT_BYTE 1 ALIGNMENT_WORD 1 ALIGNMENT_LONG 1 ALIGNMENT_FLOAT32_IEEE 1 ALIGNMENT_FLOAT64_IEEE 1 ALIGNMENT_INT64 1 /end RECORD_LAYOUT
/begin RECORD_LAYOUT CalPrmElecVacPmpBrk_SBYTE FNC_VALUES 1 SBYTE COLUMN_DIR DIRECT ALIGNMENT_BYTE 1 ALIGNMENT_WORD 1 ALIGNMENT_LONG 1 ALIGNMENT_FLOAT32_IEEE 1 ALIGNMENT_FLOAT64_IEEE 1 ALIGNMENT_INT64 1 /end RECORD_LAYOUT
/begin RECORD_LAYOUT CalPrmElecVacPmpBrk_SWORD FNC_VALUES 1 SWORD COLUMN_DIR DIRECT ALIGNMENT_BYTE 1 ALIGNMENT_WORD 1 ALIGNMENT_LONG 1 ALIGNMENT_FLOAT32_IEEE 1 ALIGNMENT_FLOAT64_IEEE 1 ALIGNMENT_INT64 1 /end RECORD_LAYOUT
/begin RECORD_LAYOUT CalPrmElecVacPmpBrk_UBYTE FNC_VALUES 1 UBYTE COLUMN_DIR DIRECT ALIGNMENT_BYTE 1 ALIGNMENT_WORD 1 ALIGNMENT_LONG 1 ALIGNMENT_FLOAT32_IEEE 1 ALIGNMENT_FLOAT64_IEEE 1 ALIGNMENT_INT64 1 /end RECORD_LAYOUT
/begin RECORD_LAYOUT CalPrmElecVacPmpBrk_UWORD FNC_VALUES 1 UWORD COLUMN_DIR DIRECT ALIGNMENT_BYTE 1 ALIGNMENT_WORD 1 ALIGNMENT_LONG 1 ALIGNMENT_FLOAT32_IEEE 1 ALIGNMENT_FLOAT64_IEEE 1 ALIGNMENT_INT64 1 /end RECORD_LAYOUT
/begin RECORD_LAYOUT CalPrmEstmrBrk_SBYTE FNC_VALUES 1 SBYTE COLUMN_DIR DIRECT ALIGNMENT_BYTE 1 ALIGNMENT_WORD 1 ALIGNMENT_LONG 1 ALIGNMENT_FLOAT32_IEEE 1 ALIGNMENT_FLOAT64_IEEE 1 ALIGNMENT_INT64 1 /end RECORD_LAYOUT
/begin RECORD_LAYOUT CalPrmEstmrBrk_SWORD FNC_VALUES 1 SWORD COLUMN_DIR DIRECT ALIGNMENT_BYTE 1 ALIGNMENT_WORD 1 ALIGNMENT_LONG 1 ALIGNMENT_FLOAT32_IEEE 1 ALIGNMENT_FLOAT64_IEEE 1 ALIGNMENT_INT64 1 /end RECORD_LAYOUT
/begin RECORD_LAYOUT CalPrmEstmrBrk_UBYTE FNC_VALUES 1 UBYTE COLUMN_DIR DIRECT ALIGNMENT_BYTE 1 ALIGNMENT_WORD 1 ALIGNMENT_LONG 1 ALIGNMENT_FLOAT32_IEEE 1 ALIGNMENT_FLOAT64_IEEE 1 ALIGNMENT_INT64 1 /end RECORD_LAYOUT
/begin RECORD_LAYOUT CalPrmEstmrBrk_UWORD FNC_VALUES 1 UWORD COLUMN_DIR DIRECT ALIGNMENT_BYTE 1 ALIGNMENT_WORD 1 ALIGNMENT_LONG 1 ALIGNMENT_FLOAT32_IEEE 1 ALIGNMENT_FLOAT64_IEEE 1 ALIGNMENT_INT64 1 /end RECORD_LAYOUT
/begin RECORD_LAYOUT CalPrmFct_SBYTE FNC_VALUES 1 SBYTE COLUMN_DIR DIRECT ALIGNMENT_BYTE 1 ALIGNMENT_WORD 1 ALIGNMENT_LONG 1 ALIGNMENT_FLOAT32_IEEE 1 ALIGNMENT_FLOAT64_IEEE 1 ALIGNMENT_INT64 1 /end RECORD_LAYOUT
/begin RECORD_LAYOUT CalPrmFct_SWORD FNC_VALUES 1 SWORD COLUMN_DIR DIRECT ALIGNMENT_BYTE 1 ALIGNMENT_WORD 1 ALIGNMENT_LONG 1 ALIGNMENT_FLOAT32_IEEE 1 ALIGNMENT_FLOAT64_IEEE 1 ALIGNMENT_INT64 1 /end RECORD_LAYOUT
/begin RECORD_LAYOUT CalPrmFct_UBYTE FNC_VALUES 1 UBYTE COLUMN_DIR DIRECT ALIGNMENT_BYTE 1 ALIGNMENT_WORD 1 ALIGNMENT_LONG 1 ALIGNMENT_FLOAT32_IEEE 1 ALIGNMENT_FLOAT64_IEEE 1 ALIGNMENT_INT64 1 /end RECORD_LAYOUT
/begin RECORD_LAYOUT CalPrmFct_ULONG FNC_VALUES 1 ULONG COLUMN_DIR DIRECT ALIGNMENT_BYTE 1 ALIGNMENT_WORD 1 ALIGNMENT_LONG 1 ALIGNMENT_FLOAT32_IEEE 1 ALIGNMENT_FLOAT64_IEEE 1 ALIGNMENT_INT64 1 /end RECORD_LAYOUT
/begin RECORD_LAYOUT CalPrmFct_UWORD FNC_VALUES 1 UWORD COLUMN_DIR DIRECT ALIGNMENT_BYTE 1 ALIGNMENT_WORD 1 ALIGNMENT_LONG 1 ALIGNMENT_FLOAT32_IEEE 1 ALIGNMENT_FLOAT64_IEEE 1 ALIGNMENT_INT64 1 /end RECORD_LAYOUT
/begin RECORD_LAYOUT CalPrmLatDynsCoorrBrk_SBYTE FNC_VALUES 1 SBYTE COLUMN_DIR DIRECT ALIGNMENT_BYTE 1 ALIGNMENT_WORD 1 ALIGNMENT_LONG 1 ALIGNMENT_FLOAT32_IEEE 1 ALIGNMENT_FLOAT64_IEEE 1 ALIGNMENT_INT64 1 /end RECORD_LAYOUT
/begin RECORD_LAYOUT CalPrmLatDynsCoorrBrk_SWORD FNC_VALUES 1 SWORD COLUMN_DIR DIRECT ALIGNMENT_BYTE 1 ALIGNMENT_WORD 1 ALIGNMENT_LONG 1 ALIGNMENT_FLOAT32_IEEE 1 ALIGNMENT_FLOAT64_IEEE 1 ALIGNMENT_INT64 1 /end RECORD_LAYOUT
/begin RECORD_LAYOUT CalPrmLatDynsCoorrBrk_UBYTE FNC_VALUES 1 UBYTE COLUMN_DIR DIRECT ALIGNMENT_BYTE 1 ALIGNMENT_WORD 1 ALIGNMENT_LONG 1 ALIGNMENT_FLOAT32_IEEE 1 ALIGNMENT_FLOAT64_IEEE 1 ALIGNMENT_INT64 1 /end RECORD_LAYOUT
/begin RECORD_LAYOUT CalPrmLatDynsCoorrBrk_UWORD FNC_VALUES 1 UWORD COLUMN_DIR DIRECT ALIGNMENT_BYTE 1 ALIGNMENT_WORD 1 ALIGNMENT_LONG 1 ALIGNMENT_FLOAT32_IEEE 1 ALIGNMENT_FLOAT64_IEEE 1 ALIGNMENT_INT64 1 /end RECORD_LAYOUT
/begin RECORD_LAYOUT CalPrmLowPCoorrBrk_SBYTE FNC_VALUES 1 SBYTE COLUMN_DIR DIRECT ALIGNMENT_BYTE 1 ALIGNMENT_WORD 1 ALIGNMENT_LONG 1 ALIGNMENT_FLOAT32_IEEE 1 ALIGNMENT_FLOAT64_IEEE 1 ALIGNMENT_INT64 1 /end RECORD_LAYOUT
/begin RECORD_LAYOUT CalPrmLowPCoorrBrk_SWORD FNC_VALUES 1 SWORD COLUMN_DIR DIRECT ALIGNMENT_BYTE 1 ALIGNMENT_WORD 1 ALIGNMENT_LONG 1 ALIGNMENT_FLOAT32_IEEE 1 ALIGNMENT_FLOAT64_IEEE 1 ALIGNMENT_INT64 1 /end RECORD_LAYOUT
/begin RECORD_LAYOUT CalPrmLowPCoorrBrk_UBYTE FNC_VALUES 1 UBYTE COLUMN_DIR DIRECT ALIGNMENT_BYTE 1 ALIGNMENT_WORD 1 ALIGNMENT_LONG 1 ALIGNMENT_FLOAT32_IEEE 1 ALIGNMENT_FLOAT64_IEEE 1 ALIGNMENT_INT64 1 /end RECORD_LAYOUT
/begin RECORD_LAYOUT CalPrmLowPCoorrBrk_UWORD FNC_VALUES 1 UWORD COLUMN_DIR DIRECT ALIGNMENT_BYTE 1 ALIGNMENT_WORD 1 ALIGNMENT_LONG 1 ALIGNMENT_FLOAT32_IEEE 1 ALIGNMENT_FLOAT64_IEEE 1 ALIGNMENT_INT64 1 /end RECORD_LAYOUT
/begin RECORD_LAYOUT CalPrmRgnBrkCtrlrBrk_SWORD FNC_VALUES 1 SWORD COLUMN_DIR DIRECT ALIGNMENT_BYTE 1 ALIGNMENT_WORD 1 ALIGNMENT_LONG 1 ALIGNMENT_FLOAT32_IEEE 1 ALIGNMENT_FLOAT64_IEEE 1 ALIGNMENT_INT64 1 /end RECORD_LAYOUT
/begin RECORD_LAYOUT CalPrmRgnBrkCtrlrBrk_SWORD FNC_VALUES 1 SWORD COLUMN_DIR DIRECT ALIGNMENT_BYTE 1 ALIGNMENT_WORD 1 ALIGNMENT_LONG 1 ALIGNMENT_FLOAT32_IEEE 1 ALIGNMENT_FLOAT64_IEEE 1 ALIGNMENT_INT64 1 /end RECORD_LAYOUT
/begin RECORD_LAYOUT CalPrmRgnBrkCtrlrBrk_UBYTE FNC_VALUES 1 UBYTE COLUMN_DIR DIRECT ALIGNMENT_BYTE 1 ALIGNMENT_WORD 1 ALIGNMENT_LONG 1 ALIGNMENT_FLOAT32_IEEE 1 ALIGNMENT_FLOAT64_IEEE 1 ALIGNMENT_INT64 1 /end RECORD_LAYOUT
/begin RECORD_LAYOUT CalPrmRgnBrkCtrlrBrk_UBYTE FNC_VALUES 1 UBYTE COLUMN_DIR DIRECT ALIGNMENT_BYTE 1 ALIGNMENT_WORD 1 ALIGNMENT_LONG 1 ALIGNMENT_FLOAT32_IEEE 1 ALIGNMENT_FLOAT64_IEEE 1 ALIGNMENT_INT64 1 /end RECORD_LAYOUT
/begin RECORD_LAYOUT CalPrmSigProcrBrk_SBYTE FNC_VALUES 1 SBYTE COLUMN_DIR DIRECT ALIGNMENT_BYTE 1 ALIGNMENT_WORD 1 ALIGNMENT_LONG 1 ALIGNMENT_FLOAT32_IEEE 1 ALIGNMENT_FLOAT64_IEEE 1 ALIGNMENT_INT64 1 /end RECORD_LAYOUT
/begin RECORD_LAYOUT CalPrmSigProcrBrk_SWORD FNC_VALUES 1 SWORD COLUMN_DIR DIRECT ALIGNMENT_BYTE 1 ALIGNMENT_WORD 1 ALIGNMENT_LONG 1 ALIGNMENT_FLOAT32_IEEE 1 ALIGNMENT_FLOAT64_IEEE 1 ALIGNMENT_INT64 1 /end RECORD_LAYOUT
/begin RECORD_LAYOUT CalPrmSigProcrBrk_UBYTE FNC_VALUES 1 UBYTE COLUMN_DIR DIRECT ALIGNMENT_BYTE 1 ALIGNMENT_WORD 1 ALIGNMENT_LONG 1 ALIGNMENT_FLOAT32_IEEE 1 ALIGNMENT_FLOAT64_IEEE 1 ALIGNMENT_INT64 1 /end RECORD_LAYOUT
/begin RECORD_LAYOUT CalPrmSigProcrBrk_UWORD FNC_VALUES 1 UWORD COLUMN_DIR DIRECT ALIGNMENT_BYTE 1 ALIGNMENT_WORD 1 ALIGNMENT_LONG 1 ALIGNMENT_FLOAT32_IEEE 1 ALIGNMENT_FLOAT64_IEEE 1 ALIGNMENT_INT64 1 /end RECORD_LAYOUT
/begin RECORD_LAYOUT CalPrmSigProcrEng_SBYTE FNC_VALUES 1 SBYTE COLUMN_DIR DIRECT ALIGNMENT_BYTE 1 ALIGNMENT_WORD 1 ALIGNMENT_LONG 1 ALIGNMENT_FLOAT32_IEEE 1 ALIGNMENT_FLOAT64_IEEE 1 ALIGNMENT_INT64 1 /end RECORD_LAYOUT
/begin RECORD_LAYOUT CalPrmSigProcrEng_SWORD FNC_VALUES 1 SWORD COLUMN_DIR DIRECT ALIGNMENT_BYTE 1 ALIGNMENT_WORD 1 ALIGNMENT_LONG 1 ALIGNMENT_FLOAT32_IEEE 1 ALIGNMENT_FLOAT64_IEEE 1 ALIGNMENT_INT64 1 /end RECORD_LAYOUT
/begin RECORD_LAYOUT CalPrmSigProcrEng_UBYTE FNC_VALUES 1 UBYTE COLUMN_DIR DIRECT ALIGNMENT_BYTE 1 ALIGNMENT_WORD 1 ALIGNMENT_LONG 1 ALIGNMENT_FLOAT32_IEEE 1 ALIGNMENT_FLOAT64_IEEE 1 ALIGNMENT_INT64 1 /end RECORD_LAYOUT
/begin RECORD_LAYOUT CalPrmSigProcrEng_UWORD FNC_VALUES 1 UWORD COLUMN_DIR DIRECT ALIGNMENT_BYTE 1 ALIGNMENT_WORD 1 ALIGNMENT_LONG 1 ALIGNMENT_FLOAT32_IEEE 1 ALIGNMENT_FLOAT64_IEEE 1 ALIGNMENT_INT64 1 /end RECORD_LAYOUT
/begin RECORD_LAYOUT CalPrmSsmBrk_SBYTE FNC_VALUES 1 SBYTE COLUMN_DIR DIRECT ALIGNMENT_BYTE 1 ALIGNMENT_WORD 1 ALIGNMENT_LONG 1 ALIGNMENT_FLOAT32_IEEE 1 ALIGNMENT_FLOAT64_IEEE 1 ALIGNMENT_INT64 1 /end RECORD_LAYOUT
/begin RECORD_LAYOUT CalPrmSsmBrk_SWORD FNC_VALUES 1 SWORD COLUMN_DIR DIRECT ALIGNMENT_BYTE 1 ALIGNMENT_WORD 1 ALIGNMENT_LONG 1 ALIGNMENT_FLOAT32_IEEE 1 ALIGNMENT_FLOAT64_IEEE 1 ALIGNMENT_INT64 1 /end RECORD_LAYOUT
/begin RECORD_LAYOUT CalPrmSsmBrk_UBYTE FNC_VALUES 1 UBYTE COLUMN_DIR DIRECT ALIGNMENT_BYTE 1 ALIGNMENT_WORD 1 ALIGNMENT_LONG 1 ALIGNMENT_FLOAT32_IEEE 1 ALIGNMENT_FLOAT64_IEEE 1 ALIGNMENT_INT64 1 /end RECORD_LAYOUT
/begin RECORD_LAYOUT CalPrmSsmBrk_UWORD FNC_VALUES 1 UWORD COLUMN_DIR DIRECT ALIGNMENT_BYTE 1 ALIGNMENT_WORD 1 ALIGNMENT_LONG 1 ALIGNMENT_FLOAT32_IEEE 1 ALIGNMENT_FLOAT64_IEEE 1 ALIGNMENT_INT64 1 /end RECORD_LAYOUT
/begin RECORD_LAYOUT CalPrmSsmEng_SBYTE FNC_VALUES 1 SBYTE COLUMN_DIR DIRECT ALIGNMENT_BYTE 1 ALIGNMENT_WORD 1 ALIGNMENT_LONG 1 ALIGNMENT_FLOAT32_IEEE 1 ALIGNMENT_FLOAT64_IEEE 1 ALIGNMENT_INT64 1 /end RECORD_LAYOUT
/begin RECORD_LAYOUT CalPrmSsmEng_SWORD FNC_VALUES 1 SWORD COLUMN_DIR DIRECT ALIGNMENT_BYTE 1 ALIGNMENT_WORD 1 ALIGNMENT_LONG 1 ALIGNMENT_FLOAT32_IEEE 1 ALIGNMENT_FLOAT64_IEEE 1 ALIGNMENT_INT64 1 /end RECORD_LAYOUT
/begin RECORD_LAYOUT CalPrmSsmEng_UBYTE FNC_VALUES 1 UBYTE COLUMN_DIR DIRECT ALIGNMENT_BYTE 1 ALIGNMENT_WORD 1 ALIGNMENT_LONG 1 ALIGNMENT_FLOAT32_IEEE 1 ALIGNMENT_FLOAT64_IEEE 1 ALIGNMENT_INT64 1 /end RECORD_LAYOUT
/begin RECORD_LAYOUT CalPrmSsmEng_UWORD FNC_VALUES 1 UWORD COLUMN_DIR DIRECT ALIGNMENT_BYTE 1 ALIGNMENT_WORD 1 ALIGNMENT_LONG 1 ALIGNMENT_FLOAT32_IEEE 1 ALIGNMENT_FLOAT64_IEEE 1 ALIGNMENT_INT64 1 /end RECORD_LAYOUT
/begin RECORD_LAYOUT CalPrmStrStabyCtrlBrk_SBYTE FNC_VALUES 1 SBYTE COLUMN_DIR DIRECT ALIGNMENT_BYTE 1 ALIGNMENT_WORD 1 ALIGNMENT_LONG 1 ALIGNMENT_FLOAT32_IEEE 1 ALIGNMENT_FLOAT64_IEEE 1 ALIGNMENT_INT64 1 /end RECORD_LAYOUT
/begin RECORD_LAYOUT CalPrmStrStabyCtrlBrk_SWORD FNC_VALUES 1 SWORD COLUMN_DIR DIRECT ALIGNMENT_BYTE 1 ALIGNMENT_WORD 1 ALIGNMENT_LONG 1 ALIGNMENT_FLOAT32_IEEE 1 ALIGNMENT_FLOAT64_IEEE 1 ALIGNMENT_INT64 1 /end RECORD_LAYOUT
/begin RECORD_LAYOUT CalPrmStrStabyCtrlBrk_UBYTE FNC_VALUES 1 UBYTE COLUMN_DIR DIRECT ALIGNMENT_BYTE 1 ALIGNMENT_WORD 1 ALIGNMENT_LONG 1 ALIGNMENT_FLOAT32_IEEE 1 ALIGNMENT_FLOAT64_IEEE 1 ALIGNMENT_INT64 1 /end RECORD_LAYOUT
/begin RECORD_LAYOUT CalPrmStrStabyCtrlBrk_UWORD FNC_VALUES 1 UWORD COLUMN_DIR DIRECT ALIGNMENT_BYTE 1 ALIGNMENT_WORD 1 ALIGNMENT_LONG 1 ALIGNMENT_FLOAT32_IEEE 1 ALIGNMENT_FLOAT64_IEEE 1 ALIGNMENT_INT64 1 /end RECORD_LAYOUT
/begin RECORD_LAYOUT CalPrmVehLgtCoorrBrk_SBYTE FNC_VALUES 1 SBYTE COLUMN_DIR DIRECT ALIGNMENT_BYTE 1 ALIGNMENT_WORD 1 ALIGNMENT_LONG 1 ALIGNMENT_FLOAT32_IEEE 1 ALIGNMENT_FLOAT64_IEEE 1 ALIGNMENT_INT64 1 /end RECORD_LAYOUT
/begin RECORD_LAYOUT CalPrmVehLgtCoorrBrk_SWORD FNC_VALUES 1 SWORD COLUMN_DIR DIRECT ALIGNMENT_BYTE 1 ALIGNMENT_WORD 1 ALIGNMENT_LONG 1 ALIGNMENT_FLOAT32_IEEE 1 ALIGNMENT_FLOAT64_IEEE 1 ALIGNMENT_INT64 1 /end RECORD_LAYOUT
/begin RECORD_LAYOUT CalPrmVehLgtCoorrBrk_UBYTE FNC_VALUES 1 UBYTE COLUMN_DIR DIRECT ALIGNMENT_BYTE 1 ALIGNMENT_WORD 1 ALIGNMENT_LONG 1 ALIGNMENT_FLOAT32_IEEE 1 ALIGNMENT_FLOAT64_IEEE 1 ALIGNMENT_INT64 1 /end RECORD_LAYOUT
/begin RECORD_LAYOUT CalPrmVehLgtCoorrBrk_ULONG FNC_VALUES 1 ULONG COLUMN_DIR DIRECT ALIGNMENT_BYTE 1 ALIGNMENT_WORD 1 ALIGNMENT_LONG 1 ALIGNMENT_FLOAT32_IEEE 1 ALIGNMENT_FLOAT64_IEEE 1 ALIGNMENT_INT64 1 /end RECORD_LAYOUT
/begin RECORD_LAYOUT CalPrmVehLgtCoorrBrk_UWORD FNC_VALUES 1 UWORD COLUMN_DIR DIRECT ALIGNMENT_BYTE 1 ALIGNMENT_WORD 1 ALIGNMENT_LONG 1 ALIGNMENT_FLOAT32_IEEE 1 ALIGNMENT_FLOAT64_IEEE 1 ALIGNMENT_INT64 1 /end RECORD_LAYOUT
/begin RECORD_LAYOUT CalPrmVehLgtCoorrEng_SBYTE FNC_VALUES 1 SBYTE COLUMN_DIR DIRECT ALIGNMENT_BYTE 1 ALIGNMENT_WORD 1 ALIGNMENT_LONG 1 ALIGNMENT_FLOAT32_IEEE 1 ALIGNMENT_FLOAT64_IEEE 1 ALIGNMENT_INT64 1 /end RECORD_LAYOUT
/begin RECORD_LAYOUT CalPrmVehLgtCoorrEng_SWORD FNC_VALUES 1 SWORD COLUMN_DIR DIRECT ALIGNMENT_BYTE 1 ALIGNMENT_WORD 1 ALIGNMENT_LONG 1 ALIGNMENT_FLOAT32_IEEE 1 ALIGNMENT_FLOAT64_IEEE 1 ALIGNMENT_INT64 1 /end RECORD_LAYOUT
/begin RECORD_LAYOUT CalPrmVehLgtCoorrEng_UBYTE FNC_VALUES 1 UBYTE COLUMN_DIR DIRECT ALIGNMENT_BYTE 1 ALIGNMENT_WORD 1 ALIGNMENT_LONG 1 ALIGNMENT_FLOAT32_IEEE 1 ALIGNMENT_FLOAT64_IEEE 1 ALIGNMENT_INT64 1 /end RECORD_LAYOUT
/begin RECORD_LAYOUT CalPrmVehLgtCoorrEng_ULONG FNC_VALUES 1 ULONG COLUMN_DIR DIRECT ALIGNMENT_BYTE 1 ALIGNMENT_WORD 1 ALIGNMENT_LONG 1 ALIGNMENT_FLOAT32_IEEE 1 ALIGNMENT_FLOAT64_IEEE 1 ALIGNMENT_INT64 1 /end RECORD_LAYOUT
/begin RECORD_LAYOUT CalPrmVehLgtCoorrEng_UWORD FNC_VALUES 1 UWORD COLUMN_DIR DIRECT ALIGNMENT_BYTE 1 ALIGNMENT_WORD 1 ALIGNMENT_LONG 1 ALIGNMENT_FLOAT32_IEEE 1 ALIGNMENT_FLOAT64_IEEE 1 ALIGNMENT_INT64 1 /end RECORD_LAYOUT
/begin RECORD_LAYOUT CalPrmWslcBrk_SBYTE FNC_VALUES 1 SBYTE COLUMN_DIR DIRECT ALIGNMENT_BYTE 1 ALIGNMENT_WORD 1 ALIGNMENT_LONG 1 ALIGNMENT_FLOAT32_IEEE 1 ALIGNMENT_FLOAT64_IEEE 1 ALIGNMENT_INT64 1 /end RECORD_LAYOUT
/begin RECORD_LAYOUT CalPrmWslcBrk_SWORD FNC_VALUES 1 SWORD COLUMN_DIR DIRECT ALIGNMENT_BYTE 1 ALIGNMENT_WORD 1 ALIGNMENT_LONG 1 ALIGNMENT_FLOAT32_IEEE 1 ALIGNMENT_FLOAT64_IEEE 1 ALIGNMENT_INT64 1 /end RECORD_LAYOUT
/begin RECORD_LAYOUT CalPrmWslcBrk_UBYTE FNC_VALUES 1 UBYTE COLUMN_DIR DIRECT ALIGNMENT_BYTE 1 ALIGNMENT_WORD 1 ALIGNMENT_LONG 1 ALIGNMENT_FLOAT32_IEEE 1 ALIGNMENT_FLOAT64_IEEE 1 ALIGNMENT_INT64 1 /end RECORD_LAYOUT
/begin RECORD_LAYOUT CalPrmWslcBrk_UWORD FNC_VALUES 1 UWORD COLUMN_DIR DIRECT ALIGNMENT_BYTE 1 ALIGNMENT_WORD 1 ALIGNMENT_LONG 1 ALIGNMENT_FLOAT32_IEEE 1 ALIGNMENT_FLOAT64_IEEE 1 ALIGNMENT_INT64 1 /end RECORD_LAYOUT
/begin RECORD_LAYOUT CalPrmWslcEng_SBYTE FNC_VALUES 1 SBYTE COLUMN_DIR DIRECT ALIGNMENT_BYTE 1 ALIGNMENT_WORD 1 ALIGNMENT_LONG 1 ALIGNMENT_FLOAT32_IEEE 1 ALIGNMENT_FLOAT64_IEEE 1 ALIGNMENT_INT64 1 /end RECORD_LAYOUT
/begin RECORD_LAYOUT CalPrmWslcEng_SWORD FNC_VALUES 1 SWORD COLUMN_DIR DIRECT ALIGNMENT_BYTE 1 ALIGNMENT_WORD 1 ALIGNMENT_LONG 1 ALIGNMENT_FLOAT32_IEEE 1 ALIGNMENT_FLOAT64_IEEE 1 ALIGNMENT_INT64 1 /end RECORD_LAYOUT
/begin RECORD_LAYOUT CalPrmWslcEng_UBYTE FNC_VALUES 1 UBYTE COLUMN_DIR DIRECT ALIGNMENT_BYTE 1 ALIGNMENT_WORD 1 ALIGNMENT_LONG 1 ALIGNMENT_FLOAT32_IEEE 1 ALIGNMENT_FLOAT64_IEEE 1 ALIGNMENT_INT64 1 /end RECORD_LAYOUT
/begin RECORD_LAYOUT CalPrmWslcEng_UWORD FNC_VALUES 1 UWORD COLUMN_DIR DIRECT ALIGNMENT_BYTE 1 ALIGNMENT_WORD 1 ALIGNMENT_LONG 1 ALIGNMENT_FLOAT32_IEEE 1 ALIGNMENT_FLOAT64_IEEE 1 ALIGNMENT_INT64 1 /end RECORD_LAYOUT
/begin RECORD_LAYOUT CalPrmWspcEng_SBYTE FNC_VALUES 1 SBYTE COLUMN_DIR DIRECT ALIGNMENT_BYTE 1 ALIGNMENT_WORD 1 ALIGNMENT_LONG 1 ALIGNMENT_FLOAT32_IEEE 1 ALIGNMENT_FLOAT64_IEEE 1 ALIGNMENT_INT64 1 /end RECORD_LAYOUT
/begin RECORD_LAYOUT CalPrmWspcEng_SWORD FNC_VALUES 1 SWORD COLUMN_DIR DIRECT ALIGNMENT_BYTE 1 ALIGNMENT_WORD 1 ALIGNMENT_LONG 1 ALIGNMENT_FLOAT32_IEEE 1 ALIGNMENT_FLOAT64_IEEE 1 ALIGNMENT_INT64 1 /end RECORD_LAYOUT
/begin RECORD_LAYOUT CalPrmWspcEng_UBYTE FNC_VALUES 1 UBYTE COLUMN_DIR DIRECT ALIGNMENT_BYTE 1 ALIGNMENT_WORD 1 ALIGNMENT_LONG 1 ALIGNMENT_FLOAT32_IEEE 1 ALIGNMENT_FLOAT64_IEEE 1 ALIGNMENT_INT64 1 /end RECORD_LAYOUT
/begin RECORD_LAYOUT CalPrmWspcEng_UWORD FNC_VALUES 1 UWORD COLUMN_DIR DIRECT ALIGNMENT_BYTE 1 ALIGNMENT_WORD 1 ALIGNMENT_LONG 1 ALIGNMENT_FLOAT32_IEEE 1 ALIGNMENT_FLOAT64_IEEE 1 ALIGNMENT_INT64 1 /end RECORD_LAYOUT
/begin RECORD_LAYOUT CalVrntCta_UBYTE FNC_VALUES 1 UBYTE COLUMN_DIR DIRECT ALIGNMENT_BYTE 1 ALIGNMENT_WORD 1 ALIGNMENT_LONG 1 ALIGNMENT_FLOAT32_IEEE 1 ALIGNMENT_FLOAT64_IEEE 1 ALIGNMENT_INT64 1 /end RECORD_LAYOUT
/begin RECORD_LAYOUT CalPrmEssBrk_SWORD FNC_VALUES 1 SWORD COLUMN_DIR DIRECT ALIGNMENT_BYTE 1 ALIGNMENT_WORD 1 ALIGNMENT_LONG 1 ALIGNMENT_FLOAT32_IEEE 1 ALIGNMENT_FLOAT64_IEEE 1 ALIGNMENT_INT64 1 /end RECORD_LAYOUT
/begin RECORD_LAYOUT CalPrmEssBrk_SBYTE FNC_VALUES 1 SBYTE COLUMN_DIR DIRECT ALIGNMENT_BYTE 1 ALIGNMENT_WORD 1 ALIGNMENT_LONG 1 ALIGNMENT_FLOAT32_IEEE 1 ALIGNMENT_FLOAT64_IEEE 1 ALIGNMENT_INT64 1 /end RECORD_LAYOUT
/begin RECORD_LAYOUT CalPrmEssBrk_UBYTE FNC_VALUES 1 UBYTE COLUMN_DIR DIRECT ALIGNMENT_BYTE 1 ALIGNMENT_WORD 1 ALIGNMENT_LONG 1 ALIGNMENT_FLOAT32_IEEE 1 ALIGNMENT_FLOAT64_IEEE 1 ALIGNMENT_INT64 1 /end RECORD_LAYOUT
/begin RECORD_LAYOUT CalPrmEssBrk_UWORD FNC_VALUES 1 SWORD COLUMN_DIR DIRECT ALIGNMENT_BYTE 1 ALIGNMENT_WORD 1 ALIGNMENT_LONG 1 ALIGNMENT_FLOAT32_IEEE 1 ALIGNMENT_FLOAT64_IEEE 1 ALIGNMENT_INT64 1 /end RECORD_LAYOUT
/begin RECORD_LAYOUT __UBYTE_Z FNC_VALUES 1 UBYTE ROW_DIR DIRECT /end RECORD_LAYOUT
/begin RECORD_LAYOUT __UWORD_Z FNC_VALUES 1 UWORD ROW_DIR DIRECT /end RECORD_LAYOUT
/begin RECORD_LAYOUT __ULONG_Z FNC_VALUES 1 ULONG ROW_DIR DIRECT /end RECORD_LAYOUT
/begin RECORD_LAYOUT __SBYTE_Z FNC_VALUES 1 SBYTE ROW_DIR DIRECT /end RECORD_LAYOUT
/begin RECORD_LAYOUT __SWORD_Z FNC_VALUES 1 SWORD ROW_DIR DIRECT /end RECORD_LAYOUT
/begin RECORD_LAYOUT __SLONG_Z FNC_VALUES 1 SLONG ROW_DIR DIRECT /end RECORD_LAYOUT
/begin RECORD_LAYOUT __FLOAT32_IEEE_Z FNC_VALUES 1 FLOAT32_IEEE ROW_DIR DIRECT /end RECORD_LAYOUT
/begin RECORD_LAYOUT __FLOAT64_IEEE_Z FNC_VALUES 1 FLOAT64_IEEE ROW_DIR DIRECT /end RECORD_LAYOUT
/begin RECORD_LAYOUT __UBYTE_S FNC_VALUES 1 UBYTE COLUMN_DIR DIRECT /end RECORD_LAYOUT
/begin RECORD_LAYOUT __UWORD_S FNC_VALUES 1 UWORD COLUMN_DIR DIRECT /end RECORD_LAYOUT
/begin RECORD_LAYOUT __ULONG_S FNC_VALUES 1 ULONG COLUMN_DIR DIRECT /end RECORD_LAYOUT
/begin RECORD_LAYOUT __SBYTE_S FNC_VALUES 1 SBYTE COLUMN_DIR DIRECT /end RECORD_LAYOUT
/begin RECORD_LAYOUT __SWORD_S FNC_VALUES 1 SWORD COLUMN_DIR DIRECT /end RECORD_LAYOUT
/begin RECORD_LAYOUT __SLONG_S FNC_VALUES 1 SLONG COLUMN_DIR DIRECT /end RECORD_LAYOUT
/begin RECORD_LAYOUT __FLOAT32_IEEE_S FNC_VALUES 1 FLOAT32_IEEE COLUMN_DIR DIRECT /end RECORD_LAYOUT
/begin RECORD_LAYOUT __FLOAT64_IEEE_S FNC_VALUES 1 FLOAT64_IEEE COLUMN_DIR DIRECT /end RECORD_LAYOUT
/begin RECORD_LAYOUT SSV__UBYTE_S AXIS_PTS_X 1 UBYTE INDEX_INCR DIRECT /end RECORD_LAYOUT
/begin RECORD_LAYOUT SSV__UWORD_S AXIS_PTS_X 1 UWORD INDEX_INCR DIRECT /end RECORD_LAYOUT
/begin RECORD_LAYOUT SSV__ULONG_S AXIS_PTS_X 1 ULONG INDEX_INCR DIRECT /end RECORD_LAYOUT
/begin RECORD_LAYOUT SSV__SBYTE_S AXIS_PTS_X 1 SBYTE INDEX_INCR DIRECT /end RECORD_LAYOUT
/begin RECORD_LAYOUT SSV__SWORD_S AXIS_PTS_X 1 SWORD INDEX_INCR DIRECT /end RECORD_LAYOUT
/begin RECORD_LAYOUT SSV__SLONG_S AXIS_PTS_X 1 SLONG INDEX_INCR DIRECT /end RECORD_LAYOUT
/begin RECORD_LAYOUT SSV__FLOAT32_IEEE_S AXIS_PTS_X 1 FLOAT32_IEEE INDEX_INCR DIRECT /end RECORD_LAYOUT
/begin RECORD_LAYOUT SSV__FLOAT64_IEEE_S AXIS_PTS_X 1 FLOAT64_IEEE INDEX_INCR DIRECT /end RECORD_LAYOUT
/begin RECORD_LAYOUT __A_UINT64_Z FNC_VALUES 1 A_UINT64 ROW_DIR DIRECT /end RECORD_LAYOUT
/begin RECORD_LAYOUT __A_INT64_Z FNC_VALUES 1 A_INT64 ROW_DIR DIRECT /end RECORD_LAYOUT
/begin RECORD_LAYOUT __A_UINT64_S FNC_VALUES 1 A_UINT64 COLUMN_DIR DIRECT /end RECORD_LAYOUT
/begin RECORD_LAYOUT __A_INT64_S FNC_VALUES 1 A_INT64 COLUMN_DIR DIRECT /end RECORD_LAYOUT
/begin RECORD_LAYOUT SSV__A_UINT64_S AXIS_PTS_X 1 A_UINT64 INDEX_INCR DIRECT /end RECORD_LAYOUT
/begin RECORD_LAYOUT SSV__A_INT64_S AXIS_PTS_X 1 A_INT64 INDEX_INCR DIRECT /end RECORD_LAYOUT
/end MODULE
/end PROJECT
