ASAP2_VERSION 1 60
/begin PROJECT Master ""
/begin MODULE CPP ""
/begin MOD_COMMON "" BYTE_ORDER MSB_LAST ALIGNMENT_BYTE 1 ALIGNMENT_WORD 1 ALIGNMENT_LONG 1 ALIGNMENT_FLOAT32_IEEE 1 ALIGNMENT_FLOAT64_IEEE 1 ALIGNMENT_INT64 1 /end MOD_COMMON
/begin VARIANT_CODING
 /begin VAR_CHARACTERISTIC SSM_K_RollBench_Apply_Feature_En EngCalVariantCriterion
  /begin VAR_ADDRESS 0x8003A884 0x8003B684 0x8003C484 0x8003D284 0x8003E084 0x8003EE84 0x8003FC84 0x80040A84 0x80041884 0x80042684 0x80043484 0x80044284 0x80045084 0x80045E84 0x80046C84 0x80047A84 0x80048884 0x80049684 0x8004A484 0x8004B284 0x8004C084 0x8004CE84 0x8004DC84 0x8004EA84 /end VAR_ADDRESS
 /end VAR_CHARACTERISTIC
 /begin VAR_CHARACTERISTIC SSM_S16_ADD_ACT_TIME_NO_ACT_EPB BrkCalVariantCriterion
  /begin VAR_ADDRESS 0x80020FE8 0x800243E8 0x800277E8 0x8002ABE8 0x8002DFE8 0x800313E8 0x800347E8 0x80037BE8 /end VAR_ADDRESS
 /end VAR_CHARACTERISTIC
 /begin VAR_CHARACTERISTIC SSM_S16_AUTO_PAUSE_TIME BrkCalVariantCriterion
  /begin VAR_ADDRESS 0x80020FEA 0x800243EA 0x800277EA 0x8002ABEA 0x8002DFEA 0x800313EA 0x800347EA 0x80037BEA /end VAR_ADDRESS
 /end VAR_CHARACTERISTIC
 /begin VAR_CHARACTERISTIC SSM_S16_AVH_ABNORMAL_HOLD_TIME BrkCalVariantCriterion
  /begin VAR_ADDRESS 0x80021016 0x80024416 0x80027816 0x8002AC16 0x8002E016 0x80031416 0x80034816 0x80037C16 /end VAR_ADDRESS
 /end VAR_CHARACTERISTIC
 /begin VAR_CHARACTERISTIC SSM_S16_AVH_ALARM_TIME_EPB_OK BrkCalVariantCriterion
  /begin VAR_ADDRESS 0x80021010 0x80024410 0x80027810 0x8002AC10 0x8002E010 0x80031410 0x80034810 0x80037C10 /end VAR_ADDRESS
 /end VAR_CHARACTERISTIC
 /begin VAR_CHARACTERISTIC SSM_S16_AVH_ALARM_TIME_INBIT_SW_OFF BrkCalVariantCriterion
  /begin VAR_ADDRESS 0x80021012 0x80024412 0x80027812 0x8002AC12 0x8002E012 0x80031412 0x80034812 0x80037C12 /end VAR_ADDRESS
 /end VAR_CHARACTERISTIC
 /begin VAR_CHARACTERISTIC SSM_S16_AVH_ALARM_TIME_INBIT_SW_ON BrkCalVariantCriterion
  /begin VAR_ADDRESS 0x80021014 0x80024414 0x80027814 0x8002AC14 0x8002E014 0x80031414 0x80034814 0x80037C14 /end VAR_ADDRESS
 /end VAR_CHARACTERISTIC
 /begin VAR_CHARACTERISTIC SSM_S16_AVH_APPLY_TIME_1ST_REF_P BrkCalVariantCriterion
  /begin VAR_ADDRESS 0x80020FFC 0x800243FC 0x800277FC 0x8002ABFC 0x8002DFFC 0x800313FC 0x800347FC 0x80037BFC /end VAR_ADDRESS
 /end VAR_CHARACTERISTIC
 /begin VAR_CHARACTERISTIC SSM_S16_AVH_APPLY_TIME_2ND_REF_P BrkCalVariantCriterion
  /begin VAR_ADDRESS 0x80020FFE 0x800243FE 0x800277FE 0x8002ABFE 0x8002DFFE 0x800313FE 0x800347FE 0x80037BFE /end VAR_ADDRESS
 /end VAR_CHARACTERISTIC
 /begin VAR_CHARACTERISTIC SSM_S16_AVH_APPLY_TIME_3RD_REF_P BrkCalVariantCriterion
  /begin VAR_ADDRESS 0x80021000 0x80024400 0x80027800 0x8002AC00 0x8002E000 0x80031400 0x80034800 0x80037C00 /end VAR_ADDRESS
 /end VAR_CHARACTERISTIC
 /begin VAR_CHARACTERISTIC SSM_S16_AVH_APPLY_TIME_4TH_REF_P BrkCalVariantCriterion
  /begin VAR_ADDRESS 0x80021002 0x80024402 0x80027802 0x8002AC02 0x8002E002 0x80031402 0x80034802 0x80037C02 /end VAR_ADDRESS
 /end VAR_CHARACTERISTIC
 /begin VAR_CHARACTERISTIC SSM_S16_AVH_APPLY_TIME_5TH_REF_P BrkCalVariantCriterion
  /begin VAR_ADDRESS 0x80021004 0x80024404 0x80027804 0x8002AC04 0x8002E004 0x80031404 0x80034804 0x80037C04 /end VAR_ADDRESS
 /end VAR_CHARACTERISTIC
 /begin VAR_CHARACTERISTIC SSM_S16_AVH_DEFAULT_IDLE_TORQ EngCalVariantCriterion
  /begin VAR_ADDRESS 0x8003A7B2 0x8003B5B2 0x8003C3B2 0x8003D1B2 0x8003DFB2 0x8003EDB2 0x8003FBB2 0x800409B2 0x800417B2 0x800425B2 0x800433B2 0x800441B2 0x80044FB2 0x80045DB2 0x80046BB2 0x800479B2 0x800487B2 0x800495B2 0x8004A3B2 0x8004B1B2 0x8004BFB2 0x8004CDB2 0x8004DBB2 0x8004E9B2 /end VAR_ADDRESS
 /end VAR_CHARACTERISTIC
 /begin VAR_CHARACTERISTIC SSM_S16_AVH_FAST_EXIT_MTP_TH BrkCalVariantCriterion
  /begin VAR_ADDRESS 0x80021018 0x80024418 0x80027818 0x8002AC18 0x8002E018 0x80031418 0x80034818 0x80037C18 /end VAR_ADDRESS
 /end VAR_CHARACTERISTIC
 /begin VAR_CHARACTERISTIC SSM_S16_AVH_F_END_E_TQ_LOW_MID_SLOP EngCalVariantCriterion
  /begin VAR_ADDRESS 0x8003A7A4 0x8003B5A4 0x8003C3A4 0x8003D1A4 0x8003DFA4 0x8003EDA4 0x8003FBA4 0x800409A4 0x800417A4 0x800425A4 0x800433A4 0x800441A4 0x80044FA4 0x80045DA4 0x80046BA4 0x800479A4 0x800487A4 0x800495A4 0x8004A3A4 0x8004B1A4 0x8004BFA4 0x8004CDA4 0x8004DBA4 0x8004E9A4 /end VAR_ADDRESS
 /end VAR_CHARACTERISTIC
 /begin VAR_CHARACTERISTIC SSM_S16_AVH_F_END_E_TQ_MAX_SLOP EngCalVariantCriterion
  /begin VAR_ADDRESS 0x8003A7A6 0x8003B5A6 0x8003C3A6 0x8003D1A6 0x8003DFA6 0x8003EDA6 0x8003FBA6 0x800409A6 0x800417A6 0x800425A6 0x800433A6 0x800441A6 0x80044FA6 0x80045DA6 0x80046BA6 0x800479A6 0x800487A6 0x800495A6 0x8004A3A6 0x8004B1A6 0x8004BFA6 0x8004CDA6 0x8004DBA6 0x8004E9A6 /end VAR_ADDRESS
 /end VAR_CHARACTERISTIC
 /begin VAR_CHARACTERISTIC SSM_S16_AVH_F_END_E_TQ_MID_SLOP EngCalVariantCriterion
  /begin VAR_ADDRESS 0x8003A7A8 0x8003B5A8 0x8003C3A8 0x8003D1A8 0x8003DFA8 0x8003EDA8 0x8003FBA8 0x800409A8 0x800417A8 0x800425A8 0x800433A8 0x800441A8 0x80044FA8 0x80045DA8 0x80046BA8 0x800479A8 0x800487A8 0x800495A8 0x8004A3A8 0x8004B1A8 0x8004BFA8 0x8004CDA8 0x8004DBA8 0x8004E9A8 /end VAR_ADDRESS
 /end VAR_CHARACTERISTIC
 /begin VAR_CHARACTERISTIC SSM_S16_AVH_F_END_E_TQ_MIN_SLOP EngCalVariantCriterion
  /begin VAR_ADDRESS 0x8003A7AA 0x8003B5AA 0x8003C3AA 0x8003D1AA 0x8003DFAA 0x8003EDAA 0x8003FBAA 0x800409AA 0x800417AA 0x800425AA 0x800433AA 0x800441AA 0x80044FAA 0x80045DAA 0x80046BAA 0x800479AA 0x800487AA 0x800495AA 0x8004A3AA 0x8004B1AA 0x8004BFAA 0x8004CDAA 0x8004DBAA 0x8004E9AA /end VAR_ADDRESS
 /end VAR_CHARACTERISTIC
 /begin VAR_CHARACTERISTIC SSM_S16_AVH_IGN_DECOUNT_CYCLE BrkCalVariantCriterion
  /begin VAR_ADDRESS 0x80020FEC 0x800243EC 0x800277EC 0x8002ABEC 0x8002DFEC 0x800313EC 0x800347EC 0x80037BEC /end VAR_ADDRESS
 /end VAR_CHARACTERISTIC
 /begin VAR_CHARACTERISTIC SSM_S16_AVH_ISG_IDLETOQ_INHIBIT_TIME EngCalVariantCriterion
  /begin VAR_ADDRESS 0x8003A73C 0x8003B53C 0x8003C33C 0x8003D13C 0x8003DF3C 0x8003ED3C 0x8003FB3C 0x8004093C 0x8004173C 0x8004253C 0x8004333C 0x8004413C 0x80044F3C 0x80045D3C 0x80046B3C 0x8004793C 0x8004873C 0x8004953C 0x8004A33C 0x8004B13C 0x8004BF3C 0x8004CD3C 0x8004DB3C 0x8004E93C /end VAR_ADDRESS
 /end VAR_CHARACTERISTIC
 /begin VAR_CHARACTERISTIC SSM_S16_AVH_RECOVERY_IGN_CNT_REF BrkCalVariantCriterion
  /begin VAR_ADDRESS 0x80020FEE 0x800243EE 0x800277EE 0x8002ABEE 0x8002DFEE 0x800313EE 0x800347EE 0x80037BEE /end VAR_ADDRESS
 /end VAR_CHARACTERISTIC
 /begin VAR_CHARACTERISTIC SSM_S16_AVH_T_P_TEMP_1 EngCalVariantCriterion
  /begin VAR_ADDRESS 0x8003A7B4 0x8003B5B4 0x8003C3B4 0x8003D1B4 0x8003DFB4 0x8003EDB4 0x8003FBB4 0x800409B4 0x800417B4 0x800425B4 0x800433B4 0x800441B4 0x80044FB4 0x80045DB4 0x80046BB4 0x800479B4 0x800487B4 0x800495B4 0x8004A3B4 0x8004B1B4 0x8004BFB4 0x8004CDB4 0x8004DBB4 0x8004E9B4 /end VAR_ADDRESS
 /end VAR_CHARACTERISTIC
 /begin VAR_CHARACTERISTIC SSM_S16_AVH_T_P_TEMP_10 EngCalVariantCriterion
  /begin VAR_ADDRESS 0x8003A7B6 0x8003B5B6 0x8003C3B6 0x8003D1B6 0x8003DFB6 0x8003EDB6 0x8003FBB6 0x800409B6 0x800417B6 0x800425B6 0x800433B6 0x800441B6 0x80044FB6 0x80045DB6 0x80046BB6 0x800479B6 0x800487B6 0x800495B6 0x8004A3B6 0x8004B1B6 0x8004BFB6 0x8004CDB6 0x8004DBB6 0x8004E9B6 /end VAR_ADDRESS
 /end VAR_CHARACTERISTIC
 /begin VAR_CHARACTERISTIC SSM_S16_AVH_T_P_TEMP_2 EngCalVariantCriterion
  /begin VAR_ADDRESS 0x8003A7B8 0x8003B5B8 0x8003C3B8 0x8003D1B8 0x8003DFB8 0x8003EDB8 0x8003FBB8 0x800409B8 0x800417B8 0x800425B8 0x800433B8 0x800441B8 0x80044FB8 0x80045DB8 0x80046BB8 0x800479B8 0x800487B8 0x800495B8 0x8004A3B8 0x8004B1B8 0x8004BFB8 0x8004CDB8 0x8004DBB8 0x8004E9B8 /end VAR_ADDRESS
 /end VAR_CHARACTERISTIC
 /begin VAR_CHARACTERISTIC SSM_S16_AVH_T_P_TEMP_3 EngCalVariantCriterion
  /begin VAR_ADDRESS 0x8003A7BA 0x8003B5BA 0x8003C3BA 0x8003D1BA 0x8003DFBA 0x8003EDBA 0x8003FBBA 0x800409BA 0x800417BA 0x800425BA 0x800433BA 0x800441BA 0x80044FBA 0x80045DBA 0x80046BBA 0x800479BA 0x800487BA 0x800495BA 0x8004A3BA 0x8004B1BA 0x8004BFBA 0x8004CDBA 0x8004DBBA 0x8004E9BA /end VAR_ADDRESS
 /end VAR_CHARACTERISTIC
 /begin VAR_CHARACTERISTIC SSM_S16_AVH_T_P_TEMP_4 EngCalVariantCriterion
  /begin VAR_ADDRESS 0x8003A7BC 0x8003B5BC 0x8003C3BC 0x8003D1BC 0x8003DFBC 0x8003EDBC 0x8003FBBC 0x800409BC 0x800417BC 0x800425BC 0x800433BC 0x800441BC 0x80044FBC 0x80045DBC 0x80046BBC 0x800479BC 0x800487BC 0x800495BC 0x8004A3BC 0x8004B1BC 0x8004BFBC 0x8004CDBC 0x8004DBBC 0x8004E9BC /end VAR_ADDRESS
 /end VAR_CHARACTERISTIC
 /begin VAR_CHARACTERISTIC SSM_S16_AVH_T_P_TEMP_5 EngCalVariantCriterion
  /begin VAR_ADDRESS 0x8003A7BE 0x8003B5BE 0x8003C3BE 0x8003D1BE 0x8003DFBE 0x8003EDBE 0x8003FBBE 0x800409BE 0x800417BE 0x800425BE 0x800433BE 0x800441BE 0x80044FBE 0x80045DBE 0x80046BBE 0x800479BE 0x800487BE 0x800495BE 0x8004A3BE 0x8004B1BE 0x8004BFBE 0x8004CDBE 0x8004DBBE 0x8004E9BE /end VAR_ADDRESS
 /end VAR_CHARACTERISTIC
 /begin VAR_CHARACTERISTIC SSM_S16_AVH_T_P_TEMP_6 EngCalVariantCriterion
  /begin VAR_ADDRESS 0x8003A7C0 0x8003B5C0 0x8003C3C0 0x8003D1C0 0x8003DFC0 0x8003EDC0 0x8003FBC0 0x800409C0 0x800417C0 0x800425C0 0x800433C0 0x800441C0 0x80044FC0 0x80045DC0 0x80046BC0 0x800479C0 0x800487C0 0x800495C0 0x8004A3C0 0x8004B1C0 0x8004BFC0 0x8004CDC0 0x8004DBC0 0x8004E9C0 /end VAR_ADDRESS
 /end VAR_CHARACTERISTIC
 /begin VAR_CHARACTERISTIC SSM_S16_AVH_T_P_TEMP_7 EngCalVariantCriterion
  /begin VAR_ADDRESS 0x8003A7C2 0x8003B5C2 0x8003C3C2 0x8003D1C2 0x8003DFC2 0x8003EDC2 0x8003FBC2 0x800409C2 0x800417C2 0x800425C2 0x800433C2 0x800441C2 0x80044FC2 0x80045DC2 0x80046BC2 0x800479C2 0x800487C2 0x800495C2 0x8004A3C2 0x8004B1C2 0x8004BFC2 0x8004CDC2 0x8004DBC2 0x8004E9C2 /end VAR_ADDRESS
 /end VAR_CHARACTERISTIC
 /begin VAR_CHARACTERISTIC SSM_S16_AVH_T_P_TEMP_8 EngCalVariantCriterion
  /begin VAR_ADDRESS 0x8003A7C4 0x8003B5C4 0x8003C3C4 0x8003D1C4 0x8003DFC4 0x8003EDC4 0x8003FBC4 0x800409C4 0x800417C4 0x800425C4 0x800433C4 0x800441C4 0x80044FC4 0x80045DC4 0x80046BC4 0x800479C4 0x800487C4 0x800495C4 0x8004A3C4 0x8004B1C4 0x8004BFC4 0x8004CDC4 0x8004DBC4 0x8004E9C4 /end VAR_ADDRESS
 /end VAR_CHARACTERISTIC
 /begin VAR_CHARACTERISTIC SSM_S16_AVH_T_P_TEMP_9 EngCalVariantCriterion
  /begin VAR_ADDRESS 0x8003A7C6 0x8003B5C6 0x8003C3C6 0x8003D1C6 0x8003DFC6 0x8003EDC6 0x8003FBC6 0x800409C6 0x800417C6 0x800425C6 0x800433C6 0x800441C6 0x80044FC6 0x80045DC6 0x80046BC6 0x800479C6 0x800487C6 0x800495C6 0x8004A3C6 0x8004B1C6 0x8004BFC6 0x8004CDC6 0x8004DBC6 0x8004E9C6 /end VAR_ADDRESS
 /end VAR_CHARACTERISTIC
 /begin VAR_CHARACTERISTIC SSM_S16_EPB_ACT_DELAY_MAXHILL BrkCalVariantCriterion
  /begin VAR_ADDRESS 0x80020FF8 0x800243F8 0x800277F8 0x8002ABF8 0x8002DFF8 0x800313F8 0x800347F8 0x80037BF8 /end VAR_ADDRESS
 /end VAR_CHARACTERISTIC
 /begin VAR_CHARACTERISTIC SSM_S16_HSA_ENTER_HM_LIMIT_MPRESS EngCalVariantCriterion
  /begin VAR_ADDRESS 0x8003A708 0x8003B508 0x8003C308 0x8003D108 0x8003DF08 0x8003ED08 0x8003FB08 0x80040908 0x80041708 0x80042508 0x80043308 0x80044108 0x80044F08 0x80045D08 0x80046B08 0x80047908 0x80048708 0x80049508 0x8004A308 0x8004B108 0x8004BF08 0x8004CD08 0x8004DB08 0x8004E908 /end VAR_ADDRESS
 /end VAR_CHARACTERISTIC
 /begin VAR_CHARACTERISTIC SSM_S16_HSA_ENTER_INBIT_MPRESS EngCalVariantCriterion
  /begin VAR_ADDRESS 0x8003A702 0x8003B502 0x8003C302 0x8003D102 0x8003DF02 0x8003ED02 0x8003FB02 0x80040902 0x80041702 0x80042502 0x80043302 0x80044102 0x80044F02 0x80045D02 0x80046B02 0x80047902 0x80048702 0x80049502 0x8004A302 0x8004B102 0x8004BF02 0x8004CD02 0x8004DB02 0x8004E902 /end VAR_ADDRESS
 /end VAR_CHARACTERISTIC
 /begin VAR_CHARACTERISTIC SSM_S16_HSA_ENTER_LIMIT_SPEED EngCalVariantCriterion
  /begin VAR_ADDRESS 0x8003A704 0x8003B504 0x8003C304 0x8003D104 0x8003DF04 0x8003ED04 0x8003FB04 0x80040904 0x80041704 0x80042504 0x80043304 0x80044104 0x80044F04 0x80045D04 0x80046B04 0x80047904 0x80048704 0x80049504 0x8004A304 0x8004B104 0x8004BF04 0x8004CD04 0x8004DB04 0x8004E904 /end VAR_ADDRESS
 /end VAR_CHARACTERISTIC
 /begin VAR_CHARACTERISTIC SSM_S16_HSA_ENTER_LM_LIMIT_MPRESS EngCalVariantCriterion
  /begin VAR_ADDRESS 0x8003A706 0x8003B506 0x8003C306 0x8003D106 0x8003DF06 0x8003ED06 0x8003FB06 0x80040906 0x80041706 0x80042506 0x80043306 0x80044106 0x80044F06 0x80045D06 0x80046B06 0x80047906 0x80048706 0x80049506 0x8004A306 0x8004B106 0x8004BF06 0x8004CD06 0x8004DB06 0x8004E906 /end VAR_ADDRESS
 /end VAR_CHARACTERISTIC
 /begin VAR_CHARACTERISTIC SSM_S16_HSA_ENTER_MAX_LIMIT_MPRESS EngCalVariantCriterion
  /begin VAR_ADDRESS 0x8003A70A 0x8003B50A 0x8003C30A 0x8003D10A 0x8003DF0A 0x8003ED0A 0x8003FB0A 0x8004090A 0x8004170A 0x8004250A 0x8004330A 0x8004410A 0x80044F0A 0x80045D0A 0x80046B0A 0x8004790A 0x8004870A 0x8004950A 0x8004A30A 0x8004B10A 0x8004BF0A 0x8004CD0A 0x8004DB0A 0x8004E90A /end VAR_ADDRESS
 /end VAR_CHARACTERISTIC
 /begin VAR_CHARACTERISTIC SSM_S16_HSA_EXIT_SPEED EngCalVariantCriterion
  /begin VAR_ADDRESS 0x8003A70C 0x8003B50C 0x8003C30C 0x8003D10C 0x8003DF0C 0x8003ED0C 0x8003FB0C 0x8004090C 0x8004170C 0x8004250C 0x8004330C 0x8004410C 0x80044F0C 0x80045D0C 0x80046B0C 0x8004790C 0x8004870C 0x8004950C 0x8004A30C 0x8004B10C 0x8004BF0C 0x8004CD0C 0x8004DB0C 0x8004E90C /end VAR_ADDRESS
 /end VAR_CHARACTERISTIC
 /begin VAR_CHARACTERISTIC SSM_S16_HSA_FLAT_THR_FORWARD EngCalVariantCriterion
  /begin VAR_ADDRESS 0x8003A6EA 0x8003B4EA 0x8003C2EA 0x8003D0EA 0x8003DEEA 0x8003ECEA 0x8003FAEA 0x800408EA 0x800416EA 0x800424EA 0x800432EA 0x800440EA 0x80044EEA 0x80045CEA 0x80046AEA 0x800478EA 0x800486EA 0x800494EA 0x8004A2EA 0x8004B0EA 0x8004BEEA 0x8004CCEA 0x8004DAEA 0x8004E8EA /end VAR_ADDRESS
 /end VAR_CHARACTERISTIC
 /begin VAR_CHARACTERISTIC SSM_S16_HSA_FLAT_THR_REVERSE EngCalVariantCriterion
  /begin VAR_ADDRESS 0x8003A6EC 0x8003B4EC 0x8003C2EC 0x8003D0EC 0x8003DEEC 0x8003ECEC 0x8003FAEC 0x800408EC 0x800416EC 0x800424EC 0x800432EC 0x800440EC 0x80044EEC 0x80045CEC 0x80046AEC 0x800478EC 0x800486EC 0x800494EC 0x8004A2EC 0x8004B0EC 0x8004BEEC 0x8004CCEC 0x8004DAEC 0x8004E8EC /end VAR_ADDRESS
 /end VAR_CHARACTERISTIC
 /begin VAR_CHARACTERISTIC SSM_S16_HSA_MIN_SLOPE_FORWARD EngCalVariantCriterion
  /begin VAR_ADDRESS 0x8003A6E4 0x8003B4E4 0x8003C2E4 0x8003D0E4 0x8003DEE4 0x8003ECE4 0x8003FAE4 0x800408E4 0x800416E4 0x800424E4 0x800432E4 0x800440E4 0x80044EE4 0x80045CE4 0x80046AE4 0x800478E4 0x800486E4 0x800494E4 0x8004A2E4 0x8004B0E4 0x8004BEE4 0x8004CCE4 0x8004DAE4 0x8004E8E4 /end VAR_ADDRESS
 /end VAR_CHARACTERISTIC
 /begin VAR_CHARACTERISTIC SSM_S16_HSA_MIN_SLOPE_REVERSE EngCalVariantCriterion
  /begin VAR_ADDRESS 0x8003A6E6 0x8003B4E6 0x8003C2E6 0x8003D0E6 0x8003DEE6 0x8003ECE6 0x8003FAE6 0x800408E6 0x800416E6 0x800424E6 0x800432E6 0x800440E6 0x80044EE6 0x80045CE6 0x80046AE6 0x800478E6 0x800486E6 0x800494E6 0x8004A2E6 0x8004B0E6 0x8004BEE6 0x8004CCE6 0x8004DAE6 0x8004E8E6 /end VAR_ADDRESS
 /end VAR_CHARACTERISTIC
 /begin VAR_CHARACTERISTIC SSM_S16_HSA_RISE_PRESS EngCalVariantCriterion
  /begin VAR_ADDRESS 0x8003A716 0x8003B516 0x8003C316 0x8003D116 0x8003DF16 0x8003ED16 0x8003FB16 0x80040916 0x80041716 0x80042516 0x80043316 0x80044116 0x80044F16 0x80045D16 0x80046B16 0x80047916 0x80048716 0x80049516 0x8004A316 0x8004B116 0x8004BF16 0x8004CD16 0x8004DB16 0x8004E916 /end VAR_ADDRESS
 /end VAR_CHARACTERISTIC
 /begin VAR_CHARACTERISTIC SSM_S16_HSA_RISE_TIME EngCalVariantCriterion
  /begin VAR_ADDRESS 0x8003A714 0x8003B514 0x8003C314 0x8003D114 0x8003DF14 0x8003ED14 0x8003FB14 0x80040914 0x80041714 0x80042514 0x80043314 0x80044114 0x80044F14 0x80045D14 0x80046B14 0x80047914 0x80048714 0x80049514 0x8004A314 0x8004B114 0x8004BF14 0x8004CD14 0x8004DB14 0x8004E914 /end VAR_ADDRESS
 /end VAR_CHARACTERISTIC
 /begin VAR_CHARACTERISTIC SSM_S16_HSA_RISE_WL_SPD_TH EngCalVariantCriterion
  /begin VAR_ADDRESS 0x8003A710 0x8003B510 0x8003C310 0x8003D110 0x8003DF10 0x8003ED10 0x8003FB10 0x80040910 0x80041710 0x80042510 0x80043310 0x80044110 0x80044F10 0x80045D10 0x80046B10 0x80047910 0x80048710 0x80049510 0x8004A310 0x8004B110 0x8004BF10 0x8004CD10 0x8004DB10 0x8004E910 /end VAR_ADDRESS
 /end VAR_CHARACTERISTIC
 /begin VAR_CHARACTERISTIC SSM_S16_HSA_STOP_ON_HILL_MIN_SPD EngCalVariantCriterion
  /begin VAR_ADDRESS 0x8003A6EE 0x8003B4EE 0x8003C2EE 0x8003D0EE 0x8003DEEE 0x8003ECEE 0x8003FAEE 0x800408EE 0x800416EE 0x800424EE 0x800432EE 0x800440EE 0x80044EEE 0x80045CEE 0x80046AEE 0x800478EE 0x800486EE 0x800494EE 0x8004A2EE 0x8004B0EE 0x8004BEEE 0x8004CCEE 0x8004DAEE 0x8004E8EE /end VAR_ADDRESS
 /end VAR_CHARACTERISTIC
 /begin VAR_CHARACTERISTIC SSM_S16_HSA_TEMP_1 EngCalVariantCriterion
  /begin VAR_ADDRESS 0x8003A71C 0x8003B51C 0x8003C31C 0x8003D11C 0x8003DF1C 0x8003ED1C 0x8003FB1C 0x8004091C 0x8004171C 0x8004251C 0x8004331C 0x8004411C 0x80044F1C 0x80045D1C 0x80046B1C 0x8004791C 0x8004871C 0x8004951C 0x8004A31C 0x8004B11C 0x8004BF1C 0x8004CD1C 0x8004DB1C 0x8004E91C /end VAR_ADDRESS
 /end VAR_CHARACTERISTIC
 /begin VAR_CHARACTERISTIC SSM_S16_HSA_TEMP_2 EngCalVariantCriterion
  /begin VAR_ADDRESS 0x8003A71E 0x8003B51E 0x8003C31E 0x8003D11E 0x8003DF1E 0x8003ED1E 0x8003FB1E 0x8004091E 0x8004171E 0x8004251E 0x8004331E 0x8004411E 0x80044F1E 0x80045D1E 0x80046B1E 0x8004791E 0x8004871E 0x8004951E 0x8004A31E 0x8004B11E 0x8004BF1E 0x8004CD1E 0x8004DB1E 0x8004E91E /end VAR_ADDRESS
 /end VAR_CHARACTERISTIC
 /begin VAR_CHARACTERISTIC SSM_S16_HSA_T_P_TEMP_1 EngCalVariantCriterion
  /begin VAR_ADDRESS 0x8003A722 0x8003B522 0x8003C322 0x8003D122 0x8003DF22 0x8003ED22 0x8003FB22 0x80040922 0x80041722 0x80042522 0x80043322 0x80044122 0x80044F22 0x80045D22 0x80046B22 0x80047922 0x80048722 0x80049522 0x8004A322 0x8004B122 0x8004BF22 0x8004CD22 0x8004DB22 0x8004E922 /end VAR_ADDRESS
 /end VAR_CHARACTERISTIC
 /begin VAR_CHARACTERISTIC SSM_S16_HSA_T_P_TEMP_10 EngCalVariantCriterion
  /begin VAR_ADDRESS 0x8003A724 0x8003B524 0x8003C324 0x8003D124 0x8003DF24 0x8003ED24 0x8003FB24 0x80040924 0x80041724 0x80042524 0x80043324 0x80044124 0x80044F24 0x80045D24 0x80046B24 0x80047924 0x80048724 0x80049524 0x8004A324 0x8004B124 0x8004BF24 0x8004CD24 0x8004DB24 0x8004E924 /end VAR_ADDRESS
 /end VAR_CHARACTERISTIC
 /begin VAR_CHARACTERISTIC SSM_S16_HSA_T_P_TEMP_2 EngCalVariantCriterion
  /begin VAR_ADDRESS 0x8003A726 0x8003B526 0x8003C326 0x8003D126 0x8003DF26 0x8003ED26 0x8003FB26 0x80040926 0x80041726 0x80042526 0x80043326 0x80044126 0x80044F26 0x80045D26 0x80046B26 0x80047926 0x80048726 0x80049526 0x8004A326 0x8004B126 0x8004BF26 0x8004CD26 0x8004DB26 0x8004E926 /end VAR_ADDRESS
 /end VAR_CHARACTERISTIC
 /begin VAR_CHARACTERISTIC SSM_S16_HSA_T_P_TEMP_3 EngCalVariantCriterion
  /begin VAR_ADDRESS 0x8003A728 0x8003B528 0x8003C328 0x8003D128 0x8003DF28 0x8003ED28 0x8003FB28 0x80040928 0x80041728 0x80042528 0x80043328 0x80044128 0x80044F28 0x80045D28 0x80046B28 0x80047928 0x80048728 0x80049528 0x8004A328 0x8004B128 0x8004BF28 0x8004CD28 0x8004DB28 0x8004E928 /end VAR_ADDRESS
 /end VAR_CHARACTERISTIC
 /begin VAR_CHARACTERISTIC SSM_S16_HSA_T_P_TEMP_4 EngCalVariantCriterion
  /begin VAR_ADDRESS 0x8003A72A 0x8003B52A 0x8003C32A 0x8003D12A 0x8003DF2A 0x8003ED2A 0x8003FB2A 0x8004092A 0x8004172A 0x8004252A 0x8004332A 0x8004412A 0x80044F2A 0x80045D2A 0x80046B2A 0x8004792A 0x8004872A 0x8004952A 0x8004A32A 0x8004B12A 0x8004BF2A 0x8004CD2A 0x8004DB2A 0x8004E92A /end VAR_ADDRESS
 /end VAR_CHARACTERISTIC
 /begin VAR_CHARACTERISTIC SSM_S16_HSA_T_P_TEMP_5 EngCalVariantCriterion
  /begin VAR_ADDRESS 0x8003A72C 0x8003B52C 0x8003C32C 0x8003D12C 0x8003DF2C 0x8003ED2C 0x8003FB2C 0x8004092C 0x8004172C 0x8004252C 0x8004332C 0x8004412C 0x80044F2C 0x80045D2C 0x80046B2C 0x8004792C 0x8004872C 0x8004952C 0x8004A32C 0x8004B12C 0x8004BF2C 0x8004CD2C 0x8004DB2C 0x8004E92C /end VAR_ADDRESS
 /end VAR_CHARACTERISTIC
 /begin VAR_CHARACTERISTIC SSM_S16_HSA_T_P_TEMP_6 EngCalVariantCriterion
  /begin VAR_ADDRESS 0x8003A72E 0x8003B52E 0x8003C32E 0x8003D12E 0x8003DF2E 0x8003ED2E 0x8003FB2E 0x8004092E 0x8004172E 0x8004252E 0x8004332E 0x8004412E 0x80044F2E 0x80045D2E 0x80046B2E 0x8004792E 0x8004872E 0x8004952E 0x8004A32E 0x8004B12E 0x8004BF2E 0x8004CD2E 0x8004DB2E 0x8004E92E /end VAR_ADDRESS
 /end VAR_CHARACTERISTIC
 /begin VAR_CHARACTERISTIC SSM_S16_HSA_T_P_TEMP_7 EngCalVariantCriterion
  /begin VAR_ADDRESS 0x8003A730 0x8003B530 0x8003C330 0x8003D130 0x8003DF30 0x8003ED30 0x8003FB30 0x80040930 0x80041730 0x80042530 0x80043330 0x80044130 0x80044F30 0x80045D30 0x80046B30 0x80047930 0x80048730 0x80049530 0x8004A330 0x8004B130 0x8004BF30 0x8004CD30 0x8004DB30 0x8004E930 /end VAR_ADDRESS
 /end VAR_CHARACTERISTIC
 /begin VAR_CHARACTERISTIC SSM_S16_HSA_T_P_TEMP_8 EngCalVariantCriterion
  /begin VAR_ADDRESS 0x8003A732 0x8003B532 0x8003C332 0x8003D132 0x8003DF32 0x8003ED32 0x8003FB32 0x80040932 0x80041732 0x80042532 0x80043332 0x80044132 0x80044F32 0x80045D32 0x80046B32 0x80047932 0x80048732 0x80049532 0x8004A332 0x8004B132 0x8004BF32 0x8004CD32 0x8004DB32 0x8004E932 /end VAR_ADDRESS
 /end VAR_CHARACTERISTIC
 /begin VAR_CHARACTERISTIC SSM_S16_HSA_T_P_TEMP_9 EngCalVariantCriterion
  /begin VAR_ADDRESS 0x8003A734 0x8003B534 0x8003C334 0x8003D134 0x8003DF34 0x8003ED34 0x8003FB34 0x80040934 0x80041734 0x80042534 0x80043334 0x80044134 0x80044F34 0x80045D34 0x80046B34 0x80047934 0x80048734 0x80049534 0x8004A334 0x8004B134 0x8004BF34 0x8004CD34 0x8004DB34 0x8004E934 /end VAR_ADDRESS
 /end VAR_CHARACTERISTIC
 /begin VAR_CHARACTERISTIC SSM_S16_HSA_c_MaxLongG EngCalVariantCriterion
  /begin VAR_ADDRESS 0x8003A6E8 0x8003B4E8 0x8003C2E8 0x8003D0E8 0x8003DEE8 0x8003ECE8 0x8003FAE8 0x800408E8 0x800416E8 0x800424E8 0x800432E8 0x800440E8 0x80044EE8 0x80045CE8 0x80046AE8 0x800478E8 0x800486E8 0x800494E8 0x8004A2E8 0x8004B0E8 0x8004BEE8 0x8004CCE8 0x8004DAE8 0x8004E8E8 /end VAR_ADDRESS
 /end VAR_CHARACTERISTIC
 /begin VAR_CHARACTERISTIC SSM_S16_ISG_End_RPM_Th EngCalVariantCriterion
  /begin VAR_ADDRESS 0x8003A736 0x8003B536 0x8003C336 0x8003D136 0x8003DF36 0x8003ED36 0x8003FB36 0x80040936 0x80041736 0x80042536 0x80043336 0x80044136 0x80044F36 0x80045D36 0x80046B36 0x80047936 0x80048736 0x80049536 0x8004A336 0x8004B136 0x8004BF36 0x8004CD36 0x8004DB36 0x8004E936 /end VAR_ADDRESS
 /end VAR_CHARACTERISTIC
 /begin VAR_CHARACTERISTIC SSM_S16_MAX_ON_TIME_ONE_CYCLE BrkCalVariantCriterion
  /begin VAR_ADDRESS 0x80020FF0 0x800243F0 0x800277F0 0x8002ABF0 0x8002DFF0 0x800313F0 0x800347F0 0x80037BF0 /end VAR_ADDRESS
 /end VAR_CHARACTERISTIC
 /begin VAR_CHARACTERISTIC SSM_S16_MAX_ON_TIME_ONE_CYCLE_AUTO BrkCalVariantCriterion
  /begin VAR_ADDRESS 0x80020FF2 0x800243F2 0x800277F2 0x8002ABF2 0x8002DFF2 0x800313F2 0x800347F2 0x80037BF2 /end VAR_ADDRESS
 /end VAR_CHARACTERISTIC
 /begin VAR_CHARACTERISTIC SSM_S16_MAX_ON_TIME_ONE_IGN BrkCalVariantCriterion
  /begin VAR_ADDRESS 0x80020FF4 0x800243F4 0x800277F4 0x8002ABF4 0x8002DFF4 0x800313F4 0x800347F4 0x80037BF4 /end VAR_ADDRESS
 /end VAR_CHARACTERISTIC
 /begin VAR_CHARACTERISTIC SSM_S16_MAX_ON_TIME_ONE_IGN_AUTO BrkCalVariantCriterion
  /begin VAR_ADDRESS 0x80020FF6 0x800243F6 0x800277F6 0x8002ABF6 0x8002DFF6 0x800313F6 0x800347F6 0x80037BF6 /end VAR_ADDRESS
 /end VAR_CHARACTERISTIC
 /begin VAR_CHARACTERISTIC SSM_S16_ROLL_RISE_PRESSURE BrkCalVariantCriterion
  /begin VAR_ADDRESS 0x80020FE4 0x800243E4 0x800277E4 0x8002ABE4 0x8002DFE4 0x800313E4 0x800347E4 0x80037BE4 /end VAR_ADDRESS
 /end VAR_CHARACTERISTIC
 /begin VAR_CHARACTERISTIC SSM_S16_SSM_ACC_PEDAL_ON_MIN_TH EngCalVariantCriterion
  /begin VAR_ADDRESS 0x8003A740 0x8003B540 0x8003C340 0x8003D140 0x8003DF40 0x8003ED40 0x8003FB40 0x80040940 0x80041740 0x80042540 0x80043340 0x80044140 0x80044F40 0x80045D40 0x80046B40 0x80047940 0x80048740 0x80049540 0x8004A340 0x8004B140 0x8004BF40 0x8004CD40 0x8004DB40 0x8004E940 /end VAR_ADDRESS
 /end VAR_CHARACTERISTIC
 /begin VAR_CHARACTERISTIC SSM_S16_SSM_AX_DIFF_FOR_DIVE_DETECT EngCalVariantCriterion
  /begin VAR_ADDRESS 0x8003A77C 0x8003B57C 0x8003C37C 0x8003D17C 0x8003DF7C 0x8003ED7C 0x8003FB7C 0x8004097C 0x8004177C 0x8004257C 0x8004337C 0x8004417C 0x80044F7C 0x80045D7C 0x80046B7C 0x8004797C 0x8004877C 0x8004957C 0x8004A37C 0x8004B17C 0x8004BF7C 0x8004CD7C 0x8004DB7C 0x8004E97C /end VAR_ADDRESS
 /end VAR_CHARACTERISTIC
 /begin VAR_CHARACTERISTIC SSM_S16_SSM_AX_DIFF_LOW_REF EngCalVariantCriterion
  /begin VAR_ADDRESS 0x8003A772 0x8003B572 0x8003C372 0x8003D172 0x8003DF72 0x8003ED72 0x8003FB72 0x80040972 0x80041772 0x80042572 0x80043372 0x80044172 0x80044F72 0x80045D72 0x80046B72 0x80047972 0x80048772 0x80049572 0x8004A372 0x8004B172 0x8004BF72 0x8004CD72 0x8004DB72 0x8004E972 /end VAR_ADDRESS
 /end VAR_CHARACTERISTIC
 /begin VAR_CHARACTERISTIC SSM_S16_SSM_AX_DIFF_MAX_REF EngCalVariantCriterion
  /begin VAR_ADDRESS 0x8003A776 0x8003B576 0x8003C376 0x8003D176 0x8003DF76 0x8003ED76 0x8003FB76 0x80040976 0x80041776 0x80042576 0x80043376 0x80044176 0x80044F76 0x80045D76 0x80046B76 0x80047976 0x80048776 0x80049576 0x8004A376 0x8004B176 0x8004BF76 0x8004CD76 0x8004DB76 0x8004E976 /end VAR_ADDRESS
 /end VAR_CHARACTERISTIC
 /begin VAR_CHARACTERISTIC SSM_S16_SSM_AX_DIFF_MED_REF EngCalVariantCriterion
  /begin VAR_ADDRESS 0x8003A774 0x8003B574 0x8003C374 0x8003D174 0x8003DF74 0x8003ED74 0x8003FB74 0x80040974 0x80041774 0x80042574 0x80043374 0x80044174 0x80044F74 0x80045D74 0x80046B74 0x80047974 0x80048774 0x80049574 0x8004A374 0x8004B174 0x8004BF74 0x8004CD74 0x8004DB74 0x8004E974 /end VAR_ADDRESS
 /end VAR_CHARACTERISTIC
 /begin VAR_CHARACTERISTIC SSM_S16_SSM_HOLD_PRESS_SAFETY_MARGIN EngCalVariantCriterion
  /begin VAR_ADDRESS 0x8003A744 0x8003B544 0x8003C344 0x8003D144 0x8003DF44 0x8003ED44 0x8003FB44 0x80040944 0x80041744 0x80042544 0x80043344 0x80044144 0x80044F44 0x80045D44 0x80046B44 0x80047944 0x80048744 0x80049544 0x8004A344 0x8004B144 0x8004BF44 0x8004CD44 0x8004DB44 0x8004E944 /end VAR_ADDRESS
 /end VAR_CHARACTERISTIC
 /begin VAR_CHARACTERISTIC SSM_S16_SSM_MAX_EXIT_TORQUE EngCalVariantCriterion
  /begin VAR_ADDRESS 0x8003A78C 0x8003B58C 0x8003C38C 0x8003D18C 0x8003DF8C 0x8003ED8C 0x8003FB8C 0x8004098C 0x8004178C 0x8004258C 0x8004338C 0x8004418C 0x80044F8C 0x80045D8C 0x80046B8C 0x8004798C 0x8004878C 0x8004958C 0x8004A38C 0x8004B18C 0x8004BF8C 0x8004CD8C 0x8004DB8C 0x8004E98C /end VAR_ADDRESS
 /end VAR_CHARACTERISTIC
 /begin VAR_CHARACTERISTIC SSM_S16_SSM_MAX_MP_OFFSET_BLS_FAIL EngCalVariantCriterion
  /begin VAR_ADDRESS 0x8003A73E 0x8003B53E 0x8003C33E 0x8003D13E 0x8003DF3E 0x8003ED3E 0x8003FB3E 0x8004093E 0x8004173E 0x8004253E 0x8004333E 0x8004413E 0x80044F3E 0x80045D3E 0x80046B3E 0x8004793E 0x8004873E 0x8004953E 0x8004A33E 0x8004B13E 0x8004BF3E 0x8004CD3E 0x8004DB3E 0x8004E93E /end VAR_ADDRESS
 /end VAR_CHARACTERISTIC
 /begin VAR_CHARACTERISTIC SSM_S16_SSM_MAX_PRESS_SLOP EngCalVariantCriterion
  /begin VAR_ADDRESS 0x8003A768 0x8003B568 0x8003C368 0x8003D168 0x8003DF68 0x8003ED68 0x8003FB68 0x80040968 0x80041768 0x80042568 0x80043368 0x80044168 0x80044F68 0x80045D68 0x80046B68 0x80047968 0x80048768 0x80049568 0x8004A368 0x8004B168 0x8004BF68 0x8004CD68 0x8004DB68 0x8004E968 /end VAR_ADDRESS
 /end VAR_CHARACTERISTIC
 /begin VAR_CHARACTERISTIC SSM_S16_SSM_MIN_CTRL_PRESS EngCalVariantCriterion
  /begin VAR_ADDRESS 0x8003A742 0x8003B542 0x8003C342 0x8003D142 0x8003DF42 0x8003ED42 0x8003FB42 0x80040942 0x80041742 0x80042542 0x80043342 0x80044142 0x80044F42 0x80045D42 0x80046B42 0x80047942 0x80048742 0x80049542 0x8004A342 0x8004B142 0x8004BF42 0x8004CD42 0x8004DB42 0x8004E942 /end VAR_ADDRESS
 /end VAR_CHARACTERISTIC
 /begin VAR_CHARACTERISTIC SSM_S16_SSM_MIN_CTRL_PRESS_F_N_HM EngCalVariantCriterion
  /begin VAR_ADDRESS 0x8003A74E 0x8003B54E 0x8003C34E 0x8003D14E 0x8003DF4E 0x8003ED4E 0x8003FB4E 0x8004094E 0x8004174E 0x8004254E 0x8004334E 0x8004414E 0x80044F4E 0x80045D4E 0x80046B4E 0x8004794E 0x8004874E 0x8004954E 0x8004A34E 0x8004B14E 0x8004BF4E 0x8004CD4E 0x8004DB4E 0x8004E94E /end VAR_ADDRESS
 /end VAR_CHARACTERISTIC
 /begin VAR_CHARACTERISTIC SSM_S16_SSM_MIN_CTRL_PRESS_F_N_LM EngCalVariantCriterion
  /begin VAR_ADDRESS 0x8003A74C 0x8003B54C 0x8003C34C 0x8003D14C 0x8003DF4C 0x8003ED4C 0x8003FB4C 0x8004094C 0x8004174C 0x8004254C 0x8004334C 0x8004414C 0x80044F4C 0x80045D4C 0x80046B4C 0x8004794C 0x8004874C 0x8004954C 0x8004A34C 0x8004B14C 0x8004BF4C 0x8004CD4C 0x8004DB4C 0x8004E94C /end VAR_ADDRESS
 /end VAR_CHARACTERISTIC
 /begin VAR_CHARACTERISTIC SSM_S16_SSM_MIN_CTRL_PRESS_F_N_MAX EngCalVariantCriterion
  /begin VAR_ADDRESS 0x8003A750 0x8003B550 0x8003C350 0x8003D150 0x8003DF50 0x8003ED50 0x8003FB50 0x80040950 0x80041750 0x80042550 0x80043350 0x80044150 0x80044F50 0x80045D50 0x80046B50 0x80047950 0x80048750 0x80049550 0x8004A350 0x8004B150 0x8004BF50 0x8004CD50 0x8004DB50 0x8004E950 /end VAR_ADDRESS
 /end VAR_CHARACTERISTIC
 /begin VAR_CHARACTERISTIC SSM_S16_SSM_MIN_CTRL_PRESS_F_P_HM EngCalVariantCriterion
  /begin VAR_ADDRESS 0x8003A748 0x8003B548 0x8003C348 0x8003D148 0x8003DF48 0x8003ED48 0x8003FB48 0x80040948 0x80041748 0x80042548 0x80043348 0x80044148 0x80044F48 0x80045D48 0x80046B48 0x80047948 0x80048748 0x80049548 0x8004A348 0x8004B148 0x8004BF48 0x8004CD48 0x8004DB48 0x8004E948 /end VAR_ADDRESS
 /end VAR_CHARACTERISTIC
 /begin VAR_CHARACTERISTIC SSM_S16_SSM_MIN_CTRL_PRESS_F_P_LM EngCalVariantCriterion
  /begin VAR_ADDRESS 0x8003A746 0x8003B546 0x8003C346 0x8003D146 0x8003DF46 0x8003ED46 0x8003FB46 0x80040946 0x80041746 0x80042546 0x80043346 0x80044146 0x80044F46 0x80045D46 0x80046B46 0x80047946 0x80048746 0x80049546 0x8004A346 0x8004B146 0x8004BF46 0x8004CD46 0x8004DB46 0x8004E946 /end VAR_ADDRESS
 /end VAR_CHARACTERISTIC
 /begin VAR_CHARACTERISTIC SSM_S16_SSM_MIN_CTRL_PRESS_F_P_MAX EngCalVariantCriterion
  /begin VAR_ADDRESS 0x8003A74A 0x8003B54A 0x8003C34A 0x8003D14A 0x8003DF4A 0x8003ED4A 0x8003FB4A 0x8004094A 0x8004174A 0x8004254A 0x8004334A 0x8004414A 0x80044F4A 0x80045D4A 0x80046B4A 0x8004794A 0x8004874A 0x8004954A 0x8004A34A 0x8004B14A 0x8004BF4A 0x8004CD4A 0x8004DB4A 0x8004E94A /end VAR_ADDRESS
 /end VAR_CHARACTERISTIC
 /begin VAR_CHARACTERISTIC SSM_S16_SSM_MIN_CTRL_PRESS_HM EngCalVariantCriterion
  /begin VAR_ADDRESS 0x8003A760 0x8003B560 0x8003C360 0x8003D160 0x8003DF60 0x8003ED60 0x8003FB60 0x80040960 0x80041760 0x80042560 0x80043360 0x80044160 0x80044F60 0x80045D60 0x80046B60 0x80047960 0x80048760 0x80049560 0x8004A360 0x8004B160 0x8004BF60 0x8004CD60 0x8004DB60 0x8004E960 /end VAR_ADDRESS
 /end VAR_CHARACTERISTIC
 /begin VAR_CHARACTERISTIC SSM_S16_SSM_MIN_CTRL_PRESS_LM EngCalVariantCriterion
  /begin VAR_ADDRESS 0x8003A75E 0x8003B55E 0x8003C35E 0x8003D15E 0x8003DF5E 0x8003ED5E 0x8003FB5E 0x8004095E 0x8004175E 0x8004255E 0x8004335E 0x8004415E 0x80044F5E 0x80045D5E 0x80046B5E 0x8004795E 0x8004875E 0x8004955E 0x8004A35E 0x8004B15E 0x8004BF5E 0x8004CD5E 0x8004DB5E 0x8004E95E /end VAR_ADDRESS
 /end VAR_CHARACTERISTIC
 /begin VAR_CHARACTERISTIC SSM_S16_SSM_MIN_CTRL_PRESS_MAX EngCalVariantCriterion
  /begin VAR_ADDRESS 0x8003A762 0x8003B562 0x8003C362 0x8003D162 0x8003DF62 0x8003ED62 0x8003FB62 0x80040962 0x80041762 0x80042562 0x80043362 0x80044162 0x80044F62 0x80045D62 0x80046B62 0x80047962 0x80048762 0x80049562 0x8004A362 0x8004B162 0x8004BF62 0x8004CD62 0x8004DB62 0x8004E962 /end VAR_ADDRESS
 /end VAR_CHARACTERISTIC
 /begin VAR_CHARACTERISTIC SSM_S16_SSM_MIN_CTRL_PRESS_R_N_HM EngCalVariantCriterion
  /begin VAR_ADDRESS 0x8003A75A 0x8003B55A 0x8003C35A 0x8003D15A 0x8003DF5A 0x8003ED5A 0x8003FB5A 0x8004095A 0x8004175A 0x8004255A 0x8004335A 0x8004415A 0x80044F5A 0x80045D5A 0x80046B5A 0x8004795A 0x8004875A 0x8004955A 0x8004A35A 0x8004B15A 0x8004BF5A 0x8004CD5A 0x8004DB5A 0x8004E95A /end VAR_ADDRESS
 /end VAR_CHARACTERISTIC
 /begin VAR_CHARACTERISTIC SSM_S16_SSM_MIN_CTRL_PRESS_R_N_LM EngCalVariantCriterion
  /begin VAR_ADDRESS 0x8003A758 0x8003B558 0x8003C358 0x8003D158 0x8003DF58 0x8003ED58 0x8003FB58 0x80040958 0x80041758 0x80042558 0x80043358 0x80044158 0x80044F58 0x80045D58 0x80046B58 0x80047958 0x80048758 0x80049558 0x8004A358 0x8004B158 0x8004BF58 0x8004CD58 0x8004DB58 0x8004E958 /end VAR_ADDRESS
 /end VAR_CHARACTERISTIC
 /begin VAR_CHARACTERISTIC SSM_S16_SSM_MIN_CTRL_PRESS_R_N_MAX EngCalVariantCriterion
  /begin VAR_ADDRESS 0x8003A75C 0x8003B55C 0x8003C35C 0x8003D15C 0x8003DF5C 0x8003ED5C 0x8003FB5C 0x8004095C 0x8004175C 0x8004255C 0x8004335C 0x8004415C 0x80044F5C 0x80045D5C 0x80046B5C 0x8004795C 0x8004875C 0x8004955C 0x8004A35C 0x8004B15C 0x8004BF5C 0x8004CD5C 0x8004DB5C 0x8004E95C /end VAR_ADDRESS
 /end VAR_CHARACTERISTIC
 /begin VAR_CHARACTERISTIC SSM_S16_SSM_MIN_CTRL_PRESS_R_P_HM EngCalVariantCriterion
  /begin VAR_ADDRESS 0x8003A754 0x8003B554 0x8003C354 0x8003D154 0x8003DF54 0x8003ED54 0x8003FB54 0x80040954 0x80041754 0x80042554 0x80043354 0x80044154 0x80044F54 0x80045D54 0x80046B54 0x80047954 0x80048754 0x80049554 0x8004A354 0x8004B154 0x8004BF54 0x8004CD54 0x8004DB54 0x8004E954 /end VAR_ADDRESS
 /end VAR_CHARACTERISTIC
 /begin VAR_CHARACTERISTIC SSM_S16_SSM_MIN_CTRL_PRESS_R_P_LM EngCalVariantCriterion
  /begin VAR_ADDRESS 0x8003A752 0x8003B552 0x8003C352 0x8003D152 0x8003DF52 0x8003ED52 0x8003FB52 0x80040952 0x80041752 0x80042552 0x80043352 0x80044152 0x80044F52 0x80045D52 0x80046B52 0x80047952 0x80048752 0x80049552 0x8004A352 0x8004B152 0x8004BF52 0x8004CD52 0x8004DB52 0x8004E952 /end VAR_ADDRESS
 /end VAR_CHARACTERISTIC
 /begin VAR_CHARACTERISTIC SSM_S16_SSM_MIN_CTRL_PRESS_R_P_MAX EngCalVariantCriterion
  /begin VAR_ADDRESS 0x8003A756 0x8003B556 0x8003C356 0x8003D156 0x8003DF56 0x8003ED56 0x8003FB56 0x80040956 0x80041756 0x80042556 0x80043356 0x80044156 0x80044F56 0x80045D56 0x80046B56 0x80047956 0x80048756 0x80049556 0x8004A356 0x8004B156 0x8004BF56 0x8004CD56 0x8004DB56 0x8004E956 /end VAR_ADDRESS
 /end VAR_CHARACTERISTIC
 /begin VAR_CHARACTERISTIC SSM_S16_SSM_MIN_PRESS_SLOP EngCalVariantCriterion
  /begin VAR_ADDRESS 0x8003A766 0x8003B566 0x8003C366 0x8003D166 0x8003DF66 0x8003ED66 0x8003FB66 0x80040966 0x80041766 0x80042566 0x80043366 0x80044166 0x80044F66 0x80045D66 0x80046B66 0x80047966 0x80048766 0x80049566 0x8004A366 0x8004B166 0x8004BF66 0x8004CD66 0x8004DB66 0x8004E966 /end VAR_ADDRESS
 /end VAR_CHARACTERISTIC
 /begin VAR_CHARACTERISTIC SSM_S16_SSM_MIN_WH_SPEED EngCalVariantCriterion
  /begin VAR_ADDRESS 0x8003A780 0x8003B580 0x8003C380 0x8003D180 0x8003DF80 0x8003ED80 0x8003FB80 0x80040980 0x80041780 0x80042580 0x80043380 0x80044180 0x80044F80 0x80045D80 0x80046B80 0x80047980 0x80048780 0x80049580 0x8004A380 0x8004B180 0x8004BF80 0x8004CD80 0x8004DB80 0x8004E980 /end VAR_ADDRESS
 /end VAR_CHARACTERISTIC
 /begin VAR_CHARACTERISTIC SSM_S16_SSM_MOVING_DETECT_CYCLE EngCalVariantCriterion
  /begin VAR_ADDRESS 0x8003A782 0x8003B582 0x8003C382 0x8003D182 0x8003DF82 0x8003ED82 0x8003FB82 0x80040982 0x80041782 0x80042582 0x80043382 0x80044182 0x80044F82 0x80045D82 0x80046B82 0x80047982 0x80048782 0x80049582 0x8004A382 0x8004B182 0x8004BF82 0x8004CD82 0x8004DB82 0x8004E982 /end VAR_ADDRESS
 /end VAR_CHARACTERISTIC
 /begin VAR_CHARACTERISTIC SSM_S16_SSM_REBRAKE_DCT_THRESHOLD EngCalVariantCriterion
  /begin VAR_ADDRESS 0x8003A770 0x8003B570 0x8003C370 0x8003D170 0x8003DF70 0x8003ED70 0x8003FB70 0x80040970 0x80041770 0x80042570 0x80043370 0x80044170 0x80044F70 0x80045D70 0x80046B70 0x80047970 0x80048770 0x80049570 0x8004A370 0x8004B170 0x8004BF70 0x8004CD70 0x8004DB70 0x8004E970 /end VAR_ADDRESS
 /end VAR_CHARACTERISTIC
 /begin VAR_CHARACTERISTIC SSM_S16_SSM_SPIN_DETECTION_TH EngCalVariantCriterion
  /begin VAR_ADDRESS 0x8003A784 0x8003B584 0x8003C384 0x8003D184 0x8003DF84 0x8003ED84 0x8003FB84 0x80040984 0x80041784 0x80042584 0x80043384 0x80044184 0x80044F84 0x80045D84 0x80046B84 0x80047984 0x80048784 0x80049584 0x8004A384 0x8004B184 0x8004BF84 0x8004CD84 0x8004DB84 0x8004E984 /end VAR_ADDRESS
 /end VAR_CHARACTERISTIC
 /begin VAR_CHARACTERISTIC SSM_S16_SSM_STOP_DETECT_MAX_SPD EngCalVariantCriterion
  /begin VAR_ADDRESS 0x8003A786 0x8003B586 0x8003C386 0x8003D186 0x8003DF86 0x8003ED86 0x8003FB86 0x80040986 0x80041786 0x80042586 0x80043386 0x80044186 0x80044F86 0x80045D86 0x80046B86 0x80047986 0x80048786 0x80049586 0x8004A386 0x8004B186 0x8004BF86 0x8004CD86 0x8004DB86 0x8004E986 /end VAR_ADDRESS
 /end VAR_CHARACTERISTIC
 /begin VAR_CHARACTERISTIC SSM_S16_SSM_VV_ACT_COMP_MAX_P_SLP EngCalVariantCriterion
  /begin VAR_ADDRESS 0x8003A76C 0x8003B56C 0x8003C36C 0x8003D16C 0x8003DF6C 0x8003ED6C 0x8003FB6C 0x8004096C 0x8004176C 0x8004256C 0x8004336C 0x8004416C 0x80044F6C 0x80045D6C 0x80046B6C 0x8004796C 0x8004876C 0x8004956C 0x8004A36C 0x8004B16C 0x8004BF6C 0x8004CD6C 0x8004DB6C 0x8004E96C /end VAR_ADDRESS
 /end VAR_CHARACTERISTIC
 /begin VAR_CHARACTERISTIC SSM_S16_SSM_VV_ACT_COMP_MIN_P_SLP EngCalVariantCriterion
  /begin VAR_ADDRESS 0x8003A76A 0x8003B56A 0x8003C36A 0x8003D16A 0x8003DF6A 0x8003ED6A 0x8003FB6A 0x8004096A 0x8004176A 0x8004256A 0x8004336A 0x8004416A 0x80044F6A 0x80045D6A 0x80046B6A 0x8004796A 0x8004876A 0x8004956A 0x8004A36A 0x8004B16A 0x8004BF6A 0x8004CD6A 0x8004DB6A 0x8004E96A /end VAR_ADDRESS
 /end VAR_CHARACTERISTIC
 /begin VAR_CHARACTERISTIC SSM_S8_AVH_ACT_MAX_GRADE_DW BrkCalVariantCriterion
  /begin VAR_ADDRESS 0x80020FFA 0x800243FA 0x800277FA 0x8002ABFA 0x8002DFFA 0x800313FA 0x800347FA 0x80037BFA /end VAR_ADDRESS
 /end VAR_CHARACTERISTIC
 /begin VAR_CHARACTERISTIC SSM_S8_ISG_HSA_ON_AX_TH_GEAR_D EngCalVariantCriterion
  /begin VAR_ADDRESS 0x8003A738 0x8003B538 0x8003C338 0x8003D138 0x8003DF38 0x8003ED38 0x8003FB38 0x80040938 0x80041738 0x80042538 0x80043338 0x80044138 0x80044F38 0x80045D38 0x80046B38 0x80047938 0x80048738 0x80049538 0x8004A338 0x8004B138 0x8004BF38 0x8004CD38 0x8004DB38 0x8004E938 /end VAR_ADDRESS
 /end VAR_CHARACTERISTIC
 /begin VAR_CHARACTERISTIC SSM_U16_SSM_WHEEL_RADIUS EngCalVariantCriterion
  /begin VAR_ADDRESS 0x8003A76E 0x8003B56E 0x8003C36E 0x8003D16E 0x8003DF6E 0x8003ED6E 0x8003FB6E 0x8004096E 0x8004176E 0x8004256E 0x8004336E 0x8004416E 0x80044F6E 0x80045D6E 0x80046B6E 0x8004796E 0x8004876E 0x8004956E 0x8004A36E 0x8004B16E 0x8004BF6E 0x8004CD6E 0x8004DB6E 0x8004E96E /end VAR_ADDRESS
 /end VAR_CHARACTERISTIC
 /begin VAR_CHARACTERISTIC SSM_U8_AVH_ACT_MAX_GRADE BrkCalVariantCriterion
  /begin VAR_ADDRESS 0x80020FFB 0x800243FB 0x800277FB 0x8002ABFB 0x8002DFFB 0x800313FB 0x800347FB 0x80037BFB /end VAR_ADDRESS
 /end VAR_CHARACTERISTIC
 /begin VAR_CHARACTERISTIC SSM_U8_AVH_APPLY_TIME_1ST BrkCalVariantCriterion
  /begin VAR_ADDRESS 0x80021006 0x80024406 0x80027806 0x8002AC06 0x8002E006 0x80031406 0x80034806 0x80037C06 /end VAR_ADDRESS
 /end VAR_CHARACTERISTIC
 /begin VAR_CHARACTERISTIC SSM_U8_AVH_APPLY_TIME_1ST_MIN BrkCalVariantCriterion
  /begin VAR_ADDRESS 0x80021007 0x80024407 0x80027807 0x8002AC07 0x8002E007 0x80031407 0x80034807 0x80037C07 /end VAR_ADDRESS
 /end VAR_CHARACTERISTIC
 /begin VAR_CHARACTERISTIC SSM_U8_AVH_APPLY_TIME_2ND BrkCalVariantCriterion
  /begin VAR_ADDRESS 0x80021008 0x80024408 0x80027808 0x8002AC08 0x8002E008 0x80031408 0x80034808 0x80037C08 /end VAR_ADDRESS
 /end VAR_CHARACTERISTIC
 /begin VAR_CHARACTERISTIC SSM_U8_AVH_APPLY_TIME_2ND_MIN BrkCalVariantCriterion
  /begin VAR_ADDRESS 0x80021009 0x80024409 0x80027809 0x8002AC09 0x8002E009 0x80031409 0x80034809 0x80037C09 /end VAR_ADDRESS
 /end VAR_CHARACTERISTIC
 /begin VAR_CHARACTERISTIC SSM_U8_AVH_APPLY_TIME_3RD BrkCalVariantCriterion
  /begin VAR_ADDRESS 0x8002100A 0x8002440A 0x8002780A 0x8002AC0A 0x8002E00A 0x8003140A 0x8003480A 0x80037C0A /end VAR_ADDRESS
 /end VAR_CHARACTERISTIC
 /begin VAR_CHARACTERISTIC SSM_U8_AVH_APPLY_TIME_3RD_MIN BrkCalVariantCriterion
  /begin VAR_ADDRESS 0x8002100B 0x8002440B 0x8002780B 0x8002AC0B 0x8002E00B 0x8003140B 0x8003480B 0x80037C0B /end VAR_ADDRESS
 /end VAR_CHARACTERISTIC
 /begin VAR_CHARACTERISTIC SSM_U8_AVH_APPLY_TIME_4TH BrkCalVariantCriterion
  /begin VAR_ADDRESS 0x8002100C 0x8002440C 0x8002780C 0x8002AC0C 0x8002E00C 0x8003140C 0x8003480C 0x80037C0C /end VAR_ADDRESS
 /end VAR_CHARACTERISTIC
 /begin VAR_CHARACTERISTIC SSM_U8_AVH_APPLY_TIME_4TH_MIN BrkCalVariantCriterion
  /begin VAR_ADDRESS 0x8002100D 0x8002440D 0x8002780D 0x8002AC0D 0x8002E00D 0x8003140D 0x8003480D 0x80037C0D /end VAR_ADDRESS
 /end VAR_CHARACTERISTIC
 /begin VAR_CHARACTERISTIC SSM_U8_AVH_APPLY_TIME_5TH BrkCalVariantCriterion
  /begin VAR_ADDRESS 0x8002100E 0x8002440E 0x8002780E 0x8002AC0E 0x8002E00E 0x8003140E 0x8003480E 0x80037C0E /end VAR_ADDRESS
 /end VAR_CHARACTERISTIC
 /begin VAR_CHARACTERISTIC SSM_U8_AVH_APPLY_TIME_5TH_MIN BrkCalVariantCriterion
  /begin VAR_ADDRESS 0x8002100F 0x8002440F 0x8002780F 0x8002AC0F 0x8002E00F 0x8003140F 0x8003480F 0x80037C0F /end VAR_ADDRESS
 /end VAR_CHARACTERISTIC
 /begin VAR_CHARACTERISTIC SSM_U8_AVH_SENSITIVE_ENTER_DELAY EngCalVariantCriterion
  /begin VAR_ADDRESS 0x8003A7AC 0x8003B5AC 0x8003C3AC 0x8003D1AC 0x8003DFAC 0x8003EDAC 0x8003FBAC 0x800409AC 0x800417AC 0x800425AC 0x800433AC 0x800441AC 0x80044FAC 0x80045DAC 0x80046BAC 0x800479AC 0x800487AC 0x800495AC 0x8004A3AC 0x8004B1AC 0x8004BFAC 0x8004CDAC 0x8004DBAC 0x8004E9AC /end VAR_ADDRESS
 /end VAR_CHARACTERISTIC
 /begin VAR_CHARACTERISTIC SSM_U8_AVH_SENSITIVE_ENTER_THRES EngCalVariantCriterion
  /begin VAR_ADDRESS 0x8003A7AD 0x8003B5AD 0x8003C3AD 0x8003D1AD 0x8003DFAD 0x8003EDAD 0x8003FBAD 0x800409AD 0x800417AD 0x800425AD 0x800433AD 0x800441AD 0x80044FAD 0x80045DAD 0x80046BAD 0x800479AD 0x800487AD 0x800495AD 0x8004A3AD 0x8004B1AD 0x8004BFAD 0x8004CDAD 0x8004DBAD 0x8004E9AD /end VAR_ADDRESS
 /end VAR_CHARACTERISTIC
 /begin VAR_CHARACTERISTIC SSM_U8_AVH_SENSITIVE_ENT_HM_THRES EngCalVariantCriterion
  /begin VAR_ADDRESS 0x8003A7AE 0x8003B5AE 0x8003C3AE 0x8003D1AE 0x8003DFAE 0x8003EDAE 0x8003FBAE 0x800409AE 0x800417AE 0x800425AE 0x800433AE 0x800441AE 0x80044FAE 0x80045DAE 0x80046BAE 0x800479AE 0x800487AE 0x800495AE 0x8004A3AE 0x8004B1AE 0x8004BFAE 0x8004CDAE 0x8004DBAE 0x8004E9AE /end VAR_ADDRESS
 /end VAR_CHARACTERISTIC
 /begin VAR_CHARACTERISTIC SSM_U8_AVH_SENSITIVE_ENT_LM_THRES EngCalVariantCriterion
  /begin VAR_ADDRESS 0x8003A7AF 0x8003B5AF 0x8003C3AF 0x8003D1AF 0x8003DFAF 0x8003EDAF 0x8003FBAF 0x800409AF 0x800417AF 0x800425AF 0x800433AF 0x800441AF 0x80044FAF 0x80045DAF 0x80046BAF 0x800479AF 0x800487AF 0x800495AF 0x8004A3AF 0x8004B1AF 0x8004BFAF 0x8004CDAF 0x8004DBAF 0x8004E9AF /end VAR_ADDRESS
 /end VAR_CHARACTERISTIC
 /begin VAR_CHARACTERISTIC SSM_U8_AVH_SENSITIVE_ENT_MAX_THRES EngCalVariantCriterion
  /begin VAR_ADDRESS 0x8003A7B0 0x8003B5B0 0x8003C3B0 0x8003D1B0 0x8003DFB0 0x8003EDB0 0x8003FBB0 0x800409B0 0x800417B0 0x800425B0 0x800433B0 0x800441B0 0x80044FB0 0x80045DB0 0x80046BB0 0x800479B0 0x800487B0 0x800495B0 0x8004A3B0 0x8004B1B0 0x8004BFB0 0x8004CDB0 0x8004DBB0 0x8004E9B0 /end VAR_ADDRESS
 /end VAR_CHARACTERISTIC
 /begin VAR_CHARACTERISTIC SSM_U8_EPB_TPS_Dect_Max_Speed_Threshold_H EngCalVariantCriterion
  /begin VAR_ADDRESS 0x8003A7F8 0x8003B5F8 0x8003C3F8 0x8003D1F8 0x8003DFF8 0x8003EDF8 0x8003FBF8 0x800409F8 0x800417F8 0x800425F8 0x800433F8 0x800441F8 0x80044FF8 0x80045DF8 0x80046BF8 0x800479F8 0x800487F8 0x800495F8 0x8004A3F8 0x8004B1F8 0x8004BFF8 0x8004CDF8 0x8004DBF8 0x8004E9F8 /end VAR_ADDRESS
 /end VAR_CHARACTERISTIC
 /begin VAR_CHARACTERISTIC SSM_U8_EPB_TPS_Dect_Max_Speed_Threshold_L EngCalVariantCriterion
  /begin VAR_ADDRESS 0x8003A7F9 0x8003B5F9 0x8003C3F9 0x8003D1F9 0x8003DFF9 0x8003EDF9 0x8003FBF9 0x800409F9 0x800417F9 0x800425F9 0x800433F9 0x800441F9 0x80044FF9 0x80045DF9 0x80046BF9 0x800479F9 0x800487F9 0x800495F9 0x8004A3F9 0x8004B1F9 0x8004BFF9 0x8004CDF9 0x8004DBF9 0x8004E9F9 /end VAR_ADDRESS
 /end VAR_CHARACTERISTIC
 /begin VAR_CHARACTERISTIC SSM_U8_HSA_AutoStart_delay_time EngCalVariantCriterion
  /begin VAR_ADDRESS 0x8003A73B 0x8003B53B 0x8003C33B 0x8003D13B 0x8003DF3B 0x8003ED3B 0x8003FB3B 0x8004093B 0x8004173B 0x8004253B 0x8004333B 0x8004413B 0x80044F3B 0x80045D3B 0x80046B3B 0x8004793B 0x8004873B 0x8004953B 0x8004A33B 0x8004B13B 0x8004BF3B 0x8004CD3B 0x8004DB3B 0x8004E93B /end VAR_ADDRESS
 /end VAR_CHARACTERISTIC
 /begin VAR_CHARACTERISTIC SSM_U8_HSA_DCT_OVERLOAD_RISE_NUM EngCalVariantCriterion
  /begin VAR_ADDRESS 0x8003A718 0x8003B518 0x8003C318 0x8003D118 0x8003DF18 0x8003ED18 0x8003FB18 0x80040918 0x80041718 0x80042518 0x80043318 0x80044118 0x80044F18 0x80045D18 0x80046B18 0x80047918 0x80048718 0x80049518 0x8004A318 0x8004B118 0x8004BF18 0x8004CD18 0x8004DB18 0x8004E918 /end VAR_ADDRESS
 /end VAR_CHARACTERISTIC
 /begin VAR_CHARACTERISTIC SSM_U8_HSA_Disable EngCalVariantCriterion
  /begin VAR_ADDRESS 0x8003A70E 0x8003B50E 0x8003C30E 0x8003D10E 0x8003DF0E 0x8003ED0E 0x8003FB0E 0x8004090E 0x8004170E 0x8004250E 0x8004330E 0x8004410E 0x80044F0E 0x80045D0E 0x80046B0E 0x8004790E 0x8004870E 0x8004950E 0x8004A30E 0x8004B10E 0x8004BF0E 0x8004CD0E 0x8004DB0E 0x8004E90E /end VAR_ADDRESS
 /end VAR_CHARACTERISTIC
 /begin VAR_CHARACTERISTIC SSM_U8_HSA_FAST_EXIT_MTP_TH EngCalVariantCriterion
  /begin VAR_ADDRESS 0x8003A6FB 0x8003B4FB 0x8003C2FB 0x8003D0FB 0x8003DEFB 0x8003ECFB 0x8003FAFB 0x800408FB 0x800416FB 0x800424FB 0x800432FB 0x800440FB 0x80044EFB 0x80045CFB 0x80046AFB 0x800478FB 0x800486FB 0x800494FB 0x8004A2FB 0x8004B0FB 0x8004BEFB 0x8004CCFB 0x8004DAFB 0x8004E8FB /end VAR_ADDRESS
 /end VAR_CHARACTERISTIC
 /begin VAR_CHARACTERISTIC SSM_U8_HSA_HOLDTIME_HIGHMED_HILL EngCalVariantCriterion
  /begin VAR_ADDRESS 0x8003A6F1 0x8003B4F1 0x8003C2F1 0x8003D0F1 0x8003DEF1 0x8003ECF1 0x8003FAF1 0x800408F1 0x800416F1 0x800424F1 0x800432F1 0x800440F1 0x80044EF1 0x80045CF1 0x80046AF1 0x800478F1 0x800486F1 0x800494F1 0x8004A2F1 0x8004B0F1 0x8004BEF1 0x8004CCF1 0x8004DAF1 0x8004E8F1 /end VAR_ADDRESS
 /end VAR_CHARACTERISTIC
 /begin VAR_CHARACTERISTIC SSM_U8_HSA_HOLDTIME_LOWMED_HILL EngCalVariantCriterion
  /begin VAR_ADDRESS 0x8003A6F2 0x8003B4F2 0x8003C2F2 0x8003D0F2 0x8003DEF2 0x8003ECF2 0x8003FAF2 0x800408F2 0x800416F2 0x800424F2 0x800432F2 0x800440F2 0x80044EF2 0x80045CF2 0x80046AF2 0x800478F2 0x800486F2 0x800494F2 0x8004A2F2 0x8004B0F2 0x8004BEF2 0x8004CCF2 0x8004DAF2 0x8004E8F2 /end VAR_ADDRESS
 /end VAR_CHARACTERISTIC
 /begin VAR_CHARACTERISTIC SSM_U8_HSA_HighMedLongG EngCalVariantCriterion
  /begin VAR_ADDRESS 0x8003A6FC 0x8003B4FC 0x8003C2FC 0x8003D0FC 0x8003DEFC 0x8003ECFC 0x8003FAFC 0x800408FC 0x800416FC 0x800424FC 0x800432FC 0x800440FC 0x80044EFC 0x80045CFC 0x80046AFC 0x800478FC 0x800486FC 0x800494FC 0x8004A2FC 0x8004B0FC 0x8004BEFC 0x8004CCFC 0x8004DAFC 0x8004E8FC /end VAR_ADDRESS
 /end VAR_CHARACTERISTIC
 /begin VAR_CHARACTERISTIC SSM_U8_HSA_INDICATION_ON_AX_TH EngCalVariantCriterion
  /begin VAR_ADDRESS 0x8003A719 0x8003B519 0x8003C319 0x8003D119 0x8003DF19 0x8003ED19 0x8003FB19 0x80040919 0x80041719 0x80042519 0x80043319 0x80044119 0x80044F19 0x80045D19 0x80046B19 0x80047919 0x80048719 0x80049519 0x8004A319 0x8004B119 0x8004BF19 0x8004CD19 0x8004DB19 0x8004E919 /end VAR_ADDRESS
 /end VAR_CHARACTERISTIC
 /begin VAR_CHARACTERISTIC SSM_U8_HSA_LowMedLongG EngCalVariantCriterion
  /begin VAR_ADDRESS 0x8003A6FD 0x8003B4FD 0x8003C2FD 0x8003D0FD 0x8003DEFD 0x8003ECFD 0x8003FAFD 0x800408FD 0x800416FD 0x800424FD 0x800432FD 0x800440FD 0x80044EFD 0x80045CFD 0x80046AFD 0x800478FD 0x800486FD 0x800494FD 0x8004A2FD 0x8004B0FD 0x8004BEFD 0x8004CCFD 0x8004DAFD 0x8004E8FD /end VAR_ADDRESS
 /end VAR_CHARACTERISTIC
 /begin VAR_CHARACTERISTIC SSM_U8_HSA_MAX_HOLDTIME_1 EngCalVariantCriterion
  /begin VAR_ADDRESS 0x8003A6F3 0x8003B4F3 0x8003C2F3 0x8003D0F3 0x8003DEF3 0x8003ECF3 0x8003FAF3 0x800408F3 0x800416F3 0x800424F3 0x800432F3 0x800440F3 0x80044EF3 0x80045CF3 0x80046AF3 0x800478F3 0x800486F3 0x800494F3 0x8004A2F3 0x8004B0F3 0x8004BEF3 0x8004CCF3 0x8004DAF3 0x8004E8F3 /end VAR_ADDRESS
 /end VAR_CHARACTERISTIC
 /begin VAR_CHARACTERISTIC SSM_U8_HSA_MAX_HOLDTIME_2 EngCalVariantCriterion
  /begin VAR_ADDRESS 0x8003A6F4 0x8003B4F4 0x8003C2F4 0x8003D0F4 0x8003DEF4 0x8003ECF4 0x8003FAF4 0x800408F4 0x800416F4 0x800424F4 0x800432F4 0x800440F4 0x80044EF4 0x80045CF4 0x80046AF4 0x800478F4 0x800486F4 0x800494F4 0x8004A2F4 0x8004B0F4 0x8004BEF4 0x8004CCF4 0x8004DAF4 0x8004E8F4 /end VAR_ADDRESS
 /end VAR_CHARACTERISTIC
 /begin VAR_CHARACTERISTIC SSM_U8_HSA_MAX_HOLDTIME_3 EngCalVariantCriterion
  /begin VAR_ADDRESS 0x8003A6F5 0x8003B4F5 0x8003C2F5 0x8003D0F5 0x8003DEF5 0x8003ECF5 0x8003FAF5 0x800408F5 0x800416F5 0x800424F5 0x800432F5 0x800440F5 0x80044EF5 0x80045CF5 0x80046AF5 0x800478F5 0x800486F5 0x800494F5 0x8004A2F5 0x8004B0F5 0x8004BEF5 0x8004CCF5 0x8004DAF5 0x8004E8F5 /end VAR_ADDRESS
 /end VAR_CHARACTERISTIC
 /begin VAR_CHARACTERISTIC SSM_U8_HSA_MAX_HOLDTIME_4 EngCalVariantCriterion
  /begin VAR_ADDRESS 0x8003A6F6 0x8003B4F6 0x8003C2F6 0x8003D0F6 0x8003DEF6 0x8003ECF6 0x8003FAF6 0x800408F6 0x800416F6 0x800424F6 0x800432F6 0x800440F6 0x80044EF6 0x80045CF6 0x80046AF6 0x800478F6 0x800486F6 0x800494F6 0x8004A2F6 0x8004B0F6 0x8004BEF6 0x8004CCF6 0x8004DAF6 0x8004E8F6 /end VAR_ADDRESS
 /end VAR_CHARACTERISTIC
 /begin VAR_CHARACTERISTIC SSM_U8_HSA_MAX_HOLDTIME_RVS_1 EngCalVariantCriterion
  /begin VAR_ADDRESS 0x8003A6F7 0x8003B4F7 0x8003C2F7 0x8003D0F7 0x8003DEF7 0x8003ECF7 0x8003FAF7 0x800408F7 0x800416F7 0x800424F7 0x800432F7 0x800440F7 0x80044EF7 0x80045CF7 0x80046AF7 0x800478F7 0x800486F7 0x800494F7 0x8004A2F7 0x8004B0F7 0x8004BEF7 0x8004CCF7 0x8004DAF7 0x8004E8F7 /end VAR_ADDRESS
 /end VAR_CHARACTERISTIC
 /begin VAR_CHARACTERISTIC SSM_U8_HSA_MAX_HOLDTIME_RVS_2 EngCalVariantCriterion
  /begin VAR_ADDRESS 0x8003A6F8 0x8003B4F8 0x8003C2F8 0x8003D0F8 0x8003DEF8 0x8003ECF8 0x8003FAF8 0x800408F8 0x800416F8 0x800424F8 0x800432F8 0x800440F8 0x80044EF8 0x80045CF8 0x80046AF8 0x800478F8 0x800486F8 0x800494F8 0x8004A2F8 0x8004B0F8 0x8004BEF8 0x8004CCF8 0x8004DAF8 0x8004E8F8 /end VAR_ADDRESS
 /end VAR_CHARACTERISTIC
 /begin VAR_CHARACTERISTIC SSM_U8_HSA_MAX_HOLDTIME_RVS_3 EngCalVariantCriterion
  /begin VAR_ADDRESS 0x8003A6F9 0x8003B4F9 0x8003C2F9 0x8003D0F9 0x8003DEF9 0x8003ECF9 0x8003FAF9 0x800408F9 0x800416F9 0x800424F9 0x800432F9 0x800440F9 0x80044EF9 0x80045CF9 0x80046AF9 0x800478F9 0x800486F9 0x800494F9 0x8004A2F9 0x8004B0F9 0x8004BEF9 0x8004CCF9 0x8004DAF9 0x8004E8F9 /end VAR_ADDRESS
 /end VAR_CHARACTERISTIC
 /begin VAR_CHARACTERISTIC SSM_U8_HSA_MAX_HOLDTIME_RVS_4 EngCalVariantCriterion
  /begin VAR_ADDRESS 0x8003A6FA 0x8003B4FA 0x8003C2FA 0x8003D0FA 0x8003DEFA 0x8003ECFA 0x8003FAFA 0x800408FA 0x800416FA 0x800424FA 0x800432FA 0x800440FA 0x80044EFA 0x80045CFA 0x80046AFA 0x800478FA 0x800486FA 0x800494FA 0x8004A2FA 0x8004B0FA 0x8004BEFA 0x8004CCFA 0x8004DAFA 0x8004E8FA /end VAR_ADDRESS
 /end VAR_CHARACTERISTIC
 /begin VAR_CHARACTERISTIC SSM_U8_HSA_ONHILL_SET_REF_AX_OK_T EngCalVariantCriterion
  /begin VAR_ADDRESS 0x8003A71A 0x8003B51A 0x8003C31A 0x8003D11A 0x8003DF1A 0x8003ED1A 0x8003FB1A 0x8004091A 0x8004171A 0x8004251A 0x8004331A 0x8004411A 0x80044F1A 0x80045D1A 0x80046B1A 0x8004791A 0x8004871A 0x8004951A 0x8004A31A 0x8004B11A 0x8004BF1A 0x8004CD1A 0x8004DB1A 0x8004E91A /end VAR_ADDRESS
 /end VAR_CHARACTERISTIC
 /begin VAR_CHARACTERISTIC SSM_U8_HSA_RELEASE_TIME_DEFAULT EngCalVariantCriterion
  /begin VAR_ADDRESS 0x8003A701 0x8003B501 0x8003C301 0x8003D101 0x8003DF01 0x8003ED01 0x8003FB01 0x80040901 0x80041701 0x80042501 0x80043301 0x80044101 0x80044F01 0x80045D01 0x80046B01 0x80047901 0x80048701 0x80049501 0x8004A301 0x8004B101 0x8004BF01 0x8004CD01 0x8004DB01 0x8004E901 /end VAR_ADDRESS
 /end VAR_CHARACTERISTIC
 /begin VAR_CHARACTERISTIC SSM_U8_HSA_RELEASE_TIME_NOT_HILL EngCalVariantCriterion
  /begin VAR_ADDRESS 0x8003A6FE 0x8003B4FE 0x8003C2FE 0x8003D0FE 0x8003DEFE 0x8003ECFE 0x8003FAFE 0x800408FE 0x800416FE 0x800424FE 0x800432FE 0x800440FE 0x80044EFE 0x80045CFE 0x80046AFE 0x800478FE 0x800486FE 0x800494FE 0x8004A2FE 0x8004B0FE 0x8004BEFE 0x8004CCFE 0x8004DAFE 0x8004E8FE /end VAR_ADDRESS
 /end VAR_CHARACTERISTIC
 /begin VAR_CHARACTERISTIC SSM_U8_HSA_RELEASE_TIME_PB_ACTIVE EngCalVariantCriterion
  /begin VAR_ADDRESS 0x8003A6FF 0x8003B4FF 0x8003C2FF 0x8003D0FF 0x8003DEFF 0x8003ECFF 0x8003FAFF 0x800408FF 0x800416FF 0x800424FF 0x800432FF 0x800440FF 0x80044EFF 0x80045CFF 0x80046AFF 0x800478FF 0x800486FF 0x800494FF 0x8004A2FF 0x8004B0FF 0x8004BEFF 0x8004CCFF 0x8004DAFF 0x8004E8FF /end VAR_ADDRESS
 /end VAR_CHARACTERISTIC
 /begin VAR_CHARACTERISTIC SSM_U8_HSA_RELEASE_TIME_UNLATCHED EngCalVariantCriterion
  /begin VAR_ADDRESS 0x8003A700 0x8003B500 0x8003C300 0x8003D100 0x8003DF00 0x8003ED00 0x8003FB00 0x80040900 0x80041700 0x80042500 0x80043300 0x80044100 0x80044F00 0x80045D00 0x80046B00 0x80047900 0x80048700 0x80049500 0x8004A300 0x8004B100 0x8004BF00 0x8004CD00 0x8004DB00 0x8004E900 /end VAR_ADDRESS
 /end VAR_CHARACTERISTIC
 /begin VAR_CHARACTERISTIC SSM_U8_HSA_RISE_ENABLE EngCalVariantCriterion
  /begin VAR_ADDRESS 0x8003A70F 0x8003B50F 0x8003C30F 0x8003D10F 0x8003DF0F 0x8003ED0F 0x8003FB0F 0x8004090F 0x8004170F 0x8004250F 0x8004330F 0x8004410F 0x80044F0F 0x80045D0F 0x80046B0F 0x8004790F 0x8004870F 0x8004950F 0x8004A30F 0x8004B10F 0x8004BF0F 0x8004CD0F 0x8004DB0F 0x8004E90F /end VAR_ADDRESS
 /end VAR_CHARACTERISTIC
 /begin VAR_CHARACTERISTIC SSM_U8_HSA_RISE_NUM_OF_WL EngCalVariantCriterion
  /begin VAR_ADDRESS 0x8003A712 0x8003B512 0x8003C312 0x8003D112 0x8003DF12 0x8003ED12 0x8003FB12 0x80040912 0x80041712 0x80042512 0x80043312 0x80044112 0x80044F12 0x80045D12 0x80046B12 0x80047912 0x80048712 0x80049512 0x8004A312 0x8004B112 0x8004BF12 0x8004CD12 0x8004DB12 0x8004E912 /end VAR_ADDRESS
 /end VAR_CHARACTERISTIC
 /begin VAR_CHARACTERISTIC SSM_U8_HSA_TEMP_3 EngCalVariantCriterion
  /begin VAR_ADDRESS 0x8003A720 0x8003B520 0x8003C320 0x8003D120 0x8003DF20 0x8003ED20 0x8003FB20 0x80040920 0x80041720 0x80042520 0x80043320 0x80044120 0x80044F20 0x80045D20 0x80046B20 0x80047920 0x80048720 0x80049520 0x8004A320 0x8004B120 0x8004BF20 0x8004CD20 0x8004DB20 0x8004E920 /end VAR_ADDRESS
 /end VAR_CHARACTERISTIC
 /begin VAR_CHARACTERISTIC SSM_U8_ISG_End_RPM_OK_delay_time EngCalVariantCriterion
  /begin VAR_ADDRESS 0x8003A739 0x8003B539 0x8003C339 0x8003D139 0x8003DF39 0x8003ED39 0x8003FB39 0x80040939 0x80041739 0x80042539 0x80043339 0x80044139 0x80044F39 0x80045D39 0x80046B39 0x80047939 0x80048739 0x80049539 0x8004A339 0x8004B139 0x8004BF39 0x8004CD39 0x8004DB39 0x8004E939 /end VAR_ADDRESS
 /end VAR_CHARACTERISTIC
 /begin VAR_CHARACTERISTIC SSM_U8_ISG_ON_MAX_SLOP_HOLD_PRESS EngCalVariantCriterion
  /begin VAR_ADDRESS 0x8003A73A 0x8003B53A 0x8003C33A 0x8003D13A 0x8003DF3A 0x8003ED3A 0x8003FB3A 0x8004093A 0x8004173A 0x8004253A 0x8004333A 0x8004413A 0x80044F3A 0x80045D3A 0x80046B3A 0x8004793A 0x8004873A 0x8004953A 0x8004A33A 0x8004B13A 0x8004BF3A 0x8004CD3A 0x8004DB3A 0x8004E93A /end VAR_ADDRESS
 /end VAR_CHARACTERISTIC
 /begin VAR_CHARACTERISTIC SSM_U8_MAX_ROLL_RISE_ATTEMPT BrkCalVariantCriterion
  /begin VAR_ADDRESS 0x80020FE6 0x800243E6 0x800277E6 0x8002ABE6 0x8002DFE6 0x800313E6 0x800347E6 0x80037BE6 /end VAR_ADDRESS
 /end VAR_CHARACTERISTIC
 /begin VAR_CHARACTERISTIC SSM_U8_MPlessHSA_ENTER_SPD_OK_TIME EngCalVariantCriterion
  /begin VAR_ADDRESS 0x8003A6F0 0x8003B4F0 0x8003C2F0 0x8003D0F0 0x8003DEF0 0x8003ECF0 0x8003FAF0 0x800408F0 0x800416F0 0x800424F0 0x800432F0 0x800440F0 0x80044EF0 0x80045CF0 0x80046AF0 0x800478F0 0x800486F0 0x800494F0 0x8004A2F0 0x8004B0F0 0x8004BEF0 0x8004CCF0 0x8004DAF0 0x8004E8F0 /end VAR_ADDRESS
 /end VAR_CHARACTERISTIC
 /begin VAR_CHARACTERISTIC SSM_U8_ROLL_RISE_TIME BrkCalVariantCriterion
  /begin VAR_ADDRESS 0x80020FE7 0x800243E7 0x800277E7 0x8002ABE7 0x8002DFE7 0x800313E7 0x800347E7 0x80037BE7 /end VAR_ADDRESS
 /end VAR_CHARACTERISTIC
 /begin VAR_CHARACTERISTIC SSM_U8_SSM_AT_PARK_GEAR_DELAY_TIME EngCalVariantCriterion
  /begin VAR_ADDRESS 0x8003A77E 0x8003B57E 0x8003C37E 0x8003D17E 0x8003DF7E 0x8003ED7E 0x8003FB7E 0x8004097E 0x8004177E 0x8004257E 0x8004337E 0x8004417E 0x80044F7E 0x80045D7E 0x80046B7E 0x8004797E 0x8004877E 0x8004957E 0x8004A37E 0x8004B17E 0x8004BF7E 0x8004CD7E 0x8004DB7E 0x8004E97E /end VAR_ADDRESS
 /end VAR_CHARACTERISTIC
 /begin VAR_CHARACTERISTIC SSM_U8_SSM_AX_AVG_VALID_TH_LOW_DIF EngCalVariantCriterion
  /begin VAR_ADDRESS 0x8003A778 0x8003B578 0x8003C378 0x8003D178 0x8003DF78 0x8003ED78 0x8003FB78 0x80040978 0x80041778 0x80042578 0x80043378 0x80044178 0x80044F78 0x80045D78 0x80046B78 0x80047978 0x80048778 0x80049578 0x8004A378 0x8004B178 0x8004BF78 0x8004CD78 0x8004DB78 0x8004E978 /end VAR_ADDRESS
 /end VAR_CHARACTERISTIC
 /begin VAR_CHARACTERISTIC SSM_U8_SSM_AX_AVG_VALID_TH_MAX_DIF EngCalVariantCriterion
  /begin VAR_ADDRESS 0x8003A77A 0x8003B57A 0x8003C37A 0x8003D17A 0x8003DF7A 0x8003ED7A 0x8003FB7A 0x8004097A 0x8004177A 0x8004257A 0x8004337A 0x8004417A 0x80044F7A 0x80045D7A 0x80046B7A 0x8004797A 0x8004877A 0x8004957A 0x8004A37A 0x8004B17A 0x8004BF7A 0x8004CD7A 0x8004DB7A 0x8004E97A /end VAR_ADDRESS
 /end VAR_CHARACTERISTIC
 /begin VAR_CHARACTERISTIC SSM_U8_SSM_AX_AVG_VALID_TH_MID_DIF EngCalVariantCriterion
  /begin VAR_ADDRESS 0x8003A779 0x8003B579 0x8003C379 0x8003D179 0x8003DF79 0x8003ED79 0x8003FB79 0x80040979 0x80041779 0x80042579 0x80043379 0x80044179 0x80044F79 0x80045D79 0x80046B79 0x80047979 0x80048779 0x80049579 0x8004A379 0x8004B179 0x8004BF79 0x8004CD79 0x8004DB79 0x8004E979 /end VAR_ADDRESS
 /end VAR_CHARACTERISTIC
 /begin VAR_CHARACTERISTIC SSM_U8_SSM_AX_IGNORE_TIME_TM_SHIFT EngCalVariantCriterion
  /begin VAR_ADDRESS 0x8003A77F 0x8003B57F 0x8003C37F 0x8003D17F 0x8003DF7F 0x8003ED7F 0x8003FB7F 0x8004097F 0x8004177F 0x8004257F 0x8004337F 0x8004417F 0x80044F7F 0x80045D7F 0x80046B7F 0x8004797F 0x8004877F 0x8004957F 0x8004A37F 0x8004B17F 0x8004BF7F 0x8004CD7F 0x8004DB7F 0x8004E97F /end VAR_ADDRESS
 /end VAR_CHARACTERISTIC
 /begin VAR_CHARACTERISTIC SSM_U8_SSM_CALC_MIN_PRESS_METHOD EngCalVariantCriterion
  /begin VAR_ADDRESS 0x8003A764 0x8003B564 0x8003C364 0x8003D164 0x8003DF64 0x8003ED64 0x8003FB64 0x80040964 0x80041764 0x80042564 0x80043364 0x80044164 0x80044F64 0x80045D64 0x80046B64 0x80047964 0x80048764 0x80049564 0x8004A364 0x8004B164 0x8004BF64 0x8004CD64 0x8004DB64 0x8004E964 /end VAR_ADDRESS
 /end VAR_CHARACTERISTIC
 /begin VAR_CHARACTERISTIC SSM_U8_SSM_DLY_ROLL_DET_TIME EngCalVariantCriterion
  /begin VAR_ADDRESS 0x8003A788 0x8003B588 0x8003C388 0x8003D188 0x8003DF88 0x8003ED88 0x8003FB88 0x80040988 0x80041788 0x80042588 0x80043388 0x80044188 0x80044F88 0x80045D88 0x80046B88 0x80047988 0x80048788 0x80049588 0x8004A388 0x8004B188 0x8004BF88 0x8004CD88 0x8004DB88 0x8004E988 /end VAR_ADDRESS
 /end VAR_CHARACTERISTIC
 /begin VAR_CHARACTERISTIC SSM_U8_SSM_EXIT_DRV_TQ_GAIN EngCalVariantCriterion
  /begin VAR_ADDRESS 0x8003A78E 0x8003B58E 0x8003C38E 0x8003D18E 0x8003DF8E 0x8003ED8E 0x8003FB8E 0x8004098E 0x8004178E 0x8004258E 0x8004338E 0x8004418E 0x80044F8E 0x80045D8E 0x80046B8E 0x8004798E 0x8004878E 0x8004958E 0x8004A38E 0x8004B18E 0x8004BF8E 0x8004CD8E 0x8004DB8E 0x8004E98E /end VAR_ADDRESS
 /end VAR_CHARACTERISTIC
 /begin VAR_CHARACTERISTIC SSM_U8_SSM_HIGH_MID_SLOP EngCalVariantCriterion
  /begin VAR_ADDRESS 0x8003A7A1 0x8003B5A1 0x8003C3A1 0x8003D1A1 0x8003DFA1 0x8003EDA1 0x8003FBA1 0x800409A1 0x800417A1 0x800425A1 0x800433A1 0x800441A1 0x80044FA1 0x80045DA1 0x80046BA1 0x800479A1 0x800487A1 0x800495A1 0x8004A3A1 0x8004B1A1 0x8004BFA1 0x8004CDA1 0x8004DBA1 0x8004E9A1 /end VAR_ADDRESS
 /end VAR_CHARACTERISTIC
 /begin VAR_CHARACTERISTIC SSM_U8_SSM_H_M_ACC_POSITION EngCalVariantCriterion
  /begin VAR_ADDRESS 0x8003A795 0x8003B595 0x8003C395 0x8003D195 0x8003DF95 0x8003ED95 0x8003FB95 0x80040995 0x80041795 0x80042595 0x80043395 0x80044195 0x80044F95 0x80045D95 0x80046B95 0x80047995 0x80048795 0x80049595 0x8004A395 0x8004B195 0x8004BF95 0x8004CD95 0x8004DB95 0x8004E995 /end VAR_ADDRESS
 /end VAR_CHARACTERISTIC
 /begin VAR_CHARACTERISTIC SSM_U8_SSM_H_M_ACC_RELS_TIME_DWN EngCalVariantCriterion
  /begin VAR_ADDRESS 0x8003A799 0x8003B599 0x8003C399 0x8003D199 0x8003DF99 0x8003ED99 0x8003FB99 0x80040999 0x80041799 0x80042599 0x80043399 0x80044199 0x80044F99 0x80045D99 0x80046B99 0x80047999 0x80048799 0x80049599 0x8004A399 0x8004B199 0x8004BF99 0x8004CD99 0x8004DB99 0x8004E999 /end VAR_ADDRESS
 /end VAR_CHARACTERISTIC
 /begin VAR_CHARACTERISTIC SSM_U8_SSM_H_M_ACC_RELS_TIME_UP EngCalVariantCriterion
  /begin VAR_ADDRESS 0x8003A79D 0x8003B59D 0x8003C39D 0x8003D19D 0x8003DF9D 0x8003ED9D 0x8003FB9D 0x8004099D 0x8004179D 0x8004259D 0x8004339D 0x8004419D 0x80044F9D 0x80045D9D 0x80046B9D 0x8004799D 0x8004879D 0x8004959D 0x8004A39D 0x8004B19D 0x8004BF9D 0x8004CD9D 0x8004DB9D 0x8004E99D /end VAR_ADDRESS
 /end VAR_CHARACTERISTIC
 /begin VAR_CHARACTERISTIC SSM_U8_SSM_H_M_SLOP_RELEASE_TIME EngCalVariantCriterion
  /begin VAR_ADDRESS 0x8003A791 0x8003B591 0x8003C391 0x8003D191 0x8003DF91 0x8003ED91 0x8003FB91 0x80040991 0x80041791 0x80042591 0x80043391 0x80044191 0x80044F91 0x80045D91 0x80046B91 0x80047991 0x80048791 0x80049591 0x8004A391 0x8004B191 0x8004BF91 0x8004CD91 0x8004DB91 0x8004E991 /end VAR_ADDRESS
 /end VAR_CHARACTERISTIC
 /begin VAR_CHARACTERISTIC SSM_U8_SSM_LOW_MID_SLOP EngCalVariantCriterion
  /begin VAR_ADDRESS 0x8003A7A0 0x8003B5A0 0x8003C3A0 0x8003D1A0 0x8003DFA0 0x8003EDA0 0x8003FBA0 0x800409A0 0x800417A0 0x800425A0 0x800433A0 0x800441A0 0x80044FA0 0x80045DA0 0x80046BA0 0x800479A0 0x800487A0 0x800495A0 0x8004A3A0 0x8004B1A0 0x8004BFA0 0x8004CDA0 0x8004DBA0 0x8004E9A0 /end VAR_ADDRESS
 /end VAR_CHARACTERISTIC
 /begin VAR_CHARACTERISTIC SSM_U8_SSM_L_M_ACC_POSITION EngCalVariantCriterion
  /begin VAR_ADDRESS 0x8003A794 0x8003B594 0x8003C394 0x8003D194 0x8003DF94 0x8003ED94 0x8003FB94 0x80040994 0x80041794 0x80042594 0x80043394 0x80044194 0x80044F94 0x80045D94 0x80046B94 0x80047994 0x80048794 0x80049594 0x8004A394 0x8004B194 0x8004BF94 0x8004CD94 0x8004DB94 0x8004E994 /end VAR_ADDRESS
 /end VAR_CHARACTERISTIC
 /begin VAR_CHARACTERISTIC SSM_U8_SSM_L_M_ACC_RELS_TIME_DWN EngCalVariantCriterion
  /begin VAR_ADDRESS 0x8003A798 0x8003B598 0x8003C398 0x8003D198 0x8003DF98 0x8003ED98 0x8003FB98 0x80040998 0x80041798 0x80042598 0x80043398 0x80044198 0x80044F98 0x80045D98 0x80046B98 0x80047998 0x80048798 0x80049598 0x8004A398 0x8004B198 0x8004BF98 0x8004CD98 0x8004DB98 0x8004E998 /end VAR_ADDRESS
 /end VAR_CHARACTERISTIC
 /begin VAR_CHARACTERISTIC SSM_U8_SSM_L_M_ACC_RELS_TIME_UP EngCalVariantCriterion
  /begin VAR_ADDRESS 0x8003A79C 0x8003B59C 0x8003C39C 0x8003D19C 0x8003DF9C 0x8003ED9C 0x8003FB9C 0x8004099C 0x8004179C 0x8004259C 0x8004339C 0x8004419C 0x80044F9C 0x80045D9C 0x80046B9C 0x8004799C 0x8004879C 0x8004959C 0x8004A39C 0x8004B19C 0x8004BF9C 0x8004CD9C 0x8004DB9C 0x8004E99C /end VAR_ADDRESS
 /end VAR_CHARACTERISTIC
 /begin VAR_CHARACTERISTIC SSM_U8_SSM_L_M_SLOP_RELEASE_TIME EngCalVariantCriterion
  /begin VAR_ADDRESS 0x8003A790 0x8003B590 0x8003C390 0x8003D190 0x8003DF90 0x8003ED90 0x8003FB90 0x80040990 0x80041790 0x80042590 0x80043390 0x80044190 0x80044F90 0x80045D90 0x80046B90 0x80047990 0x80048790 0x80049590 0x8004A390 0x8004B190 0x8004BF90 0x8004CD90 0x8004DB90 0x8004E990 /end VAR_ADDRESS
 /end VAR_CHARACTERISTIC
 /begin VAR_CHARACTERISTIC SSM_U8_SSM_MAX_ACC_POSITION EngCalVariantCriterion
  /begin VAR_ADDRESS 0x8003A796 0x8003B596 0x8003C396 0x8003D196 0x8003DF96 0x8003ED96 0x8003FB96 0x80040996 0x80041796 0x80042596 0x80043396 0x80044196 0x80044F96 0x80045D96 0x80046B96 0x80047996 0x80048796 0x80049596 0x8004A396 0x8004B196 0x8004BF96 0x8004CD96 0x8004DB96 0x8004E996 /end VAR_ADDRESS
 /end VAR_CHARACTERISTIC
 /begin VAR_CHARACTERISTIC SSM_U8_SSM_MAX_ACC_RELS_TIME_DWN EngCalVariantCriterion
  /begin VAR_ADDRESS 0x8003A79A 0x8003B59A 0x8003C39A 0x8003D19A 0x8003DF9A 0x8003ED9A 0x8003FB9A 0x8004099A 0x8004179A 0x8004259A 0x8004339A 0x8004419A 0x80044F9A 0x80045D9A 0x80046B9A 0x8004799A 0x8004879A 0x8004959A 0x8004A39A 0x8004B19A 0x8004BF9A 0x8004CD9A 0x8004DB9A 0x8004E99A /end VAR_ADDRESS
 /end VAR_CHARACTERISTIC
 /begin VAR_CHARACTERISTIC SSM_U8_SSM_MAX_ACC_RELS_TIME_UP EngCalVariantCriterion
  /begin VAR_ADDRESS 0x8003A79E 0x8003B59E 0x8003C39E 0x8003D19E 0x8003DF9E 0x8003ED9E 0x8003FB9E 0x8004099E 0x8004179E 0x8004259E 0x8004339E 0x8004419E 0x80044F9E 0x80045D9E 0x80046B9E 0x8004799E 0x8004879E 0x8004959E 0x8004A39E 0x8004B19E 0x8004BF9E 0x8004CD9E 0x8004DB9E 0x8004E99E /end VAR_ADDRESS
 /end VAR_CHARACTERISTIC
 /begin VAR_CHARACTERISTIC SSM_U8_SSM_MAX_SLOP EngCalVariantCriterion
  /begin VAR_ADDRESS 0x8003A7A2 0x8003B5A2 0x8003C3A2 0x8003D1A2 0x8003DFA2 0x8003EDA2 0x8003FBA2 0x800409A2 0x800417A2 0x800425A2 0x800433A2 0x800441A2 0x80044FA2 0x80045DA2 0x80046BA2 0x800479A2 0x800487A2 0x800495A2 0x8004A3A2 0x8004B1A2 0x8004BFA2 0x8004CDA2 0x8004DBA2 0x8004E9A2 /end VAR_ADDRESS
 /end VAR_CHARACTERISTIC
 /begin VAR_CHARACTERISTIC SSM_U8_SSM_MAX_SLOP_RELEASE_TIME EngCalVariantCriterion
  /begin VAR_ADDRESS 0x8003A792 0x8003B592 0x8003C392 0x8003D192 0x8003DF92 0x8003ED92 0x8003FB92 0x80040992 0x80041792 0x80042592 0x80043392 0x80044192 0x80044F92 0x80045D92 0x80046B92 0x80047992 0x80048792 0x80049592 0x8004A392 0x8004B192 0x8004BF92 0x8004CD92 0x8004DB92 0x8004E992 /end VAR_ADDRESS
 /end VAR_CHARACTERISTIC
 /begin VAR_CHARACTERISTIC SSM_U8_SSM_MIN_ACC_POSITION EngCalVariantCriterion
  /begin VAR_ADDRESS 0x8003A793 0x8003B593 0x8003C393 0x8003D193 0x8003DF93 0x8003ED93 0x8003FB93 0x80040993 0x80041793 0x80042593 0x80043393 0x80044193 0x80044F93 0x80045D93 0x80046B93 0x80047993 0x80048793 0x80049593 0x8004A393 0x8004B193 0x8004BF93 0x8004CD93 0x8004DB93 0x8004E993 /end VAR_ADDRESS
 /end VAR_CHARACTERISTIC
 /begin VAR_CHARACTERISTIC SSM_U8_SSM_MIN_ACC_RELS_TIME_DWN EngCalVariantCriterion
  /begin VAR_ADDRESS 0x8003A797 0x8003B597 0x8003C397 0x8003D197 0x8003DF97 0x8003ED97 0x8003FB97 0x80040997 0x80041797 0x80042597 0x80043397 0x80044197 0x80044F97 0x80045D97 0x80046B97 0x80047997 0x80048797 0x80049597 0x8004A397 0x8004B197 0x8004BF97 0x8004CD97 0x8004DB97 0x8004E997 /end VAR_ADDRESS
 /end VAR_CHARACTERISTIC
 /begin VAR_CHARACTERISTIC SSM_U8_SSM_MIN_ACC_RELS_TIME_UP EngCalVariantCriterion
  /begin VAR_ADDRESS 0x8003A79B 0x8003B59B 0x8003C39B 0x8003D19B 0x8003DF9B 0x8003ED9B 0x8003FB9B 0x8004099B 0x8004179B 0x8004259B 0x8004339B 0x8004419B 0x80044F9B 0x80045D9B 0x80046B9B 0x8004799B 0x8004879B 0x8004959B 0x8004A39B 0x8004B19B 0x8004BF9B 0x8004CD9B 0x8004DB9B 0x8004E99B /end VAR_ADDRESS
 /end VAR_CHARACTERISTIC
 /begin VAR_CHARACTERISTIC SSM_U8_SSM_MIN_SLOP EngCalVariantCriterion
  /begin VAR_ADDRESS 0x8003A79F 0x8003B59F 0x8003C39F 0x8003D19F 0x8003DF9F 0x8003ED9F 0x8003FB9F 0x8004099F 0x8004179F 0x8004259F 0x8004339F 0x8004419F 0x80044F9F 0x80045D9F 0x80046B9F 0x8004799F 0x8004879F 0x8004959F 0x8004A39F 0x8004B19F 0x8004BF9F 0x8004CD9F 0x8004DB9F 0x8004E99F /end VAR_ADDRESS
 /end VAR_CHARACTERISTIC
 /begin VAR_CHARACTERISTIC SSM_U8_SSM_MIN_SLOP_RELEASE_TIME EngCalVariantCriterion
  /begin VAR_ADDRESS 0x8003A78F 0x8003B58F 0x8003C38F 0x8003D18F 0x8003DF8F 0x8003ED8F 0x8003FB8F 0x8004098F 0x8004178F 0x8004258F 0x8004338F 0x8004418F 0x80044F8F 0x80045D8F 0x80046B8F 0x8004798F 0x8004878F 0x8004958F 0x8004A38F 0x8004B18F 0x8004BF8F 0x8004CD8F 0x8004DB8F 0x8004E98F /end VAR_ADDRESS
 /end VAR_CHARACTERISTIC
 /begin VAR_CHARACTERISTIC SSM_U8_SSM_ROLL_TH_FOR_EPB_ACT EngCalVariantCriterion
  /begin VAR_ADDRESS 0x8003A78A 0x8003B58A 0x8003C38A 0x8003D18A 0x8003DF8A 0x8003ED8A 0x8003FB8A 0x8004098A 0x8004178A 0x8004258A 0x8004338A 0x8004418A 0x80044F8A 0x80045D8A 0x80046B8A 0x8004798A 0x8004878A 0x8004958A 0x8004A38A 0x8004B18A 0x8004BF8A 0x8004CD8A 0x8004DB8A 0x8004E98A /end VAR_ADDRESS
 /end VAR_CHARACTERISTIC
 /begin VAR_CHARACTERISTIC SSM_U8_SSM_ROLL_TH_FOR_RISE EngCalVariantCriterion
  /begin VAR_ADDRESS 0x8003A789 0x8003B589 0x8003C389 0x8003D189 0x8003DF89 0x8003ED89 0x8003FB89 0x80040989 0x80041789 0x80042589 0x80043389 0x80044189 0x80044F89 0x80045D89 0x80046B89 0x80047989 0x80048789 0x80049589 0x8004A389 0x8004B189 0x8004BF89 0x8004CD89 0x8004DB89 0x8004E989 /end VAR_ADDRESS
 /end VAR_CHARACTERISTIC
 /begin VAR_CHARACTERISTIC TP_K_Brake_temperature_Overheated_Threshold EngCalVariantCriterion
  /begin VAR_ADDRESS 0x8003A03C 0x8003AE3C 0x8003BC3C 0x8003CA3C 0x8003D83C 0x8003E63C 0x8003F43C 0x8004023C 0x8004103C 0x80041E3C 0x80042C3C 0x80043A3C 0x8004483C 0x8004563C 0x8004643C 0x8004723C 0x8004803C 0x80048E3C 0x80049C3C 0x8004AA3C 0x8004B83C 0x8004C63C 0x8004D43C 0x8004E23C /end VAR_ADDRESS
 /end VAR_CHARACTERISTIC
 /begin VAR_CHARACTERISTIC TP_K_Brake_temperature_Overheated_Threshold_Low EngCalVariantCriterion
  /begin VAR_ADDRESS 0x8003A03E 0x8003AE3E 0x8003BC3E 0x8003CA3E 0x8003D83E 0x8003E63E 0x8003F43E 0x8004023E 0x8004103E 0x80041E3E 0x80042C3E 0x80043A3E 0x8004483E 0x8004563E 0x8004643E 0x8004723E 0x8004803E 0x80048E3E 0x80049C3E 0x8004AA3E 0x8004B83E 0x8004C63E 0x8004D43E 0x8004E23E /end VAR_ADDRESS
 /end VAR_CHARACTERISTIC
 /begin VAR_CHARACTERISTIC TP_Press_Dec_gain_Front_10_70bar BrkCalVariantCriterion
  /begin VAR_ADDRESS 0x8002066E 0x80023A6E 0x80026E6E 0x8002A26E 0x8002D66E 0x80030A6E 0x80033E6E 0x8003726E /end VAR_ADDRESS
 /end VAR_CHARACTERISTIC
 /begin VAR_CHARACTERISTIC TP_Press_Dec_gain_Front_5_10bar BrkCalVariantCriterion
  /begin VAR_ADDRESS 0x8002066D 0x80023A6D 0x80026E6D 0x8002A26D 0x8002D66D 0x80030A6D 0x80033E6D 0x8003726D /end VAR_ADDRESS
 /end VAR_CHARACTERISTIC
 /begin VAR_CHARACTERISTIC TP_Press_Dec_gain_Front_Above_70bar BrkCalVariantCriterion
  /begin VAR_ADDRESS 0x8002066F 0x80023A6F 0x80026E6F 0x8002A26F 0x8002D66F 0x80030A6F 0x80033E6F 0x8003726F /end VAR_ADDRESS
 /end VAR_CHARACTERISTIC
 /begin VAR_CHARACTERISTIC TP_Press_Dec_gain_Front_below_5bar BrkCalVariantCriterion
  /begin VAR_ADDRESS 0x8002066C 0x80023A6C 0x80026E6C 0x8002A26C 0x8002D66C 0x80030A6C 0x80033E6C 0x8003726C /end VAR_ADDRESS
 /end VAR_CHARACTERISTIC
 /begin VAR_CHARACTERISTIC TP_Press_Dec_gain_Rear_10_70bar BrkCalVariantCriterion
  /begin VAR_ADDRESS 0x80020672 0x80023A72 0x80026E72 0x8002A272 0x8002D672 0x80030A72 0x80033E72 0x80037272 /end VAR_ADDRESS
 /end VAR_CHARACTERISTIC
 /begin VAR_CHARACTERISTIC TP_Press_Dec_gain_Rear_5_10bar BrkCalVariantCriterion
  /begin VAR_ADDRESS 0x80020671 0x80023A71 0x80026E71 0x8002A271 0x8002D671 0x80030A71 0x80033E71 0x80037271 /end VAR_ADDRESS
 /end VAR_CHARACTERISTIC
 /begin VAR_CHARACTERISTIC TP_Press_Dec_gain_Rear_Above_70bar BrkCalVariantCriterion
  /begin VAR_ADDRESS 0x80020673 0x80023A73 0x80026E73 0x8002A273 0x8002D673 0x80030A73 0x80033E73 0x80037273 /end VAR_ADDRESS
 /end VAR_CHARACTERISTIC
 /begin VAR_CHARACTERISTIC TP_Press_Dec_gain_Rear_below_5bar BrkCalVariantCriterion
  /begin VAR_ADDRESS 0x80020670 0x80023A70 0x80026E70 0x8002A270 0x8002D670 0x80030A70 0x80033E70 0x80037270 /end VAR_ADDRESS
 /end VAR_CHARACTERISTIC
 /begin VAR_CHARACTERISTIC TP_S16BtcsVehicleMassFL EngCalVariantCriterion
  /begin VAR_ADDRESS 0x8003A16C 0x8003AF6C 0x8003BD6C 0x8003CB6C 0x8003D96C 0x8003E76C 0x8003F56C 0x8004036C 0x8004116C 0x80041F6C 0x80042D6C 0x80043B6C 0x8004496C 0x8004576C 0x8004656C 0x8004736C 0x8004816C 0x80048F6C 0x80049D6C 0x8004AB6C 0x8004B96C 0x8004C76C 0x8004D56C 0x8004E36C /end VAR_ADDRESS
 /end VAR_CHARACTERISTIC
 /begin VAR_CHARACTERISTIC TP_S16BtcsVehicleMassFR EngCalVariantCriterion
  /begin VAR_ADDRESS 0x8003A16E 0x8003AF6E 0x8003BD6E 0x8003CB6E 0x8003D96E 0x8003E76E 0x8003F56E 0x8004036E 0x8004116E 0x80041F6E 0x80042D6E 0x80043B6E 0x8004496E 0x8004576E 0x8004656E 0x8004736E 0x8004816E 0x80048F6E 0x80049D6E 0x8004AB6E 0x8004B96E 0x8004C76E 0x8004D56E 0x8004E36E /end VAR_ADDRESS
 /end VAR_CHARACTERISTIC
 /begin VAR_CHARACTERISTIC TP_S16BtcsVehicleMassRL EngCalVariantCriterion
  /begin VAR_ADDRESS 0x8003A170 0x8003AF70 0x8003BD70 0x8003CB70 0x8003D970 0x8003E770 0x8003F570 0x80040370 0x80041170 0x80041F70 0x80042D70 0x80043B70 0x80044970 0x80045770 0x80046570 0x80047370 0x80048170 0x80048F70 0x80049D70 0x8004AB70 0x8004B970 0x8004C770 0x8004D570 0x8004E370 /end VAR_ADDRESS
 /end VAR_CHARACTERISTIC
 /begin VAR_CHARACTERISTIC TP_S16BtcsVehicleMassRR EngCalVariantCriterion
  /begin VAR_ADDRESS 0x8003A172 0x8003AF72 0x8003BD72 0x8003CB72 0x8003D972 0x8003E772 0x8003F572 0x80040372 0x80041172 0x80041F72 0x80042D72 0x80043B72 0x80044972 0x80045772 0x80046572 0x80047372 0x80048172 0x80048F72 0x80049D72 0x8004AB72 0x8004B972 0x8004C772 0x8004D572 0x8004E372 /end VAR_ADDRESS
 /end VAR_CHARACTERISTIC
 /begin VAR_CHARACTERISTIC TP_S16ETCSCpAddCdrnTrq4BstMd EngCalVariantCriterion
  /begin VAR_ADDRESS 0x8003A388 0x8003B188 0x8003BF88 0x8003CD88 0x8003DB88 0x8003E988 0x8003F788 0x80040588 0x80041388 0x80042188 0x80042F88 0x80043D88 0x80044B88 0x80045988 0x80046788 0x80047588 0x80048388 0x80049188 0x80049F88 0x8004AD88 0x8004BB88 0x8004C988 0x8004D788 0x8004E588 /end VAR_ADDRESS
 /end VAR_CHARACTERISTIC
 /begin VAR_CHARACTERISTIC TP_S16ETCSCpAftTrnMaxCnt EngCalVariantCriterion
  /begin VAR_ADDRESS 0x8003A38A 0x8003B18A 0x8003BF8A 0x8003CD8A 0x8003DB8A 0x8003E98A 0x8003F78A 0x8004058A 0x8004138A 0x8004218A 0x80042F8A 0x80043D8A 0x80044B8A 0x8004598A 0x8004678A 0x8004758A 0x8004838A 0x8004918A 0x80049F8A 0x8004AD8A 0x8004BB8A 0x8004C98A 0x8004D78A 0x8004E58A /end VAR_ADDRESS
 /end VAR_CHARACTERISTIC
 /begin VAR_CHARACTERISTIC TP_S16ETCSCpAftTrnResetSpnCnt EngCalVariantCriterion
  /begin VAR_ADDRESS 0x8003A38C 0x8003B18C 0x8003BF8C 0x8003CD8C 0x8003DB8C 0x8003E98C 0x8003F78C 0x8004058C 0x8004138C 0x8004218C 0x80042F8C 0x80043D8C 0x80044B8C 0x8004598C 0x8004678C 0x8004758C 0x8004838C 0x8004918C 0x80049F8C 0x8004AD8C 0x8004BB8C 0x8004C98C 0x8004D78C 0x8004E58C /end VAR_ADDRESS
 /end VAR_CHARACTERISTIC
 /begin VAR_CHARACTERISTIC TP_S16ETCSCpCdrnTrqAt1stDrop[0][0] EngCalVariantCriterion
  /begin VAR_ADDRESS 0x8003A394 0x8003B194 0x8003BF94 0x8003CD94 0x8003DB94 0x8003E994 0x8003F794 0x80040594 0x80041394 0x80042194 0x80042F94 0x80043D94 0x80044B94 0x80045994 0x80046794 0x80047594 0x80048394 0x80049194 0x80049F94 0x8004AD94 0x8004BB94 0x8004C994 0x8004D794 0x8004E594 /end VAR_ADDRESS
 /end VAR_CHARACTERISTIC
 /begin VAR_CHARACTERISTIC TP_S16ETCSCpCdrnTrqAt1stDrop[0][1] EngCalVariantCriterion
  /begin VAR_ADDRESS 0x8003A396 0x8003B196 0x8003BF96 0x8003CD96 0x8003DB96 0x8003E996 0x8003F796 0x80040596 0x80041396 0x80042196 0x80042F96 0x80043D96 0x80044B96 0x80045996 0x80046796 0x80047596 0x80048396 0x80049196 0x80049F96 0x8004AD96 0x8004BB96 0x8004C996 0x8004D796 0x8004E596 /end VAR_ADDRESS
 /end VAR_CHARACTERISTIC
 /begin VAR_CHARACTERISTIC TP_S16ETCSCpCdrnTrqAt1stDrop[0][2] EngCalVariantCriterion
  /begin VAR_ADDRESS 0x8003A398 0x8003B198 0x8003BF98 0x8003CD98 0x8003DB98 0x8003E998 0x8003F798 0x80040598 0x80041398 0x80042198 0x80042F98 0x80043D98 0x80044B98 0x80045998 0x80046798 0x80047598 0x80048398 0x80049198 0x80049F98 0x8004AD98 0x8004BB98 0x8004C998 0x8004D798 0x8004E598 /end VAR_ADDRESS
 /end VAR_CHARACTERISTIC
 /begin VAR_CHARACTERISTIC TP_S16ETCSCpCdrnTrqAt1stDrop[0][3] EngCalVariantCriterion
  /begin VAR_ADDRESS 0x8003A39A 0x8003B19A 0x8003BF9A 0x8003CD9A 0x8003DB9A 0x8003E99A 0x8003F79A 0x8004059A 0x8004139A 0x8004219A 0x80042F9A 0x80043D9A 0x80044B9A 0x8004599A 0x8004679A 0x8004759A 0x8004839A 0x8004919A 0x80049F9A 0x8004AD9A 0x8004BB9A 0x8004C99A 0x8004D79A 0x8004E59A /end VAR_ADDRESS
 /end VAR_CHARACTERISTIC
 /begin VAR_CHARACTERISTIC TP_S16ETCSCpCdrnTrqAt1stDrop[0][4] EngCalVariantCriterion
  /begin VAR_ADDRESS 0x8003A39C 0x8003B19C 0x8003BF9C 0x8003CD9C 0x8003DB9C 0x8003E99C 0x8003F79C 0x8004059C 0x8004139C 0x8004219C 0x80042F9C 0x80043D9C 0x80044B9C 0x8004599C 0x8004679C 0x8004759C 0x8004839C 0x8004919C 0x80049F9C 0x8004AD9C 0x8004BB9C 0x8004C99C 0x8004D79C 0x8004E59C /end VAR_ADDRESS
 /end VAR_CHARACTERISTIC
 /begin VAR_CHARACTERISTIC TP_S16ETCSCpCdrnTrqAt1stDrop[1][0] EngCalVariantCriterion
  /begin VAR_ADDRESS 0x8003A39E 0x8003B19E 0x8003BF9E 0x8003CD9E 0x8003DB9E 0x8003E99E 0x8003F79E 0x8004059E 0x8004139E 0x8004219E 0x80042F9E 0x80043D9E 0x80044B9E 0x8004599E 0x8004679E 0x8004759E 0x8004839E 0x8004919E 0x80049F9E 0x8004AD9E 0x8004BB9E 0x8004C99E 0x8004D79E 0x8004E59E /end VAR_ADDRESS
 /end VAR_CHARACTERISTIC
 /begin VAR_CHARACTERISTIC TP_S16ETCSCpCdrnTrqAt1stDrop[1][1] EngCalVariantCriterion
  /begin VAR_ADDRESS 0x8003A3A0 0x8003B1A0 0x8003BFA0 0x8003CDA0 0x8003DBA0 0x8003E9A0 0x8003F7A0 0x800405A0 0x800413A0 0x800421A0 0x80042FA0 0x80043DA0 0x80044BA0 0x800459A0 0x800467A0 0x800475A0 0x800483A0 0x800491A0 0x80049FA0 0x8004ADA0 0x8004BBA0 0x8004C9A0 0x8004D7A0 0x8004E5A0 /end VAR_ADDRESS
 /end VAR_CHARACTERISTIC
 /begin VAR_CHARACTERISTIC TP_S16ETCSCpCdrnTrqAt1stDrop[1][2] EngCalVariantCriterion
  /begin VAR_ADDRESS 0x8003A3A2 0x8003B1A2 0x8003BFA2 0x8003CDA2 0x8003DBA2 0x8003E9A2 0x8003F7A2 0x800405A2 0x800413A2 0x800421A2 0x80042FA2 0x80043DA2 0x80044BA2 0x800459A2 0x800467A2 0x800475A2 0x800483A2 0x800491A2 0x80049FA2 0x8004ADA2 0x8004BBA2 0x8004C9A2 0x8004D7A2 0x8004E5A2 /end VAR_ADDRESS
 /end VAR_CHARACTERISTIC
 /begin VAR_CHARACTERISTIC TP_S16ETCSCpCdrnTrqAt1stDrop[1][3] EngCalVariantCriterion
  /begin VAR_ADDRESS 0x8003A3A4 0x8003B1A4 0x8003BFA4 0x8003CDA4 0x8003DBA4 0x8003E9A4 0x8003F7A4 0x800405A4 0x800413A4 0x800421A4 0x80042FA4 0x80043DA4 0x80044BA4 0x800459A4 0x800467A4 0x800475A4 0x800483A4 0x800491A4 0x80049FA4 0x8004ADA4 0x8004BBA4 0x8004C9A4 0x8004D7A4 0x8004E5A4 /end VAR_ADDRESS
 /end VAR_CHARACTERISTIC
 /begin VAR_CHARACTERISTIC TP_S16ETCSCpCdrnTrqAt1stDrop[1][4] EngCalVariantCriterion
  /begin VAR_ADDRESS 0x8003A3A6 0x8003B1A6 0x8003BFA6 0x8003CDA6 0x8003DBA6 0x8003E9A6 0x8003F7A6 0x800405A6 0x800413A6 0x800421A6 0x80042FA6 0x80043DA6 0x80044BA6 0x800459A6 0x800467A6 0x800475A6 0x800483A6 0x800491A6 0x80049FA6 0x8004ADA6 0x8004BBA6 0x8004C9A6 0x8004D7A6 0x8004E5A6 /end VAR_ADDRESS
 /end VAR_CHARACTERISTIC
 /begin VAR_CHARACTERISTIC TP_S16ETCSCpCdrnTrqAt1stDrop[2][0] EngCalVariantCriterion
  /begin VAR_ADDRESS 0x8003A3A8 0x8003B1A8 0x8003BFA8 0x8003CDA8 0x8003DBA8 0x8003E9A8 0x8003F7A8 0x800405A8 0x800413A8 0x800421A8 0x80042FA8 0x80043DA8 0x80044BA8 0x800459A8 0x800467A8 0x800475A8 0x800483A8 0x800491A8 0x80049FA8 0x8004ADA8 0x8004BBA8 0x8004C9A8 0x8004D7A8 0x8004E5A8 /end VAR_ADDRESS
 /end VAR_CHARACTERISTIC
 /begin VAR_CHARACTERISTIC TP_S16ETCSCpCdrnTrqAt1stDrop[2][1] EngCalVariantCriterion
  /begin VAR_ADDRESS 0x8003A3AA 0x8003B1AA 0x8003BFAA 0x8003CDAA 0x8003DBAA 0x8003E9AA 0x8003F7AA 0x800405AA 0x800413AA 0x800421AA 0x80042FAA 0x80043DAA 0x80044BAA 0x800459AA 0x800467AA 0x800475AA 0x800483AA 0x800491AA 0x80049FAA 0x8004ADAA 0x8004BBAA 0x8004C9AA 0x8004D7AA 0x8004E5AA /end VAR_ADDRESS
 /end VAR_CHARACTERISTIC
 /begin VAR_CHARACTERISTIC TP_S16ETCSCpCdrnTrqAt1stDrop[2][2] EngCalVariantCriterion
  /begin VAR_ADDRESS 0x8003A3AC 0x8003B1AC 0x8003BFAC 0x8003CDAC 0x8003DBAC 0x8003E9AC 0x8003F7AC 0x800405AC 0x800413AC 0x800421AC 0x80042FAC 0x80043DAC 0x80044BAC 0x800459AC 0x800467AC 0x800475AC 0x800483AC 0x800491AC 0x80049FAC 0x8004ADAC 0x8004BBAC 0x8004C9AC 0x8004D7AC 0x8004E5AC /end VAR_ADDRESS
 /end VAR_CHARACTERISTIC
 /begin VAR_CHARACTERISTIC TP_S16ETCSCpCdrnTrqAt1stDrop[2][3] EngCalVariantCriterion
  /begin VAR_ADDRESS 0x8003A3AE 0x8003B1AE 0x8003BFAE 0x8003CDAE 0x8003DBAE 0x8003E9AE 0x8003F7AE 0x800405AE 0x800413AE 0x800421AE 0x80042FAE 0x80043DAE 0x80044BAE 0x800459AE 0x800467AE 0x800475AE 0x800483AE 0x800491AE 0x80049FAE 0x8004ADAE 0x8004BBAE 0x8004C9AE 0x8004D7AE 0x8004E5AE /end VAR_ADDRESS
 /end VAR_CHARACTERISTIC
 /begin VAR_CHARACTERISTIC TP_S16ETCSCpCdrnTrqAt1stDrop[2][4] EngCalVariantCriterion
  /begin VAR_ADDRESS 0x8003A3B0 0x8003B1B0 0x8003BFB0 0x8003CDB0 0x8003DBB0 0x8003E9B0 0x8003F7B0 0x800405B0 0x800413B0 0x800421B0 0x80042FB0 0x80043DB0 0x80044BB0 0x800459B0 0x800467B0 0x800475B0 0x800483B0 0x800491B0 0x80049FB0 0x8004ADB0 0x8004BBB0 0x8004C9B0 0x8004D7B0 0x8004E5B0 /end VAR_ADDRESS
 /end VAR_CHARACTERISTIC
 /begin VAR_CHARACTERISTIC TP_S16ETCSCpCdrnTrqAt[0] EngCalVariantCriterion
  /begin VAR_ADDRESS 0x8003A38E 0x8003B18E 0x8003BF8E 0x8003CD8E 0x8003DB8E 0x8003E98E 0x8003F78E 0x8004058E 0x8004138E 0x8004218E 0x80042F8E 0x80043D8E 0x80044B8E 0x8004598E 0x8004678E 0x8004758E 0x8004838E 0x8004918E 0x80049F8E 0x8004AD8E 0x8004BB8E 0x8004C98E 0x8004D78E 0x8004E58E /end VAR_ADDRESS
 /end VAR_CHARACTERISTIC
 /begin VAR_CHARACTERISTIC TP_S16ETCSCpCdrnTrqAt[1] EngCalVariantCriterion
  /begin VAR_ADDRESS 0x8003A390 0x8003B190 0x8003BF90 0x8003CD90 0x8003DB90 0x8003E990 0x8003F790 0x80040590 0x80041390 0x80042190 0x80042F90 0x80043D90 0x80044B90 0x80045990 0x80046790 0x80047590 0x80048390 0x80049190 0x80049F90 0x8004AD90 0x8004BB90 0x8004C990 0x8004D790 0x8004E590 /end VAR_ADDRESS
 /end VAR_CHARACTERISTIC
 /begin VAR_CHARACTERISTIC TP_S16ETCSCpCdrnTrqAt[2] EngCalVariantCriterion
  /begin VAR_ADDRESS 0x8003A392 0x8003B192 0x8003BF92 0x8003CD92 0x8003DB92 0x8003E992 0x8003F792 0x80040592 0x80041392 0x80042192 0x80042F92 0x80043D92 0x80044B92 0x80045992 0x80046792 0x80047592 0x80048392 0x80049192 0x80049F92 0x8004AD92 0x8004BB92 0x8004C992 0x8004D792 0x8004E592 /end VAR_ADDRESS
 /end VAR_CHARACTERISTIC
 /begin VAR_CHARACTERISTIC TP_S16ETCSCpCdrnTrqDrpLmtCr[0][0] EngCalVariantCriterion
  /begin VAR_ADDRESS 0x8003A3B2 0x8003B1B2 0x8003BFB2 0x8003CDB2 0x8003DBB2 0x8003E9B2 0x8003F7B2 0x800405B2 0x800413B2 0x800421B2 0x80042FB2 0x80043DB2 0x80044BB2 0x800459B2 0x800467B2 0x800475B2 0x800483B2 0x800491B2 0x80049FB2 0x8004ADB2 0x8004BBB2 0x8004C9B2 0x8004D7B2 0x8004E5B2 /end VAR_ADDRESS
 /end VAR_CHARACTERISTIC
 /begin VAR_CHARACTERISTIC TP_S16ETCSCpCdrnTrqDrpLmtCr[0][1] EngCalVariantCriterion
  /begin VAR_ADDRESS 0x8003A3B4 0x8003B1B4 0x8003BFB4 0x8003CDB4 0x8003DBB4 0x8003E9B4 0x8003F7B4 0x800405B4 0x800413B4 0x800421B4 0x80042FB4 0x80043DB4 0x80044BB4 0x800459B4 0x800467B4 0x800475B4 0x800483B4 0x800491B4 0x80049FB4 0x8004ADB4 0x8004BBB4 0x8004C9B4 0x8004D7B4 0x8004E5B4 /end VAR_ADDRESS
 /end VAR_CHARACTERISTIC
 /begin VAR_CHARACTERISTIC TP_S16ETCSCpCdrnTrqDrpLmtCr[0][2] EngCalVariantCriterion
  /begin VAR_ADDRESS 0x8003A3B6 0x8003B1B6 0x8003BFB6 0x8003CDB6 0x8003DBB6 0x8003E9B6 0x8003F7B6 0x800405B6 0x800413B6 0x800421B6 0x80042FB6 0x80043DB6 0x80044BB6 0x800459B6 0x800467B6 0x800475B6 0x800483B6 0x800491B6 0x80049FB6 0x8004ADB6 0x8004BBB6 0x8004C9B6 0x8004D7B6 0x8004E5B6 /end VAR_ADDRESS
 /end VAR_CHARACTERISTIC
 /begin VAR_CHARACTERISTIC TP_S16ETCSCpCdrnTrqDrpLmtCr[1][0] EngCalVariantCriterion
  /begin VAR_ADDRESS 0x8003A3B8 0x8003B1B8 0x8003BFB8 0x8003CDB8 0x8003DBB8 0x8003E9B8 0x8003F7B8 0x800405B8 0x800413B8 0x800421B8 0x80042FB8 0x80043DB8 0x80044BB8 0x800459B8 0x800467B8 0x800475B8 0x800483B8 0x800491B8 0x80049FB8 0x8004ADB8 0x8004BBB8 0x8004C9B8 0x8004D7B8 0x8004E5B8 /end VAR_ADDRESS
 /end VAR_CHARACTERISTIC
 /begin VAR_CHARACTERISTIC TP_S16ETCSCpCdrnTrqDrpLmtCr[1][1] EngCalVariantCriterion
  /begin VAR_ADDRESS 0x8003A3BA 0x8003B1BA 0x8003BFBA 0x8003CDBA 0x8003DBBA 0x8003E9BA 0x8003F7BA 0x800405BA 0x800413BA 0x800421BA 0x80042FBA 0x80043DBA 0x80044BBA 0x800459BA 0x800467BA 0x800475BA 0x800483BA 0x800491BA 0x80049FBA 0x8004ADBA 0x8004BBBA 0x8004C9BA 0x8004D7BA 0x8004E5BA /end VAR_ADDRESS
 /end VAR_CHARACTERISTIC
 /begin VAR_CHARACTERISTIC TP_S16ETCSCpCdrnTrqDrpLmtCr[1][2] EngCalVariantCriterion
  /begin VAR_ADDRESS 0x8003A3BC 0x8003B1BC 0x8003BFBC 0x8003CDBC 0x8003DBBC 0x8003E9BC 0x8003F7BC 0x800405BC 0x800413BC 0x800421BC 0x80042FBC 0x80043DBC 0x80044BBC 0x800459BC 0x800467BC 0x800475BC 0x800483BC 0x800491BC 0x80049FBC 0x8004ADBC 0x8004BBBC 0x8004C9BC 0x8004D7BC 0x8004E5BC /end VAR_ADDRESS
 /end VAR_CHARACTERISTIC
 /begin VAR_CHARACTERISTIC TP_S16ETCSCpCdrnTrqDrpLmtCr[2][0] EngCalVariantCriterion
  /begin VAR_ADDRESS 0x8003A3BE 0x8003B1BE 0x8003BFBE 0x8003CDBE 0x8003DBBE 0x8003E9BE 0x8003F7BE 0x800405BE 0x800413BE 0x800421BE 0x80042FBE 0x80043DBE 0x80044BBE 0x800459BE 0x800467BE 0x800475BE 0x800483BE 0x800491BE 0x80049FBE 0x8004ADBE 0x8004BBBE 0x8004C9BE 0x8004D7BE 0x8004E5BE /end VAR_ADDRESS
 /end VAR_CHARACTERISTIC
 /begin VAR_CHARACTERISTIC TP_S16ETCSCpCdrnTrqDrpLmtCr[2][1] EngCalVariantCriterion
  /begin VAR_ADDRESS 0x8003A3C0 0x8003B1C0 0x8003BFC0 0x8003CDC0 0x8003DBC0 0x8003E9C0 0x8003F7C0 0x800405C0 0x800413C0 0x800421C0 0x80042FC0 0x80043DC0 0x80044BC0 0x800459C0 0x800467C0 0x800475C0 0x800483C0 0x800491C0 0x80049FC0 0x8004ADC0 0x8004BBC0 0x8004C9C0 0x8004D7C0 0x8004E5C0 /end VAR_ADDRESS
 /end VAR_CHARACTERISTIC
 /begin VAR_CHARACTERISTIC TP_S16ETCSCpCdrnTrqDrpLmtCr[2][2] EngCalVariantCriterion
  /begin VAR_ADDRESS 0x8003A3C2 0x8003B1C2 0x8003BFC2 0x8003CDC2 0x8003DBC2 0x8003E9C2 0x8003F7C2 0x800405C2 0x800413C2 0x800421C2 0x80042FC2 0x80043DC2 0x80044BC2 0x800459C2 0x800467C2 0x800475C2 0x800483C2 0x800491C2 0x80049FC2 0x8004ADC2 0x8004BBC2 0x8004C9C2 0x8004D7C2 0x8004E5C2 /end VAR_ADDRESS
 /end VAR_CHARACTERISTIC
 /begin VAR_CHARACTERISTIC TP_S16ETCSCpCircumferenceOfTire EngCalVariantCriterion
  /begin VAR_ADDRESS 0x8003A3C4 0x8003B1C4 0x8003BFC4 0x8003CDC4 0x8003DBC4 0x8003E9C4 0x8003F7C4 0x800405C4 0x800413C4 0x800421C4 0x80042FC4 0x80043DC4 0x80044BC4 0x800459C4 0x800467C4 0x800475C4 0x800483C4 0x800491C4 0x80049FC4 0x8004ADC4 0x8004BBC4 0x8004C9C4 0x8004D7C4 0x8004E5C4 /end VAR_ADDRESS
 /end VAR_CHARACTERISTIC
 /begin VAR_CHARACTERISTIC TP_S16ETCSCpDctRdMemTqCntThr EngCalVariantCriterion
  /begin VAR_ADDRESS 0x8003A3C6 0x8003B1C6 0x8003BFC6 0x8003CDC6 0x8003DBC6 0x8003E9C6 0x8003F7C6 0x800405C6 0x800413C6 0x800421C6 0x80042FC6 0x80043DC6 0x80044BC6 0x800459C6 0x800467C6 0x800475C6 0x800483C6 0x800491C6 0x80049FC6 0x8004ADC6 0x8004BBC6 0x8004C9C6 0x8004D7C6 0x8004E5C6 /end VAR_ADDRESS
 /end VAR_CHARACTERISTIC
 /begin VAR_CHARACTERISTIC TP_S16ETCSCpDecCdrnTrqALmtCrng EngCalVariantCriterion
  /begin VAR_ADDRESS 0x8003A3C8 0x8003B1C8 0x8003BFC8 0x8003CDC8 0x8003DBC8 0x8003E9C8 0x8003F7C8 0x800405C8 0x800413C8 0x800421C8 0x80042FC8 0x80043DC8 0x80044BC8 0x800459C8 0x800467C8 0x800475C8 0x800483C8 0x800491C8 0x80049FC8 0x8004ADC8 0x8004BBC8 0x8004C9C8 0x8004D7C8 0x8004E5C8 /end VAR_ADDRESS
 /end VAR_CHARACTERISTIC
 /begin VAR_CHARACTERISTIC TP_S16ETCSCpEngCmdTransTrq EngCalVariantCriterion
  /begin VAR_ADDRESS 0x8003A3CA 0x8003B1CA 0x8003BFCA 0x8003CDCA 0x8003DBCA 0x8003E9CA 0x8003F7CA 0x800405CA 0x800413CA 0x800421CA 0x80042FCA 0x80043DCA 0x80044BCA 0x800459CA 0x800467CA 0x800475CA 0x800483CA 0x800491CA 0x80049FCA 0x8004ADCA 0x8004BBCA 0x8004C9CA 0x8004D7CA 0x8004E5CA /end VAR_ADDRESS
 /end VAR_CHARACTERISTIC
 /begin VAR_CHARACTERISTIC TP_S16ETCSCpEngSpd[0] EngCalVariantCriterion
  /begin VAR_ADDRESS 0x8003A3CC 0x8003B1CC 0x8003BFCC 0x8003CDCC 0x8003DBCC 0x8003E9CC 0x8003F7CC 0x800405CC 0x800413CC 0x800421CC 0x80042FCC 0x80043DCC 0x80044BCC 0x800459CC 0x800467CC 0x800475CC 0x800483CC 0x800491CC 0x80049FCC 0x8004ADCC 0x8004BBCC 0x8004C9CC 0x8004D7CC 0x8004E5CC /end VAR_ADDRESS
 /end VAR_CHARACTERISTIC
 /begin VAR_CHARACTERISTIC TP_S16ETCSCpEngSpd[1] EngCalVariantCriterion
  /begin VAR_ADDRESS 0x8003A3CE 0x8003B1CE 0x8003BFCE 0x8003CDCE 0x8003DBCE 0x8003E9CE 0x8003F7CE 0x800405CE 0x800413CE 0x800421CE 0x80042FCE 0x80043DCE 0x80044BCE 0x800459CE 0x800467CE 0x800475CE 0x800483CE 0x800491CE 0x80049FCE 0x8004ADCE 0x8004BBCE 0x8004C9CE 0x8004D7CE 0x8004E5CE /end VAR_ADDRESS
 /end VAR_CHARACTERISTIC
 /begin VAR_CHARACTERISTIC TP_S16ETCSCpEngSpd[2] EngCalVariantCriterion
  /begin VAR_ADDRESS 0x8003A3D0 0x8003B1D0 0x8003BFD0 0x8003CDD0 0x8003DBD0 0x8003E9D0 0x8003F7D0 0x800405D0 0x800413D0 0x800421D0 0x80042FD0 0x80043DD0 0x80044BD0 0x800459D0 0x800467D0 0x800475D0 0x800483D0 0x800491D0 0x80049FD0 0x8004ADD0 0x8004BBD0 0x8004C9D0 0x8004D7D0 0x8004E5D0 /end VAR_ADDRESS
 /end VAR_CHARACTERISTIC
 /begin VAR_CHARACTERISTIC TP_S16ETCSCpEngSpd[3] EngCalVariantCriterion
  /begin VAR_ADDRESS 0x8003A3D2 0x8003B1D2 0x8003BFD2 0x8003CDD2 0x8003DBD2 0x8003E9D2 0x8003F7D2 0x800405D2 0x800413D2 0x800421D2 0x80042FD2 0x80043DD2 0x80044BD2 0x800459D2 0x800467D2 0x800475D2 0x800483D2 0x800491D2 0x80049FD2 0x8004ADD2 0x8004BBD2 0x8004C9D2 0x8004D7D2 0x8004E5D2 /end VAR_ADDRESS
 /end VAR_CHARACTERISTIC
 /begin VAR_CHARACTERISTIC TP_S16ETCSCpEngSpd[4] EngCalVariantCriterion
  /begin VAR_ADDRESS 0x8003A3D4 0x8003B1D4 0x8003BFD4 0x8003CDD4 0x8003DBD4 0x8003E9D4 0x8003F7D4 0x800405D4 0x800413D4 0x800421D4 0x80042FD4 0x80043DD4 0x80044BD4 0x800459D4 0x800467D4 0x800475D4 0x800483D4 0x800491D4 0x80049FD4 0x8004ADD4 0x8004BBD4 0x8004C9D4 0x8004D7D4 0x8004E5D4 /end VAR_ADDRESS
 /end VAR_CHARACTERISTIC
 /begin VAR_CHARACTERISTIC TP_S16ETCSCpEngTrq[0] EngCalVariantCriterion
  /begin VAR_ADDRESS 0x8003A3D6 0x8003B1D6 0x8003BFD6 0x8003CDD6 0x8003DBD6 0x8003E9D6 0x8003F7D6 0x800405D6 0x800413D6 0x800421D6 0x80042FD6 0x80043DD6 0x80044BD6 0x800459D6 0x800467D6 0x800475D6 0x800483D6 0x800491D6 0x80049FD6 0x8004ADD6 0x8004BBD6 0x8004C9D6 0x8004D7D6 0x8004E5D6 /end VAR_ADDRESS
 /end VAR_CHARACTERISTIC
 /begin VAR_CHARACTERISTIC TP_S16ETCSCpEngTrq[1] EngCalVariantCriterion
  /begin VAR_ADDRESS 0x8003A3D8 0x8003B1D8 0x8003BFD8 0x8003CDD8 0x8003DBD8 0x8003E9D8 0x8003F7D8 0x800405D8 0x800413D8 0x800421D8 0x80042FD8 0x80043DD8 0x80044BD8 0x800459D8 0x800467D8 0x800475D8 0x800483D8 0x800491D8 0x80049FD8 0x8004ADD8 0x8004BBD8 0x8004C9D8 0x8004D7D8 0x8004E5D8 /end VAR_ADDRESS
 /end VAR_CHARACTERISTIC
 /begin VAR_CHARACTERISTIC TP_S16ETCSCpEngTrq[2] EngCalVariantCriterion
  /begin VAR_ADDRESS 0x8003A3DA 0x8003B1DA 0x8003BFDA 0x8003CDDA 0x8003DBDA 0x8003E9DA 0x8003F7DA 0x800405DA 0x800413DA 0x800421DA 0x80042FDA 0x80043DDA 0x80044BDA 0x800459DA 0x800467DA 0x800475DA 0x800483DA 0x800491DA 0x80049FDA 0x8004ADDA 0x8004BBDA 0x8004C9DA 0x8004D7DA 0x8004E5DA /end VAR_ADDRESS
 /end VAR_CHARACTERISTIC
 /begin VAR_CHARACTERISTIC TP_S16ETCSCpFuncLampOffBrkTrq[0] EngCalVariantCriterion
  /begin VAR_ADDRESS 0x8003A3DC 0x8003B1DC 0x8003BFDC 0x8003CDDC 0x8003DBDC 0x8003E9DC 0x8003F7DC 0x800405DC 0x800413DC 0x800421DC 0x80042FDC 0x80043DDC 0x80044BDC 0x800459DC 0x800467DC 0x800475DC 0x800483DC 0x800491DC 0x80049FDC 0x8004ADDC 0x8004BBDC 0x8004C9DC 0x8004D7DC 0x8004E5DC /end VAR_ADDRESS
 /end VAR_CHARACTERISTIC
 /begin VAR_CHARACTERISTIC TP_S16ETCSCpFuncLampOffBrkTrq[1] EngCalVariantCriterion
  /begin VAR_ADDRESS 0x8003A3DE 0x8003B1DE 0x8003BFDE 0x8003CDDE 0x8003DBDE 0x8003E9DE 0x8003F7DE 0x800405DE 0x800413DE 0x800421DE 0x80042FDE 0x80043DDE 0x80044BDE 0x800459DE 0x800467DE 0x800475DE 0x800483DE 0x800491DE 0x80049FDE 0x8004ADDE 0x8004BBDE 0x8004C9DE 0x8004D7DE 0x8004E5DE /end VAR_ADDRESS
 /end VAR_CHARACTERISTIC
 /begin VAR_CHARACTERISTIC TP_S16ETCSCpHighRiskStallRpmFlat EngCalVariantCriterion
  /begin VAR_ADDRESS 0x8003A3E0 0x8003B1E0 0x8003BFE0 0x8003CDE0 0x8003DBE0 0x8003E9E0 0x8003F7E0 0x800405E0 0x800413E0 0x800421E0 0x80042FE0 0x80043DE0 0x80044BE0 0x800459E0 0x800467E0 0x800475E0 0x800483E0 0x800491E0 0x80049FE0 0x8004ADE0 0x8004BBE0 0x8004C9E0 0x8004D7E0 0x8004E5E0 /end VAR_ADDRESS
 /end VAR_CHARACTERISTIC
 /begin VAR_CHARACTERISTIC TP_S16ETCSCpHighRiskStallRpmHill EngCalVariantCriterion
  /begin VAR_ADDRESS 0x8003A3E2 0x8003B1E2 0x8003BFE2 0x8003CDE2 0x8003DBE2 0x8003E9E2 0x8003F7E2 0x800405E2 0x800413E2 0x800421E2 0x80042FE2 0x80043DE2 0x80044BE2 0x800459E2 0x800467E2 0x800475E2 0x800483E2 0x800491E2 0x80049FE2 0x8004ADE2 0x8004BBE2 0x8004C9E2 0x8004D7E2 0x8004E5E2 /end VAR_ADDRESS
 /end VAR_CHARACTERISTIC
 /begin VAR_CHARACTERISTIC TP_S16ETCSCpIGainFacLmtStr[0] EngCalVariantCriterion
  /begin VAR_ADDRESS 0x8003A3E4 0x8003B1E4 0x8003BFE4 0x8003CDE4 0x8003DBE4 0x8003E9E4 0x8003F7E4 0x800405E4 0x800413E4 0x800421E4 0x80042FE4 0x80043DE4 0x80044BE4 0x800459E4 0x800467E4 0x800475E4 0x800483E4 0x800491E4 0x80049FE4 0x8004ADE4 0x8004BBE4 0x8004C9E4 0x8004D7E4 0x8004E5E4 /end VAR_ADDRESS
 /end VAR_CHARACTERISTIC
 /begin VAR_CHARACTERISTIC TP_S16ETCSCpIGainFacLmtStr[1] EngCalVariantCriterion
  /begin VAR_ADDRESS 0x8003A3E6 0x8003B1E6 0x8003BFE6 0x8003CDE6 0x8003DBE6 0x8003E9E6 0x8003F7E6 0x800405E6 0x800413E6 0x800421E6 0x80042FE6 0x80043DE6 0x80044BE6 0x800459E6 0x800467E6 0x800475E6 0x800483E6 0x800491E6 0x80049FE6 0x8004ADE6 0x8004BBE6 0x8004C9E6 0x8004D7E6 0x8004E5E6 /end VAR_ADDRESS
 /end VAR_CHARACTERISTIC
 /begin VAR_CHARACTERISTIC TP_S16ETCSCpIGainFacLmtStr[2] EngCalVariantCriterion
  /begin VAR_ADDRESS 0x8003A3E8 0x8003B1E8 0x8003BFE8 0x8003CDE8 0x8003DBE8 0x8003E9E8 0x8003F7E8 0x800405E8 0x800413E8 0x800421E8 0x80042FE8 0x80043DE8 0x80044BE8 0x800459E8 0x800467E8 0x800475E8 0x800483E8 0x800491E8 0x80049FE8 0x8004ADE8 0x8004BBE8 0x8004C9E8 0x8004D7E8 0x8004E5E8 /end VAR_ADDRESS
 /end VAR_CHARACTERISTIC
 /begin VAR_CHARACTERISTIC TP_S16ETCSCpIGainIncFacH2L EngCalVariantCriterion
  /begin VAR_ADDRESS 0x8003A3EA 0x8003B1EA 0x8003BFEA 0x8003CDEA 0x8003DBEA 0x8003E9EA 0x8003F7EA 0x800405EA 0x800413EA 0x800421EA 0x80042FEA 0x80043DEA 0x80044BEA 0x800459EA 0x800467EA 0x800475EA 0x800483EA 0x800491EA 0x80049FEA 0x8004ADEA 0x8004BBEA 0x8004C9EA 0x8004D7EA 0x8004E5EA /end VAR_ADDRESS
 /end VAR_CHARACTERISTIC
 /begin VAR_CHARACTERISTIC TP_S16ETCSCpLatbyDrivCrng EngCalVariantCriterion
  /begin VAR_ADDRESS 0x8003A3EC 0x8003B1EC 0x8003BFEC 0x8003CDEC 0x8003DBEC 0x8003E9EC 0x8003F7EC 0x800405EC 0x800413EC 0x800421EC 0x80042FEC 0x80043DEC 0x80044BEC 0x800459EC 0x800467EC 0x800475EC 0x800483EC 0x800491EC 0x80049FEC 0x8004ADEC 0x8004BBEC 0x8004C9EC 0x8004D7EC 0x8004E5EC /end VAR_ADDRESS
 /end VAR_CHARACTERISTIC
 /begin VAR_CHARACTERISTIC TP_S16ETCSCpLdTrqAsymSpinCplCnt EngCalVariantCriterion
  /begin VAR_ADDRESS 0x8003A3EE 0x8003B1EE 0x8003BFEE 0x8003CDEE 0x8003DBEE 0x8003E9EE 0x8003F7EE 0x800405EE 0x800413EE 0x800421EE 0x80042FEE 0x80043DEE 0x80044BEE 0x800459EE 0x800467EE 0x800475EE 0x800483EE 0x800491EE 0x80049FEE 0x8004ADEE 0x8004BBEE 0x8004C9EE 0x8004D7EE 0x8004E5EE /end VAR_ADDRESS
 /end VAR_CHARACTERISTIC
 /begin VAR_CHARACTERISTIC TP_S16ETCSCpLdTrqAsymSpinMaxCnt EngCalVariantCriterion
  /begin VAR_ADDRESS 0x8003A3F0 0x8003B1F0 0x8003BFF0 0x8003CDF0 0x8003DBF0 0x8003E9F0 0x8003F7F0 0x800405F0 0x800413F0 0x800421F0 0x80042FF0 0x80043DF0 0x80044BF0 0x800459F0 0x800467F0 0x800475F0 0x800483F0 0x800491F0 0x80049FF0 0x8004ADF0 0x8004BBF0 0x8004C9F0 0x8004D7F0 0x8004E5F0 /end VAR_ADDRESS
 /end VAR_CHARACTERISTIC
 /begin VAR_CHARACTERISTIC TP_S16ETCSCpLdTrqAsymSpinMinCnt EngCalVariantCriterion
  /begin VAR_ADDRESS 0x8003A3F2 0x8003B1F2 0x8003BFF2 0x8003CDF2 0x8003DBF2 0x8003E9F2 0x8003F7F2 0x800405F2 0x800413F2 0x800421F2 0x80042FF2 0x80043DF2 0x80044BF2 0x800459F2 0x800467F2 0x800475F2 0x800483F2 0x800491F2 0x80049FF2 0x8004ADF2 0x8004BBF2 0x8004C9F2 0x8004D7F2 0x8004E5F2 /end VAR_ADDRESS
 /end VAR_CHARACTERISTIC
 /begin VAR_CHARACTERISTIC TP_S16ETCSCpLdTrqByAsymSpin EngCalVariantCriterion
  /begin VAR_ADDRESS 0x8003A3F4 0x8003B1F4 0x8003BFF4 0x8003CDF4 0x8003DBF4 0x8003E9F4 0x8003F7F4 0x800405F4 0x800413F4 0x800421F4 0x80042FF4 0x80043DF4 0x80044BF4 0x800459F4 0x800467F4 0x800475F4 0x800483F4 0x800491F4 0x80049FF4 0x8004ADF4 0x8004BBF4 0x8004C9F4 0x8004D7F4 0x8004E5F4 /end VAR_ADDRESS
 /end VAR_CHARACTERISTIC
 /begin VAR_CHARACTERISTIC TP_S16ETCSCpLdTrqByAsymSpinHill EngCalVariantCriterion
  /begin VAR_ADDRESS 0x8003A3F6 0x8003B1F6 0x8003BFF6 0x8003CDF6 0x8003DBF6 0x8003E9F6 0x8003F7F6 0x800405F6 0x800413F6 0x800421F6 0x80042FF6 0x80043DF6 0x80044BF6 0x800459F6 0x800467F6 0x800475F6 0x800483F6 0x800491F6 0x80049FF6 0x8004ADF6 0x8004BBF6 0x8004C9F6 0x8004D7F6 0x8004E5F6 /end VAR_ADDRESS
 /end VAR_CHARACTERISTIC
 /begin VAR_CHARACTERISTIC TP_S16ETCSCpLdTrqCntLwToSplt EngCalVariantCriterion
  /begin VAR_ADDRESS 0x8003A3F8 0x8003B1F8 0x8003BFF8 0x8003CDF8 0x8003DBF8 0x8003E9F8 0x8003F7F8 0x800405F8 0x800413F8 0x800421F8 0x80042FF8 0x80043DF8 0x80044BF8 0x800459F8 0x800467F8 0x800475F8 0x800483F8 0x800491F8 0x80049FF8 0x8004ADF8 0x8004BBF8 0x8004C9F8 0x8004D7F8 0x8004E5F8 /end VAR_ADDRESS
 /end VAR_CHARACTERISTIC
 /begin VAR_CHARACTERISTIC TP_S16ETCSCpLmtCrngTarTrq[0] EngCalVariantCriterion
  /begin VAR_ADDRESS 0x8003A3FA 0x8003B1FA 0x8003BFFA 0x8003CDFA 0x8003DBFA 0x8003E9FA 0x8003F7FA 0x800405FA 0x800413FA 0x800421FA 0x80042FFA 0x80043DFA 0x80044BFA 0x800459FA 0x800467FA 0x800475FA 0x800483FA 0x800491FA 0x80049FFA 0x8004ADFA 0x8004BBFA 0x8004C9FA 0x8004D7FA 0x8004E5FA /end VAR_ADDRESS
 /end VAR_CHARACTERISTIC
 /begin VAR_CHARACTERISTIC TP_S16ETCSCpLmtCrngTarTrq[1] EngCalVariantCriterion
  /begin VAR_ADDRESS 0x8003A3FC 0x8003B1FC 0x8003BFFC 0x8003CDFC 0x8003DBFC 0x8003E9FC 0x8003F7FC 0x800405FC 0x800413FC 0x800421FC 0x80042FFC 0x80043DFC 0x80044BFC 0x800459FC 0x800467FC 0x800475FC 0x800483FC 0x800491FC 0x80049FFC 0x8004ADFC 0x8004BBFC 0x8004C9FC 0x8004D7FC 0x8004E5FC /end VAR_ADDRESS
 /end VAR_CHARACTERISTIC
 /begin VAR_CHARACTERISTIC TP_S16ETCSCpLmtCrngTarTrq[2] EngCalVariantCriterion
  /begin VAR_ADDRESS 0x8003A3FE 0x8003B1FE 0x8003BFFE 0x8003CDFE 0x8003DBFE 0x8003E9FE 0x8003F7FE 0x800405FE 0x800413FE 0x800421FE 0x80042FFE 0x80043DFE 0x80044BFE 0x800459FE 0x800467FE 0x800475FE 0x800483FE 0x800491FE 0x80049FFE 0x8004ADFE 0x8004BBFE 0x8004C9FE 0x8004D7FE 0x8004E5FE /end VAR_ADDRESS
 /end VAR_CHARACTERISTIC
 /begin VAR_CHARACTERISTIC TP_S16ETCSCpLow2HighDecel EngCalVariantCriterion
  /begin VAR_ADDRESS 0x8003A400 0x8003B200 0x8003C000 0x8003CE00 0x8003DC00 0x8003EA00 0x8003F800 0x80040600 0x80041400 0x80042200 0x80043000 0x80043E00 0x80044C00 0x80045A00 0x80046800 0x80047600 0x80048400 0x80049200 0x8004A000 0x8004AE00 0x8004BC00 0x8004CA00 0x8004D800 0x8004E600 /end VAR_ADDRESS
 /end VAR_CHARACTERISTIC
 /begin VAR_CHARACTERISTIC TP_S16ETCSCpLowRiskStallRpmFlat EngCalVariantCriterion
  /begin VAR_ADDRESS 0x8003A402 0x8003B202 0x8003C002 0x8003CE02 0x8003DC02 0x8003EA02 0x8003F802 0x80040602 0x80041402 0x80042202 0x80043002 0x80043E02 0x80044C02 0x80045A02 0x80046802 0x80047602 0x80048402 0x80049202 0x8004A002 0x8004AE02 0x8004BC02 0x8004CA02 0x8004D802 0x8004E602 /end VAR_ADDRESS
 /end VAR_CHARACTERISTIC
 /begin VAR_CHARACTERISTIC TP_S16ETCSCpLowRiskStallRpmHill EngCalVariantCriterion
  /begin VAR_ADDRESS 0x8003A404 0x8003B204 0x8003C004 0x8003CE04 0x8003DC04 0x8003EA04 0x8003F804 0x80040604 0x80041404 0x80042204 0x80043004 0x80043E04 0x80044C04 0x80045A04 0x80046804 0x80047604 0x80048404 0x80049204 0x8004A004 0x8004AE04 0x8004BC04 0x8004CA04 0x8004D804 0x8004E604 /end VAR_ADDRESS
 /end VAR_CHARACTERISTIC
 /begin VAR_CHARACTERISTIC TP_S16ETCSCpLwToSpltDctCplCnt EngCalVariantCriterion
  /begin VAR_ADDRESS 0x8003A406 0x8003B206 0x8003C006 0x8003CE06 0x8003DC06 0x8003EA06 0x8003F806 0x80040606 0x80041406 0x80042206 0x80043006 0x80043E06 0x80044C06 0x80045A06 0x80046806 0x80047606 0x80048406 0x80049206 0x8004A006 0x8004AE06 0x8004BC06 0x8004CA06 0x8004D806 0x8004E606 /end VAR_ADDRESS
 /end VAR_CHARACTERISTIC
 /begin VAR_CHARACTERISTIC TP_S16ETCSCpLwToSpltDctStrtCnt EngCalVariantCriterion
  /begin VAR_ADDRESS 0x8003A408 0x8003B208 0x8003C008 0x8003CE08 0x8003DC08 0x8003EA08 0x8003F808 0x80040608 0x80041408 0x80042208 0x80043008 0x80043E08 0x80044C08 0x80045A08 0x80046808 0x80047608 0x80048408 0x80049208 0x8004A008 0x8004AE08 0x8004BC08 0x8004CA08 0x8004D808 0x8004E608 /end VAR_ADDRESS
 /end VAR_CHARACTERISTIC
 /begin VAR_CHARACTERISTIC TP_S16ETCSCpMaxEngTrq EngCalVariantCriterion
  /begin VAR_ADDRESS 0x8003A40A 0x8003B20A 0x8003C00A 0x8003CE0A 0x8003DC0A 0x8003EA0A 0x8003F80A 0x8004060A 0x8004140A 0x8004220A 0x8004300A 0x80043E0A 0x80044C0A 0x80045A0A 0x8004680A 0x8004760A 0x8004840A 0x8004920A 0x8004A00A 0x8004AE0A 0x8004BC0A 0x8004CA0A 0x8004D80A 0x8004E60A /end VAR_ADDRESS
 /end VAR_CHARACTERISTIC
 /begin VAR_CHARACTERISTIC TP_S16ETCSCpMidRiskStallRpmFlat EngCalVariantCriterion
  /begin VAR_ADDRESS 0x8003A40C 0x8003B20C 0x8003C00C 0x8003CE0C 0x8003DC0C 0x8003EA0C 0x8003F80C 0x8004060C 0x8004140C 0x8004220C 0x8004300C 0x80043E0C 0x80044C0C 0x80045A0C 0x8004680C 0x8004760C 0x8004840C 0x8004920C 0x8004A00C 0x8004AE0C 0x8004BC0C 0x8004CA0C 0x8004D80C 0x8004E60C /end VAR_ADDRESS
 /end VAR_CHARACTERISTIC
 /begin VAR_CHARACTERISTIC TP_S16ETCSCpMidRiskStallRpmHill EngCalVariantCriterion
  /begin VAR_ADDRESS 0x8003A40E 0x8003B20E 0x8003C00E 0x8003CE0E 0x8003DC0E 0x8003EA0E 0x8003F80E 0x8004060E 0x8004140E 0x8004220E 0x8004300E 0x80043E0E 0x80044C0E 0x80045A0E 0x8004680E 0x8004760E 0x8004840E 0x8004920E 0x8004A00E 0x8004AE0E 0x8004BC0E 0x8004CA0E 0x8004D80E 0x8004E60E /end VAR_ADDRESS
 /end VAR_CHARACTERISTIC
 /begin VAR_CHARACTERISTIC TP_S16ETCSCpMinCrdnCmdTrq EngCalVariantCriterion
  /begin VAR_ADDRESS 0x8003A410 0x8003B210 0x8003C010 0x8003CE10 0x8003DC10 0x8003EA10 0x8003F810 0x80040610 0x80041410 0x80042210 0x80043010 0x80043E10 0x80044C10 0x80045A10 0x80046810 0x80047610 0x80048410 0x80049210 0x8004A010 0x8004AE10 0x8004BC10 0x8004CA10 0x8004D810 0x8004E610 /end VAR_ADDRESS
 /end VAR_CHARACTERISTIC
 /begin VAR_CHARACTERISTIC TP_S16ETCSCpMinEngCdrnTrqAtDepSnw EngCalVariantCriterion
  /begin VAR_ADDRESS 0x8003A412 0x8003B212 0x8003C012 0x8003CE12 0x8003DC12 0x8003EA12 0x8003F812 0x80040612 0x80041412 0x80042212 0x80043012 0x80043E12 0x80044C12 0x80045A12 0x80046812 0x80047612 0x80048412 0x80049212 0x8004A012 0x8004AE12 0x8004BC12 0x8004CA12 0x8004D812 0x8004E612 /end VAR_ADDRESS
 /end VAR_CHARACTERISTIC
 /begin VAR_CHARACTERISTIC TP_S16ETCSCpOffsetTrq4LwToSplt EngCalVariantCriterion
  /begin VAR_ADDRESS 0x8003A414 0x8003B214 0x8003C014 0x8003CE14 0x8003DC14 0x8003EA14 0x8003F814 0x80040614 0x80041414 0x80042214 0x80043014 0x80043E14 0x80044C14 0x80045A14 0x80046814 0x80047614 0x80048414 0x80049214 0x8004A014 0x8004AE14 0x8004BC14 0x8004CA14 0x8004D814 0x8004E614 /end VAR_ADDRESS
 /end VAR_CHARACTERISTIC
 /begin VAR_CHARACTERISTIC TP_S16ETCSCpPreHighRdDctCplCnt EngCalVariantCriterion
  /begin VAR_ADDRESS 0x8003A416 0x8003B216 0x8003C016 0x8003CE16 0x8003DC16 0x8003EA16 0x8003F816 0x80040616 0x80041416 0x80042216 0x80043016 0x80043E16 0x80044C16 0x80045A16 0x80046816 0x80047616 0x80048416 0x80049216 0x8004A016 0x8004AE16 0x8004BC16 0x8004CA16 0x8004D816 0x8004E616 /end VAR_ADDRESS
 /end VAR_CHARACTERISTIC
 /begin VAR_CHARACTERISTIC TP_S16ETCSCpPreHighRdDctStrtCnt EngCalVariantCriterion
  /begin VAR_ADDRESS 0x8003A418 0x8003B218 0x8003C018 0x8003CE18 0x8003DC18 0x8003EA18 0x8003F818 0x80040618 0x80041418 0x80042218 0x80043018 0x80043E18 0x80044C18 0x80045A18 0x80046818 0x80047618 0x80048418 0x80049218 0x8004A018 0x8004AE18 0x8004BC18 0x8004CA18 0x8004D818 0x8004E618 /end VAR_ADDRESS
 /end VAR_CHARACTERISTIC
 /begin VAR_CHARACTERISTIC TP_S16ETCSCpReqVcaDctCnt EngCalVariantCriterion
  /begin VAR_ADDRESS 0x8003A41A 0x8003B21A 0x8003C01A 0x8003CE1A 0x8003DC1A 0x8003EA1A 0x8003F81A 0x8004061A 0x8004141A 0x8004221A 0x8004301A 0x80043E1A 0x80044C1A 0x80045A1A 0x8004681A 0x8004761A 0x8004841A 0x8004921A 0x8004A01A 0x8004AE1A 0x8004BC1A 0x8004CA1A 0x8004D81A 0x8004E61A /end VAR_ADDRESS
 /end VAR_CHARACTERISTIC
 /begin VAR_CHARACTERISTIC TP_S16ETCSCpSpd[0] EngCalVariantCriterion
  /begin VAR_ADDRESS 0x8003A41C 0x8003B21C 0x8003C01C 0x8003CE1C 0x8003DC1C 0x8003EA1C 0x8003F81C 0x8004061C 0x8004141C 0x8004221C 0x8004301C 0x80043E1C 0x80044C1C 0x80045A1C 0x8004681C 0x8004761C 0x8004841C 0x8004921C 0x8004A01C 0x8004AE1C 0x8004BC1C 0x8004CA1C 0x8004D81C 0x8004E61C /end VAR_ADDRESS
 /end VAR_CHARACTERISTIC
 /begin VAR_CHARACTERISTIC TP_S16ETCSCpSpd[1] EngCalVariantCriterion
  /begin VAR_ADDRESS 0x8003A41E 0x8003B21E 0x8003C01E 0x8003CE1E 0x8003DC1E 0x8003EA1E 0x8003F81E 0x8004061E 0x8004141E 0x8004221E 0x8004301E 0x80043E1E 0x80044C1E 0x80045A1E 0x8004681E 0x8004761E 0x8004841E 0x8004921E 0x8004A01E 0x8004AE1E 0x8004BC1E 0x8004CA1E 0x8004D81E 0x8004E61E /end VAR_ADDRESS
 /end VAR_CHARACTERISTIC
 /begin VAR_CHARACTERISTIC TP_S16ETCSCpSpd[2] EngCalVariantCriterion
  /begin VAR_ADDRESS 0x8003A420 0x8003B220 0x8003C020 0x8003CE20 0x8003DC20 0x8003EA20 0x8003F820 0x80040620 0x80041420 0x80042220 0x80043020 0x80043E20 0x80044C20 0x80045A20 0x80046820 0x80047620 0x80048420 0x80049220 0x8004A020 0x8004AE20 0x8004BC20 0x8004CA20 0x8004D820 0x8004E620 /end VAR_ADDRESS
 /end VAR_CHARACTERISTIC
 /begin VAR_CHARACTERISTIC TP_S16ETCSCpSpd[3] EngCalVariantCriterion
  /begin VAR_ADDRESS 0x8003A422 0x8003B222 0x8003C022 0x8003CE22 0x8003DC22 0x8003EA22 0x8003F822 0x80040622 0x80041422 0x80042222 0x80043022 0x80043E22 0x80044C22 0x80045A22 0x80046822 0x80047622 0x80048422 0x80049222 0x8004A022 0x8004AE22 0x8004BC22 0x8004CA22 0x8004D822 0x8004E622 /end VAR_ADDRESS
 /end VAR_CHARACTERISTIC
 /begin VAR_CHARACTERISTIC TP_S16ETCSCpSpd[4] EngCalVariantCriterion
  /begin VAR_ADDRESS 0x8003A424 0x8003B224 0x8003C024 0x8003CE24 0x8003DC24 0x8003EA24 0x8003F824 0x80040624 0x80041424 0x80042224 0x80043024 0x80043E24 0x80044C24 0x80045A24 0x80046824 0x80047624 0x80048424 0x80049224 0x8004A024 0x8004AE24 0x8004BC24 0x8004CA24 0x8004D824 0x8004E624 /end VAR_ADDRESS
 /end VAR_CHARACTERISTIC
 /begin VAR_CHARACTERISTIC TP_S16ETCSCpSplitDecCrdnTrq EngCalVariantCriterion
  /begin VAR_ADDRESS 0x8003A426 0x8003B226 0x8003C026 0x8003CE26 0x8003DC26 0x8003EA26 0x8003F826 0x80040626 0x80041426 0x80042226 0x80043026 0x80043E26 0x80044C26 0x80045A26 0x80046826 0x80047626 0x80048426 0x80049226 0x8004A026 0x8004AE26 0x8004BC26 0x8004CA26 0x8004D826 0x8004E626 /end VAR_ADDRESS
 /end VAR_CHARACTERISTIC
 /begin VAR_CHARACTERISTIC TP_S16ETCSCpSplitDecTrqCplSpnErr EngCalVariantCriterion
  /begin VAR_ADDRESS 0x8003A428 0x8003B228 0x8003C028 0x8003CE28 0x8003DC28 0x8003EA28 0x8003F828 0x80040628 0x80041428 0x80042228 0x80043028 0x80043E28 0x80044C28 0x80045A28 0x80046828 0x80047628 0x80048428 0x80049228 0x8004A028 0x8004AE28 0x8004BC28 0x8004CA28 0x8004D828 0x8004E628 /end VAR_ADDRESS
 /end VAR_CHARACTERISTIC
 /begin VAR_CHARACTERISTIC TP_S16ETCSCpSplitDecTrqStrSpnErr EngCalVariantCriterion
  /begin VAR_ADDRESS 0x8003A42A 0x8003B22A 0x8003C02A 0x8003CE2A 0x8003DC2A 0x8003EA2A 0x8003F82A 0x8004062A 0x8004142A 0x8004222A 0x8004302A 0x80043E2A 0x80044C2A 0x80045A2A 0x8004682A 0x8004762A 0x8004842A 0x8004922A 0x8004A02A 0x8004AE2A 0x8004BC2A 0x8004CA2A 0x8004D82A 0x8004E62A /end VAR_ADDRESS
 /end VAR_CHARACTERISTIC
 /begin VAR_CHARACTERISTIC TP_S16ETCSCpSplitHillClrEngSpd EngCalVariantCriterion
  /begin VAR_ADDRESS 0x8003A42C 0x8003B22C 0x8003C02C 0x8003CE2C 0x8003DC2C 0x8003EA2C 0x8003F82C 0x8004062C 0x8004142C 0x8004222C 0x8004302C 0x80043E2C 0x80044C2C 0x80045A2C 0x8004682C 0x8004762C 0x8004842C 0x8004922C 0x8004A02C 0x8004AE2C 0x8004BC2C 0x8004CA2C 0x8004D82C 0x8004E62C /end VAR_ADDRESS
 /end VAR_CHARACTERISTIC
 /begin VAR_CHARACTERISTIC TP_S16ETCSCpSplitHillDctEngSpd EngCalVariantCriterion
  /begin VAR_ADDRESS 0x8003A42E 0x8003B22E 0x8003C02E 0x8003CE2E 0x8003DC2E 0x8003EA2E 0x8003F82E 0x8004062E 0x8004142E 0x8004222E 0x8004302E 0x80043E2E 0x80044C2E 0x80045A2E 0x8004682E 0x8004762E 0x8004842E 0x8004922E 0x8004A02E 0x8004AE2E 0x8004BC2E 0x8004CA2E 0x8004D82E 0x8004E62E /end VAR_ADDRESS
 /end VAR_CHARACTERISTIC
 /begin VAR_CHARACTERISTIC TP_S16ETCSCpSpltPatFasIncTrqRate EngCalVariantCriterion
  /begin VAR_ADDRESS 0x8003A430 0x8003B230 0x8003C030 0x8003CE30 0x8003DC30 0x8003EA30 0x8003F830 0x80040630 0x80041430 0x80042230 0x80043030 0x80043E30 0x80044C30 0x80045A30 0x80046830 0x80047630 0x80048430 0x80049230 0x8004A030 0x8004AE30 0x8004BC30 0x8004CA30 0x8004D830 0x8004E630 /end VAR_ADDRESS
 /end VAR_CHARACTERISTIC
 /begin VAR_CHARACTERISTIC TP_S16ETCSCpSpltPatSlwDecTrqRate EngCalVariantCriterion
  /begin VAR_ADDRESS 0x8003A432 0x8003B232 0x8003C032 0x8003CE32 0x8003DC32 0x8003EA32 0x8003F832 0x80040632 0x80041432 0x80042232 0x80043032 0x80043E32 0x80044C32 0x80045A32 0x80046832 0x80047632 0x80048432 0x80049232 0x8004A032 0x8004AE32 0x8004BC32 0x8004CA32 0x8004D832 0x8004E632 /end VAR_ADDRESS
 /end VAR_CHARACTERISTIC
 /begin VAR_CHARACTERISTIC TP_S16ETCSCpSpltPatSlwIncTrqRate EngCalVariantCriterion
  /begin VAR_ADDRESS 0x8003A434 0x8003B234 0x8003C034 0x8003CE34 0x8003DC34 0x8003EA34 0x8003F834 0x80040634 0x80041434 0x80042234 0x80043034 0x80043E34 0x80044C34 0x80045A34 0x80046834 0x80047634 0x80048434 0x80049234 0x8004A034 0x8004AE34 0x8004BC34 0x8004CA34 0x8004D834 0x8004E634 /end VAR_ADDRESS
 /end VAR_CHARACTERISTIC
 /begin VAR_CHARACTERISTIC TP_S16ETCSCpSpltToLwTrqDrp[0][0] EngCalVariantCriterion
  /begin VAR_ADDRESS 0x8003A436 0x8003B236 0x8003C036 0x8003CE36 0x8003DC36 0x8003EA36 0x8003F836 0x80040636 0x80041436 0x80042236 0x80043036 0x80043E36 0x80044C36 0x80045A36 0x80046836 0x80047636 0x80048436 0x80049236 0x8004A036 0x8004AE36 0x8004BC36 0x8004CA36 0x8004D836 0x8004E636 /end VAR_ADDRESS
 /end VAR_CHARACTERISTIC
 /begin VAR_CHARACTERISTIC TP_S16ETCSCpSpltToLwTrqDrp[0][1] EngCalVariantCriterion
  /begin VAR_ADDRESS 0x8003A438 0x8003B238 0x8003C038 0x8003CE38 0x8003DC38 0x8003EA38 0x8003F838 0x80040638 0x80041438 0x80042238 0x80043038 0x80043E38 0x80044C38 0x80045A38 0x80046838 0x80047638 0x80048438 0x80049238 0x8004A038 0x8004AE38 0x8004BC38 0x8004CA38 0x8004D838 0x8004E638 /end VAR_ADDRESS
 /end VAR_CHARACTERISTIC
 /begin VAR_CHARACTERISTIC TP_S16ETCSCpSpltToLwTrqDrp[0][2] EngCalVariantCriterion
  /begin VAR_ADDRESS 0x8003A43A 0x8003B23A 0x8003C03A 0x8003CE3A 0x8003DC3A 0x8003EA3A 0x8003F83A 0x8004063A 0x8004143A 0x8004223A 0x8004303A 0x80043E3A 0x80044C3A 0x80045A3A 0x8004683A 0x8004763A 0x8004843A 0x8004923A 0x8004A03A 0x8004AE3A 0x8004BC3A 0x8004CA3A 0x8004D83A 0x8004E63A /end VAR_ADDRESS
 /end VAR_CHARACTERISTIC
 /begin VAR_CHARACTERISTIC TP_S16ETCSCpSpltToLwTrqDrp[1][0] EngCalVariantCriterion
  /begin VAR_ADDRESS 0x8003A43C 0x8003B23C 0x8003C03C 0x8003CE3C 0x8003DC3C 0x8003EA3C 0x8003F83C 0x8004063C 0x8004143C 0x8004223C 0x8004303C 0x80043E3C 0x80044C3C 0x80045A3C 0x8004683C 0x8004763C 0x8004843C 0x8004923C 0x8004A03C 0x8004AE3C 0x8004BC3C 0x8004CA3C 0x8004D83C 0x8004E63C /end VAR_ADDRESS
 /end VAR_CHARACTERISTIC
 /begin VAR_CHARACTERISTIC TP_S16ETCSCpSpltToLwTrqDrp[1][1] EngCalVariantCriterion
  /begin VAR_ADDRESS 0x8003A43E 0x8003B23E 0x8003C03E 0x8003CE3E 0x8003DC3E 0x8003EA3E 0x8003F83E 0x8004063E 0x8004143E 0x8004223E 0x8004303E 0x80043E3E 0x80044C3E 0x80045A3E 0x8004683E 0x8004763E 0x8004843E 0x8004923E 0x8004A03E 0x8004AE3E 0x8004BC3E 0x8004CA3E 0x8004D83E 0x8004E63E /end VAR_ADDRESS
 /end VAR_CHARACTERISTIC
 /begin VAR_CHARACTERISTIC TP_S16ETCSCpSpltToLwTrqDrp[1][2] EngCalVariantCriterion
  /begin VAR_ADDRESS 0x8003A440 0x8003B240 0x8003C040 0x8003CE40 0x8003DC40 0x8003EA40 0x8003F840 0x80040640 0x80041440 0x80042240 0x80043040 0x80043E40 0x80044C40 0x80045A40 0x80046840 0x80047640 0x80048440 0x80049240 0x8004A040 0x8004AE40 0x8004BC40 0x8004CA40 0x8004D840 0x8004E640 /end VAR_ADDRESS
 /end VAR_CHARACTERISTIC
 /begin VAR_CHARACTERISTIC TP_S16ETCSCpSpltToLwTrqDrp[2][0] EngCalVariantCriterion
  /begin VAR_ADDRESS 0x8003A442 0x8003B242 0x8003C042 0x8003CE42 0x8003DC42 0x8003EA42 0x8003F842 0x80040642 0x80041442 0x80042242 0x80043042 0x80043E42 0x80044C42 0x80045A42 0x80046842 0x80047642 0x80048442 0x80049242 0x8004A042 0x8004AE42 0x8004BC42 0x8004CA42 0x8004D842 0x8004E642 /end VAR_ADDRESS
 /end VAR_CHARACTERISTIC
 /begin VAR_CHARACTERISTIC TP_S16ETCSCpSpltToLwTrqDrp[2][1] EngCalVariantCriterion
  /begin VAR_ADDRESS 0x8003A444 0x8003B244 0x8003C044 0x8003CE44 0x8003DC44 0x8003EA44 0x8003F844 0x80040644 0x80041444 0x80042244 0x80043044 0x80043E44 0x80044C44 0x80045A44 0x80046844 0x80047644 0x80048444 0x80049244 0x8004A044 0x8004AE44 0x8004BC44 0x8004CA44 0x8004D844 0x8004E644 /end VAR_ADDRESS
 /end VAR_CHARACTERISTIC
 /begin VAR_CHARACTERISTIC TP_S16ETCSCpSpltToLwTrqDrp[2][2] EngCalVariantCriterion
  /begin VAR_ADDRESS 0x8003A446 0x8003B246 0x8003C046 0x8003CE46 0x8003DC46 0x8003EA46 0x8003F846 0x80040646 0x80041446 0x80042246 0x80043046 0x80043E46 0x80044C46 0x80045A46 0x80046846 0x80047646 0x80048446 0x80049246 0x8004A046 0x8004AE46 0x8004BC46 0x8004CA46 0x8004D846 0x8004E646 /end VAR_ADDRESS
 /end VAR_CHARACTERISTIC
 /begin VAR_CHARACTERISTIC TP_S16ETCSCpStrtCdrnTrqAtAsphalt EngCalVariantCriterion
  /begin VAR_ADDRESS 0x8003A448 0x8003B248 0x8003C048 0x8003CE48 0x8003DC48 0x8003EA48 0x8003F848 0x80040648 0x80041448 0x80042248 0x80043048 0x80043E48 0x80044C48 0x80045A48 0x80046848 0x80047648 0x80048448 0x80049248 0x8004A048 0x8004AE48 0x8004BC48 0x8004CA48 0x8004D848 0x8004E648 /end VAR_ADDRESS
 /end VAR_CHARACTERISTIC
 /begin VAR_CHARACTERISTIC TP_S16ETCSCpTEGWheelSpinThr EngCalVariantCriterion
  /begin VAR_ADDRESS 0x8003A44A 0x8003B24A 0x8003C04A 0x8003CE4A 0x8003DC4A 0x8003EA4A 0x8003F84A 0x8004064A 0x8004144A 0x8004224A 0x8004304A 0x80043E4A 0x80044C4A 0x80045A4A 0x8004684A 0x8004764A 0x8004844A 0x8004924A 0x8004A04A 0x8004AE4A 0x8004BC4A 0x8004CA4A 0x8004D84A 0x8004E64A /end VAR_ADDRESS
 /end VAR_CHARACTERISTIC
 /begin VAR_CHARACTERISTIC TP_S16ETCSCpTireRadi EngCalVariantCriterion
  /begin VAR_ADDRESS 0x8003A44C 0x8003B24C 0x8003C04C 0x8003CE4C 0x8003DC4C 0x8003EA4C 0x8003F84C 0x8004064C 0x8004144C 0x8004224C 0x8004304C 0x80043E4C 0x80044C4C 0x80045A4C 0x8004684C 0x8004764C 0x8004844C 0x8004924C 0x8004A04C 0x8004AE4C 0x8004BC4C 0x8004CA4C 0x8004D84C 0x8004E64C /end VAR_ADDRESS
 /end VAR_CHARACTERISTIC
 /begin VAR_CHARACTERISTIC TP_S16ETCSCpTransTmAftDrvVib EngCalVariantCriterion
  /begin VAR_ADDRESS 0x8003A44E 0x8003B24E 0x8003C04E 0x8003CE4E 0x8003DC4E 0x8003EA4E 0x8003F84E 0x8004064E 0x8004144E 0x8004224E 0x8004304E 0x80043E4E 0x80044C4E 0x80045A4E 0x8004684E 0x8004764E 0x8004844E 0x8004924E 0x8004A04E 0x8004AE4E 0x8004BC4E 0x8004CA4E 0x8004D84E 0x8004E64E /end VAR_ADDRESS
 /end VAR_CHARACTERISTIC
 /begin VAR_CHARACTERISTIC TP_S16ETCSCpTrgtEngSpdStlDetd EngCalVariantCriterion
  /begin VAR_ADDRESS 0x8003A450 0x8003B250 0x8003C050 0x8003CE50 0x8003DC50 0x8003EA50 0x8003F850 0x80040650 0x80041450 0x80042250 0x80043050 0x80043E50 0x80044C50 0x80045A50 0x80046850 0x80047650 0x80048450 0x80049250 0x8004A050 0x8004AE50 0x8004BC50 0x8004CA50 0x8004D850 0x8004E650 /end VAR_ADDRESS
 /end VAR_CHARACTERISTIC
 /begin VAR_CHARACTERISTIC TP_S16ETCSCpTrgtOffStEngSpdStlDetd EngCalVariantCriterion
  /begin VAR_ADDRESS 0x8003A452 0x8003B252 0x8003C052 0x8003CE52 0x8003DC52 0x8003EA52 0x8003F852 0x80040652 0x80041452 0x80042252 0x80043052 0x80043E52 0x80044C52 0x80045A52 0x80046852 0x80047652 0x80048452 0x80049252 0x8004A052 0x8004AE52 0x8004BC52 0x8004CA52 0x8004D852 0x8004E652 /end VAR_ADDRESS
 /end VAR_CHARACTERISTIC
 /begin VAR_CHARACTERISTIC TP_S16ETCSCpTrnfrCsGrRtoHgMd EngCalVariantCriterion
  /begin VAR_ADDRESS 0x8003A454 0x8003B254 0x8003C054 0x8003CE54 0x8003DC54 0x8003EA54 0x8003F854 0x80040654 0x80041454 0x80042254 0x80043054 0x80043E54 0x80044C54 0x80045A54 0x80046854 0x80047654 0x80048454 0x80049254 0x8004A054 0x8004AE54 0x8004BC54 0x8004CA54 0x8004D854 0x8004E654 /end VAR_ADDRESS
 /end VAR_CHARACTERISTIC
 /begin VAR_CHARACTERISTIC TP_S16ETCSCpTrnfrCsGrRtoLwMd EngCalVariantCriterion
  /begin VAR_ADDRESS 0x8003A456 0x8003B256 0x8003C056 0x8003CE56 0x8003DC56 0x8003EA56 0x8003F856 0x80040656 0x80041456 0x80042256 0x80043056 0x80043E56 0x80044C56 0x80045A56 0x80046856 0x80047656 0x80048456 0x80049256 0x8004A056 0x8004AE56 0x8004BC56 0x8004CA56 0x8004D856 0x8004E656 /end VAR_ADDRESS
 /end VAR_CHARACTERISTIC
 /begin VAR_CHARACTERISTIC TP_S16ETCSCpTrqOffset4InhHldVib EngCalVariantCriterion
  /begin VAR_ADDRESS 0x8003A458 0x8003B258 0x8003C058 0x8003CE58 0x8003DC58 0x8003EA58 0x8003F858 0x80040658 0x80041458 0x80042258 0x80043058 0x80043E58 0x80044C58 0x80045A58 0x80046858 0x80047658 0x80048458 0x80049258 0x8004A058 0x8004AE58 0x8004BC58 0x8004CA58 0x8004D858 0x8004E658 /end VAR_ADDRESS
 /end VAR_CHARACTERISTIC
 /begin VAR_CHARACTERISTIC TP_S16ETCSCpTtlVehMass EngCalVariantCriterion
  /begin VAR_ADDRESS 0x8003A45A 0x8003B25A 0x8003C05A 0x8003CE5A 0x8003DC5A 0x8003EA5A 0x8003F85A 0x8004065A 0x8004145A 0x8004225A 0x8004305A 0x80043E5A 0x80044C5A 0x80045A5A 0x8004685A 0x8004765A 0x8004845A 0x8004925A 0x8004A05A 0x8004AE5A 0x8004BC5A 0x8004CA5A 0x8004D85A 0x8004E65A /end VAR_ADDRESS
 /end VAR_CHARACTERISTIC
 /begin VAR_CHARACTERISTIC TP_S16ETCSCpVcaTrqDrp[0][0] EngCalVariantCriterion
  /begin VAR_ADDRESS 0x8003A45C 0x8003B25C 0x8003C05C 0x8003CE5C 0x8003DC5C 0x8003EA5C 0x8003F85C 0x8004065C 0x8004145C 0x8004225C 0x8004305C 0x80043E5C 0x80044C5C 0x80045A5C 0x8004685C 0x8004765C 0x8004845C 0x8004925C 0x8004A05C 0x8004AE5C 0x8004BC5C 0x8004CA5C 0x8004D85C 0x8004E65C /end VAR_ADDRESS
 /end VAR_CHARACTERISTIC
 /begin VAR_CHARACTERISTIC TP_S16ETCSCpVcaTrqDrp[0][1] EngCalVariantCriterion
  /begin VAR_ADDRESS 0x8003A45E 0x8003B25E 0x8003C05E 0x8003CE5E 0x8003DC5E 0x8003EA5E 0x8003F85E 0x8004065E 0x8004145E 0x8004225E 0x8004305E 0x80043E5E 0x80044C5E 0x80045A5E 0x8004685E 0x8004765E 0x8004845E 0x8004925E 0x8004A05E 0x8004AE5E 0x8004BC5E 0x8004CA5E 0x8004D85E 0x8004E65E /end VAR_ADDRESS
 /end VAR_CHARACTERISTIC
 /begin VAR_CHARACTERISTIC TP_S16ETCSCpVcaTrqDrp[0][2] EngCalVariantCriterion
  /begin VAR_ADDRESS 0x8003A460 0x8003B260 0x8003C060 0x8003CE60 0x8003DC60 0x8003EA60 0x8003F860 0x80040660 0x80041460 0x80042260 0x80043060 0x80043E60 0x80044C60 0x80045A60 0x80046860 0x80047660 0x80048460 0x80049260 0x8004A060 0x8004AE60 0x8004BC60 0x8004CA60 0x8004D860 0x8004E660 /end VAR_ADDRESS
 /end VAR_CHARACTERISTIC
 /begin VAR_CHARACTERISTIC TP_S16ETCSCpVcaTrqDrp[1][0] EngCalVariantCriterion
  /begin VAR_ADDRESS 0x8003A462 0x8003B262 0x8003C062 0x8003CE62 0x8003DC62 0x8003EA62 0x8003F862 0x80040662 0x80041462 0x80042262 0x80043062 0x80043E62 0x80044C62 0x80045A62 0x80046862 0x80047662 0x80048462 0x80049262 0x8004A062 0x8004AE62 0x8004BC62 0x8004CA62 0x8004D862 0x8004E662 /end VAR_ADDRESS
 /end VAR_CHARACTERISTIC
 /begin VAR_CHARACTERISTIC TP_S16ETCSCpVcaTrqDrp[1][1] EngCalVariantCriterion
  /begin VAR_ADDRESS 0x8003A464 0x8003B264 0x8003C064 0x8003CE64 0x8003DC64 0x8003EA64 0x8003F864 0x80040664 0x80041464 0x80042264 0x80043064 0x80043E64 0x80044C64 0x80045A64 0x80046864 0x80047664 0x80048464 0x80049264 0x8004A064 0x8004AE64 0x8004BC64 0x8004CA64 0x8004D864 0x8004E664 /end VAR_ADDRESS
 /end VAR_CHARACTERISTIC
 /begin VAR_CHARACTERISTIC TP_S16ETCSCpVcaTrqDrp[1][2] EngCalVariantCriterion
  /begin VAR_ADDRESS 0x8003A466 0x8003B266 0x8003C066 0x8003CE66 0x8003DC66 0x8003EA66 0x8003F866 0x80040666 0x80041466 0x80042266 0x80043066 0x80043E66 0x80044C66 0x80045A66 0x80046866 0x80047666 0x80048466 0x80049266 0x8004A066 0x8004AE66 0x8004BC66 0x8004CA66 0x8004D866 0x8004E666 /end VAR_ADDRESS
 /end VAR_CHARACTERISTIC
 /begin VAR_CHARACTERISTIC TP_S16ETCSCpVcaTrqDrp[2][0] EngCalVariantCriterion
  /begin VAR_ADDRESS 0x8003A468 0x8003B268 0x8003C068 0x8003CE68 0x8003DC68 0x8003EA68 0x8003F868 0x80040668 0x80041468 0x80042268 0x80043068 0x80043E68 0x80044C68 0x80045A68 0x80046868 0x80047668 0x80048468 0x80049268 0x8004A068 0x8004AE68 0x8004BC68 0x8004CA68 0x8004D868 0x8004E668 /end VAR_ADDRESS
 /end VAR_CHARACTERISTIC
 /begin VAR_CHARACTERISTIC TP_S16ETCSCpVcaTrqDrp[2][1] EngCalVariantCriterion
  /begin VAR_ADDRESS 0x8003A46A 0x8003B26A 0x8003C06A 0x8003CE6A 0x8003DC6A 0x8003EA6A 0x8003F86A 0x8004066A 0x8004146A 0x8004226A 0x8004306A 0x80043E6A 0x80044C6A 0x80045A6A 0x8004686A 0x8004766A 0x8004846A 0x8004926A 0x8004A06A 0x8004AE6A 0x8004BC6A 0x8004CA6A 0x8004D86A 0x8004E66A /end VAR_ADDRESS
 /end VAR_CHARACTERISTIC
 /begin VAR_CHARACTERISTIC TP_S16ETCSCpVcaTrqDrp[2][2] EngCalVariantCriterion
  /begin VAR_ADDRESS 0x8003A46C 0x8003B26C 0x8003C06C 0x8003CE6C 0x8003DC6C 0x8003EA6C 0x8003F86C 0x8004066C 0x8004146C 0x8004226C 0x8004306C 0x80043E6C 0x80044C6C 0x80045A6C 0x8004686C 0x8004766C 0x8004846C 0x8004926C 0x8004A06C 0x8004AE6C 0x8004BC6C 0x8004CA6C 0x8004D86C 0x8004E66C /end VAR_ADDRESS
 /end VAR_CHARACTERISTIC
 /begin VAR_CHARACTERISTIC TP_S16FFBrkTorqReduce4Vibration EngCalVariantCriterion
  /begin VAR_ADDRESS 0x8003A174 0x8003AF74 0x8003BD74 0x8003CB74 0x8003D974 0x8003E774 0x8003F574 0x80040374 0x80041174 0x80041F74 0x80042D74 0x80043B74 0x80044974 0x80045774 0x80046574 0x80047374 0x80048174 0x80048F74 0x80049D74 0x8004AB74 0x8004B974 0x8004C774 0x8004D574 0x8004E374 /end VAR_ADDRESS
 /end VAR_CHARACTERISTIC
 /begin VAR_CHARACTERISTIC TP_S16TCSCpADDBTCEntTh4ComPMod EngCalVariantCriterion
  /begin VAR_ADDRESS 0x8003A176 0x8003AF76 0x8003BD76 0x8003CB76 0x8003D976 0x8003E776 0x8003F576 0x80040376 0x80041176 0x80041F76 0x80042D76 0x80043B76 0x80044976 0x80045776 0x80046576 0x80047376 0x80048176 0x80048F76 0x80049D76 0x8004AB76 0x8004B976 0x8004C776 0x8004D576 0x8004E376 /end VAR_ADDRESS
 /end VAR_CHARACTERISTIC
 /begin VAR_CHARACTERISTIC TP_S16TCSCpADDBTCTarSP4ComPMod EngCalVariantCriterion
  /begin VAR_ADDRESS 0x8003A178 0x8003AF78 0x8003BD78 0x8003CB78 0x8003D978 0x8003E778 0x8003F578 0x80040378 0x80041178 0x80041F78 0x80042D78 0x80043B78 0x80044978 0x80045778 0x80046578 0x80047378 0x80048178 0x80048F78 0x80049D78 0x8004AB78 0x8004B978 0x8004C778 0x8004D578 0x8004E378 /end VAR_ADDRESS
 /end VAR_CHARACTERISTIC
 /begin VAR_CHARACTERISTIC TP_S16TCSCpADDTh4ESC EngCalVariantCriterion
  /begin VAR_ADDRESS 0x8003A17E 0x8003AF7E 0x8003BD7E 0x8003CB7E 0x8003D97E 0x8003E77E 0x8003F57E 0x8004037E 0x8004117E 0x80041F7E 0x80042D7E 0x80043B7E 0x8004497E 0x8004577E 0x8004657E 0x8004737E 0x8004817E 0x80048F7E 0x80049D7E 0x8004AB7E 0x8004B97E 0x8004C77E 0x8004D57E 0x8004E37E /end VAR_ADDRESS
 /end VAR_CHARACTERISTIC
 /begin VAR_CHARACTERISTIC TP_S16TCSCpADDTh4RTA EngCalVariantCriterion
  /begin VAR_ADDRESS 0x8003A182 0x8003AF82 0x8003BD82 0x8003CB82 0x8003D982 0x8003E782 0x8003F582 0x80040382 0x80041182 0x80041F82 0x80042D82 0x80043B82 0x80044982 0x80045782 0x80046582 0x80047382 0x80048182 0x80048F82 0x80049D82 0x8004AB82 0x8004B982 0x8004C782 0x8004D582 0x8004E382 /end VAR_ADDRESS
 /end VAR_CHARACTERISTIC
 /begin VAR_CHARACTERISTIC TP_S16TCSCpADDTh4RoughRoad EngCalVariantCriterion
  /begin VAR_ADDRESS 0x8003A180 0x8003AF80 0x8003BD80 0x8003CB80 0x8003D980 0x8003E780 0x8003F580 0x80040380 0x80041180 0x80041F80 0x80042D80 0x80043B80 0x80044980 0x80045780 0x80046580 0x80047380 0x80048180 0x80048F80 0x80049D80 0x8004AB80 0x8004B980 0x8004C780 0x8004D580 0x8004E380 /end VAR_ADDRESS
 /end VAR_CHARACTERISTIC
 /begin VAR_CHARACTERISTIC TP_S16TCSCpAddMtrV4SPHillHghMuStab EngCalVariantCriterion
  /begin VAR_ADDRESS 0x8003A17A 0x8003AF7A 0x8003BD7A 0x8003CB7A 0x8003D97A 0x8003E77A 0x8003F57A 0x8004037A 0x8004117A 0x80041F7A 0x80042D7A 0x80043B7A 0x8004497A 0x8004577A 0x8004657A 0x8004737A 0x8004817A 0x80048F7A 0x80049D7A 0x8004AB7A 0x8004B97A 0x8004C77A 0x8004D57A 0x8004E37A /end VAR_ADDRESS
 /end VAR_CHARACTERISTIC
 /begin VAR_CHARACTERISTIC TP_S16TCSCpAddMtrV4SPHillHghMuUnSt EngCalVariantCriterion
  /begin VAR_ADDRESS 0x8003A17C 0x8003AF7C 0x8003BD7C 0x8003CB7C 0x8003D97C 0x8003E77C 0x8003F57C 0x8004037C 0x8004117C 0x80041F7C 0x80042D7C 0x80043B7C 0x8004497C 0x8004577C 0x8004657C 0x8004737C 0x8004817C 0x80048F7C 0x80049D7C 0x8004AB7C 0x8004B97C 0x8004C77C 0x8004D57C 0x8004E37C /end VAR_ADDRESS
 /end VAR_CHARACTERISTIC
 /begin VAR_CHARACTERISTIC TP_S16TCSCpBrkCtlTrqAddInVIB EngCalVariantCriterion
  /begin VAR_ADDRESS 0x8003A184 0x8003AF84 0x8003BD84 0x8003CB84 0x8003D984 0x8003E784 0x8003F584 0x80040384 0x80041184 0x80041F84 0x80042D84 0x80043B84 0x80044984 0x80045784 0x80046584 0x80047384 0x80048184 0x80048F84 0x80049D84 0x8004AB84 0x8004B984 0x8004C784 0x8004D584 0x8004E384 /end VAR_ADDRESS
 /end VAR_CHARACTERISTIC
 /begin VAR_CHARACTERISTIC TP_S16TCSCpBrkCtlTrqOfStuck EngCalVariantCriterion
  /begin VAR_ADDRESS 0x8003A186 0x8003AF86 0x8003BD86 0x8003CB86 0x8003D986 0x8003E786 0x8003F586 0x80040386 0x80041186 0x80041F86 0x80042D86 0x80043B86 0x80044986 0x80045786 0x80046586 0x80047386 0x80048186 0x80048F86 0x80049D86 0x8004AB86 0x8004B986 0x8004C786 0x8004D586 0x8004E386 /end VAR_ADDRESS
 /end VAR_CHARACTERISTIC
 /begin VAR_CHARACTERISTIC TP_S16TCSCpBrkCtlTrqOfVCA EngCalVariantCriterion
  /begin VAR_ADDRESS 0x8003A188 0x8003AF88 0x8003BD88 0x8003CB88 0x8003D988 0x8003E788 0x8003F588 0x80040388 0x80041188 0x80041F88 0x80042D88 0x80043B88 0x80044988 0x80045788 0x80046588 0x80047388 0x80048188 0x80048F88 0x80049D88 0x8004AB88 0x8004B988 0x8004C788 0x8004D588 0x8004E388 /end VAR_ADDRESS
 /end VAR_CHARACTERISTIC
 /begin VAR_CHARACTERISTIC TP_S16TCSCpBrkPGrdtLimHillDecFr EngCalVariantCriterion
  /begin VAR_ADDRESS 0x8003A18A 0x8003AF8A 0x8003BD8A 0x8003CB8A 0x8003D98A 0x8003E78A 0x8003F58A 0x8004038A 0x8004118A 0x80041F8A 0x80042D8A 0x80043B8A 0x8004498A 0x8004578A 0x8004658A 0x8004738A 0x8004818A 0x80048F8A 0x80049D8A 0x8004AB8A 0x8004B98A 0x8004C78A 0x8004D58A 0x8004E38A /end VAR_ADDRESS
 /end VAR_CHARACTERISTIC
 /begin VAR_CHARACTERISTIC TP_S16TCSCpBrkPGrdtLimHillDecRe EngCalVariantCriterion
  /begin VAR_ADDRESS 0x8003A18C 0x8003AF8C 0x8003BD8C 0x8003CB8C 0x8003D98C 0x8003E78C 0x8003F58C 0x8004038C 0x8004118C 0x80041F8C 0x80042D8C 0x80043B8C 0x8004498C 0x8004578C 0x8004658C 0x8004738C 0x8004818C 0x80048F8C 0x80049D8C 0x8004AB8C 0x8004B98C 0x8004C78C 0x8004D58C 0x8004E38C /end VAR_ADDRESS
 /end VAR_CHARACTERISTIC
 /begin VAR_CHARACTERISTIC TP_S16TCSCpBrkPGrdtLimHillIncFr EngCalVariantCriterion
  /begin VAR_ADDRESS 0x8003A18E 0x8003AF8E 0x8003BD8E 0x8003CB8E 0x8003D98E 0x8003E78E 0x8003F58E 0x8004038E 0x8004118E 0x80041F8E 0x80042D8E 0x80043B8E 0x8004498E 0x8004578E 0x8004658E 0x8004738E 0x8004818E 0x80048F8E 0x80049D8E 0x8004AB8E 0x8004B98E 0x8004C78E 0x8004D58E 0x8004E38E /end VAR_ADDRESS
 /end VAR_CHARACTERISTIC
 /begin VAR_CHARACTERISTIC TP_S16TCSCpBrkPGrdtLimHillIncIniFr EngCalVariantCriterion
  /begin VAR_ADDRESS 0x8003A190 0x8003AF90 0x8003BD90 0x8003CB90 0x8003D990 0x8003E790 0x8003F590 0x80040390 0x80041190 0x80041F90 0x80042D90 0x80043B90 0x80044990 0x80045790 0x80046590 0x80047390 0x80048190 0x80048F90 0x80049D90 0x8004AB90 0x8004B990 0x8004C790 0x8004D590 0x8004E390 /end VAR_ADDRESS
 /end VAR_CHARACTERISTIC
 /begin VAR_CHARACTERISTIC TP_S16TCSCpBrkPGrdtLimHillIncIniRe EngCalVariantCriterion
  /begin VAR_ADDRESS 0x8003A192 0x8003AF92 0x8003BD92 0x8003CB92 0x8003D992 0x8003E792 0x8003F592 0x80040392 0x80041192 0x80041F92 0x80042D92 0x80043B92 0x80044992 0x80045792 0x80046592 0x80047392 0x80048192 0x80048F92 0x80049D92 0x8004AB92 0x8004B992 0x8004C792 0x8004D592 0x8004E392 /end VAR_ADDRESS
 /end VAR_CHARACTERISTIC
 /begin VAR_CHARACTERISTIC TP_S16TCSCpBrkPGrdtLimHillIncRe EngCalVariantCriterion
  /begin VAR_ADDRESS 0x8003A194 0x8003AF94 0x8003BD94 0x8003CB94 0x8003D994 0x8003E794 0x8003F594 0x80040394 0x80041194 0x80041F94 0x80042D94 0x80043B94 0x80044994 0x80045794 0x80046594 0x80047394 0x80048194 0x80048F94 0x80049D94 0x8004AB94 0x8004B994 0x8004C794 0x8004D594 0x8004E394 /end VAR_ADDRESS
 /end VAR_CHARACTERISTIC
 /begin VAR_CHARACTERISTIC TP_S16TCSCpBrkPGrdtLimIncIniCntFr EngCalVariantCriterion
  /begin VAR_ADDRESS 0x8003A196 0x8003AF96 0x8003BD96 0x8003CB96 0x8003D996 0x8003E796 0x8003F596 0x80040396 0x80041196 0x80041F96 0x80042D96 0x80043B96 0x80044996 0x80045796 0x80046596 0x80047396 0x80048196 0x80048F96 0x80049D96 0x8004AB96 0x8004B996 0x8004C796 0x8004D596 0x8004E396 /end VAR_ADDRESS
 /end VAR_CHARACTERISTIC
 /begin VAR_CHARACTERISTIC TP_S16TCSCpBrkPGrdtLimIncIniCntRe EngCalVariantCriterion
  /begin VAR_ADDRESS 0x8003A198 0x8003AF98 0x8003BD98 0x8003CB98 0x8003D998 0x8003E798 0x8003F598 0x80040398 0x80041198 0x80041F98 0x80042D98 0x80043B98 0x80044998 0x80045798 0x80046598 0x80047398 0x80048198 0x80048F98 0x80049D98 0x8004AB98 0x8004B998 0x8004C798 0x8004D598 0x8004E398 /end VAR_ADDRESS
 /end VAR_CHARACTERISTIC
 /begin VAR_CHARACTERISTIC TP_S16TCSCpBrkPGrdtLimNormDecFr EngCalVariantCriterion
  /begin VAR_ADDRESS 0x8003A19A 0x8003AF9A 0x8003BD9A 0x8003CB9A 0x8003D99A 0x8003E79A 0x8003F59A 0x8004039A 0x8004119A 0x80041F9A 0x80042D9A 0x80043B9A 0x8004499A 0x8004579A 0x8004659A 0x8004739A 0x8004819A 0x80048F9A 0x80049D9A 0x8004AB9A 0x8004B99A 0x8004C79A 0x8004D59A 0x8004E39A /end VAR_ADDRESS
 /end VAR_CHARACTERISTIC
 /begin VAR_CHARACTERISTIC TP_S16TCSCpBrkPGrdtLimNormDecRe EngCalVariantCriterion
  /begin VAR_ADDRESS 0x8003A19C 0x8003AF9C 0x8003BD9C 0x8003CB9C 0x8003D99C 0x8003E79C 0x8003F59C 0x8004039C 0x8004119C 0x80041F9C 0x80042D9C 0x80043B9C 0x8004499C 0x8004579C 0x8004659C 0x8004739C 0x8004819C 0x80048F9C 0x80049D9C 0x8004AB9C 0x8004B99C 0x8004C79C 0x8004D59C 0x8004E39C /end VAR_ADDRESS
 /end VAR_CHARACTERISTIC
 /begin VAR_CHARACTERISTIC TP_S16TCSCpBrkPGrdtLimNormIncFr EngCalVariantCriterion
  /begin VAR_ADDRESS 0x8003A19E 0x8003AF9E 0x8003BD9E 0x8003CB9E 0x8003D99E 0x8003E79E 0x8003F59E 0x8004039E 0x8004119E 0x80041F9E 0x80042D9E 0x80043B9E 0x8004499E 0x8004579E 0x8004659E 0x8004739E 0x8004819E 0x80048F9E 0x80049D9E 0x8004AB9E 0x8004B99E 0x8004C79E 0x8004D59E 0x8004E39E /end VAR_ADDRESS
 /end VAR_CHARACTERISTIC
 /begin VAR_CHARACTERISTIC TP_S16TCSCpBrkPGrdtLimNormIncIniFr EngCalVariantCriterion
  /begin VAR_ADDRESS 0x8003A1A0 0x8003AFA0 0x8003BDA0 0x8003CBA0 0x8003D9A0 0x8003E7A0 0x8003F5A0 0x800403A0 0x800411A0 0x80041FA0 0x80042DA0 0x80043BA0 0x800449A0 0x800457A0 0x800465A0 0x800473A0 0x800481A0 0x80048FA0 0x80049DA0 0x8004ABA0 0x8004B9A0 0x8004C7A0 0x8004D5A0 0x8004E3A0 /end VAR_ADDRESS
 /end VAR_CHARACTERISTIC
 /begin VAR_CHARACTERISTIC TP_S16TCSCpBrkPGrdtLimNormIncIniRe EngCalVariantCriterion
  /begin VAR_ADDRESS 0x8003A1A2 0x8003AFA2 0x8003BDA2 0x8003CBA2 0x8003D9A2 0x8003E7A2 0x8003F5A2 0x800403A2 0x800411A2 0x80041FA2 0x80042DA2 0x80043BA2 0x800449A2 0x800457A2 0x800465A2 0x800473A2 0x800481A2 0x80048FA2 0x80049DA2 0x8004ABA2 0x8004B9A2 0x8004C7A2 0x8004D5A2 0x8004E3A2 /end VAR_ADDRESS
 /end VAR_CHARACTERISTIC
 /begin VAR_CHARACTERISTIC TP_S16TCSCpBrkPGrdtLimNormIncRe EngCalVariantCriterion
  /begin VAR_ADDRESS 0x8003A1A4 0x8003AFA4 0x8003BDA4 0x8003CBA4 0x8003D9A4 0x8003E7A4 0x8003F5A4 0x800403A4 0x800411A4 0x80041FA4 0x80042DA4 0x80043BA4 0x800449A4 0x800457A4 0x800465A4 0x800473A4 0x800481A4 0x80048FA4 0x80049DA4 0x8004ABA4 0x8004B9A4 0x8004C7A4 0x8004D5A4 0x8004E3A4 /end VAR_ADDRESS
 /end VAR_CHARACTERISTIC
 /begin VAR_CHARACTERISTIC TP_S16TCSCpBrkPGrdtLimStpRednDecFr EngCalVariantCriterion
  /begin VAR_ADDRESS 0x8003A1A6 0x8003AFA6 0x8003BDA6 0x8003CBA6 0x8003D9A6 0x8003E7A6 0x8003F5A6 0x800403A6 0x800411A6 0x80041FA6 0x80042DA6 0x80043BA6 0x800449A6 0x800457A6 0x800465A6 0x800473A6 0x800481A6 0x80048FA6 0x80049DA6 0x8004ABA6 0x8004B9A6 0x8004C7A6 0x8004D5A6 0x8004E3A6 /end VAR_ADDRESS
 /end VAR_CHARACTERISTIC
 /begin VAR_CHARACTERISTIC TP_S16TCSCpBrkPGrdtLimStpRednDecRe EngCalVariantCriterion
  /begin VAR_ADDRESS 0x8003A1A8 0x8003AFA8 0x8003BDA8 0x8003CBA8 0x8003D9A8 0x8003E7A8 0x8003F5A8 0x800403A8 0x800411A8 0x80041FA8 0x80042DA8 0x80043BA8 0x800449A8 0x800457A8 0x800465A8 0x800473A8 0x800481A8 0x80048FA8 0x80049DA8 0x8004ABA8 0x8004B9A8 0x8004C7A8 0x8004D5A8 0x8004E3A8 /end VAR_ADDRESS
 /end VAR_CHARACTERISTIC
 /begin VAR_CHARACTERISTIC TP_S16TCSCpBrkPGrdtLimStpRednIncFr EngCalVariantCriterion
  /begin VAR_ADDRESS 0x8003A1AA 0x8003AFAA 0x8003BDAA 0x8003CBAA 0x8003D9AA 0x8003E7AA 0x8003F5AA 0x800403AA 0x800411AA 0x80041FAA 0x80042DAA 0x80043BAA 0x800449AA 0x800457AA 0x800465AA 0x800473AA 0x800481AA 0x80048FAA 0x80049DAA 0x8004ABAA 0x8004B9AA 0x8004C7AA 0x8004D5AA 0x8004E3AA /end VAR_ADDRESS
 /end VAR_CHARACTERISTIC
 /begin VAR_CHARACTERISTIC TP_S16TCSCpBrkPGrdtLimStpRednIncRe EngCalVariantCriterion
  /begin VAR_ADDRESS 0x8003A1AC 0x8003AFAC 0x8003BDAC 0x8003CBAC 0x8003D9AC 0x8003E7AC 0x8003F5AC 0x800403AC 0x800411AC 0x80041FAC 0x80042DAC 0x80043BAC 0x800449AC 0x800457AC 0x800465AC 0x800473AC 0x800481AC 0x80048FAC 0x80049DAC 0x8004ABAC 0x8004B9AC 0x8004C7AC 0x8004D5AC 0x8004E3AC /end VAR_ADDRESS
 /end VAR_CHARACTERISTIC
 /begin VAR_CHARACTERISTIC TP_S16TCSCpBrkPGrdtLimVCAInc EngCalVariantCriterion
  /begin VAR_ADDRESS 0x8003A1AE 0x8003AFAE 0x8003BDAE 0x8003CBAE 0x8003D9AE 0x8003E7AE 0x8003F5AE 0x800403AE 0x800411AE 0x80041FAE 0x80042DAE 0x80043BAE 0x800449AE 0x800457AE 0x800465AE 0x800473AE 0x800481AE 0x80048FAE 0x80049DAE 0x8004ABAE 0x8004B9AE 0x8004C7AE 0x8004D5AE 0x8004E3AE /end VAR_ADDRESS
 /end VAR_CHARACTERISTIC
 /begin VAR_CHARACTERISTIC TP_S16TCSCpBrkTorq1stDecTrqOfHWIS EngCalVariantCriterion
  /begin VAR_ADDRESS 0x8003A1B0 0x8003AFB0 0x8003BDB0 0x8003CBB0 0x8003D9B0 0x8003E7B0 0x8003F5B0 0x800403B0 0x800411B0 0x80041FB0 0x80042DB0 0x80043BB0 0x800449B0 0x800457B0 0x800465B0 0x800473B0 0x800481B0 0x80048FB0 0x80049DB0 0x8004ABB0 0x8004B9B0 0x8004C7B0 0x8004D5B0 0x8004E3B0 /end VAR_ADDRESS
 /end VAR_CHARACTERISTIC
 /begin VAR_CHARACTERISTIC TP_S16TCSCpBrkTorqDecRateOfOvBrk EngCalVariantCriterion
  /begin VAR_ADDRESS 0x8003A1B2 0x8003AFB2 0x8003BDB2 0x8003CBB2 0x8003D9B2 0x8003E7B2 0x8003F5B2 0x800403B2 0x800411B2 0x80041FB2 0x80042DB2 0x80043BB2 0x800449B2 0x800457B2 0x800465B2 0x800473B2 0x800481B2 0x80048FB2 0x80049DB2 0x8004ABB2 0x8004B9B2 0x8004C7B2 0x8004D5B2 0x8004E3B2 /end VAR_ADDRESS
 /end VAR_CHARACTERISTIC
 /begin VAR_CHARACTERISTIC TP_S16TCSCpBrkTq1stDecTrqOfHWISHill EngCalVariantCriterion
  /begin VAR_ADDRESS 0x8003A1B4 0x8003AFB4 0x8003BDB4 0x8003CBB4 0x8003D9B4 0x8003E7B4 0x8003F5B4 0x800403B4 0x800411B4 0x80041FB4 0x80042DB4 0x80043BB4 0x800449B4 0x800457B4 0x800465B4 0x800473B4 0x800481B4 0x80048FB4 0x80049DB4 0x8004ABB4 0x8004B9B4 0x8004C7B4 0x8004D5B4 0x8004E3B4 /end VAR_ADDRESS
 /end VAR_CHARACTERISTIC
 /begin VAR_CHARACTERISTIC TP_S16TCSCpBrkTrqMaxIncStartTime EngCalVariantCriterion
  /begin VAR_ADDRESS 0x8003A1B6 0x8003AFB6 0x8003BDB6 0x8003CBB6 0x8003D9B6 0x8003E7B6 0x8003F5B6 0x800403B6 0x800411B6 0x80041FB6 0x80042DB6 0x80043BB6 0x800449B6 0x800457B6 0x800465B6 0x800473B6 0x800481B6 0x80048FB6 0x80049DB6 0x8004ABB6 0x8004B9B6 0x8004C7B6 0x8004D5B6 0x8004E3B6 /end VAR_ADDRESS
 /end VAR_CHARACTERISTIC
 /begin VAR_CHARACTERISTIC TP_S16TCSCpCtlMotorV_Stuck EngCalVariantCriterion
  /begin VAR_ADDRESS 0x8003A1B8 0x8003AFB8 0x8003BDB8 0x8003CBB8 0x8003D9B8 0x8003E7B8 0x8003F5B8 0x800403B8 0x800411B8 0x80041FB8 0x80042DB8 0x80043BB8 0x800449B8 0x800457B8 0x800465B8 0x800473B8 0x800481B8 0x80048FB8 0x80049DB8 0x8004ABB8 0x8004B9B8 0x8004C7B8 0x8004D5B8 0x8004E3B8 /end VAR_ADDRESS
 /end VAR_CHARACTERISTIC
 /begin VAR_CHARACTERISTIC TP_S16TCSCpCtlMotorV_VCA EngCalVariantCriterion
  /begin VAR_ADDRESS 0x8003A1BA 0x8003AFBA 0x8003BDBA 0x8003CBBA 0x8003D9BA 0x8003E7BA 0x8003F5BA 0x800403BA 0x800411BA 0x80041FBA 0x80042DBA 0x80043BBA 0x800449BA 0x800457BA 0x800465BA 0x800473BA 0x800481BA 0x80048FBA 0x80049DBA 0x8004ABBA 0x8004B9BA 0x8004C7BA 0x8004D5BA 0x8004E3BA /end VAR_ADDRESS
 /end VAR_CHARACTERISTIC
 /begin VAR_CHARACTERISTIC TP_S16TCSCpDctTurnIndexBaseAyTh EngCalVariantCriterion
  /begin VAR_ADDRESS 0x8003A1BC 0x8003AFBC 0x8003BDBC 0x8003CBBC 0x8003D9BC 0x8003E7BC 0x8003F5BC 0x800403BC 0x800411BC 0x80041FBC 0x80042DBC 0x80043BBC 0x800449BC 0x800457BC 0x800465BC 0x800473BC 0x800481BC 0x80048FBC 0x80049DBC 0x8004ABBC 0x8004B9BC 0x8004C7BC 0x8004D5BC 0x8004E3BC /end VAR_ADDRESS
 /end VAR_CHARACTERISTIC
 /begin VAR_CHARACTERISTIC TP_S16TCSCpDctTurnIndexEnterAyTh[0] EngCalVariantCriterion
  /begin VAR_ADDRESS 0x8003A1BE 0x8003AFBE 0x8003BDBE 0x8003CBBE 0x8003D9BE 0x8003E7BE 0x8003F5BE 0x800403BE 0x800411BE 0x80041FBE 0x80042DBE 0x80043BBE 0x800449BE 0x800457BE 0x800465BE 0x800473BE 0x800481BE 0x80048FBE 0x80049DBE 0x8004ABBE 0x8004B9BE 0x8004C7BE 0x8004D5BE 0x8004E3BE /end VAR_ADDRESS
 /end VAR_CHARACTERISTIC
 /begin VAR_CHARACTERISTIC TP_S16TCSCpDctTurnIndexEnterAyTh[1] EngCalVariantCriterion
  /begin VAR_ADDRESS 0x8003A1C0 0x8003AFC0 0x8003BDC0 0x8003CBC0 0x8003D9C0 0x8003E7C0 0x8003F5C0 0x800403C0 0x800411C0 0x80041FC0 0x80042DC0 0x80043BC0 0x800449C0 0x800457C0 0x800465C0 0x800473C0 0x800481C0 0x80048FC0 0x80049DC0 0x8004ABC0 0x8004B9C0 0x8004C7C0 0x8004D5C0 0x8004E3C0 /end VAR_ADDRESS
 /end VAR_CHARACTERISTIC
 /begin VAR_CHARACTERISTIC TP_S16TCSCpDctTurnIndexEnterAyTh[2] EngCalVariantCriterion
  /begin VAR_ADDRESS 0x8003A1C2 0x8003AFC2 0x8003BDC2 0x8003CBC2 0x8003D9C2 0x8003E7C2 0x8003F5C2 0x800403C2 0x800411C2 0x80041FC2 0x80042DC2 0x80043BC2 0x800449C2 0x800457C2 0x800465C2 0x800473C2 0x800481C2 0x80048FC2 0x80049DC2 0x8004ABC2 0x8004B9C2 0x8004C7C2 0x8004D5C2 0x8004E3C2 /end VAR_ADDRESS
 /end VAR_CHARACTERISTIC
 /begin VAR_CHARACTERISTIC TP_S16TCSCpDctTurnIndexEnterAyTh[3] EngCalVariantCriterion
  /begin VAR_ADDRESS 0x8003A1C4 0x8003AFC4 0x8003BDC4 0x8003CBC4 0x8003D9C4 0x8003E7C4 0x8003F5C4 0x800403C4 0x800411C4 0x80041FC4 0x80042DC4 0x80043BC4 0x800449C4 0x800457C4 0x800465C4 0x800473C4 0x800481C4 0x80048FC4 0x80049DC4 0x8004ABC4 0x8004B9C4 0x8004C7C4 0x8004D5C4 0x8004E3C4 /end VAR_ADDRESS
 /end VAR_CHARACTERISTIC
 /begin VAR_CHARACTERISTIC TP_S16TCSCpDctTurnIndexEnterAyTh[4] EngCalVariantCriterion
  /begin VAR_ADDRESS 0x8003A1C6 0x8003AFC6 0x8003BDC6 0x8003CBC6 0x8003D9C6 0x8003E7C6 0x8003F5C6 0x800403C6 0x800411C6 0x80041FC6 0x80042DC6 0x80043BC6 0x800449C6 0x800457C6 0x800465C6 0x800473C6 0x800481C6 0x80048FC6 0x80049DC6 0x8004ABC6 0x8004B9C6 0x8004C7C6 0x8004D5C6 0x8004E3C6 /end VAR_ADDRESS
 /end VAR_CHARACTERISTIC
 /begin VAR_CHARACTERISTIC TP_S16TCSCpDctTurnIndexFinalAyTh[0] EngCalVariantCriterion
  /begin VAR_ADDRESS 0x8003A1C8 0x8003AFC8 0x8003BDC8 0x8003CBC8 0x8003D9C8 0x8003E7C8 0x8003F5C8 0x800403C8 0x800411C8 0x80041FC8 0x80042DC8 0x80043BC8 0x800449C8 0x800457C8 0x800465C8 0x800473C8 0x800481C8 0x80048FC8 0x80049DC8 0x8004ABC8 0x8004B9C8 0x8004C7C8 0x8004D5C8 0x8004E3C8 /end VAR_ADDRESS
 /end VAR_CHARACTERISTIC
 /begin VAR_CHARACTERISTIC TP_S16TCSCpDctTurnIndexFinalAyTh[1] EngCalVariantCriterion
  /begin VAR_ADDRESS 0x8003A1CA 0x8003AFCA 0x8003BDCA 0x8003CBCA 0x8003D9CA 0x8003E7CA 0x8003F5CA 0x800403CA 0x800411CA 0x80041FCA 0x80042DCA 0x80043BCA 0x800449CA 0x800457CA 0x800465CA 0x800473CA 0x800481CA 0x80048FCA 0x80049DCA 0x8004ABCA 0x8004B9CA 0x8004C7CA 0x8004D5CA 0x8004E3CA /end VAR_ADDRESS
 /end VAR_CHARACTERISTIC
 /begin VAR_CHARACTERISTIC TP_S16TCSCpDctTurnIndexFinalAyTh[2] EngCalVariantCriterion
  /begin VAR_ADDRESS 0x8003A1CC 0x8003AFCC 0x8003BDCC 0x8003CBCC 0x8003D9CC 0x8003E7CC 0x8003F5CC 0x800403CC 0x800411CC 0x80041FCC 0x80042DCC 0x80043BCC 0x800449CC 0x800457CC 0x800465CC 0x800473CC 0x800481CC 0x80048FCC 0x80049DCC 0x8004ABCC 0x8004B9CC 0x8004C7CC 0x8004D5CC 0x8004E3CC /end VAR_ADDRESS
 /end VAR_CHARACTERISTIC
 /begin VAR_CHARACTERISTIC TP_S16TCSCpDctTurnIndexFinalAyTh[3] EngCalVariantCriterion
  /begin VAR_ADDRESS 0x8003A1CE 0x8003AFCE 0x8003BDCE 0x8003CBCE 0x8003D9CE 0x8003E7CE 0x8003F5CE 0x800403CE 0x800411CE 0x80041FCE 0x80042DCE 0x80043BCE 0x800449CE 0x800457CE 0x800465CE 0x800473CE 0x800481CE 0x80048FCE 0x80049DCE 0x8004ABCE 0x8004B9CE 0x8004C7CE 0x8004D5CE 0x8004E3CE /end VAR_ADDRESS
 /end VAR_CHARACTERISTIC
 /begin VAR_CHARACTERISTIC TP_S16TCSCpDctTurnIndexFinalAyTh[4] EngCalVariantCriterion
  /begin VAR_ADDRESS 0x8003A1D0 0x8003AFD0 0x8003BDD0 0x8003CBD0 0x8003D9D0 0x8003E7D0 0x8003F5D0 0x800403D0 0x800411D0 0x80041FD0 0x80042DD0 0x80043BD0 0x800449D0 0x800457D0 0x800465D0 0x800473D0 0x800481D0 0x80048FD0 0x80049DD0 0x8004ABD0 0x8004B9D0 0x8004C7D0 0x8004D5D0 0x8004E3D0 /end VAR_ADDRESS
 /end VAR_CHARACTERISTIC
 /begin VAR_CHARACTERISTIC TP_S16TCSCpFBMtrV_ASC EngCalVariantCriterion
  /begin VAR_ADDRESS 0x8003A1F2 0x8003AFF2 0x8003BDF2 0x8003CBF2 0x8003D9F2 0x8003E7F2 0x8003F5F2 0x800403F2 0x800411F2 0x80041FF2 0x80042DF2 0x80043BF2 0x800449F2 0x800457F2 0x800465F2 0x800473F2 0x800481F2 0x80048FF2 0x80049DF2 0x8004ABF2 0x8004B9F2 0x8004C7F2 0x8004D5F2 0x8004E3F2 /end VAR_ADDRESS
 /end VAR_CHARACTERISTIC
 /begin VAR_CHARACTERISTIC TP_S16TCSCpFBMtrV_Turn EngCalVariantCriterion
  /begin VAR_ADDRESS 0x8003A1F4 0x8003AFF4 0x8003BDF4 0x8003CBF4 0x8003D9F4 0x8003E7F4 0x8003F5F4 0x800403F4 0x800411F4 0x80041FF4 0x80042DF4 0x80043BF4 0x800449F4 0x800457F4 0x800465F4 0x800473F4 0x800481F4 0x80048FF4 0x80049DF4 0x8004ABF4 0x8004B9F4 0x8004C7F4 0x8004D5F4 0x8004E3F4 /end VAR_ADDRESS
 /end VAR_CHARACTERISTIC
 /begin VAR_CHARACTERISTIC TP_S16TCSCpFFMtrV_ASC EngCalVariantCriterion
  /begin VAR_ADDRESS 0x8003A1F6 0x8003AFF6 0x8003BDF6 0x8003CBF6 0x8003D9F6 0x8003E7F6 0x8003F5F6 0x800403F6 0x800411F6 0x80041FF6 0x80042DF6 0x80043BF6 0x800449F6 0x800457F6 0x800465F6 0x800473F6 0x800481F6 0x80048FF6 0x80049DF6 0x8004ABF6 0x8004B9F6 0x8004C7F6 0x8004D5F6 0x8004E3F6 /end VAR_ADDRESS
 /end VAR_CHARACTERISTIC
 /begin VAR_CHARACTERISTIC TP_S16TCSCpFFMtrV_Turn EngCalVariantCriterion
  /begin VAR_ADDRESS 0x8003A1F8 0x8003AFF8 0x8003BDF8 0x8003CBF8 0x8003D9F8 0x8003E7F8 0x8003F5F8 0x800403F8 0x800411F8 0x80041FF8 0x80042DF8 0x80043BF8 0x800449F8 0x800457F8 0x800465F8 0x800473F8 0x800481F8 0x80048FF8 0x80049DF8 0x8004ABF8 0x8004B9F8 0x8004C7F8 0x8004D5F8 0x8004E3F8 /end VAR_ADDRESS
 /end VAR_CHARACTERISTIC
 /begin VAR_CHARACTERISTIC TP_S16TCSCpFadeOutCtrlHghPreSTTh_FA EngCalVariantCriterion
  /begin VAR_ADDRESS 0x8003A1D2 0x8003AFD2 0x8003BDD2 0x8003CBD2 0x8003D9D2 0x8003E7D2 0x8003F5D2 0x800403D2 0x800411D2 0x80041FD2 0x80042DD2 0x80043BD2 0x800449D2 0x800457D2 0x800465D2 0x800473D2 0x800481D2 0x80048FD2 0x80049DD2 0x8004ABD2 0x8004B9D2 0x8004C7D2 0x8004D5D2 0x8004E3D2 /end VAR_ADDRESS
 /end VAR_CHARACTERISTIC
 /begin VAR_CHARACTERISTIC TP_S16TCSCpFadeOutCtrlHghPreSTTh_RA EngCalVariantCriterion
  /begin VAR_ADDRESS 0x8003A1D4 0x8003AFD4 0x8003BDD4 0x8003CBD4 0x8003D9D4 0x8003E7D4 0x8003F5D4 0x800403D4 0x800411D4 0x80041FD4 0x80042DD4 0x80043BD4 0x800449D4 0x800457D4 0x800465D4 0x800473D4 0x800481D4 0x80048FD4 0x80049DD4 0x8004ABD4 0x8004B9D4 0x8004C7D4 0x8004D5D4 0x8004E3D4 /end VAR_ADDRESS
 /end VAR_CHARACTERISTIC
 /begin VAR_CHARACTERISTIC TP_S16TCSCpFadeOutCtrlHghPreTunTh_FA EngCalVariantCriterion
  /begin VAR_ADDRESS 0x8003A1D6 0x8003AFD6 0x8003BDD6 0x8003CBD6 0x8003D9D6 0x8003E7D6 0x8003F5D6 0x800403D6 0x800411D6 0x80041FD6 0x80042DD6 0x80043BD6 0x800449D6 0x800457D6 0x800465D6 0x800473D6 0x800481D6 0x80048FD6 0x80049DD6 0x8004ABD6 0x8004B9D6 0x8004C7D6 0x8004D5D6 0x8004E3D6 /end VAR_ADDRESS
 /end VAR_CHARACTERISTIC
 /begin VAR_CHARACTERISTIC TP_S16TCSCpFadeOutCtrlHghPreTunTh_RA EngCalVariantCriterion
  /begin VAR_ADDRESS 0x8003A1D8 0x8003AFD8 0x8003BDD8 0x8003CBD8 0x8003D9D8 0x8003E7D8 0x8003F5D8 0x800403D8 0x800411D8 0x80041FD8 0x80042DD8 0x80043BD8 0x800449D8 0x800457D8 0x800465D8 0x800473D8 0x800481D8 0x80048FD8 0x80049DD8 0x8004ABD8 0x8004B9D8 0x8004C7D8 0x8004D5D8 0x8004E3D8 /end VAR_ADDRESS
 /end VAR_CHARACTERISTIC
 /begin VAR_CHARACTERISTIC TP_S16TCSCpFadeOutCtrlLowPreSTTh_FA EngCalVariantCriterion
  /begin VAR_ADDRESS 0x8003A1DA 0x8003AFDA 0x8003BDDA 0x8003CBDA 0x8003D9DA 0x8003E7DA 0x8003F5DA 0x800403DA 0x800411DA 0x80041FDA 0x80042DDA 0x80043BDA 0x800449DA 0x800457DA 0x800465DA 0x800473DA 0x800481DA 0x80048FDA 0x80049DDA 0x8004ABDA 0x8004B9DA 0x8004C7DA 0x8004D5DA 0x8004E3DA /end VAR_ADDRESS
 /end VAR_CHARACTERISTIC
 /begin VAR_CHARACTERISTIC TP_S16TCSCpFadeOutCtrlLowPreSTTh_RA EngCalVariantCriterion
  /begin VAR_ADDRESS 0x8003A1DC 0x8003AFDC 0x8003BDDC 0x8003CBDC 0x8003D9DC 0x8003E7DC 0x8003F5DC 0x800403DC 0x800411DC 0x80041FDC 0x80042DDC 0x80043BDC 0x800449DC 0x800457DC 0x800465DC 0x800473DC 0x800481DC 0x80048FDC 0x80049DDC 0x8004ABDC 0x8004B9DC 0x8004C7DC 0x8004D5DC 0x8004E3DC /end VAR_ADDRESS
 /end VAR_CHARACTERISTIC
 /begin VAR_CHARACTERISTIC TP_S16TCSCpFadeOutCtrlLowPreTunTh_FA EngCalVariantCriterion
  /begin VAR_ADDRESS 0x8003A1DE 0x8003AFDE 0x8003BDDE 0x8003CBDE 0x8003D9DE 0x8003E7DE 0x8003F5DE 0x800403DE 0x800411DE 0x80041FDE 0x80042DDE 0x80043BDE 0x800449DE 0x800457DE 0x800465DE 0x800473DE 0x800481DE 0x80048FDE 0x80049DDE 0x8004ABDE 0x8004B9DE 0x8004C7DE 0x8004D5DE 0x8004E3DE /end VAR_ADDRESS
 /end VAR_CHARACTERISTIC
 /begin VAR_CHARACTERISTIC TP_S16TCSCpFadeOutCtrlLowPreTunTh_RA EngCalVariantCriterion
  /begin VAR_ADDRESS 0x8003A1E0 0x8003AFE0 0x8003BDE0 0x8003CBE0 0x8003D9E0 0x8003E7E0 0x8003F5E0 0x800403E0 0x800411E0 0x80041FE0 0x80042DE0 0x80043BE0 0x800449E0 0x800457E0 0x800465E0 0x800473E0 0x800481E0 0x80048FE0 0x80049DE0 0x8004ABE0 0x8004B9E0 0x8004C7E0 0x8004D5E0 0x8004E3E0 /end VAR_ADDRESS
 /end VAR_CHARACTERISTIC
 /begin VAR_CHARACTERISTIC TP_S16TCSCpFadeOutDecTQ4HghPreST_FA EngCalVariantCriterion
  /begin VAR_ADDRESS 0x8003A1E2 0x8003AFE2 0x8003BDE2 0x8003CBE2 0x8003D9E2 0x8003E7E2 0x8003F5E2 0x800403E2 0x800411E2 0x80041FE2 0x80042DE2 0x80043BE2 0x800449E2 0x800457E2 0x800465E2 0x800473E2 0x800481E2 0x80048FE2 0x80049DE2 0x8004ABE2 0x8004B9E2 0x8004C7E2 0x8004D5E2 0x8004E3E2 /end VAR_ADDRESS
 /end VAR_CHARACTERISTIC
 /begin VAR_CHARACTERISTIC TP_S16TCSCpFadeOutDecTQ4HghPreST_RA EngCalVariantCriterion
  /begin VAR_ADDRESS 0x8003A1E4 0x8003AFE4 0x8003BDE4 0x8003CBE4 0x8003D9E4 0x8003E7E4 0x8003F5E4 0x800403E4 0x800411E4 0x80041FE4 0x80042DE4 0x80043BE4 0x800449E4 0x800457E4 0x800465E4 0x800473E4 0x800481E4 0x80048FE4 0x80049DE4 0x8004ABE4 0x8004B9E4 0x8004C7E4 0x8004D5E4 0x8004E3E4 /end VAR_ADDRESS
 /end VAR_CHARACTERISTIC
 /begin VAR_CHARACTERISTIC TP_S16TCSCpFadeOutDecTQ4HghPreTurn_FA EngCalVariantCriterion
  /begin VAR_ADDRESS 0x8003A1E6 0x8003AFE6 0x8003BDE6 0x8003CBE6 0x8003D9E6 0x8003E7E6 0x8003F5E6 0x800403E6 0x800411E6 0x80041FE6 0x80042DE6 0x80043BE6 0x800449E6 0x800457E6 0x800465E6 0x800473E6 0x800481E6 0x80048FE6 0x80049DE6 0x8004ABE6 0x8004B9E6 0x8004C7E6 0x8004D5E6 0x8004E3E6 /end VAR_ADDRESS
 /end VAR_CHARACTERISTIC
 /begin VAR_CHARACTERISTIC TP_S16TCSCpFadeOutDecTQ4HghPreTurn_RA EngCalVariantCriterion
  /begin VAR_ADDRESS 0x8003A1E8 0x8003AFE8 0x8003BDE8 0x8003CBE8 0x8003D9E8 0x8003E7E8 0x8003F5E8 0x800403E8 0x800411E8 0x80041FE8 0x80042DE8 0x80043BE8 0x800449E8 0x800457E8 0x800465E8 0x800473E8 0x800481E8 0x80048FE8 0x80049DE8 0x8004ABE8 0x8004B9E8 0x8004C7E8 0x8004D5E8 0x8004E3E8 /end VAR_ADDRESS
 /end VAR_CHARACTERISTIC
 /begin VAR_CHARACTERISTIC TP_S16TCSCpFadeOutDecTQ4LowPreST_FA EngCalVariantCriterion
  /begin VAR_ADDRESS 0x8003A1EA 0x8003AFEA 0x8003BDEA 0x8003CBEA 0x8003D9EA 0x8003E7EA 0x8003F5EA 0x800403EA 0x800411EA 0x80041FEA 0x80042DEA 0x80043BEA 0x800449EA 0x800457EA 0x800465EA 0x800473EA 0x800481EA 0x80048FEA 0x80049DEA 0x8004ABEA 0x8004B9EA 0x8004C7EA 0x8004D5EA 0x8004E3EA /end VAR_ADDRESS
 /end VAR_CHARACTERISTIC
 /begin VAR_CHARACTERISTIC TP_S16TCSCpFadeOutDecTQ4LowPreST_RA EngCalVariantCriterion
  /begin VAR_ADDRESS 0x8003A1EC 0x8003AFEC 0x8003BDEC 0x8003CBEC 0x8003D9EC 0x8003E7EC 0x8003F5EC 0x800403EC 0x800411EC 0x80041FEC 0x80042DEC 0x80043BEC 0x800449EC 0x800457EC 0x800465EC 0x800473EC 0x800481EC 0x80048FEC 0x80049DEC 0x8004ABEC 0x8004B9EC 0x8004C7EC 0x8004D5EC 0x8004E3EC /end VAR_ADDRESS
 /end VAR_CHARACTERISTIC
 /begin VAR_CHARACTERISTIC TP_S16TCSCpFadeOutDecTQ4LowPreTurn_FA EngCalVariantCriterion
  /begin VAR_ADDRESS 0x8003A1EE 0x8003AFEE 0x8003BDEE 0x8003CBEE 0x8003D9EE 0x8003E7EE 0x8003F5EE 0x800403EE 0x800411EE 0x80041FEE 0x80042DEE 0x80043BEE 0x800449EE 0x800457EE 0x800465EE 0x800473EE 0x800481EE 0x80048FEE 0x80049DEE 0x8004ABEE 0x8004B9EE 0x8004C7EE 0x8004D5EE 0x8004E3EE /end VAR_ADDRESS
 /end VAR_CHARACTERISTIC
 /begin VAR_CHARACTERISTIC TP_S16TCSCpFadeOutDecTQ4LowPreTurn_RA EngCalVariantCriterion
  /begin VAR_ADDRESS 0x8003A1F0 0x8003AFF0 0x8003BDF0 0x8003CBF0 0x8003D9F0 0x8003E7F0 0x8003F5F0 0x800403F0 0x800411F0 0x80041FF0 0x80042DF0 0x80043BF0 0x800449F0 0x800457F0 0x800465F0 0x800473F0 0x800481F0 0x80048FF0 0x80049DF0 0x8004ABF0 0x8004B9F0 0x8004C7F0 0x8004D5F0 0x8004E3F0 /end VAR_ADDRESS
 /end VAR_CHARACTERISTIC
 /begin VAR_CHARACTERISTIC TP_S16TCSCpIniRMdeMtrV_ASC EngCalVariantCriterion
  /begin VAR_ADDRESS 0x8003A1FA 0x8003AFFA 0x8003BDFA 0x8003CBFA 0x8003D9FA 0x8003E7FA 0x8003F5FA 0x800403FA 0x800411FA 0x80041FFA 0x80042DFA 0x80043BFA 0x800449FA 0x800457FA 0x800465FA 0x800473FA 0x800481FA 0x80048FFA 0x80049DFA 0x8004ABFA 0x8004B9FA 0x8004C7FA 0x8004D5FA 0x8004E3FA /end VAR_ADDRESS
 /end VAR_CHARACTERISTIC
 /begin VAR_CHARACTERISTIC TP_S16TCSCpIniRMdeMtrV_SC EngCalVariantCriterion
  /begin VAR_ADDRESS 0x8003A1FC 0x8003AFFC 0x8003BDFC 0x8003CBFC 0x8003D9FC 0x8003E7FC 0x8003F5FC 0x800403FC 0x800411FC 0x80041FFC 0x80042DFC 0x80043BFC 0x800449FC 0x800457FC 0x800465FC 0x800473FC 0x800481FC 0x80048FFC 0x80049DFC 0x8004ABFC 0x8004B9FC 0x8004C7FC 0x8004D5FC 0x8004E3FC /end VAR_ADDRESS
 /end VAR_CHARACTERISTIC
 /begin VAR_CHARACTERISTIC TP_S16TCSCpIniRMdeMtrV_Turn EngCalVariantCriterion
  /begin VAR_ADDRESS 0x8003A1FE 0x8003AFFE 0x8003BDFE 0x8003CBFE 0x8003D9FE 0x8003E7FE 0x8003F5FE 0x800403FE 0x800411FE 0x80041FFE 0x80042DFE 0x80043BFE 0x800449FE 0x800457FE 0x800465FE 0x800473FE 0x800481FE 0x80048FFE 0x80049DFE 0x8004ABFE 0x8004B9FE 0x8004C7FE 0x8004D5FE 0x8004E3FE /end VAR_ADDRESS
 /end VAR_CHARACTERISTIC
 /begin VAR_CHARACTERISTIC TP_S16TCSCpInitMaxMotorV_VCA EngCalVariantCriterion
  /begin VAR_ADDRESS 0x8003A200 0x8003B000 0x8003BE00 0x8003CC00 0x8003DA00 0x8003E800 0x8003F600 0x80040400 0x80041200 0x80042000 0x80042E00 0x80043C00 0x80044A00 0x80045800 0x80046600 0x80047400 0x80048200 0x80049000 0x80049E00 0x8004AC00 0x8004BA00 0x8004C800 0x8004D600 0x8004E400 /end VAR_ADDRESS
 /end VAR_CHARACTERISTIC
 /begin VAR_CHARACTERISTIC TP_S16TCSCpInitMaxVCATCCurnt EngCalVariantCriterion
  /begin VAR_ADDRESS 0x8003A202 0x8003B002 0x8003BE02 0x8003CC02 0x8003DA02 0x8003E802 0x8003F602 0x80040402 0x80041202 0x80042002 0x80042E02 0x80043C02 0x80044A02 0x80045802 0x80046602 0x80047402 0x80048202 0x80049002 0x80049E02 0x8004AC02 0x8004BA02 0x8004C802 0x8004D602 0x8004E402 /end VAR_ADDRESS
 /end VAR_CHARACTERISTIC
 /begin VAR_CHARACTERISTIC TP_S16TCSCpMaxTCCurnt EngCalVariantCriterion
  /begin VAR_ADDRESS 0x8003A204 0x8003B004 0x8003BE04 0x8003CC04 0x8003DA04 0x8003E804 0x8003F604 0x80040404 0x80041204 0x80042004 0x80042E04 0x80043C04 0x80044A04 0x80045804 0x80046604 0x80047404 0x80048204 0x80049004 0x80049E04 0x8004AC04 0x8004BA04 0x8004C804 0x8004D604 0x8004E404 /end VAR_ADDRESS
 /end VAR_CHARACTERISTIC
 /begin VAR_CHARACTERISTIC TP_S16TCSCpNormMtrV_SC EngCalVariantCriterion
  /begin VAR_ADDRESS 0x8003A206 0x8003B006 0x8003BE06 0x8003CC06 0x8003DA06 0x8003E806 0x8003F606 0x80040406 0x80041206 0x80042006 0x80042E06 0x80043C06 0x80044A06 0x80045806 0x80046606 0x80047406 0x80048206 0x80049006 0x80049E06 0x8004AC06 0x8004BA06 0x8004C806 0x8004D606 0x8004E406 /end VAR_ADDRESS
 /end VAR_CHARACTERISTIC
 /begin VAR_CHARACTERISTIC TP_S16TCSCpSplitHilExtDistanceTh EngCalVariantCriterion
  /begin VAR_ADDRESS 0x8003A208 0x8003B008 0x8003BE08 0x8003CC08 0x8003DA08 0x8003E808 0x8003F608 0x80040408 0x80041208 0x80042008 0x80042E08 0x80043C08 0x80044A08 0x80045808 0x80046608 0x80047408 0x80048208 0x80049008 0x80049E08 0x8004AC08 0x8004BA08 0x8004C808 0x8004D608 0x8004E408 /end VAR_ADDRESS
 /end VAR_CHARACTERISTIC
 /begin VAR_CHARACTERISTIC TP_S16TCSCpTarWhlPreStMax EngCalVariantCriterion
  /begin VAR_ADDRESS 0x8003A20A 0x8003B00A 0x8003BE0A 0x8003CC0A 0x8003DA0A 0x8003E80A 0x8003F60A 0x8004040A 0x8004120A 0x8004200A 0x80042E0A 0x80043C0A 0x80044A0A 0x8004580A 0x8004660A 0x8004740A 0x8004820A 0x8004900A 0x80049E0A 0x8004AC0A 0x8004BA0A 0x8004C80A 0x8004D60A 0x8004E40A /end VAR_ADDRESS
 /end VAR_CHARACTERISTIC
 /begin VAR_CHARACTERISTIC TP_S16TCSCpThOfAsymSpCtlInTurn[0] EngCalVariantCriterion
  /begin VAR_ADDRESS 0x8003A20C 0x8003B00C 0x8003BE0C 0x8003CC0C 0x8003DA0C 0x8003E80C 0x8003F60C 0x8004040C 0x8004120C 0x8004200C 0x80042E0C 0x80043C0C 0x80044A0C 0x8004580C 0x8004660C 0x8004740C 0x8004820C 0x8004900C 0x80049E0C 0x8004AC0C 0x8004BA0C 0x8004C80C 0x8004D60C 0x8004E40C /end VAR_ADDRESS
 /end VAR_CHARACTERISTIC
 /begin VAR_CHARACTERISTIC TP_S16TCSCpThOfAsymSpCtlInTurn[1] EngCalVariantCriterion
  /begin VAR_ADDRESS 0x8003A20E 0x8003B00E 0x8003BE0E 0x8003CC0E 0x8003DA0E 0x8003E80E 0x8003F60E 0x8004040E 0x8004120E 0x8004200E 0x80042E0E 0x80043C0E 0x80044A0E 0x8004580E 0x8004660E 0x8004740E 0x8004820E 0x8004900E 0x80049E0E 0x8004AC0E 0x8004BA0E 0x8004C80E 0x8004D60E 0x8004E40E /end VAR_ADDRESS
 /end VAR_CHARACTERISTIC
 /begin VAR_CHARACTERISTIC TP_S16TCSCpThOfAsymSpCtlInTurn[2] EngCalVariantCriterion
  /begin VAR_ADDRESS 0x8003A210 0x8003B010 0x8003BE10 0x8003CC10 0x8003DA10 0x8003E810 0x8003F610 0x80040410 0x80041210 0x80042010 0x80042E10 0x80043C10 0x80044A10 0x80045810 0x80046610 0x80047410 0x80048210 0x80049010 0x80049E10 0x8004AC10 0x8004BA10 0x8004C810 0x8004D610 0x8004E410 /end VAR_ADDRESS
 /end VAR_CHARACTERISTIC
 /begin VAR_CHARACTERISTIC TP_S16TCSCpThOfAsymSpCtlInTurn[3] EngCalVariantCriterion
  /begin VAR_ADDRESS 0x8003A212 0x8003B012 0x8003BE12 0x8003CC12 0x8003DA12 0x8003E812 0x8003F612 0x80040412 0x80041212 0x80042012 0x80042E12 0x80043C12 0x80044A12 0x80045812 0x80046612 0x80047412 0x80048212 0x80049012 0x80049E12 0x8004AC12 0x8004BA12 0x8004C812 0x8004D612 0x8004E412 /end VAR_ADDRESS
 /end VAR_CHARACTERISTIC
 /begin VAR_CHARACTERISTIC TP_S16TCSCpThOfAsymSpCtlInTurn[4] EngCalVariantCriterion
  /begin VAR_ADDRESS 0x8003A214 0x8003B014 0x8003BE14 0x8003CC14 0x8003DA14 0x8003E814 0x8003F614 0x80040414 0x80041214 0x80042014 0x80042E14 0x80043C14 0x80044A14 0x80045814 0x80046614 0x80047414 0x80048214 0x80049014 0x80049E14 0x8004AC14 0x8004BA14 0x8004C814 0x8004D614 0x8004E414 /end VAR_ADDRESS
 /end VAR_CHARACTERISTIC
 /begin VAR_CHARACTERISTIC TP_S16TCSCpThOfWhlSpnDiffDPInSt[0] EngCalVariantCriterion
  /begin VAR_ADDRESS 0x8003A216 0x8003B016 0x8003BE16 0x8003CC16 0x8003DA16 0x8003E816 0x8003F616 0x80040416 0x80041216 0x80042016 0x80042E16 0x80043C16 0x80044A16 0x80045816 0x80046616 0x80047416 0x80048216 0x80049016 0x80049E16 0x8004AC16 0x8004BA16 0x8004C816 0x8004D616 0x8004E416 /end VAR_ADDRESS
 /end VAR_CHARACTERISTIC
 /begin VAR_CHARACTERISTIC TP_S16TCSCpThOfWhlSpnDiffDPInSt[1] EngCalVariantCriterion
  /begin VAR_ADDRESS 0x8003A218 0x8003B018 0x8003BE18 0x8003CC18 0x8003DA18 0x8003E818 0x8003F618 0x80040418 0x80041218 0x80042018 0x80042E18 0x80043C18 0x80044A18 0x80045818 0x80046618 0x80047418 0x80048218 0x80049018 0x80049E18 0x8004AC18 0x8004BA18 0x8004C818 0x8004D618 0x8004E418 /end VAR_ADDRESS
 /end VAR_CHARACTERISTIC
 /begin VAR_CHARACTERISTIC TP_S16TCSCpThOfWhlSpnDiffDPInSt[2] EngCalVariantCriterion
  /begin VAR_ADDRESS 0x8003A21A 0x8003B01A 0x8003BE1A 0x8003CC1A 0x8003DA1A 0x8003E81A 0x8003F61A 0x8004041A 0x8004121A 0x8004201A 0x80042E1A 0x80043C1A 0x80044A1A 0x8004581A 0x8004661A 0x8004741A 0x8004821A 0x8004901A 0x80049E1A 0x8004AC1A 0x8004BA1A 0x8004C81A 0x8004D61A 0x8004E41A /end VAR_ADDRESS
 /end VAR_CHARACTERISTIC
 /begin VAR_CHARACTERISTIC TP_S16TCSCpThOfWhlSpnDiffDPInSt[3] EngCalVariantCriterion
  /begin VAR_ADDRESS 0x8003A21C 0x8003B01C 0x8003BE1C 0x8003CC1C 0x8003DA1C 0x8003E81C 0x8003F61C 0x8004041C 0x8004121C 0x8004201C 0x80042E1C 0x80043C1C 0x80044A1C 0x8004581C 0x8004661C 0x8004741C 0x8004821C 0x8004901C 0x80049E1C 0x8004AC1C 0x8004BA1C 0x8004C81C 0x8004D61C 0x8004E41C /end VAR_ADDRESS
 /end VAR_CHARACTERISTIC
 /begin VAR_CHARACTERISTIC TP_S16TCSCpThOfWhlSpnDiffDPInSt[4] EngCalVariantCriterion
  /begin VAR_ADDRESS 0x8003A21E 0x8003B01E 0x8003BE1E 0x8003CC1E 0x8003DA1E 0x8003E81E 0x8003F61E 0x8004041E 0x8004121E 0x8004201E 0x80042E1E 0x80043C1E 0x80044A1E 0x8004581E 0x8004661E 0x8004741E 0x8004821E 0x8004901E 0x80049E1E 0x8004AC1E 0x8004BA1E 0x8004C81E 0x8004D61E 0x8004E41E /end VAR_ADDRESS
 /end VAR_CHARACTERISTIC
 /begin VAR_CHARACTERISTIC TP_S16TCSCpThOfWhlSpnDiffInSt[0] EngCalVariantCriterion
  /begin VAR_ADDRESS 0x8003A220 0x8003B020 0x8003BE20 0x8003CC20 0x8003DA20 0x8003E820 0x8003F620 0x80040420 0x80041220 0x80042020 0x80042E20 0x80043C20 0x80044A20 0x80045820 0x80046620 0x80047420 0x80048220 0x80049020 0x80049E20 0x8004AC20 0x8004BA20 0x8004C820 0x8004D620 0x8004E420 /end VAR_ADDRESS
 /end VAR_CHARACTERISTIC
 /begin VAR_CHARACTERISTIC TP_S16TCSCpThOfWhlSpnDiffInSt[1] EngCalVariantCriterion
  /begin VAR_ADDRESS 0x8003A222 0x8003B022 0x8003BE22 0x8003CC22 0x8003DA22 0x8003E822 0x8003F622 0x80040422 0x80041222 0x80042022 0x80042E22 0x80043C22 0x80044A22 0x80045822 0x80046622 0x80047422 0x80048222 0x80049022 0x80049E22 0x8004AC22 0x8004BA22 0x8004C822 0x8004D622 0x8004E422 /end VAR_ADDRESS
 /end VAR_CHARACTERISTIC
 /begin VAR_CHARACTERISTIC TP_S16TCSCpThOfWhlSpnDiffInSt[2] EngCalVariantCriterion
  /begin VAR_ADDRESS 0x8003A224 0x8003B024 0x8003BE24 0x8003CC24 0x8003DA24 0x8003E824 0x8003F624 0x80040424 0x80041224 0x80042024 0x80042E24 0x80043C24 0x80044A24 0x80045824 0x80046624 0x80047424 0x80048224 0x80049024 0x80049E24 0x8004AC24 0x8004BA24 0x8004C824 0x8004D624 0x8004E424 /end VAR_ADDRESS
 /end VAR_CHARACTERISTIC
 /begin VAR_CHARACTERISTIC TP_S16TCSCpThOfWhlSpnDiffInSt[3] EngCalVariantCriterion
  /begin VAR_ADDRESS 0x8003A226 0x8003B026 0x8003BE26 0x8003CC26 0x8003DA26 0x8003E826 0x8003F626 0x80040426 0x80041226 0x80042026 0x80042E26 0x80043C26 0x80044A26 0x80045826 0x80046626 0x80047426 0x80048226 0x80049026 0x80049E26 0x8004AC26 0x8004BA26 0x8004C826 0x8004D626 0x8004E426 /end VAR_ADDRESS
 /end VAR_CHARACTERISTIC
 /begin VAR_CHARACTERISTIC TP_S16TCSCpThOfWhlSpnDiffInSt[4] EngCalVariantCriterion
  /begin VAR_ADDRESS 0x8003A228 0x8003B028 0x8003BE28 0x8003CC28 0x8003DA28 0x8003E828 0x8003F628 0x80040428 0x80041228 0x80042028 0x80042E28 0x80043C28 0x80044A28 0x80045828 0x80046628 0x80047428 0x80048228 0x80049028 0x80049E28 0x8004AC28 0x8004BA28 0x8004C828 0x8004D628 0x8004E428 /end VAR_ADDRESS
 /end VAR_CHARACTERISTIC
 /begin VAR_CHARACTERISTIC TP_S16TCSCpVcaBrkCtlTrqAxisAxMax EngCalVariantCriterion
  /begin VAR_ADDRESS 0x8003A22A 0x8003B02A 0x8003BE2A 0x8003CC2A 0x8003DA2A 0x8003E82A 0x8003F62A 0x8004042A 0x8004122A 0x8004202A 0x80042E2A 0x80043C2A 0x80044A2A 0x8004582A 0x8004662A 0x8004742A 0x8004822A 0x8004902A 0x80049E2A 0x8004AC2A 0x8004BA2A 0x8004C82A 0x8004D62A 0x8004E42A /end VAR_ADDRESS
 /end VAR_CHARACTERISTIC
 /begin VAR_CHARACTERISTIC TP_S16TCSCpVcaBrkCtlTrqAxisAxMin EngCalVariantCriterion
  /begin VAR_ADDRESS 0x8003A22C 0x8003B02C 0x8003BE2C 0x8003CC2C 0x8003DA2C 0x8003E82C 0x8003F62C 0x8004042C 0x8004122C 0x8004202C 0x80042E2C 0x80043C2C 0x80044A2C 0x8004582C 0x8004662C 0x8004742C 0x8004822C 0x8004902C 0x80049E2C 0x8004AC2C 0x8004BA2C 0x8004C82C 0x8004D62C 0x8004E42C /end VAR_ADDRESS
 /end VAR_CHARACTERISTIC
 /begin VAR_CHARACTERISTIC TP_S16TCSCpVcaBrkCtlTrqMax EngCalVariantCriterion
  /begin VAR_ADDRESS 0x8003A22E 0x8003B02E 0x8003BE2E 0x8003CC2E 0x8003DA2E 0x8003E82E 0x8003F62E 0x8004042E 0x8004122E 0x8004202E 0x80042E2E 0x80043C2E 0x80044A2E 0x8004582E 0x8004662E 0x8004742E 0x8004822E 0x8004902E 0x80049E2E 0x8004AC2E 0x8004BA2E 0x8004C82E 0x8004D62E 0x8004E42E /end VAR_ADDRESS
 /end VAR_CHARACTERISTIC
 /begin VAR_CHARACTERISTIC TP_S16TCSCpVcaBrkCtlTrqMin EngCalVariantCriterion
  /begin VAR_ADDRESS 0x8003A230 0x8003B030 0x8003BE30 0x8003CC30 0x8003DA30 0x8003E830 0x8003F630 0x80040430 0x80041230 0x80042030 0x80042E30 0x80043C30 0x80044A30 0x80045830 0x80046630 0x80047430 0x80048230 0x80049030 0x80049E30 0x8004AC30 0x8004BA30 0x8004C830 0x8004D630 0x8004E430 /end VAR_ADDRESS
 /end VAR_CHARACTERISTIC
 /begin VAR_CHARACTERISTIC TP_S16TCSCpWLSpdCrosTh4QuickFadOut EngCalVariantCriterion
  /begin VAR_ADDRESS 0x8003A232 0x8003B032 0x8003BE32 0x8003CC32 0x8003DA32 0x8003E832 0x8003F632 0x80040432 0x80041232 0x80042032 0x80042E32 0x80043C32 0x80044A32 0x80045832 0x80046632 0x80047432 0x80048232 0x80049032 0x80049E32 0x8004AC32 0x8004BA32 0x8004C832 0x8004D632 0x8004E432 /end VAR_ADDRESS
 /end VAR_CHARACTERISTIC
 /begin VAR_CHARACTERISTIC TP_S16TCSCpWorkTh4BrkTrqMaxLim EngCalVariantCriterion
  /begin VAR_ADDRESS 0x8003A234 0x8003B034 0x8003BE34 0x8003CC34 0x8003DA34 0x8003E834 0x8003F634 0x80040434 0x80041234 0x80042034 0x80042E34 0x80043C34 0x80044A34 0x80045834 0x80046634 0x80047434 0x80048234 0x80049034 0x80049E34 0x8004AC34 0x8004BA34 0x8004C834 0x8004D634 0x8004E434 /end VAR_ADDRESS
 /end VAR_CHARACTERISTIC
 /begin VAR_CHARACTERISTIC TP_S16TCSCpWorkTh4FFAdapt EngCalVariantCriterion
  /begin VAR_ADDRESS 0x8003A236 0x8003B036 0x8003BE36 0x8003CC36 0x8003DA36 0x8003E836 0x8003F636 0x80040436 0x80041236 0x80042036 0x80042E36 0x80043C36 0x80044A36 0x80045836 0x80046636 0x80047436 0x80048236 0x80049036 0x80049E36 0x8004AC36 0x8004BA36 0x8004C836 0x8004D636 0x8004E436 /end VAR_ADDRESS
 /end VAR_CHARACTERISTIC
 /begin VAR_CHARACTERISTIC TP_S16TCSCpWorkTh4FFAdaptReset EngCalVariantCriterion
  /begin VAR_ADDRESS 0x8003A238 0x8003B038 0x8003BE38 0x8003CC38 0x8003DA38 0x8003E838 0x8003F638 0x80040438 0x80041238 0x80042038 0x80042E38 0x80043C38 0x80044A38 0x80045838 0x80046638 0x80047438 0x80048238 0x80049038 0x80049E38 0x8004AC38 0x8004BA38 0x8004C838 0x8004D638 0x8004E438 /end VAR_ADDRESS
 /end VAR_CHARACTERISTIC
 /begin VAR_CHARACTERISTIC TP_S16TCSCpWorkTh4HuntDctReset EngCalVariantCriterion
  /begin VAR_ADDRESS 0x8003A23A 0x8003B03A 0x8003BE3A 0x8003CC3A 0x8003DA3A 0x8003E83A 0x8003F63A 0x8004043A 0x8004123A 0x8004203A 0x80042E3A 0x80043C3A 0x80044A3A 0x8004583A 0x8004663A 0x8004743A 0x8004823A 0x8004903A 0x80049E3A 0x8004AC3A 0x8004BA3A 0x8004C83A 0x8004D63A 0x8004E43A /end VAR_ADDRESS
 /end VAR_CHARACTERISTIC
 /begin VAR_CHARACTERISTIC TP_S16TCSCpWorkTh4L2SplitSuspect EngCalVariantCriterion
  /begin VAR_ADDRESS 0x8003A23C 0x8003B03C 0x8003BE3C 0x8003CC3C 0x8003DA3C 0x8003E83C 0x8003F63C 0x8004043C 0x8004123C 0x8004203C 0x80042E3C 0x80043C3C 0x80044A3C 0x8004583C 0x8004663C 0x8004743C 0x8004823C 0x8004903C 0x80049E3C 0x8004AC3C 0x8004BA3C 0x8004C83C 0x8004D63C 0x8004E43C /end VAR_ADDRESS
 /end VAR_CHARACTERISTIC
 /begin VAR_CHARACTERISTIC TP_S16TCSCpYawLim4VcaWhlSeln EngCalVariantCriterion
  /begin VAR_ADDRESS 0x8003A23E 0x8003B03E 0x8003BE3E 0x8003CC3E 0x8003DA3E 0x8003E83E 0x8003F63E 0x8004043E 0x8004123E 0x8004203E 0x80042E3E 0x80043C3E 0x80044A3E 0x8004583E 0x8004663E 0x8004743E 0x8004823E 0x8004903E 0x80049E3E 0x8004AC3E 0x8004BA3E 0x8004C83E 0x8004D63E 0x8004E43E /end VAR_ADDRESS
 /end VAR_CHARACTERISTIC
 /begin VAR_CHARACTERISTIC TP_S16TotalGearRatio_1 EngCalVariantCriterion
  /begin VAR_ADDRESS 0x8003A010 0x8003AE10 0x8003BC10 0x8003CA10 0x8003D810 0x8003E610 0x8003F410 0x80040210 0x80041010 0x80041E10 0x80042C10 0x80043A10 0x80044810 0x80045610 0x80046410 0x80047210 0x80048010 0x80048E10 0x80049C10 0x8004AA10 0x8004B810 0x8004C610 0x8004D410 0x8004E210 /end VAR_ADDRESS
 /end VAR_CHARACTERISTIC
 /begin VAR_CHARACTERISTIC TP_S16TotalGearRatio_2 EngCalVariantCriterion
  /begin VAR_ADDRESS 0x8003A012 0x8003AE12 0x8003BC12 0x8003CA12 0x8003D812 0x8003E612 0x8003F412 0x80040212 0x80041012 0x80041E12 0x80042C12 0x80043A12 0x80044812 0x80045612 0x80046412 0x80047212 0x80048012 0x80048E12 0x80049C12 0x8004AA12 0x8004B812 0x8004C612 0x8004D412 0x8004E212 /end VAR_ADDRESS
 /end VAR_CHARACTERISTIC
 /begin VAR_CHARACTERISTIC TP_S16TotalGearRatio_3 EngCalVariantCriterion
  /begin VAR_ADDRESS 0x8003A014 0x8003AE14 0x8003BC14 0x8003CA14 0x8003D814 0x8003E614 0x8003F414 0x80040214 0x80041014 0x80041E14 0x80042C14 0x80043A14 0x80044814 0x80045614 0x80046414 0x80047214 0x80048014 0x80048E14 0x80049C14 0x8004AA14 0x8004B814 0x8004C614 0x8004D414 0x8004E214 /end VAR_ADDRESS
 /end VAR_CHARACTERISTIC
 /begin VAR_CHARACTERISTIC TP_S16TotalGearRatio_4 EngCalVariantCriterion
  /begin VAR_ADDRESS 0x8003A016 0x8003AE16 0x8003BC16 0x8003CA16 0x8003D816 0x8003E616 0x8003F416 0x80040216 0x80041016 0x80041E16 0x80042C16 0x80043A16 0x80044816 0x80045616 0x80046416 0x80047216 0x80048016 0x80048E16 0x80049C16 0x8004AA16 0x8004B816 0x8004C616 0x8004D416 0x8004E216 /end VAR_ADDRESS
 /end VAR_CHARACTERISTIC
 /begin VAR_CHARACTERISTIC TP_S16TotalGearRatio_5 EngCalVariantCriterion
  /begin VAR_ADDRESS 0x8003A018 0x8003AE18 0x8003BC18 0x8003CA18 0x8003D818 0x8003E618 0x8003F418 0x80040218 0x80041018 0x80041E18 0x80042C18 0x80043A18 0x80044818 0x80045618 0x80046418 0x80047218 0x80048018 0x80048E18 0x80049C18 0x8004AA18 0x8004B818 0x8004C618 0x8004D418 0x8004E218 /end VAR_ADDRESS
 /end VAR_CHARACTERISTIC
 /begin VAR_CHARACTERISTIC TP_S16TotalGearRatio_6 EngCalVariantCriterion
  /begin VAR_ADDRESS 0x8003A01A 0x8003AE1A 0x8003BC1A 0x8003CA1A 0x8003D81A 0x8003E61A 0x8003F41A 0x8004021A 0x8004101A 0x80041E1A 0x80042C1A 0x80043A1A 0x8004481A 0x8004561A 0x8004641A 0x8004721A 0x8004801A 0x80048E1A 0x80049C1A 0x8004AA1A 0x8004B81A 0x8004C61A 0x8004D41A 0x8004E21A /end VAR_ADDRESS
 /end VAR_CHARACTERISTIC
 /begin VAR_CHARACTERISTIC TP_S16TotalGearRatio_7 EngCalVariantCriterion
  /begin VAR_ADDRESS 0x8003A01C 0x8003AE1C 0x8003BC1C 0x8003CA1C 0x8003D81C 0x8003E61C 0x8003F41C 0x8004021C 0x8004101C 0x80041E1C 0x80042C1C 0x80043A1C 0x8004481C 0x8004561C 0x8004641C 0x8004721C 0x8004801C 0x80048E1C 0x80049C1C 0x8004AA1C 0x8004B81C 0x8004C61C 0x8004D41C 0x8004E21C /end VAR_ADDRESS
 /end VAR_CHARACTERISTIC
 /begin VAR_CHARACTERISTIC TP_S16TotalGearRatio_8 EngCalVariantCriterion
  /begin VAR_ADDRESS 0x8003A01E 0x8003AE1E 0x8003BC1E 0x8003CA1E 0x8003D81E 0x8003E61E 0x8003F41E 0x8004021E 0x8004101E 0x80041E1E 0x80042C1E 0x80043A1E 0x8004481E 0x8004561E 0x8004641E 0x8004721E 0x8004801E 0x80048E1E 0x80049C1E 0x8004AA1E 0x8004B81E 0x8004C61E 0x8004D41E 0x8004E21E /end VAR_ADDRESS
 /end VAR_CHARACTERISTIC
 /begin VAR_CHARACTERISTIC TP_S16TotalGearRatio_R EngCalVariantCriterion
  /begin VAR_ADDRESS 0x8003A020 0x8003AE20 0x8003BC20 0x8003CA20 0x8003D820 0x8003E620 0x8003F420 0x80040220 0x80041020 0x80041E20 0x80042C20 0x80043A20 0x80044820 0x80045620 0x80046420 0x80047220 0x80048020 0x80048E20 0x80049C20 0x8004AA20 0x8004B820 0x8004C620 0x8004D420 0x8004E220 /end VAR_ADDRESS
 /end VAR_CHARACTERISTIC
 /begin VAR_CHARACTERISTIC TP_S16_ABS_ALLOW_SLIP_REF_HSPD BrkCalVariantCriterion
  /begin VAR_ADDRESS 0x80020570 0x80023970 0x80026D70 0x8002A170 0x8002D570 0x80030970 0x80033D70 0x80037170 /end VAR_ADDRESS
 /end VAR_CHARACTERISTIC
 /begin VAR_CHARACTERISTIC TP_S16_ABS_ALLOW_SLIP_REF_LSPD BrkCalVariantCriterion
  /begin VAR_ADDRESS 0x80020572 0x80023972 0x80026D72 0x8002A172 0x8002D572 0x80030972 0x80033D72 0x80037172 /end VAR_ADDRESS
 /end VAR_CHARACTERISTIC
 /begin VAR_CHARACTERISTIC TP_S16_AIR_CONDUCTIVITY EngCalVariantCriterion
  /begin VAR_ADDRESS 0x8003A040 0x8003AE40 0x8003BC40 0x8003CA40 0x8003D840 0x8003E640 0x8003F440 0x80040240 0x80041040 0x80041E40 0x80042C40 0x80043A40 0x80044840 0x80045640 0x80046440 0x80047240 0x80048040 0x80048E40 0x80049C40 0x8004AA40 0x8004B840 0x8004C640 0x8004D440 0x8004E240 /end VAR_ADDRESS
 /end VAR_CHARACTERISTIC
 /begin VAR_CHARACTERISTIC TP_S16_AT_Eng_Status_Threshold EngCalVariantCriterion
  /begin VAR_ADDRESS 0x8003A162 0x8003AF62 0x8003BD62 0x8003CB62 0x8003D962 0x8003E762 0x8003F562 0x80040362 0x80041162 0x80041F62 0x80042D62 0x80043B62 0x80044962 0x80045762 0x80046562 0x80047362 0x80048162 0x80048F62 0x80049D62 0x8004AB62 0x8004B962 0x8004C762 0x8004D562 0x8004E362 /end VAR_ADDRESS
 /end VAR_CHARACTERISTIC
 /begin VAR_CHARACTERISTIC TP_S16_AT_In_Gear_Lower_Limit EngCalVariantCriterion
  /begin VAR_ADDRESS 0x8003A156 0x8003AF56 0x8003BD56 0x8003CB56 0x8003D956 0x8003E756 0x8003F556 0x80040356 0x80041156 0x80041F56 0x80042D56 0x80043B56 0x80044956 0x80045756 0x80046556 0x80047356 0x80048156 0x80048F56 0x80049D56 0x8004AB56 0x8004B956 0x8004C756 0x8004D556 0x8004E356 /end VAR_ADDRESS
 /end VAR_CHARACTERISTIC
 /begin VAR_CHARACTERISTIC TP_S16_AT_In_Gear_Upper_Limit EngCalVariantCriterion
  /begin VAR_ADDRESS 0x8003A158 0x8003AF58 0x8003BD58 0x8003CB58 0x8003D958 0x8003E758 0x8003F558 0x80040358 0x80041158 0x80041F58 0x80042D58 0x80043B58 0x80044958 0x80045758 0x80046558 0x80047358 0x80048158 0x80048F58 0x80049D58 0x8004AB58 0x8004B958 0x8004C758 0x8004D558 0x8004E358 /end VAR_ADDRESS
 /end VAR_CHARACTERISTIC
 /begin VAR_CHARACTERISTIC TP_S16_Additional_HDF_ref_F BrkCalVariantCriterion
  /begin VAR_ADDRESS 0x800205B2 0x800239B2 0x80026DB2 0x8002A1B2 0x8002D5B2 0x800309B2 0x80033DB2 0x800371B2 /end VAR_ADDRESS
 /end VAR_CHARACTERISTIC
 /begin VAR_CHARACTERISTIC TP_S16_Additional_HDF_ref_R BrkCalVariantCriterion
  /begin VAR_ADDRESS 0x800205B4 0x800239B4 0x80026DB4 0x8002A1B4 0x8002D5B4 0x800309B4 0x80033DB4 0x800371B4 /end VAR_ADDRESS
 /end VAR_CHARACTERISTIC
 /begin VAR_CHARACTERISTIC TP_S16_BRAKE_COOLING_COEFFIC_F EngCalVariantCriterion
  /begin VAR_ADDRESS 0x8003A042 0x8003AE42 0x8003BC42 0x8003CA42 0x8003D842 0x8003E642 0x8003F442 0x80040242 0x80041042 0x80041E42 0x80042C42 0x80043A42 0x80044842 0x80045642 0x80046442 0x80047242 0x80048042 0x80048E42 0x80049C42 0x8004AA42 0x8004B842 0x8004C642 0x8004D442 0x8004E242 /end VAR_ADDRESS
 /end VAR_CHARACTERISTIC
 /begin VAR_CHARACTERISTIC TP_S16_BRAKE_COOLING_COEFFIC_R EngCalVariantCriterion
  /begin VAR_ADDRESS 0x8003A044 0x8003AE44 0x8003BC44 0x8003CA44 0x8003D844 0x8003E644 0x8003F444 0x80040244 0x80041044 0x80041E44 0x80042C44 0x80043A44 0x80044844 0x80045644 0x80046444 0x80047244 0x80048044 0x80048E44 0x80049C44 0x8004AA44 0x8004B844 0x8004C644 0x8004D444 0x8004E244 /end VAR_ADDRESS
 /end VAR_CHARACTERISTIC
 /begin VAR_CHARACTERISTIC TP_S16_BRAKE_DISK_AREA_F EngCalVariantCriterion
  /begin VAR_ADDRESS 0x8003A046 0x8003AE46 0x8003BC46 0x8003CA46 0x8003D846 0x8003E646 0x8003F446 0x80040246 0x80041046 0x80041E46 0x80042C46 0x80043A46 0x80044846 0x80045646 0x80046446 0x80047246 0x80048046 0x80048E46 0x80049C46 0x8004AA46 0x8004B846 0x8004C646 0x8004D446 0x8004E246 /end VAR_ADDRESS
 /end VAR_CHARACTERISTIC
 /begin VAR_CHARACTERISTIC TP_S16_BRAKE_DISK_AREA_R EngCalVariantCriterion
  /begin VAR_ADDRESS 0x8003A048 0x8003AE48 0x8003BC48 0x8003CA48 0x8003D848 0x8003E648 0x8003F448 0x80040248 0x80041048 0x80041E48 0x80042C48 0x80043A48 0x80044848 0x80045648 0x80046448 0x80047248 0x80048048 0x80048E48 0x80049C48 0x8004AA48 0x8004B848 0x8004C648 0x8004D448 0x8004E248 /end VAR_ADDRESS
 /end VAR_CHARACTERISTIC
 /begin VAR_CHARACTERISTIC TP_S16_BRAKE_DISK_DIAMETER_F EngCalVariantCriterion
  /begin VAR_ADDRESS 0x8003A04A 0x8003AE4A 0x8003BC4A 0x8003CA4A 0x8003D84A 0x8003E64A 0x8003F44A 0x8004024A 0x8004104A 0x80041E4A 0x80042C4A 0x80043A4A 0x8004484A 0x8004564A 0x8004644A 0x8004724A 0x8004804A 0x80048E4A 0x80049C4A 0x8004AA4A 0x8004B84A 0x8004C64A 0x8004D44A 0x8004E24A /end VAR_ADDRESS
 /end VAR_CHARACTERISTIC
 /begin VAR_CHARACTERISTIC TP_S16_BRAKE_DISK_DIAMETER_R EngCalVariantCriterion
  /begin VAR_ADDRESS 0x8003A04C 0x8003AE4C 0x8003BC4C 0x8003CA4C 0x8003D84C 0x8003E64C 0x8003F44C 0x8004024C 0x8004104C 0x80041E4C 0x80042C4C 0x80043A4C 0x8004484C 0x8004564C 0x8004644C 0x8004724C 0x8004804C 0x80048E4C 0x80049C4C 0x8004AA4C 0x8004B84C 0x8004C64C 0x8004D44C 0x8004E24C /end VAR_ADDRESS
 /end VAR_CHARACTERISTIC
 /begin VAR_CHARACTERISTIC TP_S16_BRAKE_DISK_MASS_F EngCalVariantCriterion
  /begin VAR_ADDRESS 0x8003A04E 0x8003AE4E 0x8003BC4E 0x8003CA4E 0x8003D84E 0x8003E64E 0x8003F44E 0x8004024E 0x8004104E 0x80041E4E 0x80042C4E 0x80043A4E 0x8004484E 0x8004564E 0x8004644E 0x8004724E 0x8004804E 0x80048E4E 0x80049C4E 0x8004AA4E 0x8004B84E 0x8004C64E 0x8004D44E 0x8004E24E /end VAR_ADDRESS
 /end VAR_CHARACTERISTIC
 /begin VAR_CHARACTERISTIC TP_S16_BRAKE_DISK_MASS_R EngCalVariantCriterion
  /begin VAR_ADDRESS 0x8003A050 0x8003AE50 0x8003BC50 0x8003CA50 0x8003D850 0x8003E650 0x8003F450 0x80040250 0x80041050 0x80041E50 0x80042C50 0x80043A50 0x80044850 0x80045650 0x80046450 0x80047250 0x80048050 0x80048E50 0x80049C50 0x8004AA50 0x8004B850 0x8004C650 0x8004D450 0x8004E250 /end VAR_ADDRESS
 /end VAR_CHARACTERISTIC
 /begin VAR_CHARACTERISTIC TP_S16_BRAKE_DISK_SPECIFIC_HEAT EngCalVariantCriterion
  /begin VAR_ADDRESS 0x8003A052 0x8003AE52 0x8003BC52 0x8003CA52 0x8003D852 0x8003E652 0x8003F452 0x80040252 0x80041052 0x80041E52 0x80042C52 0x80043A52 0x80044852 0x80045652 0x80046452 0x80047252 0x80048052 0x80048E52 0x80049C52 0x8004AA52 0x8004B852 0x8004C652 0x8004D452 0x8004E252 /end VAR_ADDRESS
 /end VAR_CHARACTERISTIC
 /begin VAR_CHARACTERISTIC TP_S16_BRAKE_PAD_AREA_F EngCalVariantCriterion
  /begin VAR_ADDRESS 0x8003A054 0x8003AE54 0x8003BC54 0x8003CA54 0x8003D854 0x8003E654 0x8003F454 0x80040254 0x80041054 0x80041E54 0x80042C54 0x80043A54 0x80044854 0x80045654 0x80046454 0x80047254 0x80048054 0x80048E54 0x80049C54 0x8004AA54 0x8004B854 0x8004C654 0x8004D454 0x8004E254 /end VAR_ADDRESS
 /end VAR_CHARACTERISTIC
 /begin VAR_CHARACTERISTIC TP_S16_BRAKE_PAD_AREA_R EngCalVariantCriterion
  /begin VAR_ADDRESS 0x8003A056 0x8003AE56 0x8003BC56 0x8003CA56 0x8003D856 0x8003E656 0x8003F456 0x80040256 0x80041056 0x80041E56 0x80042C56 0x80043A56 0x80044856 0x80045656 0x80046456 0x80047256 0x80048056 0x80048E56 0x80049C56 0x8004AA56 0x8004B856 0x8004C656 0x8004D456 0x8004E256 /end VAR_ADDRESS
 /end VAR_CHARACTERISTIC
 /begin VAR_CHARACTERISTIC TP_S16_BRAKE_PAD_FRICTION_F EngCalVariantCriterion
  /begin VAR_ADDRESS 0x8003A058 0x8003AE58 0x8003BC58 0x8003CA58 0x8003D858 0x8003E658 0x8003F458 0x80040258 0x80041058 0x80041E58 0x80042C58 0x80043A58 0x80044858 0x80045658 0x80046458 0x80047258 0x80048058 0x80048E58 0x80049C58 0x8004AA58 0x8004B858 0x8004C658 0x8004D458 0x8004E258 /end VAR_ADDRESS
 /end VAR_CHARACTERISTIC
 /begin VAR_CHARACTERISTIC TP_S16_BRAKE_PAD_FRICTION_R EngCalVariantCriterion
  /begin VAR_ADDRESS 0x8003A05A 0x8003AE5A 0x8003BC5A 0x8003CA5A 0x8003D85A 0x8003E65A 0x8003F45A 0x8004025A 0x8004105A 0x80041E5A 0x80042C5A 0x80043A5A 0x8004485A 0x8004565A 0x8004645A 0x8004725A 0x8004805A 0x80048E5A 0x80049C5A 0x8004AA5A 0x8004B85A 0x8004C65A 0x8004D45A 0x8004E25A /end VAR_ADDRESS
 /end VAR_CHARACTERISTIC
 /begin VAR_CHARACTERISTIC TP_S16_BRAKE_THERM_EFFIC_F EngCalVariantCriterion
  /begin VAR_ADDRESS 0x8003A05C 0x8003AE5C 0x8003BC5C 0x8003CA5C 0x8003D85C 0x8003E65C 0x8003F45C 0x8004025C 0x8004105C 0x80041E5C 0x80042C5C 0x80043A5C 0x8004485C 0x8004565C 0x8004645C 0x8004725C 0x8004805C 0x80048E5C 0x80049C5C 0x8004AA5C 0x8004B85C 0x8004C65C 0x8004D45C 0x8004E25C /end VAR_ADDRESS
 /end VAR_CHARACTERISTIC
 /begin VAR_CHARACTERISTIC TP_S16_BRAKE_THERM_EFFIC_R EngCalVariantCriterion
  /begin VAR_ADDRESS 0x8003A05E 0x8003AE5E 0x8003BC5E 0x8003CA5E 0x8003D85E 0x8003E65E 0x8003F45E 0x8004025E 0x8004105E 0x80041E5E 0x80042C5E 0x80043A5E 0x8004485E 0x8004565E 0x8004645E 0x8004725E 0x8004805E 0x80048E5E 0x80049C5E 0x8004AA5E 0x8004B85E 0x8004C65E 0x8004D45E 0x8004E25E /end VAR_ADDRESS
 /end VAR_CHARACTERISTIC
 /begin VAR_CHARACTERISTIC TP_S16_BUMP_HI_SPD BrkCalVariantCriterion
  /begin VAR_ADDRESS 0x8002061C 0x80023A1C 0x80026E1C 0x8002A21C 0x8002D61C 0x80030A1C 0x80033E1C 0x8003721C /end VAR_ADDRESS
 /end VAR_CHARACTERISTIC
 /begin VAR_CHARACTERISTIC TP_S16_BUMP_LOW_SPD BrkCalVariantCriterion
  /begin VAR_ADDRESS 0x8002061E 0x80023A1E 0x80026E1E 0x8002A21E 0x8002D61E 0x80030A1E 0x80033E1E 0x8003721E /end VAR_ADDRESS
 /end VAR_CHARACTERISTIC
 /begin VAR_CHARACTERISTIC TP_S16_BUMP_MED_SPD BrkCalVariantCriterion
  /begin VAR_ADDRESS 0x80020620 0x80023A20 0x80026E20 0x8002A220 0x8002D620 0x80030A20 0x80033E20 0x80037220 /end VAR_ADDRESS
 /end VAR_CHARACTERISTIC
 /begin VAR_CHARACTERISTIC TP_S16_CBC_ABS_REAR_ENTER_DV_SPD_H BrkCalVariantCriterion
  /begin VAR_ADDRESS 0x8002072C 0x80023B2C 0x80026F2C 0x8002A32C 0x8002D72C 0x80030B2C 0x80033F2C 0x8003732C /end VAR_ADDRESS
 /end VAR_CHARACTERISTIC
 /begin VAR_CHARACTERISTIC TP_S16_CBC_ABS_REAR_ENTER_DV_SPD_M BrkCalVariantCriterion
  /begin VAR_ADDRESS 0x8002072E 0x80023B2E 0x80026F2E 0x8002A32E 0x8002D72E 0x80030B2E 0x80033F2E 0x8003732E /end VAR_ADDRESS
 /end VAR_CHARACTERISTIC
 /begin VAR_CHARACTERISTIC TP_S16_CBC_ABS_REAR_ENTER_DV_SPD_S BrkCalVariantCriterion
  /begin VAR_ADDRESS 0x80020730 0x80023B30 0x80026F30 0x8002A330 0x8002D730 0x80030B30 0x80033F30 0x80037330 /end VAR_ADDRESS
 /end VAR_CHARACTERISTIC
 /begin VAR_CHARACTERISTIC TP_S16_CBC_ABS_REAR_EXIT_DV BrkCalVariantCriterion
  /begin VAR_ADDRESS 0x80020732 0x80023B32 0x80026F32 0x8002A332 0x8002D732 0x80030B32 0x80033F32 0x80037332 /end VAR_ADDRESS
 /end VAR_CHARACTERISTIC
 /begin VAR_CHARACTERISTIC TP_S16_CBC_ABS_REAR_SLIP_DEL_P_SPD_H BrkCalVariantCriterion
  /begin VAR_ADDRESS 0x80020734 0x80023B34 0x80026F34 0x8002A334 0x8002D734 0x80030B34 0x80033F34 0x80037334 /end VAR_ADDRESS
 /end VAR_CHARACTERISTIC
 /begin VAR_CHARACTERISTIC TP_S16_CBC_ABS_REAR_SLIP_DEL_P_SPD_M BrkCalVariantCriterion
  /begin VAR_ADDRESS 0x80020736 0x80023B36 0x80026F36 0x8002A336 0x8002D736 0x80030B36 0x80033F36 0x80037336 /end VAR_ADDRESS
 /end VAR_CHARACTERISTIC
 /begin VAR_CHARACTERISTIC TP_S16_CBC_ABS_REAR_SLIP_DEL_P_SPD_S BrkCalVariantCriterion
  /begin VAR_ADDRESS 0x80020738 0x80023B38 0x80026F38 0x8002A338 0x8002D738 0x80030B38 0x80033F38 0x80037338 /end VAR_ADDRESS
 /end VAR_CHARACTERISTIC
 /begin VAR_CHARACTERISTIC TP_S16_CBC_ALAT_ENTER_SPD_H BrkCalVariantCriterion
  /begin VAR_ADDRESS 0x800206E6 0x80023AE6 0x80026EE6 0x8002A2E6 0x8002D6E6 0x80030AE6 0x80033EE6 0x800372E6 /end VAR_ADDRESS
 /end VAR_CHARACTERISTIC
 /begin VAR_CHARACTERISTIC TP_S16_CBC_ALAT_ENTER_SPD_H_FAST_STR BrkCalVariantCriterion
  /begin VAR_ADDRESS 0x80020740 0x80023B40 0x80026F40 0x8002A340 0x8002D740 0x80030B40 0x80033F40 0x80037340 /end VAR_ADDRESS
 /end VAR_CHARACTERISTIC
 /begin VAR_CHARACTERISTIC TP_S16_CBC_ALAT_ENTER_SPD_H_SLOW_STR BrkCalVariantCriterion
  /begin VAR_ADDRESS 0x80020742 0x80023B42 0x80026F42 0x8002A342 0x8002D742 0x80030B42 0x80033F42 0x80037342 /end VAR_ADDRESS
 /end VAR_CHARACTERISTIC
 /begin VAR_CHARACTERISTIC TP_S16_CBC_ALAT_ENTER_SPD_M BrkCalVariantCriterion
  /begin VAR_ADDRESS 0x800206E8 0x80023AE8 0x80026EE8 0x8002A2E8 0x8002D6E8 0x80030AE8 0x80033EE8 0x800372E8 /end VAR_ADDRESS
 /end VAR_CHARACTERISTIC
 /begin VAR_CHARACTERISTIC TP_S16_CBC_ALAT_ENTER_SPD_M_FAST_STR BrkCalVariantCriterion
  /begin VAR_ADDRESS 0x80020744 0x80023B44 0x80026F44 0x8002A344 0x8002D744 0x80030B44 0x80033F44 0x80037344 /end VAR_ADDRESS
 /end VAR_CHARACTERISTIC
 /begin VAR_CHARACTERISTIC TP_S16_CBC_ALAT_ENTER_SPD_M_SLOW_STR BrkCalVariantCriterion
  /begin VAR_ADDRESS 0x80020746 0x80023B46 0x80026F46 0x8002A346 0x8002D746 0x80030B46 0x80033F46 0x80037346 /end VAR_ADDRESS
 /end VAR_CHARACTERISTIC
 /begin VAR_CHARACTERISTIC TP_S16_CBC_ALAT_ENTER_SPD_S BrkCalVariantCriterion
  /begin VAR_ADDRESS 0x800206EA 0x80023AEA 0x80026EEA 0x8002A2EA 0x8002D6EA 0x80030AEA 0x80033EEA 0x800372EA /end VAR_ADDRESS
 /end VAR_CHARACTERISTIC
 /begin VAR_CHARACTERISTIC TP_S16_CBC_ALAT_ENTER_SPD_S_FAST_STR BrkCalVariantCriterion
  /begin VAR_ADDRESS 0x80020748 0x80023B48 0x80026F48 0x8002A348 0x8002D748 0x80030B48 0x80033F48 0x80037348 /end VAR_ADDRESS
 /end VAR_CHARACTERISTIC
 /begin VAR_CHARACTERISTIC TP_S16_CBC_ALAT_ENTER_SPD_S_SLOW_STR BrkCalVariantCriterion
  /begin VAR_ADDRESS 0x8002074A 0x80023B4A 0x80026F4A 0x8002A34A 0x8002D74A 0x80030B4A 0x80033F4A 0x8003734A /end VAR_ADDRESS
 /end VAR_CHARACTERISTIC
 /begin VAR_CHARACTERISTIC TP_S16_CBC_ALAT_EXIT BrkCalVariantCriterion
  /begin VAR_ADDRESS 0x80020762 0x80023B62 0x80026F62 0x8002A362 0x8002D762 0x80030B62 0x80033F62 0x80037362 /end VAR_ADDRESS
 /end VAR_CHARACTERISTIC
 /begin VAR_CHARACTERISTIC TP_S16_CBC_ALAT_EXIT_ABS BrkCalVariantCriterion
  /begin VAR_ADDRESS 0x800206F2 0x80023AF2 0x80026EF2 0x8002A2F2 0x8002D6F2 0x80030AF2 0x80033EF2 0x800372F2 /end VAR_ADDRESS
 /end VAR_CHARACTERISTIC
 /begin VAR_CHARACTERISTIC TP_S16_CBC_AY_ERROR_CHECK_TIME BrkCalVariantCriterion
  /begin VAR_ADDRESS 0x80020724 0x80023B24 0x80026F24 0x8002A324 0x8002D724 0x80030B24 0x80033F24 0x80037324 /end VAR_ADDRESS
 /end VAR_CHARACTERISTIC
 /begin VAR_CHARACTERISTIC TP_S16_CBC_AY_ERROR_DET_LEVEL BrkCalVariantCriterion
  /begin VAR_ADDRESS 0x80020726 0x80023B26 0x80026F26 0x8002A326 0x8002D726 0x80030B26 0x80033F26 0x80037326 /end VAR_ADDRESS
 /end VAR_CHARACTERISTIC
 /begin VAR_CHARACTERISTIC TP_S16_CBC_AY_ERROR_SUS_LEVEL BrkCalVariantCriterion
  /begin VAR_ADDRESS 0x80020728 0x80023B28 0x80026F28 0x8002A328 0x8002D728 0x80030B28 0x80033F28 0x80037328 /end VAR_ADDRESS
 /end VAR_CHARACTERISTIC
 /begin VAR_CHARACTERISTIC TP_S16_CBC_AY_EST_REF_SPD_H BrkCalVariantCriterion
  /begin VAR_ADDRESS 0x80020714 0x80023B14 0x80026F14 0x8002A314 0x8002D714 0x80030B14 0x80033F14 0x80037314 /end VAR_ADDRESS
 /end VAR_CHARACTERISTIC
 /begin VAR_CHARACTERISTIC TP_S16_CBC_AY_EST_REF_SPD_M BrkCalVariantCriterion
  /begin VAR_ADDRESS 0x80020716 0x80023B16 0x80026F16 0x8002A316 0x8002D716 0x80030B16 0x80033F16 0x80037316 /end VAR_ADDRESS
 /end VAR_CHARACTERISTIC
 /begin VAR_CHARACTERISTIC TP_S16_CBC_AY_EST_REF_SPD_S BrkCalVariantCriterion
  /begin VAR_ADDRESS 0x80020718 0x80023B18 0x80026F18 0x8002A318 0x8002D718 0x80030B18 0x80033F18 0x80037318 /end VAR_ADDRESS
 /end VAR_CHARACTERISTIC
 /begin VAR_CHARACTERISTIC TP_S16_CBC_AY_OK_CHECK_TIME BrkCalVariantCriterion
  /begin VAR_ADDRESS 0x8002072A 0x80023B2A 0x80026F2A 0x8002A32A 0x8002D72A 0x80030B2A 0x80033F2A 0x8003732A /end VAR_ADDRESS
 /end VAR_CHARACTERISTIC
 /begin VAR_CHARACTERISTIC TP_S16_CBC_BRAKING_AX_THRES_BLS BrkCalVariantCriterion
  /begin VAR_ADDRESS 0x8002070A 0x80023B0A 0x80026F0A 0x8002A30A 0x8002D70A 0x80030B0A 0x80033F0A 0x8003730A /end VAR_ADDRESS
 /end VAR_CHARACTERISTIC
 /begin VAR_CHARACTERISTIC TP_S16_CBC_BRAKING_AX_THRES_NO_BLS BrkCalVariantCriterion
  /begin VAR_ADDRESS 0x8002070C 0x80023B0C 0x80026F0C 0x8002A30C 0x8002D70C 0x80030B0C 0x80033F0C 0x8003730C /end VAR_ADDRESS
 /end VAR_CHARACTERISTIC
 /begin VAR_CHARACTERISTIC TP_S16_CBC_BRAKING_DET_THRES BrkCalVariantCriterion
  /begin VAR_ADDRESS 0x8002073A 0x80023B3A 0x80026F3A 0x8002A33A 0x8002D73A 0x80030B3A 0x80033F3A 0x8003733A /end VAR_ADDRESS
 /end VAR_CHARACTERISTIC
 /begin VAR_CHARACTERISTIC TP_S16_CBC_BRAKING_DET_THRES_ABS BrkCalVariantCriterion
  /begin VAR_ADDRESS 0x800206EC 0x80023AEC 0x80026EEC 0x8002A2EC 0x8002D6EC 0x80030AEC 0x80033EEC 0x800372EC /end VAR_ADDRESS
 /end VAR_CHARACTERISTIC
 /begin VAR_CHARACTERISTIC TP_S16_CBC_BRAKING_MIN_THRES BrkCalVariantCriterion
  /begin VAR_ADDRESS 0x8002073C 0x80023B3C 0x80026F3C 0x8002A33C 0x8002D73C 0x80030B3C 0x80033F3C 0x8003733C /end VAR_ADDRESS
 /end VAR_CHARACTERISTIC
 /begin VAR_CHARACTERISTIC TP_S16_CBC_BRAKING_MIN_THRES_ABS BrkCalVariantCriterion
  /begin VAR_ADDRESS 0x800206EE 0x80023AEE 0x80026EEE 0x8002A2EE 0x8002D6EE 0x80030AEE 0x80033EEE 0x800372EE /end VAR_ADDRESS
 /end VAR_CHARACTERISTIC
 /begin VAR_CHARACTERISTIC TP_S16_CBC_COMP_MAX_DEL_YAW BrkCalVariantCriterion
  /begin VAR_ADDRESS 0x8002076C 0x80023B6C 0x80026F6C 0x8002A36C 0x8002D76C 0x80030B6C 0x80033F6C 0x8003736C /end VAR_ADDRESS
 /end VAR_CHARACTERISTIC
 /begin VAR_CHARACTERISTIC TP_S16_CBC_COMP_MAX_PRESS BrkCalVariantCriterion
  /begin VAR_ADDRESS 0x8002076E 0x80023B6E 0x80026F6E 0x8002A36E 0x8002D76E 0x80030B6E 0x80033F6E 0x8003736E /end VAR_ADDRESS
 /end VAR_CHARACTERISTIC
 /begin VAR_CHARACTERISTIC TP_S16_CBC_COMP_MIN_DEL_YAW BrkCalVariantCriterion
  /begin VAR_ADDRESS 0x80020770 0x80023B70 0x80026F70 0x8002A370 0x8002D770 0x80030B70 0x80033F70 0x80037370 /end VAR_ADDRESS
 /end VAR_CHARACTERISTIC
 /begin VAR_CHARACTERISTIC TP_S16_CBC_COMP_MIN_PRESS BrkCalVariantCriterion
  /begin VAR_ADDRESS 0x80020772 0x80023B72 0x80026F72 0x8002A372 0x8002D772 0x80030B72 0x80033F72 0x80037372 /end VAR_ADDRESS
 /end VAR_CHARACTERISTIC
 /begin VAR_CHARACTERISTIC TP_S16_CBC_DECEL_THRES_COMP_H BrkCalVariantCriterion
  /begin VAR_ADDRESS 0x80020752 0x80023B52 0x80026F52 0x8002A352 0x8002D752 0x80030B52 0x80033F52 0x80037352 /end VAR_ADDRESS
 /end VAR_CHARACTERISTIC
 /begin VAR_CHARACTERISTIC TP_S16_CBC_DECEL_THRES_COMP_M BrkCalVariantCriterion
  /begin VAR_ADDRESS 0x80020754 0x80023B54 0x80026F54 0x8002A354 0x8002D754 0x80030B54 0x80033F54 0x80037354 /end VAR_ADDRESS
 /end VAR_CHARACTERISTIC
 /begin VAR_CHARACTERISTIC TP_S16_CBC_DECEL_THRES_H BrkCalVariantCriterion
  /begin VAR_ADDRESS 0x80020756 0x80023B56 0x80026F56 0x8002A356 0x8002D756 0x80030B56 0x80033F56 0x80037356 /end VAR_ADDRESS
 /end VAR_CHARACTERISTIC
 /begin VAR_CHARACTERISTIC TP_S16_CBC_DECEL_THRES_L BrkCalVariantCriterion
  /begin VAR_ADDRESS 0x80020758 0x80023B58 0x80026F58 0x8002A358 0x8002D758 0x80030B58 0x80033F58 0x80037358 /end VAR_ADDRESS
 /end VAR_CHARACTERISTIC
 /begin VAR_CHARACTERISTIC TP_S16_CBC_DECEL_THRES_M BrkCalVariantCriterion
  /begin VAR_ADDRESS 0x8002075A 0x80023B5A 0x80026F5A 0x8002A35A 0x8002D75A 0x80030B5A 0x80033F5A 0x8003735A /end VAR_ADDRESS
 /end VAR_CHARACTERISTIC
 /begin VAR_CHARACTERISTIC TP_S16_CBC_DELTA_PRESS_ABS_SPD_H BrkCalVariantCriterion
  /begin VAR_ADDRESS 0x800206F6 0x80023AF6 0x80026EF6 0x8002A2F6 0x8002D6F6 0x80030AF6 0x80033EF6 0x800372F6 /end VAR_ADDRESS
 /end VAR_CHARACTERISTIC
 /begin VAR_CHARACTERISTIC TP_S16_CBC_DELTA_PRESS_ABS_SPD_M BrkCalVariantCriterion
  /begin VAR_ADDRESS 0x800206F8 0x80023AF8 0x80026EF8 0x8002A2F8 0x8002D6F8 0x80030AF8 0x80033EF8 0x800372F8 /end VAR_ADDRESS
 /end VAR_CHARACTERISTIC
 /begin VAR_CHARACTERISTIC TP_S16_CBC_DELTA_PRESS_ABS_SPD_S BrkCalVariantCriterion
  /begin VAR_ADDRESS 0x800206FA 0x80023AFA 0x80026EFA 0x8002A2FA 0x8002D6FA 0x80030AFA 0x80033EFA 0x800372FA /end VAR_ADDRESS
 /end VAR_CHARACTERISTIC
 /begin VAR_CHARACTERISTIC TP_S16_CBC_DELTA_PRESS_ALAT_H_Spd_H BrkCalVariantCriterion
  /begin VAR_ADDRESS 0x80020774 0x80023B74 0x80026F74 0x8002A374 0x8002D774 0x80030B74 0x80033F74 0x80037374 /end VAR_ADDRESS
 /end VAR_CHARACTERISTIC
 /begin VAR_CHARACTERISTIC TP_S16_CBC_DELTA_PRESS_ALAT_H_Spd_M BrkCalVariantCriterion
  /begin VAR_ADDRESS 0x80020776 0x80023B76 0x80026F76 0x8002A376 0x8002D776 0x80030B76 0x80033F76 0x80037376 /end VAR_ADDRESS
 /end VAR_CHARACTERISTIC
 /begin VAR_CHARACTERISTIC TP_S16_CBC_DELTA_PRESS_ALAT_H_Spd_S BrkCalVariantCriterion
  /begin VAR_ADDRESS 0x80020778 0x80023B78 0x80026F78 0x8002A378 0x8002D778 0x80030B78 0x80033F78 0x80037378 /end VAR_ADDRESS
 /end VAR_CHARACTERISTIC
 /begin VAR_CHARACTERISTIC TP_S16_CBC_DELTA_PRESS_ALAT_LEVEL_H BrkCalVariantCriterion
  /begin VAR_ADDRESS 0x80020768 0x80023B68 0x80026F68 0x8002A368 0x8002D768 0x80030B68 0x80033F68 0x80037368 /end VAR_ADDRESS
 /end VAR_CHARACTERISTIC
 /begin VAR_CHARACTERISTIC TP_S16_CBC_DELTA_PRESS_ALAT_LEVEL_L BrkCalVariantCriterion
  /begin VAR_ADDRESS 0x80020766 0x80023B66 0x80026F66 0x8002A366 0x8002D766 0x80030B66 0x80033F66 0x80037366 /end VAR_ADDRESS
 /end VAR_CHARACTERISTIC
 /begin VAR_CHARACTERISTIC TP_S16_CBC_DELTA_PRESS_ALAT_LEVEL_M BrkCalVariantCriterion
  /begin VAR_ADDRESS 0x8002076A 0x80023B6A 0x80026F6A 0x8002A36A 0x8002D76A 0x80030B6A 0x80033F6A 0x8003736A /end VAR_ADDRESS
 /end VAR_CHARACTERISTIC
 /begin VAR_CHARACTERISTIC TP_S16_CBC_DELTA_PRESS_ALAT_M_Spd_H BrkCalVariantCriterion
  /begin VAR_ADDRESS 0x8002077A 0x80023B7A 0x80026F7A 0x8002A37A 0x8002D77A 0x80030B7A 0x80033F7A 0x8003737A /end VAR_ADDRESS
 /end VAR_CHARACTERISTIC
 /begin VAR_CHARACTERISTIC TP_S16_CBC_DELTA_PRESS_ALAT_M_Spd_M BrkCalVariantCriterion
  /begin VAR_ADDRESS 0x8002077C 0x80023B7C 0x80026F7C 0x8002A37C 0x8002D77C 0x80030B7C 0x80033F7C 0x8003737C /end VAR_ADDRESS
 /end VAR_CHARACTERISTIC
 /begin VAR_CHARACTERISTIC TP_S16_CBC_DELTA_PRESS_ALAT_M_Spd_S BrkCalVariantCriterion
  /begin VAR_ADDRESS 0x8002077E 0x80023B7E 0x80026F7E 0x8002A37E 0x8002D77E 0x80030B7E 0x80033F7E 0x8003737E /end VAR_ADDRESS
 /end VAR_CHARACTERISTIC
 /begin VAR_CHARACTERISTIC TP_S16_CBC_DELTA_PRESS_ALAT_S_Spd_H BrkCalVariantCriterion
  /begin VAR_ADDRESS 0x80020780 0x80023B80 0x80026F80 0x8002A380 0x8002D780 0x80030B80 0x80033F80 0x80037380 /end VAR_ADDRESS
 /end VAR_CHARACTERISTIC
 /begin VAR_CHARACTERISTIC TP_S16_CBC_DELTA_PRESS_ALAT_S_Spd_M BrkCalVariantCriterion
  /begin VAR_ADDRESS 0x80020782 0x80023B82 0x80026F82 0x8002A382 0x8002D782 0x80030B82 0x80033F82 0x80037382 /end VAR_ADDRESS
 /end VAR_CHARACTERISTIC
 /begin VAR_CHARACTERISTIC TP_S16_CBC_DELTA_PRESS_ALAT_S_Spd_S BrkCalVariantCriterion
  /begin VAR_ADDRESS 0x80020784 0x80023B84 0x80026F84 0x8002A384 0x8002D784 0x80030B84 0x80033F84 0x80037384 /end VAR_ADDRESS
 /end VAR_CHARACTERISTIC
 /begin VAR_CHARACTERISTIC TP_S16_CBC_DELTA_PRES_MAX_DUMP BrkCalVariantCriterion
  /begin VAR_ADDRESS 0x80020786 0x80023B86 0x80026F86 0x8002A386 0x8002D786 0x80030B86 0x80033F86 0x80037386 /end VAR_ADDRESS
 /end VAR_CHARACTERISTIC
 /begin VAR_CHARACTERISTIC TP_S16_CBC_DELTA_PRES_MAX_DUMP_ABS BrkCalVariantCriterion
  /begin VAR_ADDRESS 0x800206FC 0x80023AFC 0x80026EFC 0x8002A2FC 0x8002D6FC 0x80030AFC 0x80033EFC 0x800372FC /end VAR_ADDRESS
 /end VAR_CHARACTERISTIC
 /begin VAR_CHARACTERISTIC TP_S16_CBC_DELTA_PRES_MAX_RISE BrkCalVariantCriterion
  /begin VAR_ADDRESS 0x80020788 0x80023B88 0x80026F88 0x8002A388 0x8002D788 0x80030B88 0x80033F88 0x80037388 /end VAR_ADDRESS
 /end VAR_CHARACTERISTIC
 /begin VAR_CHARACTERISTIC TP_S16_CBC_DELTA_PRES_MAX_RISE_ABS BrkCalVariantCriterion
  /begin VAR_ADDRESS 0x800206FE 0x80023AFE 0x80026EFE 0x8002A2FE 0x8002D6FE 0x80030AFE 0x80033EFE 0x800372FE /end VAR_ADDRESS
 /end VAR_CHARACTERISTIC
 /begin VAR_CHARACTERISTIC TP_S16_CBC_FADE_OUT_HOLD_SCAN BrkCalVariantCriterion
  /begin VAR_ADDRESS 0x80020790 0x80023B90 0x80026F90 0x8002A390 0x8002D790 0x80030B90 0x80033F90 0x80037390 /end VAR_ADDRESS
 /end VAR_CHARACTERISTIC
 /begin VAR_CHARACTERISTIC TP_S16_CBC_FADE_OUT_HOLD_SCAN_ABS BrkCalVariantCriterion
  /begin VAR_ADDRESS 0x80020706 0x80023B06 0x80026F06 0x8002A306 0x8002D706 0x80030B06 0x80033F06 0x80037306 /end VAR_ADDRESS
 /end VAR_CHARACTERISTIC
 /begin VAR_CHARACTERISTIC TP_S16_CBC_FADE_OUT_TIME BrkCalVariantCriterion
  /begin VAR_ADDRESS 0x80020792 0x80023B92 0x80026F92 0x8002A392 0x8002D792 0x80030B92 0x80033F92 0x80037392 /end VAR_ADDRESS
 /end VAR_CHARACTERISTIC
 /begin VAR_CHARACTERISTIC TP_S16_CBC_FADE_OUT_TIME_ABS BrkCalVariantCriterion
  /begin VAR_ADDRESS 0x80020708 0x80023B08 0x80026F08 0x8002A308 0x8002D708 0x80030B08 0x80033F08 0x80037308 /end VAR_ADDRESS
 /end VAR_CHARACTERISTIC
 /begin VAR_CHARACTERISTIC TP_S16_CBC_FRONT_DEL_PRESS_H_SPD_H BrkCalVariantCriterion
  /begin VAR_ADDRESS 0x800207A6 0x80023BA6 0x80026FA6 0x8002A3A6 0x8002D7A6 0x80030BA6 0x80033FA6 0x800373A6 /end VAR_ADDRESS
 /end VAR_CHARACTERISTIC
 /begin VAR_CHARACTERISTIC TP_S16_CBC_FRONT_DEL_PRESS_H_SPD_M BrkCalVariantCriterion
  /begin VAR_ADDRESS 0x800207A8 0x80023BA8 0x80026FA8 0x8002A3A8 0x8002D7A8 0x80030BA8 0x80033FA8 0x800373A8 /end VAR_ADDRESS
 /end VAR_CHARACTERISTIC
 /begin VAR_CHARACTERISTIC TP_S16_CBC_FRONT_DEL_PRESS_H_SPD_S BrkCalVariantCriterion
  /begin VAR_ADDRESS 0x800207AA 0x80023BAA 0x80026FAA 0x8002A3AA 0x8002D7AA 0x80030BAA 0x80033FAA 0x800373AA /end VAR_ADDRESS
 /end VAR_CHARACTERISTIC
 /begin VAR_CHARACTERISTIC TP_S16_CBC_FRONT_DEL_PRESS_S_SPD_H BrkCalVariantCriterion
  /begin VAR_ADDRESS 0x800207AC 0x80023BAC 0x80026FAC 0x8002A3AC 0x8002D7AC 0x80030BAC 0x80033FAC 0x800373AC /end VAR_ADDRESS
 /end VAR_CHARACTERISTIC
 /begin VAR_CHARACTERISTIC TP_S16_CBC_FRONT_DEL_PRESS_S_SPD_M BrkCalVariantCriterion
  /begin VAR_ADDRESS 0x800207AE 0x80023BAE 0x80026FAE 0x8002A3AE 0x8002D7AE 0x80030BAE 0x80033FAE 0x800373AE /end VAR_ADDRESS
 /end VAR_CHARACTERISTIC
 /begin VAR_CHARACTERISTIC TP_S16_CBC_FRONT_DEL_PRESS_S_SPD_S BrkCalVariantCriterion
  /begin VAR_ADDRESS 0x800207B0 0x80023BB0 0x80026FB0 0x8002A3B0 0x8002D7B0 0x80030BB0 0x80033FB0 0x800373B0 /end VAR_ADDRESS
 /end VAR_CHARACTERISTIC
 /begin VAR_CHARACTERISTIC TP_S16_CBC_FRONT_ENTER_DV_SPD_H BrkCalVariantCriterion
  /begin VAR_ADDRESS 0x80020794 0x80023B94 0x80026F94 0x8002A394 0x8002D794 0x80030B94 0x80033F94 0x80037394 /end VAR_ADDRESS
 /end VAR_CHARACTERISTIC
 /begin VAR_CHARACTERISTIC TP_S16_CBC_FRONT_ENTER_DV_SPD_M BrkCalVariantCriterion
  /begin VAR_ADDRESS 0x80020796 0x80023B96 0x80026F96 0x8002A396 0x8002D796 0x80030B96 0x80033F96 0x80037396 /end VAR_ADDRESS
 /end VAR_CHARACTERISTIC
 /begin VAR_CHARACTERISTIC TP_S16_CBC_FRONT_ENTER_DV_SPD_S BrkCalVariantCriterion
  /begin VAR_ADDRESS 0x80020798 0x80023B98 0x80026F98 0x8002A398 0x8002D798 0x80030B98 0x80033F98 0x80037398 /end VAR_ADDRESS
 /end VAR_CHARACTERISTIC
 /begin VAR_CHARACTERISTIC TP_S16_CBC_FRONT_EXIT_DV_SPD_H BrkCalVariantCriterion
  /begin VAR_ADDRESS 0x8002079A 0x80023B9A 0x80026F9A 0x8002A39A 0x8002D79A 0x80030B9A 0x80033F9A 0x8003739A /end VAR_ADDRESS
 /end VAR_CHARACTERISTIC
 /begin VAR_CHARACTERISTIC TP_S16_CBC_FRONT_EXIT_DV_SPD_M BrkCalVariantCriterion
  /begin VAR_ADDRESS 0x8002079C 0x80023B9C 0x80026F9C 0x8002A39C 0x8002D79C 0x80030B9C 0x80033F9C 0x8003739C /end VAR_ADDRESS
 /end VAR_CHARACTERISTIC
 /begin VAR_CHARACTERISTIC TP_S16_CBC_FRONT_EXIT_DV_SPD_S BrkCalVariantCriterion
  /begin VAR_ADDRESS 0x8002079E 0x80023B9E 0x80026F9E 0x8002A39E 0x8002D79E 0x80030B9E 0x80033F9E 0x8003739E /end VAR_ADDRESS
 /end VAR_CHARACTERISTIC
 /begin VAR_CHARACTERISTIC TP_S16_CBC_FRONT_MEDIUM_DV_SPD_H BrkCalVariantCriterion
  /begin VAR_ADDRESS 0x800207A0 0x80023BA0 0x80026FA0 0x8002A3A0 0x8002D7A0 0x80030BA0 0x80033FA0 0x800373A0 /end VAR_ADDRESS
 /end VAR_CHARACTERISTIC
/end VARIANT_CODING
/end MODULE
/end PROJECT
