ASAP2_VERSION 1 60
/begin PROJECT Master ""
/begin MODULE CPP ""
/begin MOD_COMMON "" BYTE_ORDER MSB_LAST ALIGNMENT_BYTE 1 ALIGNMENT_WORD 1 ALIGNMENT_LONG 1 ALIGNMENT_FLOAT32_IEEE 1 ALIGNMENT_FLOAT64_IEEE 1 ALIGNMENT_INT64 1 /end MOD_COMMON
/begin CHARACTERISTIC S16_AEB_TEMP_01 "AEB temporary signed integer parameter 01" VALUE 0x80021060 CalPrmVehLgtCoorrBrk_SWORD 0 Fac31 -32768 32767 SYMBOL_LINK "CalPrmVehLgtCoorrBrk01.S16_AEB_TEMP_01" 0 /end CHARACTERISTIC
/begin CHARACTERISTIC S16_AEB_TEMP_02 "AEB temporary signed integer parameter 02" VALUE 0x80021062 CalPrmVehLgtCoorrBrk_SWORD 0 Fac31 -32768 32767 SYMBOL_LINK "CalPrmVehLgtCoorrBrk01.S16_AEB_TEMP_02" 0 /end CHARACTERISTIC
/begin CHARACTERISTIC S16_AEB_TEMP_03 "AEB temporary signed integer parameter 03" VALUE 0x80021064 CalPrmVehLgtCoorrBrk_SWORD 0 Fac31 -32768 32767 SYMBOL_LINK "CalPrmVehLgtCoorrBrk01.S16_AEB_TEMP_03" 0 /end CHARACTERISTIC
/begin CHARACTERISTIC S16_DPB_DEAD_ZONE_ERROR_HIGH "DPB To be defined" VALUE 0x8002107E CalPrmVehLgtCoorrBrk_SWORD 0 PGrdt11 -3276.8 3276.7 SYMBOL_LINK "CalPrmVehLgtCoorrBrk01.S16_DPB_DEAD_ZONE_ERROR_HIGH" 0 /end CHARACTERISTIC
/begin CHARACTERISTIC S16_DPB_DEAD_ZONE_ERROR_LOW "DPB To be defined" VALUE 0x80021080 CalPrmVehLgtCoorrBrk_SWORD 0 PGrdt11 -3276.8 3276.7 SYMBOL_LINK "CalPrmVehLgtCoorrBrk01.S16_DPB_DEAD_ZONE_ERROR_LOW" 0 /end CHARACTERISTIC
/begin CHARACTERISTIC S16_DPB_FF_TQ_GRD "DPB To be defined" VALUE 0x80021084 CalPrmVehLgtCoorrBrk_SWORD 0 Amp2 -32.768 32.767 SYMBOL_LINK "CalPrmVehLgtCoorrBrk01.S16_DPB_FF_TQ_GRD" 0 /end CHARACTERISTIC
/begin CHARACTERISTIC S16_DPB_FF_TQ_INIT_GRD "DPB To be defined" VALUE 0x80021082 CalPrmVehLgtCoorrBrk_SWORD 0 Amp2 -32.768 32.767 SYMBOL_LINK "CalPrmVehLgtCoorrBrk01.S16_DPB_FF_TQ_INIT_GRD" 0 /end CHARACTERISTIC
/begin CHARACTERISTIC S16_DPB_FINE_GAP_ERROR_HIGH "DPB To be defined" VALUE 0x8002107A CalPrmVehLgtCoorrBrk_SWORD 0 PGrdt11 -3276.8 3276.7 SYMBOL_LINK "CalPrmVehLgtCoorrBrk01.S16_DPB_FINE_GAP_ERROR_HIGH" 0 /end CHARACTERISTIC
/begin CHARACTERISTIC S16_DPB_FINE_GAP_ERROR_LOW "DPB To be defined" VALUE 0x8002107C CalPrmVehLgtCoorrBrk_SWORD 0 PGrdt11 -3276.8 3276.7 SYMBOL_LINK "CalPrmVehLgtCoorrBrk01.S16_DPB_FINE_GAP_ERROR_LOW" 0 /end CHARACTERISTIC
/begin CHARACTERISTIC S16_DPB_FORCED_HOLD_SPD "DPB pressure forced hold speed" VALUE 0x8003A92E CalPrmVehLgtCoorrEng_SWORD 0 Fac31 -32768 32767 SYMBOL_LINK "CalPrmVehLgtCoorrEng01.S16_DPB_FORCED_HOLD_SPD" 0 /end CHARACTERISTIC
/begin CHARACTERISTIC S16_DPB_TARGET_DECEL "DPB target deceleration" VALUE 0x8003A92C CalPrmVehLgtCoorrEng_SWORD 0 Fac31 -32768 32767 SYMBOL_LINK "CalPrmVehLgtCoorrEng01.S16_DPB_TARGET_DECEL" 0 /end CHARACTERISTIC
/begin CHARACTERISTIC S16_DPB_TQ_D_GRD_D_GAIN "DPB To be defined" VALUE 0x80021076 CalPrmVehLgtCoorrBrk_SWORD 0 PGrdt11 -3276.8 3276.7 SYMBOL_LINK "CalPrmVehLgtCoorrBrk01.S16_DPB_TQ_D_GRD_D_GAIN" 0 /end CHARACTERISTIC
/begin CHARACTERISTIC S16_DPB_TQ_D_GRD_I_GAIN "DPB To be defined" VALUE 0x80021078 CalPrmVehLgtCoorrBrk_SWORD 0 PGrdt11 -3276.8 3276.7 SYMBOL_LINK "CalPrmVehLgtCoorrBrk01.S16_DPB_TQ_D_GRD_I_GAIN" 0 /end CHARACTERISTIC
/begin CHARACTERISTIC S16_DPB_TQ_GRD_DUMP_TH "DPB To be defined" VALUE 0x8002108A CalPrmVehLgtCoorrBrk_SWORD 0 Amp2 -32.768 32.767 SYMBOL_LINK "CalPrmVehLgtCoorrBrk01.S16_DPB_TQ_GRD_DUMP_TH" 0 /end CHARACTERISTIC
/begin CHARACTERISTIC S16_DPB_TQ_P_GRD_P_GAIN "DPB To be defined" VALUE 0x80021074 CalPrmVehLgtCoorrBrk_SWORD 0 PGrdt11 -3276.8 3276.7 SYMBOL_LINK "CalPrmVehLgtCoorrBrk01.S16_DPB_TQ_P_GRD_P_GAIN" 0 /end CHARACTERISTIC
/begin CHARACTERISTIC SSM_EPB_lms16FS_Reserved1 "" VALUE 0x8003A886 CalPrmSsmBrk_UWORD 0 OnOff1 0 65535 SYMBOL_LINK "CalPrmSsmEng01.SSM_EPB_lms16FS_Reserved1" 0 /end CHARACTERISTIC
/begin CHARACTERISTIC SSM_EPB_lms16FS_Reserved2 "" VALUE 0x8003A888 CalPrmSsmBrk_UWORD 0 OnOff1 0 65535 SYMBOL_LINK "CalPrmSsmEng01.SSM_EPB_lms16FS_Reserved2" 0 /end CHARACTERISTIC
/begin CHARACTERISTIC SSM_EPB_lms16FS_Reserved3 "" VALUE 0x8003A88A CalPrmSsmBrk_UWORD 0 OnOff1 0 65535 SYMBOL_LINK "CalPrmSsmEng01.SSM_EPB_lms16FS_Reserved3" 0 /end CHARACTERISTIC
/begin CHARACTERISTIC SSM_EPB_lms16FS_Reserved4 "" VALUE 0x8003A88C CalPrmSsmBrk_UWORD 0 OnOff1 0 65535 SYMBOL_LINK "CalPrmSsmEng01.SSM_EPB_lms16FS_Reserved4" 0 /end CHARACTERISTIC
/begin CHARACTERISTIC SSM_EPB_lms16FS_Reserved5 "" VALUE 0x8003A88E CalPrmSsmBrk_UWORD 0 OnOff1 0 65535 SYMBOL_LINK "CalPrmSsmEng01.SSM_EPB_lms16FS_Reserved5" 0 /end CHARACTERISTIC
/begin CHARACTERISTIC SSM_EPB_lmu8FS_Reserved1 "" VALUE 0x8003A890 CalPrmSsmBrk_UBYTE 0 OnOff1 0 255 SYMBOL_LINK "CalPrmSsmEng01.SSM_EPB_lmu8FS_Reserved1" 0 /end CHARACTERISTIC
/begin CHARACTERISTIC SSM_EPB_lmu8FS_Reserved2 "" VALUE 0x8003A891 CalPrmSsmBrk_UBYTE 0 OnOff1 0 255 SYMBOL_LINK "CalPrmSsmEng01.SSM_EPB_lmu8FS_Reserved2" 0 /end CHARACTERISTIC
/begin CHARACTERISTIC SSM_EPB_lmu8FS_Reserved3 "" VALUE 0x8003A892 CalPrmSsmBrk_UBYTE 0 OnOff1 0 255 SYMBOL_LINK "CalPrmSsmEng01.SSM_EPB_lmu8FS_Reserved3" 0 /end CHARACTERISTIC
/begin CHARACTERISTIC SSM_EPB_lmu8FS_Reserved4 "" VALUE 0x8003A893 CalPrmSsmBrk_UBYTE 0 OnOff1 0 255 SYMBOL_LINK "CalPrmSsmEng01.SSM_EPB_lmu8FS_Reserved4" 0 /end CHARACTERISTIC
/begin CHARACTERISTIC SSM_EPB_lmu8FS_Reserved5 "" VALUE 0x8003A894 CalPrmSsmBrk_UBYTE 0 OnOff1 0 255 SYMBOL_LINK "CalPrmSsmEng01.SSM_EPB_lmu8FS_Reserved5" 0 /end CHARACTERISTIC
/begin CHARACTERISTIC SSM_K_EPB_Automatic_Apply_AVH_On_Act "" VALUE 0x8003A831 CalPrmSsmBrk_UBYTE 0 OnOff1 0 255 SYMBOL_LINK "CalPrmSsmEng01.SSM_K_EPB_Automatic_Apply_AVH_On_Act" 0 /end CHARACTERISTIC
/begin CHARACTERISTIC SSM_K_EPB_Automatic_Apply_Eng_Off_Act "" VALUE 0x8003A833 CalPrmSsmBrk_UBYTE 0 OnOff1 0 255 SYMBOL_LINK "CalPrmSsmEng01.SSM_K_EPB_Automatic_Apply_Eng_Off_Act" 0 /end CHARACTERISTIC
/begin CHARACTERISTIC SSM_K_EPB_Automatic_Apply_Ign_Feature_En "" VALUE 0x8003A834 CalPrmSsmBrk_UBYTE 0 OnOff1 0 255 SYMBOL_LINK "CalPrmSsmEng01.SSM_K_EPB_Automatic_Apply_Ign_Feature_En" 0 /end CHARACTERISTIC
/begin CHARACTERISTIC SSM_K_EPB_Automatic_Apply_Ign_Off_Act "" VALUE 0x8003A835 CalPrmSsmBrk_UBYTE 0 OnOff1 0 255 SYMBOL_LINK "CalPrmSsmEng01.SSM_K_EPB_Automatic_Apply_Ign_Off_Act" 0 /end CHARACTERISTIC
/begin CHARACTERISTIC SSM_K_EPB_Automatic_Apply_Key_Out_Act "" VALUE 0x8003A836 CalPrmSsmBrk_UBYTE 0 OnOff1 0 255 SYMBOL_LINK "CalPrmSsmEng01.SSM_K_EPB_Automatic_Apply_Key_Out_Act" 0 /end CHARACTERISTIC
/begin CHARACTERISTIC SSM_K_EPB_Engine_Run_rpm_Th_H "" VALUE 0x8003A7E8 CalPrmSsmBrk_UWORD 0 N10 0 65535 SYMBOL_LINK "CalPrmSsmEng01.SSM_K_EPB_Engine_Run_rpm_Th_H" 0 /end CHARACTERISTIC
/begin CHARACTERISTIC SSM_K_EPB_Engine_Run_rpm_Th_L "" VALUE 0x8003A7E6 CalPrmSsmBrk_UWORD 0 N10 0 65535 SYMBOL_LINK "CalPrmSsmEng01.SSM_K_EPB_Engine_Run_rpm_Th_L" 0 /end CHARACTERISTIC
/begin CHARACTERISTIC SSM_K_EPB_Release_Engine_RPM_Rate_Z1_Th "" VALUE 0x8003A816 CalPrmSsmBrk_UBYTE 0 A48 0 0.0255 SYMBOL_LINK "CalPrmSsmEng01.SSM_K_EPB_Release_Engine_RPM_Rate_Z1_Th" 0 /end CHARACTERISTIC
/begin CHARACTERISTIC SSM_K_EPB_Release_Engine_RPM_Rate_Z2_Th "" VALUE 0x8003A817 CalPrmSsmBrk_UBYTE 0 A48 0 0.0255 SYMBOL_LINK "CalPrmSsmEng01.SSM_K_EPB_Release_Engine_RPM_Rate_Z2_Th" 0 /end CHARACTERISTIC
/begin CHARACTERISTIC SSM_K_EPB_Release_Engine_RPM_Rate_Z3_Th "" VALUE 0x8003A818 CalPrmSsmBrk_UBYTE 0 A48 0 0.0255 SYMBOL_LINK "CalPrmSsmEng01.SSM_K_EPB_Release_Engine_RPM_Rate_Z3_Th" 0 /end CHARACTERISTIC
/begin CHARACTERISTIC SSM_K_EPB_Release_Engine_Rpm_Dot_LF_Gain "" VALUE 0x8003A815 CalPrmSsmBrk_UBYTE 0 N10 0 255 SYMBOL_LINK "CalPrmSsmEng01.SSM_K_EPB_Release_Engine_Rpm_Dot_LF_Gain" 0 /end CHARACTERISTIC
/begin CHARACTERISTIC SSM_K_EPB_Release_Engine_Torq_AT_Back "" VALUE 0x8003A819 CalPrmSsmBrk_UBYTE 0 Tq2 0 255 SYMBOL_LINK "CalPrmSsmEng01.SSM_K_EPB_Release_Engine_Torq_AT_Back" 0 /end CHARACTERISTIC
/begin CHARACTERISTIC SSM_K_EPB_Release_Engine_Torq_AT_Idle "" VALUE 0x8003A81A CalPrmSsmBrk_SWORD 0 Tq2 -32768 32767 SYMBOL_LINK "CalPrmSsmEng01.SSM_K_EPB_Release_Engine_Torq_AT_Idle" 0 /end CHARACTERISTIC
/begin CHARACTERISTIC SSM_K_EPB_Release_Engine_Torq_AT_Z1_Th "" VALUE 0x8003A81C CalPrmSsmBrk_UBYTE 0 Tq2 0 255 SYMBOL_LINK "CalPrmSsmEng01.SSM_K_EPB_Release_Engine_Torq_AT_Z1_Th" 0 /end CHARACTERISTIC
/begin CHARACTERISTIC SSM_K_EPB_Release_Engine_Torq_AT_Z2_Th "" VALUE 0x8003A81D CalPrmSsmBrk_UBYTE 0 Tq2 0 255 SYMBOL_LINK "CalPrmSsmEng01.SSM_K_EPB_Release_Engine_Torq_AT_Z2_Th" 0 /end CHARACTERISTIC
/begin CHARACTERISTIC SSM_K_EPB_Release_Engine_Torq_AT_Z3_Th "" VALUE 0x8003A81E CalPrmSsmBrk_UBYTE 0 Tq2 0 255 SYMBOL_LINK "CalPrmSsmEng01.SSM_K_EPB_Release_Engine_Torq_AT_Z3_Th" 0 /end CHARACTERISTIC
/begin CHARACTERISTIC SSM_K_EPB_Release_Engine_Torq_AT_ZU_Th "" VALUE 0x8003A81F CalPrmSsmBrk_UBYTE 0 Tq2 0 255 SYMBOL_LINK "CalPrmSsmEng01.SSM_K_EPB_Release_Engine_Torq_AT_ZU_Th" 0 /end CHARACTERISTIC
/begin CHARACTERISTIC SSM_K_EPB_Release_Engine_Torq_Delay_Z1_Th "" VALUE 0x8003A820 CalPrmSsmBrk_UBYTE 0 Tq2 0 255 SYMBOL_LINK "CalPrmSsmEng01.SSM_K_EPB_Release_Engine_Torq_Delay_Z1_Th" 0 /end CHARACTERISTIC
/begin CHARACTERISTIC SSM_K_EPB_Release_Engine_Torq_Delay_Z2_Th "" VALUE 0x8003A821 CalPrmSsmBrk_UBYTE 0 Tq2 0 255 SYMBOL_LINK "CalPrmSsmEng01.SSM_K_EPB_Release_Engine_Torq_Delay_Z2_Th" 0 /end CHARACTERISTIC
/begin CHARACTERISTIC SSM_K_EPB_Release_Engine_Torq_Delay_Z3_Th "" VALUE 0x8003A822 CalPrmSsmBrk_UBYTE 0 Tq2 0 255 SYMBOL_LINK "CalPrmSsmEng01.SSM_K_EPB_Release_Engine_Torq_Delay_Z3_Th" 0 /end CHARACTERISTIC
/begin CHARACTERISTIC SSM_K_EPB_Release_Engine_Torq_Dot_LF_Gain1 "" VALUE 0x8003A823 CalPrmSsmBrk_UBYTE 0 Tq2 0 255 SYMBOL_LINK "CalPrmSsmEng01.SSM_K_EPB_Release_Engine_Torq_Dot_LF_Gain1" 0 /end CHARACTERISTIC
/begin CHARACTERISTIC SSM_K_EPB_Release_Engine_Torq_Dot_LF_Gain2 "" VALUE 0x8003A824 CalPrmSsmBrk_UBYTE 0 Tq2 0 255 SYMBOL_LINK "CalPrmSsmEng01.SSM_K_EPB_Release_Engine_Torq_Dot_LF_Gain2" 0 /end CHARACTERISTIC
/begin CHARACTERISTIC SSM_K_EPB_Release_Engine_Torq_MT_Back "" VALUE 0x8003A825 CalPrmSsmBrk_UBYTE 0 Tq2 0 255 SYMBOL_LINK "CalPrmSsmEng01.SSM_K_EPB_Release_Engine_Torq_MT_Back" 0 /end CHARACTERISTIC
/begin CHARACTERISTIC SSM_K_EPB_Release_Engine_Torq_MT_Idle "" VALUE 0x8003A826 CalPrmSsmBrk_SWORD 0 Tq2 -32768 32767 SYMBOL_LINK "CalPrmSsmEng01.SSM_K_EPB_Release_Engine_Torq_MT_Idle" 0 /end CHARACTERISTIC
/begin CHARACTERISTIC SSM_K_EPB_Release_Engine_Torq_MT_Z1_Th "" VALUE 0x8003A828 CalPrmSsmBrk_UBYTE 0 Tq2 0 255 SYMBOL_LINK "CalPrmSsmEng01.SSM_K_EPB_Release_Engine_Torq_MT_Z1_Th" 0 /end CHARACTERISTIC
/begin CHARACTERISTIC SSM_K_EPB_Release_Engine_Torq_MT_Z2_Th "" VALUE 0x8003A829 CalPrmSsmBrk_UBYTE 0 Tq2 0 255 SYMBOL_LINK "CalPrmSsmEng01.SSM_K_EPB_Release_Engine_Torq_MT_Z2_Th" 0 /end CHARACTERISTIC
/begin CHARACTERISTIC SSM_K_EPB_Release_Engine_Torq_MT_Z3_Th "" VALUE 0x8003A82A CalPrmSsmBrk_UBYTE 0 Tq2 0 255 SYMBOL_LINK "CalPrmSsmEng01.SSM_K_EPB_Release_Engine_Torq_MT_Z3_Th" 0 /end CHARACTERISTIC
/begin CHARACTERISTIC SSM_K_EPB_Release_Engine_Torq_MT_ZU_Th "" VALUE 0x8003A82B CalPrmSsmBrk_UBYTE 0 Tq2 0 255 SYMBOL_LINK "CalPrmSsmEng01.SSM_K_EPB_Release_Engine_Torq_MT_ZU_Th" 0 /end CHARACTERISTIC
/begin CHARACTERISTIC SSM_K_EPB_Release_Engine_Torq_Rate_Z1_Th "" VALUE 0x8003A82C CalPrmSsmBrk_UBYTE 0 Tq2 0 255 SYMBOL_LINK "CalPrmSsmEng01.SSM_K_EPB_Release_Engine_Torq_Rate_Z1_Th" 0 /end CHARACTERISTIC
/begin CHARACTERISTIC SSM_K_EPB_Release_Engine_Torq_Rate_Z2_Th "" VALUE 0x8003A82D CalPrmSsmBrk_UBYTE 0 Tq2 0 255 SYMBOL_LINK "CalPrmSsmEng01.SSM_K_EPB_Release_Engine_Torq_Rate_Z2_Th" 0 /end CHARACTERISTIC
/begin CHARACTERISTIC SSM_K_EPB_Release_Engine_Torq_Rate_Z3_Th "" VALUE 0x8003A82E CalPrmSsmBrk_UBYTE 0 Tq2 0 255 SYMBOL_LINK "CalPrmSsmEng01.SSM_K_EPB_Release_Engine_Torq_Rate_Z3_Th" 0 /end CHARACTERISTIC
/begin CHARACTERISTIC SSM_K_EPB_Release_Throttle_Per_AT_Back "" VALUE 0x8003A7EC CalPrmSsmBrk_UBYTE 0 Perc2 0 127.5 SYMBOL_LINK "CalPrmSsmEng01.SSM_K_EPB_Release_Throttle_Per_AT_Back" 0 /end CHARACTERISTIC
/begin CHARACTERISTIC SSM_K_EPB_Release_Throttle_Per_AT_Th_L "" VALUE 0x8003A7ED CalPrmSsmBrk_UBYTE 0 Perc2 0 127.5 SYMBOL_LINK "CalPrmSsmEng01.SSM_K_EPB_Release_Throttle_Per_AT_Th_L" 0 /end CHARACTERISTIC
/begin CHARACTERISTIC SSM_K_EPB_Release_Throttle_Per_AT_Z1_Th_H "" VALUE 0x8003A7EE CalPrmSsmBrk_UBYTE 0 Perc2 0 127.5 SYMBOL_LINK "CalPrmSsmEng01.SSM_K_EPB_Release_Throttle_Per_AT_Z1_Th_H" 0 /end CHARACTERISTIC
/begin CHARACTERISTIC SSM_K_EPB_Release_Throttle_Per_AT_Z2_Th_H "" VALUE 0x8003A7EF CalPrmSsmBrk_UBYTE 0 Perc2 0 127.5 SYMBOL_LINK "CalPrmSsmEng01.SSM_K_EPB_Release_Throttle_Per_AT_Z2_Th_H" 0 /end CHARACTERISTIC
/begin CHARACTERISTIC SSM_K_EPB_Release_Throttle_Per_AT_Z3_Th_H "" VALUE 0x8003A7F0 CalPrmSsmBrk_UBYTE 0 Perc2 0 127.5 SYMBOL_LINK "CalPrmSsmEng01.SSM_K_EPB_Release_Throttle_Per_AT_Z3_Th_H" 0 /end CHARACTERISTIC
/begin CHARACTERISTIC SSM_K_EPB_Release_Throttle_Per_AT_ZU_Th "" VALUE 0x8003A7F1 CalPrmSsmBrk_UBYTE 0 Perc2 0 127.5 SYMBOL_LINK "CalPrmSsmEng01.SSM_K_EPB_Release_Throttle_Per_AT_ZU_Th" 0 /end CHARACTERISTIC
/begin CHARACTERISTIC SSM_K_EPB_Release_Throttle_Per_MT_Back "" VALUE 0x8003A7F2 CalPrmSsmBrk_UBYTE 0 Perc2 0 127.5 SYMBOL_LINK "CalPrmSsmEng01.SSM_K_EPB_Release_Throttle_Per_MT_Back" 0 /end CHARACTERISTIC
/begin CHARACTERISTIC SSM_K_EPB_Release_Throttle_Per_MT_Th_L "" VALUE 0x8003A7F3 CalPrmSsmBrk_UBYTE 0 Perc2 0 127.5 SYMBOL_LINK "CalPrmSsmEng01.SSM_K_EPB_Release_Throttle_Per_MT_Th_L" 0 /end CHARACTERISTIC
/begin CHARACTERISTIC SSM_K_EPB_Release_Throttle_Per_MT_Z1_Th_H "" VALUE 0x8003A7F4 CalPrmSsmBrk_UBYTE 0 Perc2 0 127.5 SYMBOL_LINK "CalPrmSsmEng01.SSM_K_EPB_Release_Throttle_Per_MT_Z1_Th_H" 0 /end CHARACTERISTIC
/begin CHARACTERISTIC SSM_K_EPB_Release_Throttle_Per_MT_Z2_Th_H "" VALUE 0x8003A7F5 CalPrmSsmBrk_UBYTE 0 Perc2 0 127.5 SYMBOL_LINK "CalPrmSsmEng01.SSM_K_EPB_Release_Throttle_Per_MT_Z2_Th_H" 0 /end CHARACTERISTIC
/begin CHARACTERISTIC SSM_K_EPB_Release_Throttle_Per_MT_Z3_Th_H "" VALUE 0x8003A7F6 CalPrmSsmBrk_UBYTE 0 Perc2 0 127.5 SYMBOL_LINK "CalPrmSsmEng01.SSM_K_EPB_Release_Throttle_Per_MT_Z3_Th_H" 0 /end CHARACTERISTIC
/begin CHARACTERISTIC SSM_K_EPB_Release_Throttle_Per_MT_ZU_Th "" VALUE 0x8003A7F7 CalPrmSsmBrk_UBYTE 0 Perc2 0 127.5 SYMBOL_LINK "CalPrmSsmEng01.SSM_K_EPB_Release_Throttle_Per_MT_ZU_Th" 0 /end CHARACTERISTIC
/begin CHARACTERISTIC SSM_U8_EPB_TPS_Dect_Max_Speed_Threshold_H "" VALUE 0x8003A7F8 CalPrmSsmBrk_UBYTE 0 Spd12 0 31.875 SYMBOL_LINK "CalPrmSsmEng01.SSM_U8_EPB_TPS_Dect_Max_Speed_Threshold_H" 0 /end CHARACTERISTIC
/begin CHARACTERISTIC SSM_U8_EPB_TPS_Dect_Max_Speed_Threshold_L "" VALUE 0x8003A7F9 CalPrmSsmBrk_UBYTE 0 Spd12 0 31.875 SYMBOL_LINK "CalPrmSsmEng01.SSM_U8_EPB_TPS_Dect_Max_Speed_Threshold_L" 0 /end CHARACTERISTIC
/begin CHARACTERISTIC TP_K_Brake_temperature_Overheated_Threshold " " VALUE 0x8003A03C CalPrmEstmrEng_SWORD 0 Gain -32768 32767 SYMBOL_LINK "CalPrmEstmrEng01.TP_K_Brake_temperature_Overheated_Threshold" 0 /end CHARACTERISTIC
/begin CHARACTERISTIC TP_K_Brake_temperature_Overheated_Threshold_Low " " VALUE 0x8003A03E CalPrmEstmrEng_SWORD 0 Gain -32768 32767 SYMBOL_LINK "CalPrmEstmrEng01.TP_K_Brake_temperature_Overheated_Threshold_Low" 0 /end CHARACTERISTIC
/begin CHARACTERISTIC TP_S16BtcsVehicleMassFL "" VALUE 0x8003A16C CalPrmWspcEng_SWORD 0 M1 -32768 32767 SYMBOL_LINK "CalPrmWspcEng01.TP_S16BtcsVehicleMassFL" 0 /end CHARACTERISTIC
/begin CHARACTERISTIC TP_S16BtcsVehicleMassFR "" VALUE 0x8003A16E CalPrmWspcEng_SWORD 0 M1 -32768 32767 SYMBOL_LINK "CalPrmWspcEng01.TP_S16BtcsVehicleMassFR" 0 /end CHARACTERISTIC
/begin CHARACTERISTIC TP_S16BtcsVehicleMassRL "" VALUE 0x8003A170 CalPrmWspcEng_SWORD 0 M1 -32768 32767 SYMBOL_LINK "CalPrmWspcEng01.TP_S16BtcsVehicleMassRL" 0 /end CHARACTERISTIC
/begin CHARACTERISTIC TP_S16BtcsVehicleMassRR "" VALUE 0x8003A172 CalPrmWspcEng_SWORD 0 M1 -32768 32767 SYMBOL_LINK "CalPrmWspcEng01.TP_S16BtcsVehicleMassRR" 0 /end CHARACTERISTIC
/begin CHARACTERISTIC TP_S16ETCSCpAddCdrnTrq4BstMd "" VALUE 0x8003A388 CalPrmWspcEng_SWORD 0 Gain -32768 32767 SYMBOL_LINK "CalPrmWspcEng01.TP_S16ETCSCpAddCdrnTrq4BstMd" 0 /end CHARACTERISTIC
/begin CHARACTERISTIC TP_S16ETCSCpCdrnTrqAt1stDrop[0][0] "" VALUE 0x8003A394 CalPrmWspcEng_SWORD 0 Tq2 -32768 32767 SYMBOL_LINK "CalPrmWspcEng01.TP_S16ETCSCpCdrnTrqAt1stDrop[0][0]" 0 /end CHARACTERISTIC
/begin CHARACTERISTIC TP_S16ETCSCpCdrnTrqAt1stDrop[0][1] "" VALUE 0x8003A396 CalPrmWspcEng_SWORD 0 Tq2 -32768 32767 SYMBOL_LINK "CalPrmWspcEng01.TP_S16ETCSCpCdrnTrqAt1stDrop[0][1]" 0 /end CHARACTERISTIC
/begin CHARACTERISTIC TP_S16ETCSCpCdrnTrqAt1stDrop[0][2] "" VALUE 0x8003A398 CalPrmWspcEng_SWORD 0 Tq2 -32768 32767 SYMBOL_LINK "CalPrmWspcEng01.TP_S16ETCSCpCdrnTrqAt1stDrop[0][2]" 0 /end CHARACTERISTIC
/begin CHARACTERISTIC TP_S16ETCSCpCdrnTrqAt1stDrop[0][3] "" VALUE 0x8003A39A CalPrmWspcEng_SWORD 0 Tq2 -32768 32767 SYMBOL_LINK "CalPrmWspcEng01.TP_S16ETCSCpCdrnTrqAt1stDrop[0][3]" 0 /end CHARACTERISTIC
/begin CHARACTERISTIC TP_S16ETCSCpCdrnTrqAt1stDrop[0][4] "" VALUE 0x8003A39C CalPrmWspcEng_SWORD 0 Tq2 -32768 32767 SYMBOL_LINK "CalPrmWspcEng01.TP_S16ETCSCpCdrnTrqAt1stDrop[0][4]" 0 /end CHARACTERISTIC
/begin CHARACTERISTIC TP_S16ETCSCpCdrnTrqAt1stDrop[1][0] "" VALUE 0x8003A39E CalPrmWspcEng_SWORD 0 Tq2 -32768 32767 SYMBOL_LINK "CalPrmWspcEng01.TP_S16ETCSCpCdrnTrqAt1stDrop[1][0]" 0 /end CHARACTERISTIC
/begin CHARACTERISTIC TP_S16ETCSCpCdrnTrqAt1stDrop[1][1] "" VALUE 0x8003A3A0 CalPrmWspcEng_SWORD 0 Tq2 -32768 32767 SYMBOL_LINK "CalPrmWspcEng01.TP_S16ETCSCpCdrnTrqAt1stDrop[1][1]" 0 /end CHARACTERISTIC
/begin CHARACTERISTIC TP_S16ETCSCpCdrnTrqAt1stDrop[1][2] "" VALUE 0x8003A3A2 CalPrmWspcEng_SWORD 0 Tq2 -32768 32767 SYMBOL_LINK "CalPrmWspcEng01.TP_S16ETCSCpCdrnTrqAt1stDrop[1][2]" 0 /end CHARACTERISTIC
/begin CHARACTERISTIC TP_S16ETCSCpCdrnTrqAt1stDrop[1][3] "" VALUE 0x8003A3A4 CalPrmWspcEng_SWORD 0 Tq2 -32768 32767 SYMBOL_LINK "CalPrmWspcEng01.TP_S16ETCSCpCdrnTrqAt1stDrop[1][3]" 0 /end CHARACTERISTIC
/begin CHARACTERISTIC TP_S16ETCSCpCdrnTrqAt1stDrop[1][4] "" VALUE 0x8003A3A6 CalPrmWspcEng_SWORD 0 Tq2 -32768 32767 SYMBOL_LINK "CalPrmWspcEng01.TP_S16ETCSCpCdrnTrqAt1stDrop[1][4]" 0 /end CHARACTERISTIC
/begin CHARACTERISTIC TP_S16ETCSCpCdrnTrqAt1stDrop[2][0] "" VALUE 0x8003A3A8 CalPrmWspcEng_SWORD 0 Tq2 -32768 32767 SYMBOL_LINK "CalPrmWspcEng01.TP_S16ETCSCpCdrnTrqAt1stDrop[2][0]" 0 /end CHARACTERISTIC
/begin CHARACTERISTIC TP_S16ETCSCpCdrnTrqAt1stDrop[2][1] "" VALUE 0x8003A3AA CalPrmWspcEng_SWORD 0 Tq2 -32768 32767 SYMBOL_LINK "CalPrmWspcEng01.TP_S16ETCSCpCdrnTrqAt1stDrop[2][1]" 0 /end CHARACTERISTIC
/begin CHARACTERISTIC TP_S16ETCSCpCdrnTrqAt1stDrop[2][2] "" VALUE 0x8003A3AC CalPrmWspcEng_SWORD 0 Tq2 -32768 32767 SYMBOL_LINK "CalPrmWspcEng01.TP_S16ETCSCpCdrnTrqAt1stDrop[2][2]" 0 /end CHARACTERISTIC
/begin CHARACTERISTIC TP_S16ETCSCpCdrnTrqAt1stDrop[2][3] "" VALUE 0x8003A3AE CalPrmWspcEng_SWORD 0 Tq2 -32768 32767 SYMBOL_LINK "CalPrmWspcEng01.TP_S16ETCSCpCdrnTrqAt1stDrop[2][3]" 0 /end CHARACTERISTIC
/begin CHARACTERISTIC TP_S16ETCSCpCdrnTrqAt1stDrop[2][4] "" VALUE 0x8003A3B0 CalPrmWspcEng_SWORD 0 Tq2 -32768 32767 SYMBOL_LINK "CalPrmWspcEng01.TP_S16ETCSCpCdrnTrqAt1stDrop[2][4]" 0 /end CHARACTERISTIC
/begin CHARACTERISTIC TP_S16ETCSCpCdrnTrqAt[0] "" VALUE 0x8003A38E CalPrmWspcEng_SWORD 0 Tq2 -32768 32767 SYMBOL_LINK "CalPrmWspcEng01.TP_S16ETCSCpCdrnTrqAt[0]" 0 /end CHARACTERISTIC
/begin CHARACTERISTIC TP_S16ETCSCpCdrnTrqAt[1] "" VALUE 0x8003A390 CalPrmWspcEng_SWORD 0 Tq2 -32768 32767 SYMBOL_LINK "CalPrmWspcEng01.TP_S16ETCSCpCdrnTrqAt[1]" 0 /end CHARACTERISTIC
/begin CHARACTERISTIC TP_S16ETCSCpCdrnTrqAt[2] "" VALUE 0x8003A392 CalPrmWspcEng_SWORD 0 Tq2 -32768 32767 SYMBOL_LINK "CalPrmWspcEng01.TP_S16ETCSCpCdrnTrqAt[2]" 0 /end CHARACTERISTIC
/begin CHARACTERISTIC TP_S16ETCSCpDctRdMemTqCntThr "" VALUE 0x8003A3C6 CalPrmWspcEng_SWORD 0 Gain -32768 32767 SYMBOL_LINK "CalPrmWspcEng01.TP_S16ETCSCpDctRdMemTqCntThr" 0 /end CHARACTERISTIC
/begin CHARACTERISTIC TP_S16ETCSCpDecCdrnTrqALmtCrng "" VALUE 0x8003A3C8 CalPrmWspcEng_SWORD 0 Tq2 -32768 32767 SYMBOL_LINK "CalPrmWspcEng01.TP_S16ETCSCpDecCdrnTrqALmtCrng" 0 /end CHARACTERISTIC
/begin CHARACTERISTIC TP_S16ETCSCpEngTrq[0] "" VALUE 0x8003A3D6 CalPrmWspcEng_SWORD 0 Tq51 -3276.8 3276.7 SYMBOL_LINK "CalPrmWspcEng01.TP_S16ETCSCpEngTrq[0]" 0 /end CHARACTERISTIC
/begin CHARACTERISTIC TP_S16ETCSCpEngTrq[1] "" VALUE 0x8003A3D8 CalPrmWspcEng_SWORD 0 Tq51 -3276.8 3276.7 SYMBOL_LINK "CalPrmWspcEng01.TP_S16ETCSCpEngTrq[1]" 0 /end CHARACTERISTIC
/begin CHARACTERISTIC TP_S16ETCSCpEngTrq[2] "" VALUE 0x8003A3DA CalPrmWspcEng_SWORD 0 Tq51 -3276.8 3276.7 SYMBOL_LINK "CalPrmWspcEng01.TP_S16ETCSCpEngTrq[2]" 0 /end CHARACTERISTIC
/begin CHARACTERISTIC TP_S16ETCSCpHighRiskStallRpmFlat "" VALUE 0x8003A3E0 CalPrmWspcEng_SWORD 0 N10 -32768 32767 SYMBOL_LINK "CalPrmWspcEng01.TP_S16ETCSCpHighRiskStallRpmFlat" 0 /end CHARACTERISTIC
/begin CHARACTERISTIC TP_S16ETCSCpHighRiskStallRpmHill "" VALUE 0x8003A3E2 CalPrmWspcEng_SWORD 0 N10 -32768 32767 SYMBOL_LINK "CalPrmWspcEng01.TP_S16ETCSCpHighRiskStallRpmHill" 0 /end CHARACTERISTIC
/begin CHARACTERISTIC TP_S16ETCSCpIGainFacLmtStr[0] "" VALUE 0x8003A3E4 CalPrmWspcEng_SWORD 0 Gain -32768 32767 SYMBOL_LINK "CalPrmWspcEng01.TP_S16ETCSCpIGainFacLmtStr[0]" 0 /end CHARACTERISTIC
/begin CHARACTERISTIC TP_S16ETCSCpIGainFacLmtStr[1] "" VALUE 0x8003A3E6 CalPrmWspcEng_SWORD 0 Gain -32768 32767 SYMBOL_LINK "CalPrmWspcEng01.TP_S16ETCSCpIGainFacLmtStr[1]" 0 /end CHARACTERISTIC
/begin CHARACTERISTIC TP_S16ETCSCpIGainFacLmtStr[2] "" VALUE 0x8003A3E8 CalPrmWspcEng_SWORD 0 Gain -32768 32767 SYMBOL_LINK "CalPrmWspcEng01.TP_S16ETCSCpIGainFacLmtStr[2]" 0 /end CHARACTERISTIC
/begin CHARACTERISTIC TP_S16ETCSCpIGainIncFacH2L "" VALUE 0x8003A3EA CalPrmWspcEng_SWORD 0 Perc6 -32768 32767 SYMBOL_LINK "CalPrmWspcEng01.TP_S16ETCSCpIGainIncFacH2L" 0 /end CHARACTERISTIC
/begin CHARACTERISTIC TP_S16ETCSCpLatbyDrivCrng "" VALUE 0x8003A3EC CalPrmWspcEng_SWORD 0 Gain -32768 32767 SYMBOL_LINK "CalPrmWspcEng01.TP_S16ETCSCpLatbyDrivCrng" 0 /end CHARACTERISTIC
/begin CHARACTERISTIC TP_S16ETCSCpLow2HighDecel "" VALUE 0x8003A400 CalPrmWspcEng_SWORD 0 A42 -327.68 327.67 SYMBOL_LINK "CalPrmWspcEng01.TP_S16ETCSCpLow2HighDecel" 0 /end CHARACTERISTIC
/begin CHARACTERISTIC TP_S16ETCSCpLowRiskStallRpmFlat "" VALUE 0x8003A402 CalPrmWspcEng_SWORD 0 N10 -32768 32767 SYMBOL_LINK "CalPrmWspcEng01.TP_S16ETCSCpLowRiskStallRpmFlat" 0 /end CHARACTERISTIC
/begin CHARACTERISTIC TP_S16ETCSCpLowRiskStallRpmHill "" VALUE 0x8003A404 CalPrmWspcEng_SWORD 0 N10 -32768 32767 SYMBOL_LINK "CalPrmWspcEng01.TP_S16ETCSCpLowRiskStallRpmHill" 0 /end CHARACTERISTIC
/begin CHARACTERISTIC TP_S16ETCSCpLwToSpltDctCplCnt "" VALUE 0x8003A406 CalPrmWspcEng_SWORD 0 Ti51 -655.36 655.34 SYMBOL_LINK "CalPrmWspcEng01.TP_S16ETCSCpLwToSpltDctCplCnt" 0 /end CHARACTERISTIC
/begin CHARACTERISTIC TP_S16ETCSCpLwToSpltDctStrtCnt "" VALUE 0x8003A408 CalPrmWspcEng_SWORD 0 Ti51 -655.36 655.34 SYMBOL_LINK "CalPrmWspcEng01.TP_S16ETCSCpLwToSpltDctStrtCnt" 0 /end CHARACTERISTIC
/begin CHARACTERISTIC TP_S16ETCSCpMidRiskStallRpmFlat "" VALUE 0x8003A40C CalPrmWspcEng_SWORD 0 N10 -32768 32767 SYMBOL_LINK "CalPrmWspcEng01.TP_S16ETCSCpMidRiskStallRpmFlat" 0 /end CHARACTERISTIC
/begin CHARACTERISTIC TP_S16ETCSCpMidRiskStallRpmHill "" VALUE 0x8003A40E CalPrmWspcEng_SWORD 0 N10 -32768 32767 SYMBOL_LINK "CalPrmWspcEng01.TP_S16ETCSCpMidRiskStallRpmHill" 0 /end CHARACTERISTIC
/begin CHARACTERISTIC TP_S16ETCSCpMinEngCdrnTrqAtDepSnw "" VALUE 0x8003A412 CalPrmWspcEng_SWORD 0 Gain -32768 32767 SYMBOL_LINK "CalPrmWspcEng01.TP_S16ETCSCpMinEngCdrnTrqAtDepSnw" 0 /end CHARACTERISTIC
/begin CHARACTERISTIC TP_S16ETCSCpOffsetTrq4LwToSplt "" VALUE 0x8003A414 CalPrmWspcEng_SWORD 0 Tq51 -3276.8 3276.7 SYMBOL_LINK "CalPrmWspcEng01.TP_S16ETCSCpOffsetTrq4LwToSplt" 0 /end CHARACTERISTIC
/begin CHARACTERISTIC TP_S16ETCSCpPreHighRdDctCplCnt "" VALUE 0x8003A416 CalPrmWspcEng_SWORD 0 Ti51 -655.36 655.34 SYMBOL_LINK "CalPrmWspcEng01.TP_S16ETCSCpPreHighRdDctCplCnt" 0 /end CHARACTERISTIC
/begin CHARACTERISTIC TP_S16ETCSCpPreHighRdDctStrtCnt "" VALUE 0x8003A418 CalPrmWspcEng_SWORD 0 Ti51 -655.36 655.34 SYMBOL_LINK "CalPrmWspcEng01.TP_S16ETCSCpPreHighRdDctStrtCnt" 0 /end CHARACTERISTIC
/begin CHARACTERISTIC TP_S16ETCSCpReqVcaDctCnt "" VALUE 0x8003A41A CalPrmWspcEng_SWORD 0 Ti51 -655.36 655.34 SYMBOL_LINK "CalPrmWspcEng01.TP_S16ETCSCpReqVcaDctCnt" 0 /end CHARACTERISTIC
/begin CHARACTERISTIC TP_S16ETCSCpSplitHillClrEngSpd "" VALUE 0x8003A42C CalPrmWspcEng_SWORD 0 N10 -32768 32767 SYMBOL_LINK "CalPrmWspcEng01.TP_S16ETCSCpSplitHillClrEngSpd" 0 /end CHARACTERISTIC
/begin CHARACTERISTIC TP_S16ETCSCpSplitHillDctEngSpd "" VALUE 0x8003A42E CalPrmWspcEng_SWORD 0 N10 -32768 32767 SYMBOL_LINK "CalPrmWspcEng01.TP_S16ETCSCpSplitHillDctEngSpd" 0 /end CHARACTERISTIC
/begin CHARACTERISTIC TP_S16ETCSCpStrtCdrnTrqAtAsphalt "" VALUE 0x8003A448 CalPrmWspcEng_SWORD 0 Tq2 -32768 32767 SYMBOL_LINK "CalPrmWspcEng01.TP_S16ETCSCpStrtCdrnTrqAtAsphalt" 0 /end CHARACTERISTIC
/begin CHARACTERISTIC TP_S16ETCSCpTrqOffset4InhHldVib "" VALUE 0x8003A458 CalPrmWspcEng_SWORD 0 Tq2 -32768 32767 SYMBOL_LINK "CalPrmWspcEng01.TP_S16ETCSCpTrqOffset4InhHldVib" 0 /end CHARACTERISTIC
/begin CHARACTERISTIC TP_S16ETCSCpVcaTrqDrp[0][0] "" VALUE 0x8003A45C CalPrmWspcEng_SWORD 0 Tq2 -32768 32767 SYMBOL_LINK "CalPrmWspcEng01.TP_S16ETCSCpVcaTrqDrp[0][0]" 0 /end CHARACTERISTIC
/begin CHARACTERISTIC TP_S16ETCSCpVcaTrqDrp[0][1] "" VALUE 0x8003A45E CalPrmWspcEng_SWORD 0 Tq2 -32768 32767 SYMBOL_LINK "CalPrmWspcEng01.TP_S16ETCSCpVcaTrqDrp[0][1]" 0 /end CHARACTERISTIC
/begin CHARACTERISTIC TP_S16ETCSCpVcaTrqDrp[0][2] "" VALUE 0x8003A460 CalPrmWspcEng_SWORD 0 Tq2 -32768 32767 SYMBOL_LINK "CalPrmWspcEng01.TP_S16ETCSCpVcaTrqDrp[0][2]" 0 /end CHARACTERISTIC
/begin CHARACTERISTIC TP_S16ETCSCpVcaTrqDrp[1][0] "" VALUE 0x8003A462 CalPrmWspcEng_SWORD 0 Tq2 -32768 32767 SYMBOL_LINK "CalPrmWspcEng01.TP_S16ETCSCpVcaTrqDrp[1][0]" 0 /end CHARACTERISTIC
/begin CHARACTERISTIC TP_S16ETCSCpVcaTrqDrp[1][1] "" VALUE 0x8003A464 CalPrmWspcEng_SWORD 0 Tq2 -32768 32767 SYMBOL_LINK "CalPrmWspcEng01.TP_S16ETCSCpVcaTrqDrp[1][1]" 0 /end CHARACTERISTIC
/begin CHARACTERISTIC TP_S16ETCSCpVcaTrqDrp[1][2] "" VALUE 0x8003A466 CalPrmWspcEng_SWORD 0 Tq2 -32768 32767 SYMBOL_LINK "CalPrmWspcEng01.TP_S16ETCSCpVcaTrqDrp[1][2]" 0 /end CHARACTERISTIC
/begin CHARACTERISTIC TP_S16ETCSCpVcaTrqDrp[2][0] "" VALUE 0x8003A468 CalPrmWspcEng_SWORD 0 Tq2 -32768 32767 SYMBOL_LINK "CalPrmWspcEng01.TP_S16ETCSCpVcaTrqDrp[2][0]" 0 /end CHARACTERISTIC
/begin CHARACTERISTIC TP_S16ETCSCpVcaTrqDrp[2][1] "" VALUE 0x8003A46A CalPrmWspcEng_SWORD 0 Tq2 -32768 32767 SYMBOL_LINK "CalPrmWspcEng01.TP_S16ETCSCpVcaTrqDrp[2][1]" 0 /end CHARACTERISTIC
/begin CHARACTERISTIC TP_S16ETCSCpVcaTrqDrp[2][2] "" VALUE 0x8003A46C CalPrmWspcEng_SWORD 0 Tq2 -32768 32767 SYMBOL_LINK "CalPrmWspcEng01.TP_S16ETCSCpVcaTrqDrp[2][2]" 0 /end CHARACTERISTIC
/begin CHARACTERISTIC TP_S16TCSCpADDBTCEntTh4ComPMod "" VALUE 0x8003A176 CalPrmWspcEng_SWORD 0 Spd12 -4096 4095.875 SYMBOL_LINK "CalPrmWspcEng01.TP_S16TCSCpADDBTCEntTh4ComPMod" 0 /end CHARACTERISTIC
/begin CHARACTERISTIC TP_S16TCSCpADDBTCTarSP4ComPMod "" VALUE 0x8003A178 CalPrmWspcEng_SWORD 0 Spd12 -4096 4095.875 SYMBOL_LINK "CalPrmWspcEng01.TP_S16TCSCpADDBTCTarSP4ComPMod" 0 /end CHARACTERISTIC
/begin CHARACTERISTIC TP_S16TCSCpBrkPGrdtLimHillDecFr "" VALUE 0x8003A18A CalPrmWspcEng_SWORD 0 PGrdt15 -3276.8 3276.7 SYMBOL_LINK "CalPrmWspcEng01.TP_S16TCSCpBrkPGrdtLimHillDecFr" 0 /end CHARACTERISTIC
/begin CHARACTERISTIC TP_S16TCSCpBrkPGrdtLimHillDecRe "" VALUE 0x8003A18C CalPrmWspcEng_SWORD 0 PGrdt15 -3276.8 3276.7 SYMBOL_LINK "CalPrmWspcEng01.TP_S16TCSCpBrkPGrdtLimHillDecRe" 0 /end CHARACTERISTIC
/begin CHARACTERISTIC TP_S16TCSCpBrkPGrdtLimHillIncFr "" VALUE 0x8003A18E CalPrmWspcEng_SWORD 0 PGrdt15 -3276.8 3276.7 SYMBOL_LINK "CalPrmWspcEng01.TP_S16TCSCpBrkPGrdtLimHillIncFr" 0 /end CHARACTERISTIC
/begin CHARACTERISTIC TP_S16TCSCpBrkPGrdtLimHillIncIniFr "" VALUE 0x8003A190 CalPrmWspcEng_SWORD 0 PGrdt15 -3276.8 3276.7 SYMBOL_LINK "CalPrmWspcEng01.TP_S16TCSCpBrkPGrdtLimHillIncIniFr" 0 /end CHARACTERISTIC
/begin CHARACTERISTIC TP_S16TCSCpBrkPGrdtLimHillIncIniRe "" VALUE 0x8003A192 CalPrmWspcEng_SWORD 0 PGrdt15 -3276.8 3276.7 SYMBOL_LINK "CalPrmWspcEng01.TP_S16TCSCpBrkPGrdtLimHillIncIniRe" 0 /end CHARACTERISTIC
/begin CHARACTERISTIC TP_S16TCSCpBrkPGrdtLimHillIncRe "" VALUE 0x8003A194 CalPrmWspcEng_SWORD 0 PGrdt15 -3276.8 3276.7 SYMBOL_LINK "CalPrmWspcEng01.TP_S16TCSCpBrkPGrdtLimHillIncRe" 0 /end CHARACTERISTIC
/begin CHARACTERISTIC TP_S16TCSCpDctTurnIndexBaseAyTh "" VALUE 0x8003A1BC CalPrmWspcEng_SWORD 0 Gain -32768 32767 SYMBOL_LINK "CalPrmWspcEng01.TP_S16TCSCpDctTurnIndexBaseAyTh" 0 /end CHARACTERISTIC
/begin CHARACTERISTIC TP_S16TCSCpDctTurnIndexEnterAyTh[0] "" VALUE 0x8003A1BE CalPrmWspcEng_SWORD 0 Gain -32768 32767 SYMBOL_LINK "CalPrmWspcEng01.TP_S16TCSCpDctTurnIndexEnterAyTh[0]" 0 /end CHARACTERISTIC
/begin CHARACTERISTIC TP_S16TCSCpDctTurnIndexEnterAyTh[1] "" VALUE 0x8003A1C0 CalPrmWspcEng_SWORD 0 Gain -32768 32767 SYMBOL_LINK "CalPrmWspcEng01.TP_S16TCSCpDctTurnIndexEnterAyTh[1]" 0 /end CHARACTERISTIC
/begin CHARACTERISTIC TP_S16TCSCpDctTurnIndexEnterAyTh[2] "" VALUE 0x8003A1C2 CalPrmWspcEng_SWORD 0 Gain -32768 32767 SYMBOL_LINK "CalPrmWspcEng01.TP_S16TCSCpDctTurnIndexEnterAyTh[2]" 0 /end CHARACTERISTIC
/begin CHARACTERISTIC TP_S16TCSCpDctTurnIndexEnterAyTh[3] "" VALUE 0x8003A1C4 CalPrmWspcEng_SWORD 0 Gain -32768 32767 SYMBOL_LINK "CalPrmWspcEng01.TP_S16TCSCpDctTurnIndexEnterAyTh[3]" 0 /end CHARACTERISTIC
/begin CHARACTERISTIC TP_S16TCSCpDctTurnIndexEnterAyTh[4] "" VALUE 0x8003A1C6 CalPrmWspcEng_SWORD 0 Gain -32768 32767 SYMBOL_LINK "CalPrmWspcEng01.TP_S16TCSCpDctTurnIndexEnterAyTh[4]" 0 /end CHARACTERISTIC
/begin CHARACTERISTIC TP_S16TCSCpDctTurnIndexFinalAyTh[0] "" VALUE 0x8003A1C8 CalPrmWspcEng_SWORD 0 Gain -32768 32767 SYMBOL_LINK "CalPrmWspcEng01.TP_S16TCSCpDctTurnIndexFinalAyTh[0]" 0 /end CHARACTERISTIC
/begin CHARACTERISTIC TP_S16TCSCpDctTurnIndexFinalAyTh[1] "" VALUE 0x8003A1CA CalPrmWspcEng_SWORD 0 Gain -32768 32767 SYMBOL_LINK "CalPrmWspcEng01.TP_S16TCSCpDctTurnIndexFinalAyTh[1]" 0 /end CHARACTERISTIC
/begin CHARACTERISTIC TP_S16TCSCpDctTurnIndexFinalAyTh[2] "" VALUE 0x8003A1CC CalPrmWspcEng_SWORD 0 Gain -32768 32767 SYMBOL_LINK "CalPrmWspcEng01.TP_S16TCSCpDctTurnIndexFinalAyTh[2]" 0 /end CHARACTERISTIC
/begin CHARACTERISTIC TP_S16TCSCpDctTurnIndexFinalAyTh[3] "" VALUE 0x8003A1CE CalPrmWspcEng_SWORD 0 Gain -32768 32767 SYMBOL_LINK "CalPrmWspcEng01.TP_S16TCSCpDctTurnIndexFinalAyTh[3]" 0 /end CHARACTERISTIC
/begin CHARACTERISTIC TP_S16TCSCpDctTurnIndexFinalAyTh[4] "" VALUE 0x8003A1D0 CalPrmWspcEng_SWORD 0 Gain -32768 32767 SYMBOL_LINK "CalPrmWspcEng01.TP_S16TCSCpDctTurnIndexFinalAyTh[4]" 0 /end CHARACTERISTIC
/begin CHARACTERISTIC TP_S16_AIR_CONDUCTIVITY " " VALUE 0x8003A040 CalPrmEstmrEng_SWORD 0 Gain -32768 32767 SYMBOL_LINK "CalPrmEstmrEng01.TP_S16_AIR_CONDUCTIVITY" 0 /end CHARACTERISTIC
/begin CHARACTERISTIC TP_S16_BRAKE_COOLING_COEFFIC_F " " VALUE 0x8003A042 CalPrmEstmrEng_SWORD 0 Gain -32768 32767 SYMBOL_LINK "CalPrmEstmrEng01.TP_S16_BRAKE_COOLING_COEFFIC_F" 0 /end CHARACTERISTIC
/begin CHARACTERISTIC TP_S16_BRAKE_COOLING_COEFFIC_R " " VALUE 0x8003A044 CalPrmEstmrEng_SWORD 0 Gain -32768 32767 SYMBOL_LINK "CalPrmEstmrEng01.TP_S16_BRAKE_COOLING_COEFFIC_R" 0 /end CHARACTERISTIC
/begin CHARACTERISTIC TP_S16_BRAKE_DISK_AREA_F " " VALUE 0x8003A046 CalPrmEstmrEng_SWORD 0 Gain -32768 32767 SYMBOL_LINK "CalPrmEstmrEng01.TP_S16_BRAKE_DISK_AREA_F" 0 /end CHARACTERISTIC
/begin CHARACTERISTIC TP_S16_BRAKE_DISK_AREA_R " " VALUE 0x8003A048 CalPrmEstmrEng_SWORD 0 Gain -32768 32767 SYMBOL_LINK "CalPrmEstmrEng01.TP_S16_BRAKE_DISK_AREA_R" 0 /end CHARACTERISTIC
/begin CHARACTERISTIC TP_S16_BRAKE_DISK_DIAMETER_F " " VALUE 0x8003A04A CalPrmEstmrEng_SWORD 0 Gain -32768 32767 SYMBOL_LINK "CalPrmEstmrEng01.TP_S16_BRAKE_DISK_DIAMETER_F" 0 /end CHARACTERISTIC
/begin CHARACTERISTIC TP_S16_BRAKE_DISK_DIAMETER_R " " VALUE 0x8003A04C CalPrmEstmrEng_SWORD 0 Gain -32768 32767 SYMBOL_LINK "CalPrmEstmrEng01.TP_S16_BRAKE_DISK_DIAMETER_R" 0 /end CHARACTERISTIC
/begin CHARACTERISTIC TP_S16_BRAKE_DISK_MASS_F " " VALUE 0x8003A04E CalPrmEstmrEng_SWORD 0 Gain -32768 32767 SYMBOL_LINK "CalPrmEstmrEng01.TP_S16_BRAKE_DISK_MASS_F" 0 /end CHARACTERISTIC
/begin CHARACTERISTIC TP_S16_BRAKE_DISK_MASS_R " " VALUE 0x8003A050 CalPrmEstmrEng_SWORD 0 Gain -32768 32767 SYMBOL_LINK "CalPrmEstmrEng01.TP_S16_BRAKE_DISK_MASS_R" 0 /end CHARACTERISTIC
/begin CHARACTERISTIC TP_S16_BRAKE_DISK_SPECIFIC_HEAT " " VALUE 0x8003A052 CalPrmEstmrEng_SWORD 0 Gain -32768 32767 SYMBOL_LINK "CalPrmEstmrEng01.TP_S16_BRAKE_DISK_SPECIFIC_HEAT" 0 /end CHARACTERISTIC
/begin CHARACTERISTIC TP_S16_BRAKE_PAD_AREA_F " " VALUE 0x8003A054 CalPrmEstmrEng_SWORD 0 Gain -32768 32767 SYMBOL_LINK "CalPrmEstmrEng01.TP_S16_BRAKE_PAD_AREA_F" 0 /end CHARACTERISTIC
/begin CHARACTERISTIC TP_S16_BRAKE_PAD_AREA_R " " VALUE 0x8003A056 CalPrmEstmrEng_SWORD 0 Gain -32768 32767 SYMBOL_LINK "CalPrmEstmrEng01.TP_S16_BRAKE_PAD_AREA_R" 0 /end CHARACTERISTIC
/begin CHARACTERISTIC TP_S16_BRAKE_PAD_FRICTION_F " " VALUE 0x8003A058 CalPrmEstmrEng_SWORD 0 Gain -32768 32767 SYMBOL_LINK "CalPrmEstmrEng01.TP_S16_BRAKE_PAD_FRICTION_F" 0 /end CHARACTERISTIC
/begin CHARACTERISTIC TP_S16_BRAKE_PAD_FRICTION_R " " VALUE 0x8003A05A CalPrmEstmrEng_SWORD 0 Gain -32768 32767 SYMBOL_LINK "CalPrmEstmrEng01.TP_S16_BRAKE_PAD_FRICTION_R" 0 /end CHARACTERISTIC
/begin CHARACTERISTIC TP_S16_BRAKE_THERM_EFFIC_F " " VALUE 0x8003A05C CalPrmEstmrEng_SWORD 0 Gain -32768 32767 SYMBOL_LINK "CalPrmEstmrEng01.TP_S16_BRAKE_THERM_EFFIC_F" 0 /end CHARACTERISTIC
/begin CHARACTERISTIC TP_S16_BRAKE_THERM_EFFIC_R " " VALUE 0x8003A05E CalPrmEstmrEng_SWORD 0 Gain -32768 32767 SYMBOL_LINK "CalPrmEstmrEng01.TP_S16_BRAKE_THERM_EFFIC_R" 0 /end CHARACTERISTIC
/begin CHARACTERISTIC TP_S16_EDC_INHIBIT_SPEED "" VALUE 0x8003A140 CalPrmWslcEng_SWORD 0 Spd12 -4096 4095.875 SYMBOL_LINK "CalPrmWslcEng01.TP_S16_EDC_INHIBIT_SPEED" 0 /end CHARACTERISTIC
/begin CHARACTERISTIC TP_S16_EDC_INHIBIT_SPEED_IN_EDC "" VALUE 0x8003A142 CalPrmWslcEng_SWORD 0 Spd12 -4096 4095.875 SYMBOL_LINK "CalPrmWslcEng01.TP_S16_EDC_INHIBIT_SPEED_IN_EDC" 0 /end CHARACTERISTIC
/begin CHARACTERISTIC TP_S16_STOP_STATE_CONV_COEFFIC_F " " VALUE 0x8003A060 CalPrmEstmrEng_SWORD 0 Gain -32768 32767 SYMBOL_LINK "CalPrmEstmrEng01.TP_S16_STOP_STATE_CONV_COEFFIC_F" 0 /end CHARACTERISTIC
/begin CHARACTERISTIC TP_S16_STOP_STATE_CONV_COEFFIC_R " " VALUE 0x8003A062 CalPrmEstmrEng_SWORD 0 Gain -32768 32767 SYMBOL_LINK "CalPrmEstmrEng01.TP_S16_STOP_STATE_CONV_COEFFIC_R" 0 /end CHARACTERISTIC
/begin CHARACTERISTIC TP_S16_TIRE_DIAMETER " " VALUE 0x8003A064 CalPrmEstmrEng_SWORD 0 Gain -32768 32767 SYMBOL_LINK "CalPrmEstmrEng01.TP_S16_TIRE_DIAMETER" 0 /end CHARACTERISTIC
/begin CHARACTERISTIC TP_S16_WHEEL_RADIUS " " VALUE 0x8003A066 CalPrmEstmrEng_SWORD 0 Gain -32768 32767 SYMBOL_LINK "CalPrmEstmrEng01.TP_S16_WHEEL_RADIUS" 0 /end CHARACTERISTIC
/begin CHARACTERISTIC TP_S8ETCSCpCtlExitCntDnTh "" VALUE 0x8003A46E CalPrmWspcEng_SBYTE 0 Tq51 -12.8 12.7 SYMBOL_LINK "CalPrmWspcEng01.TP_S8ETCSCpCtlExitCntDnTh" 0 /end CHARACTERISTIC
/begin CHARACTERISTIC TP_S8ETCSCpCtlExitCntTh "" VALUE 0x8003A46F CalPrmWspcEng_SBYTE 0 Ti51 -2.56 2.54 SYMBOL_LINK "CalPrmWspcEng01.TP_S8ETCSCpCtlExitCntTh" 0 /end CHARACTERISTIC
/begin CHARACTERISTIC TP_S8ETCSCpCtlExitCntUpTh "" VALUE 0x8003A470 CalPrmWspcEng_SBYTE 0 Tq51 -12.8 12.7 SYMBOL_LINK "CalPrmWspcEng01.TP_S8ETCSCpCtlExitCntUpTh" 0 /end CHARACTERISTIC
/begin CHARACTERISTIC TP_S8ETCSCpH2LDctHiMuTh "" VALUE 0x8003A471 CalPrmWspcEng_SBYTE 0 A42 -1.28 1.27 SYMBOL_LINK "CalPrmWspcEng01.TP_S8ETCSCpH2LDctHiMuTh" 0 /end CHARACTERISTIC
/begin CHARACTERISTIC TP_S8ETCSCpH2LDctLwMuTh "" VALUE 0x8003A472 CalPrmWspcEng_SBYTE 0 A42 -1.28 1.27 SYMBOL_LINK "CalPrmWspcEng01.TP_S8ETCSCpH2LDctLwMuTh" 0 /end CHARACTERISTIC
/begin CHARACTERISTIC TP_S8ETCSCpHiSusResetTime "" VALUE 0x8003A473 CalPrmWspcEng_SBYTE 0 Ti51 -2.56 2.54 SYMBOL_LINK "CalPrmWspcEng01.TP_S8ETCSCpHiSusResetTime" 0 /end CHARACTERISTIC
/begin CHARACTERISTIC TP_S8_EDC_DEC_ENT_THR_INC_IN_CTL "" VALUE 0x8003A0AF CalPrmWslcEng_SBYTE 0 Spd12 -16 15.875 SYMBOL_LINK "CalPrmWslcEng01.TP_S8_EDC_DEC_ENT_THR_INC_IN_CTL" 0 /end CHARACTERISTIC
/begin CHARACTERISTIC TP_S8_EDC_DEC_ENT_THR_IN_RR "" VALUE 0x8003A0B0 CalPrmWslcEng_SBYTE 0 Spd12 -16 15.875 SYMBOL_LINK "CalPrmWslcEng01.TP_S8_EDC_DEC_ENT_THR_IN_RR" 0 /end CHARACTERISTIC
/begin CHARACTERISTIC TP_S8_EDC_DEC_TAR_DEL_V_IN_RR "" VALUE 0x8003A0C3 CalPrmWslcEng_SBYTE 0 Spd12 -16 15.875 SYMBOL_LINK "CalPrmWslcEng01.TP_S8_EDC_DEC_TAR_DEL_V_IN_RR" 0 /end CHARACTERISTIC
/begin CHARACTERISTIC TP_S8_EDC_ENTRY_LIMIT "" VALUE 0x8003A144 CalPrmWslcEng_SBYTE 0 Spd12 -16 15.875 SYMBOL_LINK "CalPrmWslcEng01.TP_S8_EDC_ENTRY_LIMIT" 0 /end CHARACTERISTIC
/begin CHARACTERISTIC TP_S8_EDC_ENT_THR_REL_LAM "" VALUE 0x8003A0B1 CalPrmWslcEng_SBYTE 0 Perc6 -128 127 SYMBOL_LINK "CalPrmWslcEng01.TP_S8_EDC_ENT_THR_REL_LAM" 0 /end CHARACTERISTIC
/begin CHARACTERISTIC TP_S8_EDC_ENT_THR_REL_LAM_AT_B_DCT "" VALUE 0x8003A0B2 CalPrmWslcEng_SBYTE 0 Perc6 -128 127 SYMBOL_LINK "CalPrmWslcEng01.TP_S8_EDC_ENT_THR_REL_LAM_AT_B_DCT" 0 /end CHARACTERISTIC
/begin CHARACTERISTIC TP_S8_EDC_GSD_AVG_WHL_SLIP_DIFF_THR "" VALUE 0x8003A165 CalPrmWslcEng_SBYTE 0 Gain -128 127 SYMBOL_LINK "CalPrmWslcEng01.TP_S8_EDC_GSD_AVG_WHL_SLIP_DIFF_THR" 0 /end CHARACTERISTIC
/begin CHARACTERISTIC TP_S8_EDC_GSD_ENTRY_CNT "" VALUE 0x8003A166 CalPrmWslcEng_SBYTE 0 Gain -128 127 SYMBOL_LINK "CalPrmWslcEng01.TP_S8_EDC_GSD_ENTRY_CNT" 0 /end CHARACTERISTIC
/begin CHARACTERISTIC TP_S8_EDC_GSD_ENTRY_WHL_SLIP "" VALUE 0x8003A167 CalPrmWslcEng_SBYTE 0 Spd12 -16 15.875 SYMBOL_LINK "CalPrmWslcEng01.TP_S8_EDC_GSD_ENTRY_WHL_SLIP" 0 /end CHARACTERISTIC
/begin CHARACTERISTIC TP_S8_EDC_GSD_EXIT_WHL_SLIP "" VALUE 0x8003A168 CalPrmWslcEng_SBYTE 0 Spd12 -16 15.875 SYMBOL_LINK "CalPrmWslcEng01.TP_S8_EDC_GSD_EXIT_WHL_SLIP" 0 /end CHARACTERISTIC
/begin CHARACTERISTIC TP_S8_EDC_GSD_SLOPE_ENG_RPM_THR "" VALUE 0x8003A169 CalPrmWslcEng_SBYTE 0 Gain -128 127 SYMBOL_LINK "CalPrmWslcEng01.TP_S8_EDC_GSD_SLOPE_ENG_RPM_THR" 0 /end CHARACTERISTIC
/begin CHARACTERISTIC TP_U16ETCSCpDctLwHmMaxCnt "" VALUE 0x8003A486 CalPrmWspcEng_UWORD 0 Ti51 0 1310.7 SYMBOL_LINK "CalPrmWspcEng01.TP_U16ETCSCpDctLwHmMaxCnt" 0 /end CHARACTERISTIC
/begin CHARACTERISTIC TP_U16TCSCpDriverAccelIntendSuspCntTh "" VALUE 0x8003A254 CalPrmWspcEng_UWORD 0 Ti21 0 655.35 SYMBOL_LINK "CalPrmWspcEng01.TP_U16TCSCpDriverAccelIntendSuspCntTh" 0 /end CHARACTERISTIC
/begin CHARACTERISTIC TP_U16_EDC_ENG_RPM_LIMIT "" VALUE 0x8003A126 CalPrmWslcEng_UWORD 0 Gain 0 65535 SYMBOL_LINK "CalPrmWslcEng01.TP_U16_EDC_ENG_RPM_LIMIT" 0 /end CHARACTERISTIC
/begin CHARACTERISTIC TP_U16_EDC_GAIN_SCALING_FACTOR "" VALUE 0x8003A146 CalPrmWslcEng_UWORD 0 Gain 0 65535 SYMBOL_LINK "CalPrmWslcEng01.TP_U16_EDC_GAIN_SCALING_FACTOR" 0 /end CHARACTERISTIC
/begin CHARACTERISTIC TP_U16_EDC_TIRE_L "" VALUE 0x8003A14A CalPrmWslcEng_UWORD 0 Gain 0 65535 SYMBOL_LINK "CalPrmWslcEng01.TP_U16_EDC_TIRE_L" 0 /end CHARACTERISTIC
/begin CHARACTERISTIC TP_U16_EDC_TIRE_L_R "" VALUE 0x8003A14C CalPrmWslcEng_UWORD 0 Gain 0 65535 SYMBOL_LINK "CalPrmWslcEng01.TP_U16_EDC_TIRE_L_R" 0 /end CHARACTERISTIC
/begin CHARACTERISTIC TP_U16_TCS_BRK_CLT_MAX_SPD "" VALUE 0x8003A244 CalPrmWspcEng_UWORD 0 Spd12 0 8191.875 SYMBOL_LINK "CalPrmWspcEng01.TP_U16_TCS_BRK_CLT_MAX_SPD" 0 /end CHARACTERISTIC
/begin CHARACTERISTIC TP_U16_TCS_SPEED[0] "" VALUE 0x8003A246 CalPrmWspcEng_UWORD 0 Spd12 0 8191.875 SYMBOL_LINK "CalPrmWspcEng01.TP_U16_TCS_SPEED[0]" 0 /end CHARACTERISTIC
/begin CHARACTERISTIC TP_U16_TCS_SPEED[1] "" VALUE 0x8003A248 CalPrmWspcEng_UWORD 0 Spd12 0 8191.875 SYMBOL_LINK "CalPrmWspcEng01.TP_U16_TCS_SPEED[1]" 0 /end CHARACTERISTIC
/begin CHARACTERISTIC TP_U16_TCS_SPEED[2] "" VALUE 0x8003A24A CalPrmWspcEng_UWORD 0 Spd12 0 8191.875 SYMBOL_LINK "CalPrmWspcEng01.TP_U16_TCS_SPEED[2]" 0 /end CHARACTERISTIC
/begin CHARACTERISTIC TP_U16_TCS_SPEED[3] "" VALUE 0x8003A24C CalPrmWspcEng_UWORD 0 Spd12 0 8191.875 SYMBOL_LINK "CalPrmWspcEng01.TP_U16_TCS_SPEED[3]" 0 /end CHARACTERISTIC
/begin CHARACTERISTIC TP_U16_TCS_SPEED[4] "" VALUE 0x8003A24E CalPrmWspcEng_UWORD 0 Spd12 0 8191.875 SYMBOL_LINK "CalPrmWspcEng01.TP_U16_TCS_SPEED[4]" 0 /end CHARACTERISTIC
/begin CHARACTERISTIC TP_U16_TCS_START_ENGINE_TORQUE "" VALUE 0x8003A250 CalPrmWspcEng_UWORD 0 Tq51 0 6553.5 SYMBOL_LINK "CalPrmWspcEng01.TP_U16_TCS_START_ENGINE_TORQUE" 0 /end CHARACTERISTIC
/begin CHARACTERISTIC TP_U16_TCS_START_RPM "" VALUE 0x8003A252 CalPrmWspcEng_UWORD 0 N10 0 65535 SYMBOL_LINK "CalPrmWspcEng01.TP_U16_TCS_START_RPM" 0 /end CHARACTERISTIC
/begin CHARACTERISTIC TP_U8ETCSCpAWDVehicle "" VALUE 0x8003A498 CalPrmWspcEng_UBYTE 0 Fac31 0 255 SYMBOL_LINK "CalPrmWspcEng01.TP_U8ETCSCpAWDVehicle" 0 /end CHARACTERISTIC
/begin CHARACTERISTIC TP_U8ETCSCpAdaptHighRdCplCnt "" VALUE 0x8003A48E CalPrmWspcEng_UBYTE 0 Ti51 0 5.1 SYMBOL_LINK "CalPrmWspcEng01.TP_U8ETCSCpAdaptHighRdCplCnt" 0 /end CHARACTERISTIC
/begin CHARACTERISTIC TP_U8ETCSCpAdaptHighRdStrtCnt "" VALUE 0x8003A48F CalPrmWspcEng_UBYTE 0 Ti51 0 5.1 SYMBOL_LINK "CalPrmWspcEng01.TP_U8ETCSCpAdaptHighRdStrtCnt" 0 /end CHARACTERISTIC
/begin CHARACTERISTIC TP_U8ETCSCpAddRefRdCfFrci "" VALUE 0x8003A493 CalPrmWspcEng_UBYTE 0 A42 0 2.55 SYMBOL_LINK "CalPrmWspcEng01.TP_U8ETCSCpAddRefRdCfFrci" 0 /end CHARACTERISTIC
/begin CHARACTERISTIC TP_U8ETCSCpAreaSetLwToHiSpin "" VALUE 0x8003A497 CalPrmWspcEng_UBYTE 0 Spd12 0 31.875 SYMBOL_LINK "CalPrmWspcEng01.TP_U8ETCSCpAreaSetLwToHiSpin" 0 /end CHARACTERISTIC
/begin CHARACTERISTIC TP_U8ETCSCpAxAt[0][0] "" VALUE 0x8003A499 CalPrmWspcEng_UBYTE 0 A42 0 2.55 SYMBOL_LINK "CalPrmWspcEng01.TP_U8ETCSCpAxAt[0][0]" 0 /end CHARACTERISTIC
/begin CHARACTERISTIC TP_U8ETCSCpAxAt[0][1] "" VALUE 0x8003A49A CalPrmWspcEng_UBYTE 0 A42 0 2.55 SYMBOL_LINK "CalPrmWspcEng01.TP_U8ETCSCpAxAt[0][1]" 0 /end CHARACTERISTIC
/begin CHARACTERISTIC TP_U8ETCSCpAxAt[0][2] "" VALUE 0x8003A49B CalPrmWspcEng_UBYTE 0 A42 0 2.55 SYMBOL_LINK "CalPrmWspcEng01.TP_U8ETCSCpAxAt[0][2]" 0 /end CHARACTERISTIC
/begin CHARACTERISTIC TP_U8ETCSCpAxAt[0][3] "" VALUE 0x8003A49C CalPrmWspcEng_UBYTE 0 A42 0 2.55 SYMBOL_LINK "CalPrmWspcEng01.TP_U8ETCSCpAxAt[0][3]" 0 /end CHARACTERISTIC
/begin CHARACTERISTIC TP_U8ETCSCpAxAt[0][4] "" VALUE 0x8003A49D CalPrmWspcEng_UBYTE 0 A42 0 2.55 SYMBOL_LINK "CalPrmWspcEng01.TP_U8ETCSCpAxAt[0][4]" 0 /end CHARACTERISTIC
/begin CHARACTERISTIC TP_U8ETCSCpAxAt[1][0] "" VALUE 0x8003A49E CalPrmWspcEng_UBYTE 0 A42 0 2.55 SYMBOL_LINK "CalPrmWspcEng01.TP_U8ETCSCpAxAt[1][0]" 0 /end CHARACTERISTIC
/begin CHARACTERISTIC TP_U8ETCSCpAxAt[1][1] "" VALUE 0x8003A49F CalPrmWspcEng_UBYTE 0 A42 0 2.55 SYMBOL_LINK "CalPrmWspcEng01.TP_U8ETCSCpAxAt[1][1]" 0 /end CHARACTERISTIC
/begin CHARACTERISTIC TP_U8ETCSCpAxAt[1][2] "" VALUE 0x8003A4A0 CalPrmWspcEng_UBYTE 0 A42 0 2.55 SYMBOL_LINK "CalPrmWspcEng01.TP_U8ETCSCpAxAt[1][2]" 0 /end CHARACTERISTIC
/begin CHARACTERISTIC TP_U8ETCSCpAxAt[1][3] "" VALUE 0x8003A4A1 CalPrmWspcEng_UBYTE 0 A42 0 2.55 SYMBOL_LINK "CalPrmWspcEng01.TP_U8ETCSCpAxAt[1][3]" 0 /end CHARACTERISTIC
/begin CHARACTERISTIC TP_U8ETCSCpAxAt[1][4] "" VALUE 0x8003A4A2 CalPrmWspcEng_UBYTE 0 A42 0 2.55 SYMBOL_LINK "CalPrmWspcEng01.TP_U8ETCSCpAxAt[1][4]" 0 /end CHARACTERISTIC
/begin CHARACTERISTIC TP_U8ETCSCpAxAt[2][0] "" VALUE 0x8003A4A3 CalPrmWspcEng_UBYTE 0 A42 0 2.55 SYMBOL_LINK "CalPrmWspcEng01.TP_U8ETCSCpAxAt[2][0]" 0 /end CHARACTERISTIC
/begin CHARACTERISTIC TP_U8ETCSCpAxAt[2][1] "" VALUE 0x8003A4A4 CalPrmWspcEng_UBYTE 0 A42 0 2.55 SYMBOL_LINK "CalPrmWspcEng01.TP_U8ETCSCpAxAt[2][1]" 0 /end CHARACTERISTIC
/begin CHARACTERISTIC TP_U8ETCSCpAxAt[2][2] "" VALUE 0x8003A4A5 CalPrmWspcEng_UBYTE 0 A42 0 2.55 SYMBOL_LINK "CalPrmWspcEng01.TP_U8ETCSCpAxAt[2][2]" 0 /end CHARACTERISTIC
/begin CHARACTERISTIC TP_U8ETCSCpAxAt[2][3] "" VALUE 0x8003A4A6 CalPrmWspcEng_UBYTE 0 A42 0 2.55 SYMBOL_LINK "CalPrmWspcEng01.TP_U8ETCSCpAxAt[2][3]" 0 /end CHARACTERISTIC
/begin CHARACTERISTIC TP_U8ETCSCpAxAt[2][4] "" VALUE 0x8003A4A7 CalPrmWspcEng_UBYTE 0 A42 0 2.55 SYMBOL_LINK "CalPrmWspcEng01.TP_U8ETCSCpAxAt[2][4]" 0 /end CHARACTERISTIC
/begin CHARACTERISTIC TP_U8ETCSCpAxOffset4InhHldVib "" VALUE 0x8003A4A8 CalPrmWspcEng_UBYTE 0 A42 0 2.55 SYMBOL_LINK "CalPrmWspcEng01.TP_U8ETCSCpAxOffset4InhHldVib" 0 /end CHARACTERISTIC
/begin CHARACTERISTIC TP_U8ETCSCpCtlActCntThAtHiAxlAcc "" VALUE 0x8003A4BF CalPrmWspcEng_UBYTE 0 Fac31 0 255 SYMBOL_LINK "CalPrmWspcEng01.TP_U8ETCSCpCtlActCntThAtHiAxlAcc" 0 /end CHARACTERISTIC
/begin CHARACTERISTIC TP_U8ETCSCpCtlActCntThAtLwAxlAcc "" VALUE 0x8003A4C0 CalPrmWspcEng_UBYTE 0 Fac31 0 255 SYMBOL_LINK "CalPrmWspcEng01.TP_U8ETCSCpCtlActCntThAtLwAxlAcc" 0 /end CHARACTERISTIC
/begin CHARACTERISTIC TP_U8ETCSCpCtlEnterAccPdlTh "" VALUE 0x8003A4C2 CalPrmWspcEng_UBYTE 0 Perc6 0 255 SYMBOL_LINK "CalPrmWspcEng01.TP_U8ETCSCpCtlEnterAccPdlTh" 0 /end CHARACTERISTIC
/begin CHARACTERISTIC TP_U8ETCSCpCtlExitAccPdlTh "" VALUE 0x8003A4C3 CalPrmWspcEng_UBYTE 0 Perc6 0 255 SYMBOL_LINK "CalPrmWspcEng01.TP_U8ETCSCpCtlExitAccPdlTh" 0 /end CHARACTERISTIC
/begin CHARACTERISTIC TP_U8ETCSCpDelYawTransVal "" VALUE 0x8003A4F4 CalPrmWspcEng_UBYTE 0 Gain 0 255 SYMBOL_LINK "CalPrmWspcEng01.TP_U8ETCSCpDelYawTransVal" 0 /end CHARACTERISTIC
/begin CHARACTERISTIC TP_U8ETCSCpDetDepSnwHilCnt "" VALUE 0x8003A4F5 CalPrmWspcEng_UBYTE 0 Ti51 0 5.1 SYMBOL_LINK "CalPrmWspcEng01.TP_U8ETCSCpDetDepSnwHilCnt" 0 /end CHARACTERISTIC
/begin CHARACTERISTIC TP_U8ETCSCpEngAvail "" VALUE 0x8003A4F8 CalPrmWspcEng_UBYTE 0 Fac31 0 255 SYMBOL_LINK "CalPrmWspcEng01.TP_U8ETCSCpEngAvail" 0 /end CHARACTERISTIC
/begin CHARACTERISTIC TP_U8ETCSCpEngStallRpmOffset "" VALUE 0x8003A4F9 CalPrmWspcEng_UBYTE 0 N10 0 255 SYMBOL_LINK "CalPrmWspcEng01.TP_U8ETCSCpEngStallRpmOffset" 0 /end CHARACTERISTIC
/begin CHARACTERISTIC TP_U8ETCSCpFtr4JmpDnMax "" VALUE 0x8003A4FC CalPrmWspcEng_UBYTE 0 Perc6 0 255 SYMBOL_LINK "CalPrmWspcEng01.TP_U8ETCSCpFtr4JmpDnMax" 0 /end CHARACTERISTIC
/begin CHARACTERISTIC TP_U8ETCSCpFtr4JmpDnMin "" VALUE 0x8003A4FD CalPrmWspcEng_UBYTE 0 Perc6 0 255 SYMBOL_LINK "CalPrmWspcEng01.TP_U8ETCSCpFtr4JmpDnMin" 0 /end CHARACTERISTIC
/begin CHARACTERISTIC TP_U8ETCSCpFtr4JmpUpMax "" VALUE 0x8003A4FE CalPrmWspcEng_UBYTE 0 Perc6 0 255 SYMBOL_LINK "CalPrmWspcEng01.TP_U8ETCSCpFtr4JmpUpMax" 0 /end CHARACTERISTIC
/begin CHARACTERISTIC TP_U8ETCSCpFtr4JmpUpMin "" VALUE 0x8003A4FF CalPrmWspcEng_UBYTE 0 Perc6 0 255 SYMBOL_LINK "CalPrmWspcEng01.TP_U8ETCSCpFtr4JmpUpMin" 0 /end CHARACTERISTIC
/begin CHARACTERISTIC TP_U8ETCSCpFtr4JmpUpSpnAcclMax "" VALUE 0x8003A500 CalPrmWspcEng_UBYTE 0 Perc6 0 255 SYMBOL_LINK "CalPrmWspcEng01.TP_U8ETCSCpFtr4JmpUpSpnAcclMax" 0 /end CHARACTERISTIC
/begin CHARACTERISTIC TP_U8ETCSCpFtr4JmpUpSpnAcclMin "" VALUE 0x8003A501 CalPrmWspcEng_UBYTE 0 Perc6 0 255 SYMBOL_LINK "CalPrmWspcEng01.TP_U8ETCSCpFtr4JmpUpSpnAcclMin" 0 /end CHARACTERISTIC
/begin CHARACTERISTIC TP_U8ETCSCpFtr4RefTrqAt2ndCylStrt "" VALUE 0x8003A502 CalPrmWspcEng_UBYTE 0 Perc6 0 255 SYMBOL_LINK "CalPrmWspcEng01.TP_U8ETCSCpFtr4RefTrqAt2ndCylStrt" 0 /end CHARACTERISTIC
/begin CHARACTERISTIC TP_U8ETCSCpFtr4RefTrqAtVcaOfCtl "" VALUE 0x8003A504 CalPrmWspcEng_UWORD 0 Perc6 0 65535 SYMBOL_LINK "CalPrmWspcEng01.TP_U8ETCSCpFtr4RefTrqAtVcaOfCtl" 0 /end CHARACTERISTIC
/begin CHARACTERISTIC TP_U8ETCSCpFtr4RefTrqLmg2ndCylStrt "" VALUE 0x8003A506 CalPrmWspcEng_UBYTE 0 Gain 0 255 SYMBOL_LINK "CalPrmWspcEng01.TP_U8ETCSCpFtr4RefTrqLmg2ndCylStrt" 0 /end CHARACTERISTIC
/begin CHARACTERISTIC TP_U8ETCSCpGradientTrstCplCnt "" VALUE 0x8003A509 CalPrmWspcEng_UBYTE 0 Ti51 0 5.1 SYMBOL_LINK "CalPrmWspcEng01.TP_U8ETCSCpGradientTrstCplCnt" 0 /end CHARACTERISTIC
/begin CHARACTERISTIC TP_U8ETCSCpGradientTrstStCnt "" VALUE 0x8003A50A CalPrmWspcEng_UBYTE 0 Ti51 0 5.1 SYMBOL_LINK "CalPrmWspcEng01.TP_U8ETCSCpGradientTrstStCnt" 0 /end CHARACTERISTIC
/begin CHARACTERISTIC TP_U8ETCSCpGrdTransTme "" VALUE 0x8003A50C CalPrmWspcEng_UBYTE 0 Ti51 0 5.1 SYMBOL_LINK "CalPrmWspcEng01.TP_U8ETCSCpGrdTransTme" 0 /end CHARACTERISTIC
/begin CHARACTERISTIC TP_U8ETCSCpH2LDctHldTm "" VALUE 0x8003A516 CalPrmWspcEng_UBYTE 0 Ti51 0 5.1 SYMBOL_LINK "CalPrmWspcEng01.TP_U8ETCSCpH2LDctHldTm" 0 /end CHARACTERISTIC
/begin CHARACTERISTIC TP_U8ETCSCpH2LDctSpnTh "" VALUE 0x8003A517 CalPrmWspcEng_UBYTE 0 Spd12 0 31.875 SYMBOL_LINK "CalPrmWspcEng01.TP_U8ETCSCpH2LDctSpnTh" 0 /end CHARACTERISTIC
/begin CHARACTERISTIC TP_U8ETCSCpHiAxlAccTh "" VALUE 0x8003A518 CalPrmWspcEng_UBYTE 0 A42 0 2.55 SYMBOL_LINK "CalPrmWspcEng01.TP_U8ETCSCpHiAxlAccTh" 0 /end CHARACTERISTIC
/begin CHARACTERISTIC TP_U8ETCSCpHighBigSpnL2SpltTh "" VALUE 0x8003A519 CalPrmWspcEng_UBYTE 0 Spd12 0 31.875 SYMBOL_LINK "CalPrmWspcEng01.TP_U8ETCSCpHighBigSpnL2SpltTh" 0 /end CHARACTERISTIC
/begin CHARACTERISTIC TP_U8ETCSCpHighSpnL2SpltTh "" VALUE 0x8003A51B CalPrmWspcEng_UBYTE 0 Spd12 0 31.875 SYMBOL_LINK "CalPrmWspcEng01.TP_U8ETCSCpHighSpnL2SpltTh" 0 /end CHARACTERISTIC
/begin CHARACTERISTIC TP_U8ETCSCpHillClrTime "" VALUE 0x8003A51D CalPrmWspcEng_UBYTE 0 Ti51 0 5.1 SYMBOL_LINK "CalPrmWspcEng01.TP_U8ETCSCpHillClrTime" 0 /end CHARACTERISTIC
/begin CHARACTERISTIC TP_U8ETCSCpHillDctAlongTh "" VALUE 0x8003A51E CalPrmWspcEng_UBYTE 0 A42 0 2.55 SYMBOL_LINK "CalPrmWspcEng01.TP_U8ETCSCpHillDctAlongTh" 0 /end CHARACTERISTIC
/begin CHARACTERISTIC TP_U8ETCSCpHillDctTime "" VALUE 0x8003A51F CalPrmWspcEng_UBYTE 0 Ti51 0 5.1 SYMBOL_LINK "CalPrmWspcEng01.TP_U8ETCSCpHillDctTime" 0 /end CHARACTERISTIC
/begin CHARACTERISTIC TP_U8ETCSCpHillDctTimeAx "" VALUE 0x8003A520 CalPrmWspcEng_UBYTE 0 Ti51 0 5.1 SYMBOL_LINK "CalPrmWspcEng01.TP_U8ETCSCpHillDctTimeAx" 0 /end CHARACTERISTIC
/begin CHARACTERISTIC TP_U8ETCSCpHillDiffAx "" VALUE 0x8003A521 CalPrmWspcEng_UBYTE 0 A42 0 2.55 SYMBOL_LINK "CalPrmWspcEng01.TP_U8ETCSCpHillDiffAx" 0 /end CHARACTERISTIC
/begin CHARACTERISTIC TP_U8ETCSCpHillTransTme "" VALUE 0x8003A522 CalPrmWspcEng_UBYTE 0 Ti51 0 5.1 SYMBOL_LINK "CalPrmWspcEng01.TP_U8ETCSCpHillTransTme" 0 /end CHARACTERISTIC
/begin CHARACTERISTIC TP_U8ETCSCpHsaHillTime "" VALUE 0x8003A523 CalPrmWspcEng_UBYTE 0 Ti51 0 5.1 SYMBOL_LINK "CalPrmWspcEng01.TP_U8ETCSCpHsaHillTime" 0 /end CHARACTERISTIC
/begin CHARACTERISTIC TP_U8ETCSCpHysDeltAcc "" VALUE 0x8003A524 CalPrmWspcEng_UBYTE 0 Fac31 0 255 SYMBOL_LINK "CalPrmWspcEng01.TP_U8ETCSCpHysDeltAcc" 0 /end CHARACTERISTIC
/begin CHARACTERISTIC TP_U8ETCSCpHysDepSnwHilCnt "" VALUE 0x8003A525 CalPrmWspcEng_UBYTE 0 Ti51 0 5.1 SYMBOL_LINK "CalPrmWspcEng01.TP_U8ETCSCpHysDepSnwHilCnt" 0 /end CHARACTERISTIC
/begin CHARACTERISTIC TP_U8ETCSCpLmtStrDepSnwHil "" VALUE 0x8003A566 CalPrmWspcEng_UBYTE 0 Ag43 0 2550 SYMBOL_LINK "CalPrmWspcEng01.TP_U8ETCSCpLmtStrDepSnwHil" 0 /end CHARACTERISTIC
/begin CHARACTERISTIC TP_U8ETCSCpLowSpnL2SpltTh "" VALUE 0x8003A567 CalPrmWspcEng_UBYTE 0 Spd12 0 31.875 SYMBOL_LINK "CalPrmWspcEng01.TP_U8ETCSCpLowSpnL2SpltTh" 0 /end CHARACTERISTIC
/begin CHARACTERISTIC TP_U8ETCSCpLowWhlSpnCntDnTh "" VALUE 0x8003A569 CalPrmWspcEng_UBYTE 0 Spd12 0 31.875 SYMBOL_LINK "CalPrmWspcEng01.TP_U8ETCSCpLowWhlSpnCntDnTh" 0 /end CHARACTERISTIC
/begin CHARACTERISTIC TP_U8ETCSCpLowWhlSpnCntUpTh "" VALUE 0x8003A56A CalPrmWspcEng_UBYTE 0 Spd12 0 31.875 SYMBOL_LINK "CalPrmWspcEng01.TP_U8ETCSCpLowWhlSpnCntUpTh" 0 /end CHARACTERISTIC
/begin CHARACTERISTIC TP_U8ETCSCpLwAxlAccTh "" VALUE 0x8003A56B CalPrmWspcEng_UBYTE 0 A42 0 2.55 SYMBOL_LINK "CalPrmWspcEng01.TP_U8ETCSCpLwAxlAccTh" 0 /end CHARACTERISTIC
/begin CHARACTERISTIC TP_U8ETCSCpLwSpnHldCntTh[0] "" VALUE 0x8003A56C CalPrmWspcEng_UBYTE 0 Ti51 0 5.1 SYMBOL_LINK "CalPrmWspcEng01.TP_U8ETCSCpLwSpnHldCntTh[0]" 0 /end CHARACTERISTIC
/begin CHARACTERISTIC TP_U8ETCSCpLwSpnHldCntTh[1] "" VALUE 0x8003A56D CalPrmWspcEng_UBYTE 0 Ti51 0 5.1 SYMBOL_LINK "CalPrmWspcEng01.TP_U8ETCSCpLwSpnHldCntTh[1]" 0 /end CHARACTERISTIC
/begin CHARACTERISTIC TP_U8ETCSCpLwSpnHldCntTh[2] "" VALUE 0x8003A56E CalPrmWspcEng_UBYTE 0 Ti51 0 5.1 SYMBOL_LINK "CalPrmWspcEng01.TP_U8ETCSCpLwSpnHldCntTh[2]" 0 /end CHARACTERISTIC
/begin CHARACTERISTIC TP_U8ETCSCpLwToHiDetAreaCnt "" VALUE 0x8003A56F CalPrmWspcEng_UBYTE 0 Ti51 0 5.1 SYMBOL_LINK "CalPrmWspcEng01.TP_U8ETCSCpLwToHiDetAreaCnt" 0 /end CHARACTERISTIC
/begin CHARACTERISTIC TP_U8ETCSCpLwToHiDetCnt "" VALUE 0x8003A570 CalPrmWspcEng_UBYTE 0 Ti51 0 5.1 SYMBOL_LINK "CalPrmWspcEng01.TP_U8ETCSCpLwToHiDetCnt" 0 /end CHARACTERISTIC
/begin CHARACTERISTIC TP_U8ETCSCpLwWhlSpnTh2ClrCyl1st "" VALUE 0x8003A571 CalPrmWspcEng_UBYTE 0 Fac31 0 255 SYMBOL_LINK "CalPrmWspcEng01.TP_U8ETCSCpLwWhlSpnTh2ClrCyl1st" 0 /end CHARACTERISTIC
/begin CHARACTERISTIC TP_U8ETCSCpPGainIncFacH2L "" VALUE 0x8003A5A4 CalPrmWspcEng_UBYTE 0 Perc6 0 255 SYMBOL_LINK "CalPrmWspcEng01.TP_U8ETCSCpPGainIncFacH2L" 0 /end CHARACTERISTIC
/begin CHARACTERISTIC TP_U8ETCSCpRdMemTqDecGainFac "" VALUE 0x8003A5E8 CalPrmWspcEng_UBYTE 0 Gain 0 255 SYMBOL_LINK "CalPrmWspcEng01.TP_U8ETCSCpRdMemTqDecGainFac" 0 /end CHARACTERISTIC
/begin CHARACTERISTIC TP_U8ETCSCpRecTrqFacInBump "" VALUE 0x8003A5E9 CalPrmWspcEng_UBYTE 0 Perc6 0 255 SYMBOL_LINK "CalPrmWspcEng01.TP_U8ETCSCpRecTrqFacInBump" 0 /end CHARACTERISTIC
/begin CHARACTERISTIC TP_U8ETCSCpRefTrqNvldTm "" VALUE 0x8003A5EA CalPrmWspcEng_UBYTE 0 Gain 0 255 SYMBOL_LINK "CalPrmWspcEng01.TP_U8ETCSCpRefTrqNvldTm" 0 /end CHARACTERISTIC
/begin CHARACTERISTIC TP_U8ETCSCpRefTrqVldTm "" VALUE 0x8003A5EB CalPrmWspcEng_UBYTE 0 Ti51 0 5.1 SYMBOL_LINK "CalPrmWspcEng01.TP_U8ETCSCpRefTrqVldTm" 0 /end CHARACTERISTIC
/begin CHARACTERISTIC TP_U8ETCSCpSplitHillClrAccel "" VALUE 0x8003A5EC CalPrmWspcEng_UBYTE 0 A42 0 2.55 SYMBOL_LINK "CalPrmWspcEng01.TP_U8ETCSCpSplitHillClrAccel" 0 /end CHARACTERISTIC
/begin CHARACTERISTIC TP_U8ETCSCpSplitHillClrVehSpd "" VALUE 0x8003A5ED CalPrmWspcEng_UBYTE 0 Spd12 0 31.875 SYMBOL_LINK "CalPrmWspcEng01.TP_U8ETCSCpSplitHillClrVehSpd" 0 /end CHARACTERISTIC
/begin CHARACTERISTIC TP_U8ETCSCpSplitHillDctAccel "" VALUE 0x8003A5EE CalPrmWspcEng_UBYTE 0 A42 0 2.55 SYMBOL_LINK "CalPrmWspcEng01.TP_U8ETCSCpSplitHillDctAccel" 0 /end CHARACTERISTIC
/begin CHARACTERISTIC TP_U8ETCSCpSplitHillDctMinAx "" VALUE 0x8003A5EF CalPrmWspcEng_UBYTE 0 A42 0 2.55 SYMBOL_LINK "CalPrmWspcEng01.TP_U8ETCSCpSplitHillDctMinAx" 0 /end CHARACTERISTIC
/begin CHARACTERISTIC TP_U8ETCSCpSplitHillDctVehSpd "" VALUE 0x8003A5F0 CalPrmWspcEng_UBYTE 0 Spd12 0 31.875 SYMBOL_LINK "CalPrmWspcEng01.TP_U8ETCSCpSplitHillDctVehSpd" 0 /end CHARACTERISTIC
/begin CHARACTERISTIC TP_U8ETCSCpSpltDctBrkTrqCnt "" VALUE 0x8003A5F1 CalPrmWspcEng_UBYTE 0 Ti51 0 5.1 SYMBOL_LINK "CalPrmWspcEng01.TP_U8ETCSCpSpltDctBrkTrqCnt" 0 /end CHARACTERISTIC
/begin CHARACTERISTIC TP_U8ETCSCpStDeltAcc "" VALUE 0x8003A5F3 CalPrmWspcEng_UBYTE 0 Fac31 0 255 SYMBOL_LINK "CalPrmWspcEng01.TP_U8ETCSCpStDeltAcc" 0 /end CHARACTERISTIC
/begin CHARACTERISTIC TP_U8ETCSCpSymSpnDifL2SpltTh "" VALUE 0x8003A60A CalPrmWspcEng_UBYTE 0 Spd12 0 31.875 SYMBOL_LINK "CalPrmWspcEng01.TP_U8ETCSCpSymSpnDifL2SpltTh" 0 /end CHARACTERISTIC
/begin CHARACTERISTIC TP_U8ETCSCpTarAddAcc "" VALUE 0x8003A60C CalPrmWspcEng_UBYTE 0 A42 0 2.55 SYMBOL_LINK "CalPrmWspcEng01.TP_U8ETCSCpTarAddAcc" 0 /end CHARACTERISTIC
/begin CHARACTERISTIC TP_U8ETCSCpTarTransCplReBrkTrq2Sp "" VALUE 0x8003A621 CalPrmWspcEng_UBYTE 0 Gain 0 255 SYMBOL_LINK "CalPrmWspcEng01.TP_U8ETCSCpTarTransCplReBrkTrq2Sp" 0 /end CHARACTERISTIC
/begin CHARACTERISTIC TP_U8ETCSCpTarTransStReBrkTrq2Sp "" VALUE 0x8003A623 CalPrmWspcEng_UBYTE 0 Gain 0 255 SYMBOL_LINK "CalPrmWspcEng01.TP_U8ETCSCpTarTransStReBrkTrq2Sp" 0 /end CHARACTERISTIC
/begin CHARACTERISTIC TP_U8ETCSCpTimeTh2ClrCyl1st "" VALUE 0x8003A630 CalPrmWspcEng_UBYTE 0 Ti51 0 5.1 SYMBOL_LINK "CalPrmWspcEng01.TP_U8ETCSCpTimeTh2ClrCyl1st" 0 /end CHARACTERISTIC
/begin CHARACTERISTIC TP_U8ETCSCpTrackHiRdCplCnt "" VALUE 0x8003A631 CalPrmWspcEng_UBYTE 0 Ti51 0 5.1 SYMBOL_LINK "CalPrmWspcEng01.TP_U8ETCSCpTrackHiRdCplCnt" 0 /end CHARACTERISTIC
/begin CHARACTERISTIC TP_U8ETCSCpTrackHiRdStCnt "" VALUE 0x8003A632 CalPrmWspcEng_UBYTE 0 Ti51 0 5.1 SYMBOL_LINK "CalPrmWspcEng01.TP_U8ETCSCpTrackHiRdStCnt" 0 /end CHARACTERISTIC
/begin CHARACTERISTIC TP_U8ETCSCpYawCtlFacInDepSnw "" VALUE 0x8003A639 CalPrmWspcEng_UBYTE 0 Gain 0 255 SYMBOL_LINK "CalPrmWspcEng01.TP_U8ETCSCpYawCtlFacInDepSnw" 0 /end CHARACTERISTIC
/begin CHARACTERISTIC TP_U8ETCSCpYawThFacInDepSnw "" VALUE 0x8003A64D CalPrmWspcEng_UBYTE 0 Gain 0 255 SYMBOL_LINK "CalPrmWspcEng01.TP_U8ETCSCpYawThFacInDepSnw" 0 /end CHARACTERISTIC
/begin CHARACTERISTIC TP_U8TCSCpBtcsEndByHuntingWhlSpnDiffThr "" VALUE 0x8003A2F7 CalPrmWspcEng_UBYTE 0 Gain 0 255 SYMBOL_LINK "CalPrmWspcEng01.TP_U8TCSCpBtcsEndByHuntingWhlSpnDiffThr" 0 /end CHARACTERISTIC
/begin CHARACTERISTIC TP_U8TCSCpDecBsTarBrkF4ESCBrkCtl "" VALUE 0x8003A2FB CalPrmWspcEng_UBYTE 0 Gain 0 255 SYMBOL_LINK "CalPrmWspcEng01.TP_U8TCSCpDecBsTarBrkF4ESCBrkCtl" 0 /end CHARACTERISTIC
/begin CHARACTERISTIC TP_U8_D_GAIN_DEC_FACTOR_IN_RR "" VALUE 0x8003A124 CalPrmWslcEng_UBYTE 0 Perc6 0 255 SYMBOL_LINK "CalPrmWslcEng01.TP_U8_D_GAIN_DEC_FACTOR_IN_RR" 0 /end CHARACTERISTIC
/begin CHARACTERISTIC TP_U8_EDC_CONTROL_TIME_MAX "" VALUE 0x8003A148 CalPrmWslcEng_UBYTE 0 Ti11 0 255 SYMBOL_LINK "CalPrmWslcEng01.TP_U8_EDC_CONTROL_TIME_MAX" 0 /end CHARACTERISTIC
/begin CHARACTERISTIC TP_U8_EDC_GSD_ENABLE_FLG "" VALUE 0x8003A16A CalPrmWslcEng_SBYTE 0 Gain -128 127 SYMBOL_LINK "CalPrmWslcEng01.TP_U8_EDC_GSD_ENABLE_FLG" 0 /end CHARACTERISTIC
/begin CHARACTERISTIC TP_U8_EDC_MTP_THR_FOR_EDC_INHIBIT "" VALUE 0x8003A128 CalPrmWslcEng_UBYTE 0 Perc6 0 255 SYMBOL_LINK "CalPrmWslcEng01.TP_U8_EDC_MTP_THR_FOR_EDC_INHIBIT" 0 /end CHARACTERISTIC
/begin CHARACTERISTIC TP_U8_EDC_TM_1_GEAR_RATIO "" VALUE 0x8003A138 CalPrmWslcEng_UBYTE 0 Gain 0 255 SYMBOL_LINK "CalPrmWslcEng01.TP_U8_EDC_TM_1_GEAR_RATIO" 0 /end CHARACTERISTIC
/begin CHARACTERISTIC TP_U8_EDC_TM_2_GEAR_RATIO "" VALUE 0x8003A139 CalPrmWslcEng_UBYTE 0 Gain 0 255 SYMBOL_LINK "CalPrmWslcEng01.TP_U8_EDC_TM_2_GEAR_RATIO" 0 /end CHARACTERISTIC
/begin CHARACTERISTIC TP_U8_EDC_TM_3_GEAR_RATIO "" VALUE 0x8003A13A CalPrmWslcEng_UBYTE 0 Gain 0 255 SYMBOL_LINK "CalPrmWslcEng01.TP_U8_EDC_TM_3_GEAR_RATIO" 0 /end CHARACTERISTIC
/begin CHARACTERISTIC TP_U8_EDC_TM_4_GEAR_RATIO "" VALUE 0x8003A13B CalPrmWslcEng_UBYTE 0 Gain 0 255 SYMBOL_LINK "CalPrmWslcEng01.TP_U8_EDC_TM_4_GEAR_RATIO" 0 /end CHARACTERISTIC
/begin CHARACTERISTIC TP_U8_EDC_TM_5_GEAR_RATIO "" VALUE 0x8003A13C CalPrmWslcEng_UBYTE 0 Gain 0 255 SYMBOL_LINK "CalPrmWslcEng01.TP_U8_EDC_TM_5_GEAR_RATIO" 0 /end CHARACTERISTIC
/begin CHARACTERISTIC TP_U8_EDC_TM_6_GEAR_RATIO "" VALUE 0x8003A13D CalPrmWslcEng_UBYTE 0 Gain 0 255 SYMBOL_LINK "CalPrmWslcEng01.TP_U8_EDC_TM_6_GEAR_RATIO" 0 /end CHARACTERISTIC
/begin CHARACTERISTIC TP_U8_EDC_TM_R_GEAR_RATIO "" VALUE 0x8003A13E CalPrmWslcEng_UBYTE 0 Gain 0 255 SYMBOL_LINK "CalPrmWslcEng01.TP_U8_EDC_TM_R_GEAR_RATIO" 0 /end CHARACTERISTIC
/begin CHARACTERISTIC TP_U8_EDC_TORQ_DEC_RATE "" VALUE 0x8003A129 CalPrmWslcEng_UBYTE 0 Perc9 0 25.5 SYMBOL_LINK "CalPrmWslcEng01.TP_U8_EDC_TORQ_DEC_RATE" 0 /end CHARACTERISTIC
/begin CHARACTERISTIC TP_U8_EDC_TORQ_DEC_RATE_EXIT_EAO "" VALUE 0x8003A12A CalPrmWslcEng_UBYTE 0 Perc9 0 25.5 SYMBOL_LINK "CalPrmWslcEng01.TP_U8_EDC_TORQ_DEC_RATE_EXIT_EAO" 0 /end CHARACTERISTIC
/begin CHARACTERISTIC TP_U8_EDC_TORQ_DEC_RATE_EXIT_EEO "" VALUE 0x8003A12B CalPrmWslcEng_UBYTE 0 Perc9 0 25.5 SYMBOL_LINK "CalPrmWslcEng01.TP_U8_EDC_TORQ_DEC_RATE_EXIT_EEO" 0 /end CHARACTERISTIC
/begin CHARACTERISTIC TP_U8_EDC_TORQ_DEC_RATE_EXIT_ESO "" VALUE 0x8003A12C CalPrmWslcEng_UBYTE 0 Perc9 0 25.5 SYMBOL_LINK "CalPrmWslcEng01.TP_U8_EDC_TORQ_DEC_RATE_EXIT_ESO" 0 /end CHARACTERISTIC
/begin CHARACTERISTIC TP_U8_EDC_TORQ_DEC_RATE_RPM "" VALUE 0x8003A12D CalPrmWslcEng_UBYTE 0 Perc9 0 25.5 SYMBOL_LINK "CalPrmWslcEng01.TP_U8_EDC_TORQ_DEC_RATE_RPM" 0 /end CHARACTERISTIC
/begin CHARACTERISTIC TP_U8_EDC_TORQ_FAST_DEC_RATE_EXIT "" VALUE 0x8003A12E CalPrmWslcEng_UBYTE 0 Perc9 0 25.5 SYMBOL_LINK "CalPrmWslcEng01.TP_U8_EDC_TORQ_FAST_DEC_RATE_EXIT" 0 /end CHARACTERISTIC
/begin CHARACTERISTIC TP_U8_EDC_TORQ_SLOW_DEC_RATE_EXIT "" VALUE 0x8003A12F CalPrmWslcEng_UBYTE 0 Perc9 0 25.5 SYMBOL_LINK "CalPrmWslcEng01.TP_U8_EDC_TORQ_SLOW_DEC_RATE_EXIT" 0 /end CHARACTERISTIC
/begin CHARACTERISTIC TP_U8_GAIN_DEC_FACTOR_IN_HIGH_MU "" VALUE 0x8003A125 CalPrmWslcEng_UBYTE 0 Perc6 0 255 SYMBOL_LINK "CalPrmWslcEng01.TP_U8_GAIN_DEC_FACTOR_IN_HIGH_MU" 0 /end CHARACTERISTIC
/begin CHARACTERISTIC TP_U8_TCS_MOVING_WINDOW_LENGTH "" VALUE 0x8003A25A CalPrmWspcEng_UBYTE 0 Gain 0 255 SYMBOL_LINK "CalPrmWspcEng01.TP_U8_TCS_MOVING_WINDOW_LENGTH" 0 /end CHARACTERISTIC
/begin CHARACTERISTIC TP_U8_TOD_MODE_CST_OVER1 "TOD Control Mode, while coasting, for oversteer" VALUE 0x8003A6CA CalPrmAwdCtrlrEng_UBYTE 0 Gain 0 255 SYMBOL_LINK "CalPrmAwdCtrlrEng01.TP_U8_TOD_MODE_CST_OVER1" 0 /end CHARACTERISTIC
/begin CHARACTERISTIC TP_U8_TOD_MODE_CST_OVER2 "TOD Control Mode, while coasting, for severe oversteer" VALUE 0x8003A6CB CalPrmAwdCtrlrEng_UBYTE 0 Gain 0 255 SYMBOL_LINK "CalPrmAwdCtrlrEng01.TP_U8_TOD_MODE_CST_OVER2" 0 /end CHARACTERISTIC
/begin CHARACTERISTIC TP_U8_TOD_MODE_CST_STABL "TOD Control Mode, while coasting, for stable" VALUE 0x8003A6CC CalPrmAwdCtrlrEng_UBYTE 0 Gain 0 255 SYMBOL_LINK "CalPrmAwdCtrlrEng01.TP_U8_TOD_MODE_CST_STABL" 0 /end CHARACTERISTIC
/begin CHARACTERISTIC TP_U8_TOD_MODE_CST_UNDER1 "TOD Control Mode, while coasting, for understeer" VALUE 0x8003A6CD CalPrmAwdCtrlrEng_UBYTE 0 Gain 0 255 SYMBOL_LINK "CalPrmAwdCtrlrEng01.TP_U8_TOD_MODE_CST_UNDER1" 0 /end CHARACTERISTIC
/begin CHARACTERISTIC TP_U8_TOD_MODE_CST_UNDER2 "TOD Control Mode, while coasting, for severe understeer" VALUE 0x8003A6CE CalPrmAwdCtrlrEng_UBYTE 0 Gain 0 255 SYMBOL_LINK "CalPrmAwdCtrlrEng01.TP_U8_TOD_MODE_CST_UNDER2" 0 /end CHARACTERISTIC
/begin CHARACTERISTIC TP_U8_TOD_MODE_HOT_OVER1 "TOD Control Mode, while driving with half open throttle, for oversteer" VALUE 0x8003A6CF CalPrmAwdCtrlrEng_UBYTE 0 Gain 0 255 SYMBOL_LINK "CalPrmAwdCtrlrEng01.TP_U8_TOD_MODE_HOT_OVER1" 0 /end CHARACTERISTIC
/begin CHARACTERISTIC TP_U8_TOD_MODE_HOT_OVER2 "TOD Control Mode, while driving with half open throttle, for severe oversteer" VALUE 0x8003A6D0 CalPrmAwdCtrlrEng_UBYTE 0 Gain 0 255 SYMBOL_LINK "CalPrmAwdCtrlrEng01.TP_U8_TOD_MODE_HOT_OVER2" 0 /end CHARACTERISTIC
/begin CHARACTERISTIC TP_U8_TOD_MODE_HOT_STABL "TOD Control Mode, while driving with half open throttle, for stable" VALUE 0x8003A6D1 CalPrmAwdCtrlrEng_UBYTE 0 Gain 0 255 SYMBOL_LINK "CalPrmAwdCtrlrEng01.TP_U8_TOD_MODE_HOT_STABL" 0 /end CHARACTERISTIC
/begin CHARACTERISTIC TP_U8_TOD_MODE_HOT_UNDER1 "TOD Control Mode, while driving with half open throttle, for understeer" VALUE 0x8003A6D2 CalPrmAwdCtrlrEng_UBYTE 0 Gain 0 255 SYMBOL_LINK "CalPrmAwdCtrlrEng01.TP_U8_TOD_MODE_HOT_UNDER1" 0 /end CHARACTERISTIC
/begin CHARACTERISTIC TP_U8_TOD_MODE_HOT_UNDER2 "TOD Control Mode, while driving with half open throttle, for severe understeer" VALUE 0x8003A6D3 CalPrmAwdCtrlrEng_UBYTE 0 Gain 0 255 SYMBOL_LINK "CalPrmAwdCtrlrEng01.TP_U8_TOD_MODE_HOT_UNDER2" 0 /end CHARACTERISTIC
/begin CHARACTERISTIC TP_U8_TOD_MODE_WOT_OVER1 "TOD Control Mode, while driving with wide open throttle, for oversteer" VALUE 0x8003A6D4 CalPrmAwdCtrlrEng_UBYTE 0 Gain 0 255 SYMBOL_LINK "CalPrmAwdCtrlrEng01.TP_U8_TOD_MODE_WOT_OVER1" 0 /end CHARACTERISTIC
/begin CHARACTERISTIC TP_U8_TOD_MODE_WOT_OVER2 "TOD Control Mode, while driving with wide open throttle, for severe oversteer" VALUE 0x8003A6D5 CalPrmAwdCtrlrEng_UBYTE 0 Gain 0 255 SYMBOL_LINK "CalPrmAwdCtrlrEng01.TP_U8_TOD_MODE_WOT_OVER2" 0 /end CHARACTERISTIC
/begin CHARACTERISTIC TP_U8_TOD_MODE_WOT_STABL "TOD Control Mode, while driving with wide open throttle, for stable" VALUE 0x8003A6D6 CalPrmAwdCtrlrEng_UBYTE 0 Gain 0 255 SYMBOL_LINK "CalPrmAwdCtrlrEng01.TP_U8_TOD_MODE_WOT_STABL" 0 /end CHARACTERISTIC
/begin CHARACTERISTIC TP_U8_TOD_MODE_WOT_UNDER1 "TOD Control Mode, while driving with wide open throttle, for understeer" VALUE 0x8003A6D7 CalPrmAwdCtrlrEng_UBYTE 0 Gain 0 255 SYMBOL_LINK "CalPrmAwdCtrlrEng01.TP_U8_TOD_MODE_WOT_UNDER1" 0 /end CHARACTERISTIC
/begin CHARACTERISTIC TP_U8_TOD_MODE_WOT_UNDER2 "TOD Control Mode, while driving with wide open throttle, for severe understeer" VALUE 0x8003A6D8 CalPrmAwdCtrlrEng_UBYTE 0 Gain 0 255 SYMBOL_LINK "CalPrmAwdCtrlrEng01.TP_U8_TOD_MODE_WOT_UNDER2" 0 /end CHARACTERISTIC
/begin CHARACTERISTIC TP_U8_TORQ_HOLD_LV_IN_EDC_S1 "" VALUE 0x8003A130 CalPrmWslcEng_UBYTE 0 Perc9 0 25.5 SYMBOL_LINK "CalPrmWslcEng01.TP_U8_TORQ_HOLD_LV_IN_EDC_S1" 0 /end CHARACTERISTIC
/begin CHARACTERISTIC TP_U8_TORQ_HOLD_LV_IN_EDC_S2 "" VALUE 0x8003A131 CalPrmWslcEng_UBYTE 0 Perc9 0 25.5 SYMBOL_LINK "CalPrmWslcEng01.TP_U8_TORQ_HOLD_LV_IN_EDC_S2" 0 /end CHARACTERISTIC
/begin CHARACTERISTIC TP_U8_TORQ_HOLD_LV_IN_EDC_S3 "" VALUE 0x8003A132 CalPrmWslcEng_UBYTE 0 Perc9 0 25.5 SYMBOL_LINK "CalPrmWslcEng01.TP_U8_TORQ_HOLD_LV_IN_EDC_S3" 0 /end CHARACTERISTIC
/begin CHARACTERISTIC TP_U8_TORQ_HOLD_LV_IN_EDC_S4 "" VALUE 0x8003A133 CalPrmWslcEng_UBYTE 0 Perc9 0 25.5 SYMBOL_LINK "CalPrmWslcEng01.TP_U8_TORQ_HOLD_LV_IN_EDC_S4" 0 /end CHARACTERISTIC
/begin CHARACTERISTIC TP_U8_TORQ_UP_LIMIT_ABS "" VALUE 0x8003A134 CalPrmWslcEng_UBYTE 0 Perc6 0 255 SYMBOL_LINK "CalPrmWslcEng01.TP_U8_TORQ_UP_LIMIT_ABS" 0 /end CHARACTERISTIC
/begin CHARACTERISTIC TP_U8_TORQ_UP_LIMIT_ABS_HIGH_MU "" VALUE 0x8003A135 CalPrmWslcEng_UBYTE 0 Perc6 0 255 SYMBOL_LINK "CalPrmWslcEng01.TP_U8_TORQ_UP_LIMIT_ABS_HIGH_MU" 0 /end CHARACTERISTIC
/begin CHARACTERISTIC TP_U8_TORQ_UP_LIMIT_ESC "" VALUE 0x8003A136 CalPrmWslcEng_UBYTE 0 Perc6 0 255 SYMBOL_LINK "CalPrmWslcEng01.TP_U8_TORQ_UP_LIMIT_ESC" 0 /end CHARACTERISTIC
/begin CHARACTERISTIC TP_U8_TORQ_UP_LIMIT_SOLO "" VALUE 0x8003A137 CalPrmWslcEng_UBYTE 0 Perc6 0 255 SYMBOL_LINK "CalPrmWslcEng01.TP_U8_TORQ_UP_LIMIT_SOLO" 0 /end CHARACTERISTIC
/begin CHARACTERISTIC TP_U8_VEL_GAP_MOVING_WINDOW_LENGTH "" VALUE 0x8003A149 CalPrmWslcEng_UBYTE 0 Gain 0 255 SYMBOL_LINK "CalPrmWslcEng01.TP_U8_VEL_GAP_MOVING_WINDOW_LENGTH" 0 /end CHARACTERISTIC
/begin CHARACTERISTIC TP_ZS16BTCSCpReserved01 "" VALUE 0x8003A360 CalPrmWspcEng_SWORD 0 Gain -32768 32767 SYMBOL_LINK "CalPrmWspcEng01.TP_ZS16BTCSCpReserved01" 0 /end CHARACTERISTIC
/begin CHARACTERISTIC TP_ZS16BTCSCpReserved02 "" VALUE 0x8003A362 CalPrmWspcEng_SWORD 0 Gain -32768 32767 SYMBOL_LINK "CalPrmWspcEng01.TP_ZS16BTCSCpReserved02" 0 /end CHARACTERISTIC
/begin CHARACTERISTIC TP_ZS16BTCSCpReserved03 "" VALUE 0x8003A364 CalPrmWspcEng_SWORD 0 Gain -32768 32767 SYMBOL_LINK "CalPrmWspcEng01.TP_ZS16BTCSCpReserved03" 0 /end CHARACTERISTIC
/begin CHARACTERISTIC TP_ZS16BTCSCpReserved04 "" VALUE 0x8003A366 CalPrmWspcEng_SWORD 0 Gain -32768 32767 SYMBOL_LINK "CalPrmWspcEng01.TP_ZS16BTCSCpReserved04" 0 /end CHARACTERISTIC
/begin CHARACTERISTIC TP_ZS16BTCSCpReserved05 "" VALUE 0x8003A368 CalPrmWspcEng_SWORD 0 Gain -32768 32767 SYMBOL_LINK "CalPrmWspcEng01.TP_ZS16BTCSCpReserved05" 0 /end CHARACTERISTIC
/begin CHARACTERISTIC TP_ZS16BTCSCpReserved06 "" VALUE 0x8003A36A CalPrmWspcEng_SWORD 0 Gain -32768 32767 SYMBOL_LINK "CalPrmWspcEng01.TP_ZS16BTCSCpReserved06" 0 /end CHARACTERISTIC
/begin CHARACTERISTIC TP_ZS16BTCSCpReserved07 "" VALUE 0x8003A36C CalPrmWspcEng_SWORD 0 Gain -32768 32767 SYMBOL_LINK "CalPrmWspcEng01.TP_ZS16BTCSCpReserved07" 0 /end CHARACTERISTIC
/begin CHARACTERISTIC TP_ZS16BTCSCpReserved08 "" VALUE 0x8003A36E CalPrmWspcEng_SWORD 0 Gain -32768 32767 SYMBOL_LINK "CalPrmWspcEng01.TP_ZS16BTCSCpReserved08" 0 /end CHARACTERISTIC
/begin CHARACTERISTIC TP_ZS16BTCSCpReserved09 "" VALUE 0x8003A370 CalPrmWspcEng_SWORD 0 Gain -32768 32767 SYMBOL_LINK "CalPrmWspcEng01.TP_ZS16BTCSCpReserved09" 0 /end CHARACTERISTIC
/begin CHARACTERISTIC TP_ZS16BTCSCpReserved10 "" VALUE 0x8003A372 CalPrmWspcEng_SWORD 0 Gain -32768 32767 SYMBOL_LINK "CalPrmWspcEng01.TP_ZS16BTCSCpReserved10" 0 /end CHARACTERISTIC
/begin CHARACTERISTIC TP_ZS16BTCSCpReserved11 "" VALUE 0x8003A374 CalPrmWspcEng_SWORD 0 Gain -32768 32767 SYMBOL_LINK "CalPrmWspcEng01.TP_ZS16BTCSCpReserved11" 0 /end CHARACTERISTIC
/begin CHARACTERISTIC TP_ZS16BTCSCpReserved12 "" VALUE 0x8003A376 CalPrmWspcEng_SWORD 0 Gain -32768 32767 SYMBOL_LINK "CalPrmWspcEng01.TP_ZS16BTCSCpReserved12" 0 /end CHARACTERISTIC
/begin CHARACTERISTIC TP_ZS16BTCSCpReserved13 "" VALUE 0x8003A378 CalPrmWspcEng_SWORD 0 Gain -32768 32767 SYMBOL_LINK "CalPrmWspcEng01.TP_ZS16BTCSCpReserved13" 0 /end CHARACTERISTIC
/begin CHARACTERISTIC TP_ZS16BTCSCpReserved14 "" VALUE 0x8003A37A CalPrmWspcEng_SWORD 0 Gain -32768 32767 SYMBOL_LINK "CalPrmWspcEng01.TP_ZS16BTCSCpReserved14" 0 /end CHARACTERISTIC
/begin CHARACTERISTIC TP_ZS16BTCSCpReserved15 "" VALUE 0x8003A37C CalPrmWspcEng_SWORD 0 Gain -32768 32767 SYMBOL_LINK "CalPrmWspcEng01.TP_ZS16BTCSCpReserved15" 0 /end CHARACTERISTIC
/begin CHARACTERISTIC TP_ZS16BTCSCpReserved16 "" VALUE 0x8003A37E CalPrmWspcEng_SWORD 0 Gain -32768 32767 SYMBOL_LINK "CalPrmWspcEng01.TP_ZS16BTCSCpReserved16" 0 /end CHARACTERISTIC
/begin CHARACTERISTIC TP_ZS16BTCSCpReserved17 "" VALUE 0x8003A380 CalPrmWspcEng_SWORD 0 Gain -32768 32767 SYMBOL_LINK "CalPrmWspcEng01.TP_ZS16BTCSCpReserved17" 0 /end CHARACTERISTIC
/begin CHARACTERISTIC TP_ZS16BTCSCpReserved18 "" VALUE 0x8003A382 CalPrmWspcEng_SWORD 0 Gain -32768 32767 SYMBOL_LINK "CalPrmWspcEng01.TP_ZS16BTCSCpReserved18" 0 /end CHARACTERISTIC
/begin CHARACTERISTIC TP_ZS16BTCSCpReserved19 "" VALUE 0x8003A384 CalPrmWspcEng_SWORD 0 Gain -32768 32767 SYMBOL_LINK "CalPrmWspcEng01.TP_ZS16BTCSCpReserved19" 0 /end CHARACTERISTIC
/begin CHARACTERISTIC TP_ZS16BTCSCpReserved20 "" VALUE 0x8003A386 CalPrmWspcEng_SWORD 0 Gain -32768 32767 SYMBOL_LINK "CalPrmWspcEng01.TP_ZS16BTCSCpReserved20" 0 /end CHARACTERISTIC
/begin CHARACTERISTIC TP_ZS16ETCSCpReserved01 "" VALUE 0x8003A67C CalPrmWspcEng_SWORD 0 Gain -32768 32767 SYMBOL_LINK "CalPrmWspcEng01.TP_ZS16ETCSCpReserved01" 0 /end CHARACTERISTIC
/begin CHARACTERISTIC TP_ZS16ETCSCpReserved02 "" VALUE 0x8003A67E CalPrmWspcEng_SWORD 0 Gain -32768 32767 SYMBOL_LINK "CalPrmWspcEng01.TP_ZS16ETCSCpReserved02" 0 /end CHARACTERISTIC
/begin CHARACTERISTIC TP_ZS16ETCSCpReserved03 "" VALUE 0x8003A680 CalPrmWspcEng_SWORD 0 Gain -32768 32767 SYMBOL_LINK "CalPrmWspcEng01.TP_ZS16ETCSCpReserved03" 0 /end CHARACTERISTIC
/begin CHARACTERISTIC TP_ZS16ETCSCpReserved04 "" VALUE 0x8003A682 CalPrmWspcEng_SWORD 0 Gain -32768 32767 SYMBOL_LINK "CalPrmWspcEng01.TP_ZS16ETCSCpReserved04" 0 /end CHARACTERISTIC
/begin CHARACTERISTIC TP_ZS16ETCSCpReserved05 "" VALUE 0x8003A684 CalPrmWspcEng_SWORD 0 Gain -32768 32767 SYMBOL_LINK "CalPrmWspcEng01.TP_ZS16ETCSCpReserved05" 0 /end CHARACTERISTIC
/begin CHARACTERISTIC TP_ZS16ETCSCpReserved06 "" VALUE 0x8003A686 CalPrmWspcEng_SWORD 0 Gain -32768 32767 SYMBOL_LINK "CalPrmWspcEng01.TP_ZS16ETCSCpReserved06" 0 /end CHARACTERISTIC
/begin CHARACTERISTIC TP_ZS16ETCSCpReserved07 "" VALUE 0x8003A688 CalPrmWspcEng_SWORD 0 Gain -32768 32767 SYMBOL_LINK "CalPrmWspcEng01.TP_ZS16ETCSCpReserved07" 0 /end CHARACTERISTIC
/begin CHARACTERISTIC TP_ZS16ETCSCpReserved08 "" VALUE 0x8003A68A CalPrmWspcEng_SWORD 0 Gain -32768 32767 SYMBOL_LINK "CalPrmWspcEng01.TP_ZS16ETCSCpReserved08" 0 /end CHARACTERISTIC
/begin CHARACTERISTIC TP_ZS16ETCSCpReserved09 "" VALUE 0x8003A68C CalPrmWspcEng_SWORD 0 Gain -32768 32767 SYMBOL_LINK "CalPrmWspcEng01.TP_ZS16ETCSCpReserved09" 0 /end CHARACTERISTIC
/begin CHARACTERISTIC TP_ZS16ETCSCpReserved10 "" VALUE 0x8003A68E CalPrmWspcEng_SWORD 0 Gain -32768 32767 SYMBOL_LINK "CalPrmWspcEng01.TP_ZS16ETCSCpReserved10" 0 /end CHARACTERISTIC
/begin CHARACTERISTIC TP_ZS16ETCSCpReserved11 "" VALUE 0x8003A690 CalPrmWspcEng_SWORD 0 Gain -32768 32767 SYMBOL_LINK "CalPrmWspcEng01.TP_ZS16ETCSCpReserved11" 0 /end CHARACTERISTIC
/begin CHARACTERISTIC TP_ZS16ETCSCpReserved12 "" VALUE 0x8003A692 CalPrmWspcEng_SWORD 0 Gain -32768 32767 SYMBOL_LINK "CalPrmWspcEng01.TP_ZS16ETCSCpReserved12" 0 /end CHARACTERISTIC
/begin CHARACTERISTIC TP_ZS16ETCSCpReserved13 "" VALUE 0x8003A694 CalPrmWspcEng_SWORD 0 Gain -32768 32767 SYMBOL_LINK "CalPrmWspcEng01.TP_ZS16ETCSCpReserved13" 0 /end CHARACTERISTIC
/begin CHARACTERISTIC TP_ZS16ETCSCpReserved14 "" VALUE 0x8003A696 CalPrmWspcEng_SWORD 0 Gain -32768 32767 SYMBOL_LINK "CalPrmWspcEng01.TP_ZS16ETCSCpReserved14" 0 /end CHARACTERISTIC
/begin CHARACTERISTIC TP_ZS16ETCSCpReserved15 "" VALUE 0x8003A698 CalPrmWspcEng_SWORD 0 Gain -32768 32767 SYMBOL_LINK "CalPrmWspcEng01.TP_ZS16ETCSCpReserved15" 0 /end CHARACTERISTIC
/begin CHARACTERISTIC TP_ZS16ETCSCpReserved16 "" VALUE 0x8003A69A CalPrmWspcEng_SWORD 0 Gain -32768 32767 SYMBOL_LINK "CalPrmWspcEng01.TP_ZS16ETCSCpReserved16" 0 /end CHARACTERISTIC
/begin CHARACTERISTIC TP_ZS16ETCSCpReserved17 "" VALUE 0x8003A69C CalPrmWspcEng_SWORD 0 Gain -32768 32767 SYMBOL_LINK "CalPrmWspcEng01.TP_ZS16ETCSCpReserved17" 0 /end CHARACTERISTIC
/begin CHARACTERISTIC TP_ZS16ETCSCpReserved18 "" VALUE 0x8003A69E CalPrmWspcEng_SWORD 0 Gain -32768 32767 SYMBOL_LINK "CalPrmWspcEng01.TP_ZS16ETCSCpReserved18" 0 /end CHARACTERISTIC
/begin CHARACTERISTIC TP_ZS16ETCSCpReserved19 "" VALUE 0x8003A6A0 CalPrmWspcEng_SWORD 0 Gain -32768 32767 SYMBOL_LINK "CalPrmWspcEng01.TP_ZS16ETCSCpReserved19" 0 /end CHARACTERISTIC
/begin CHARACTERISTIC TP_ZS16ETCSCpReserved20 "" VALUE 0x8003A6A2 CalPrmWspcEng_SWORD 0 Gain -32768 32767 SYMBOL_LINK "CalPrmWspcEng01.TP_ZS16ETCSCpReserved20" 0 /end CHARACTERISTIC
/begin CHARACTERISTIC TP_ZS16ETCSCpReserved21 "" VALUE 0x8003A6A4 CalPrmWspcEng_SWORD 0 Gain -32768 32767 SYMBOL_LINK "CalPrmWspcEng01.TP_ZS16ETCSCpReserved21" 0 /end CHARACTERISTIC
/begin CHARACTERISTIC TP_ZS16ETCSCpReserved22 "" VALUE 0x8003A6A6 CalPrmWspcEng_SWORD 0 Gain -32768 32767 SYMBOL_LINK "CalPrmWspcEng01.TP_ZS16ETCSCpReserved22" 0 /end CHARACTERISTIC
/begin CHARACTERISTIC TQCW_S16_STR_RATIO_10_1st "" VALUE 0x80020086 CalPrmCmnBrk_SWORD 0 Gain -32768 32767 SYMBOL_LINK "CalPrmCmnBrk01.TQCW_S16_STR_RATIO_10_1st" 0 /end CHARACTERISTIC
/begin CHARACTERISTIC TQCW_S16_STR_RATIO_10_2nd "" VALUE 0x80020088 CalPrmCmnBrk_SWORD 0 Gain -32768 32767 SYMBOL_LINK "CalPrmCmnBrk01.TQCW_S16_STR_RATIO_10_2nd" 0 /end CHARACTERISTIC
/begin CHARACTERISTIC TQCW_S16_STR_RATIO_10_3rd "" VALUE 0x8002008A CalPrmCmnBrk_SWORD 0 Gain -32768 32767 SYMBOL_LINK "CalPrmCmnBrk01.TQCW_S16_STR_RATIO_10_3rd" 0 /end CHARACTERISTIC
/begin CHARACTERISTIC TQCW_S16_STR_RATIO_10_4th "" VALUE 0x8002008C CalPrmCmnBrk_SWORD 0 Gain -32768 32767 SYMBOL_LINK "CalPrmCmnBrk01.TQCW_S16_STR_RATIO_10_4th" 0 /end CHARACTERISTIC
/begin CHARACTERISTIC TQCW_S16_STR_RATIO_10_5th "" VALUE 0x8002008E CalPrmCmnBrk_SWORD 0 Gain -32768 32767 SYMBOL_LINK "CalPrmCmnBrk01.TQCW_S16_STR_RATIO_10_5th" 0 /end CHARACTERISTIC
/begin CHARACTERISTIC TQCW_S16_STR_RATIO_10_MAX "" VALUE 0x80020090 CalPrmCmnBrk_SWORD 0 Gain -32768 32767 SYMBOL_LINK "CalPrmCmnBrk01.TQCW_S16_STR_RATIO_10_MAX" 0 /end CHARACTERISTIC
/begin CHARACTERISTIC TQS16_ADM_VCH_NOMINAL "" VALUE 0x8002006C CalPrmCmnBrk_SWORD 0 Gain -32768 32767 SYMBOL_LINK "CalPrmCmnBrk01.TQS16_ADM_VCH_NOMINAL" 0 /end CHARACTERISTIC
/begin CHARACTERISTIC TQS16_BANK_ALAT_Roll_Gain "" VALUE 0x80020092 CalPrmCmnBrk_SWORD 0 Gain -32768 32767 SYMBOL_LINK "CalPrmCmnBrk01.TQS16_BANK_ALAT_Roll_Gain" 0 /end CHARACTERISTIC
/begin CHARACTERISTIC TQS16_CORNER_STIFF_FRONT "" VALUE 0x80020044 CalPrmCmnBrk_SWORD 0 Gain -32768 32767 SYMBOL_LINK "CalPrmCmnBrk01.TQS16_CORNER_STIFF_FRONT" 0 /end CHARACTERISTIC
/begin CHARACTERISTIC TQS16_CORNER_STIFF_REAR "" VALUE 0x80020046 CalPrmCmnBrk_SWORD 0 Gain -32768 32767 SYMBOL_LINK "CalPrmCmnBrk01.TQS16_CORNER_STIFF_REAR" 0 /end CHARACTERISTIC
/begin CHARACTERISTIC TQS16_DELTA_STEER_FOR_BANK "" VALUE 0x8002005E CalPrmCmnBrk_SWORD 0 Gain -32768 32767 SYMBOL_LINK "CalPrmCmnBrk01.TQS16_DELTA_STEER_FOR_BANK" 0 /end CHARACTERISTIC
/begin CHARACTERISTIC TQS16_EHC_ENTER_STEER_HM_100K "" VALUE 0x80020F08 CalPrmLatDynsCoorrBrk_SWORD 0 Gain -32768 32767 SYMBOL_LINK "CalPrmLatDynsCoorrBrk01.TQS16_EHC_ENTER_STEER_HM_100K" 0 /end CHARACTERISTIC
/begin CHARACTERISTIC TQS16_EHC_ENTER_STEER_HM_40K "" VALUE 0x80020F02 CalPrmLatDynsCoorrBrk_SWORD 0 Gain -32768 32767 SYMBOL_LINK "CalPrmLatDynsCoorrBrk01.TQS16_EHC_ENTER_STEER_HM_40K" 0 /end CHARACTERISTIC
/begin CHARACTERISTIC TQS16_EHC_ENTER_STEER_HM_60K "" VALUE 0x80020F04 CalPrmLatDynsCoorrBrk_SWORD 0 Gain -32768 32767 SYMBOL_LINK "CalPrmLatDynsCoorrBrk01.TQS16_EHC_ENTER_STEER_HM_60K" 0 /end CHARACTERISTIC
/begin CHARACTERISTIC TQS16_EHC_ENTER_STEER_HM_80K "" VALUE 0x80020F06 CalPrmLatDynsCoorrBrk_SWORD 0 Gain -32768 32767 SYMBOL_LINK "CalPrmLatDynsCoorrBrk01.TQS16_EHC_ENTER_STEER_HM_80K" 0 /end CHARACTERISTIC
/begin CHARACTERISTIC TQS16_EHC_ENTER_STEER_MM_100K "" VALUE 0x80020F00 CalPrmLatDynsCoorrBrk_SWORD 0 Gain -32768 32767 SYMBOL_LINK "CalPrmLatDynsCoorrBrk01.TQS16_EHC_ENTER_STEER_MM_100K" 0 /end CHARACTERISTIC
/begin CHARACTERISTIC TQS16_EHC_ENTER_STEER_MM_40K "" VALUE 0x80020EFA CalPrmLatDynsCoorrBrk_SWORD 0 Gain -32768 32767 SYMBOL_LINK "CalPrmLatDynsCoorrBrk01.TQS16_EHC_ENTER_STEER_MM_40K" 0 /end CHARACTERISTIC
/begin CHARACTERISTIC TQS16_EHC_ENTER_STEER_MM_60K "" VALUE 0x80020EFC CalPrmLatDynsCoorrBrk_SWORD 0 Gain -32768 32767 SYMBOL_LINK "CalPrmLatDynsCoorrBrk01.TQS16_EHC_ENTER_STEER_MM_60K" 0 /end CHARACTERISTIC
/begin CHARACTERISTIC TQS16_EHC_ENTER_STEER_MM_80K "" VALUE 0x80020EFE CalPrmLatDynsCoorrBrk_SWORD 0 Gain -32768 32767 SYMBOL_LINK "CalPrmLatDynsCoorrBrk01.TQS16_EHC_ENTER_STEER_MM_80K" 0 /end CHARACTERISTIC
/begin CHARACTERISTIC TQS16_EHC_TORQ_INC_100K "" VALUE 0x80020D1C CalPrmLatDynsCoorrBrk_SWORD 0 Gain -32768 32767 SYMBOL_LINK "CalPrmLatDynsCoorrBrk01.TQS16_EHC_TORQ_INC_100K" 0 /end CHARACTERISTIC
/begin CHARACTERISTIC TQS16_EHC_TORQ_INC_40K "" VALUE 0x80020D16 CalPrmLatDynsCoorrBrk_SWORD 0 Gain -32768 32767 SYMBOL_LINK "CalPrmLatDynsCoorrBrk01.TQS16_EHC_TORQ_INC_40K" 0 /end CHARACTERISTIC
/begin CHARACTERISTIC TQS16_EHC_TORQ_INC_60K "" VALUE 0x80020D18 CalPrmLatDynsCoorrBrk_SWORD 0 Gain -32768 32767 SYMBOL_LINK "CalPrmLatDynsCoorrBrk01.TQS16_EHC_TORQ_INC_60K" 0 /end CHARACTERISTIC
/begin CHARACTERISTIC TQS16_EHC_TORQ_INC_80K "" VALUE 0x80020D1A CalPrmLatDynsCoorrBrk_SWORD 0 Gain -32768 32767 SYMBOL_LINK "CalPrmLatDynsCoorrBrk01.TQS16_EHC_TORQ_INC_80K" 0 /end CHARACTERISTIC
/begin CHARACTERISTIC TQS16_EHC_TORQ_INC_MM_100K "" VALUE 0x80020EE8 CalPrmLatDynsCoorrBrk_SWORD 0 Gain -32768 32767 SYMBOL_LINK "CalPrmLatDynsCoorrBrk01.TQS16_EHC_TORQ_INC_MM_100K" 0 /end CHARACTERISTIC
/begin CHARACTERISTIC TQS16_EHC_TORQ_INC_MM_40K "" VALUE 0x80020EE2 CalPrmLatDynsCoorrBrk_SWORD 0 Gain -32768 32767 SYMBOL_LINK "CalPrmLatDynsCoorrBrk01.TQS16_EHC_TORQ_INC_MM_40K" 0 /end CHARACTERISTIC
/begin CHARACTERISTIC TQS16_EHC_TORQ_INC_MM_60K "" VALUE 0x80020EE4 CalPrmLatDynsCoorrBrk_SWORD 0 Gain -32768 32767 SYMBOL_LINK "CalPrmLatDynsCoorrBrk01.TQS16_EHC_TORQ_INC_MM_60K" 0 /end CHARACTERISTIC
/begin CHARACTERISTIC TQS16_EHC_TORQ_INC_MM_80K "" VALUE 0x80020EE6 CalPrmLatDynsCoorrBrk_SWORD 0 Gain -32768 32767 SYMBOL_LINK "CalPrmLatDynsCoorrBrk01.TQS16_EHC_TORQ_INC_MM_80K" 0 /end CHARACTERISTIC
/begin CHARACTERISTIC TQS16_EHC_WSTR_DOT_ENT_100K "" VALUE 0x80020CF4 CalPrmLatDynsCoorrBrk_SWORD 0 Gain -32768 32767 SYMBOL_LINK "CalPrmLatDynsCoorrBrk01.TQS16_EHC_WSTR_DOT_ENT_100K" 0 /end CHARACTERISTIC
/begin CHARACTERISTIC TQS16_EHC_WSTR_DOT_ENT_40K "" VALUE 0x80020CEE CalPrmLatDynsCoorrBrk_SWORD 0 Gain -32768 32767 SYMBOL_LINK "CalPrmLatDynsCoorrBrk01.TQS16_EHC_WSTR_DOT_ENT_40K" 0 /end CHARACTERISTIC
/begin CHARACTERISTIC TQS16_EHC_WSTR_DOT_ENT_60K "" VALUE 0x80020CF0 CalPrmLatDynsCoorrBrk_SWORD 0 Gain -32768 32767 SYMBOL_LINK "CalPrmLatDynsCoorrBrk01.TQS16_EHC_WSTR_DOT_ENT_60K" 0 /end CHARACTERISTIC
/begin CHARACTERISTIC TQS16_EHC_WSTR_DOT_ENT_80K "" VALUE 0x80020CF2 CalPrmLatDynsCoorrBrk_SWORD 0 Gain -32768 32767 SYMBOL_LINK "CalPrmLatDynsCoorrBrk01.TQS16_EHC_WSTR_DOT_ENT_80K" 0 /end CHARACTERISTIC
/begin CHARACTERISTIC TQS16_EHC_WSTR_DOT_ENT_MM_100K "" VALUE 0x80020EA8 CalPrmLatDynsCoorrBrk_SWORD 0 Gain -32768 32767 SYMBOL_LINK "CalPrmLatDynsCoorrBrk01.TQS16_EHC_WSTR_DOT_ENT_MM_100K" 0 /end CHARACTERISTIC
/begin CHARACTERISTIC TQS16_EHC_WSTR_DOT_ENT_MM_40K "" VALUE 0x80020EA2 CalPrmLatDynsCoorrBrk_SWORD 0 Gain -32768 32767 SYMBOL_LINK "CalPrmLatDynsCoorrBrk01.TQS16_EHC_WSTR_DOT_ENT_MM_40K" 0 /end CHARACTERISTIC
/begin CHARACTERISTIC TQS16_EHC_WSTR_DOT_ENT_MM_60K "" VALUE 0x80020EA4 CalPrmLatDynsCoorrBrk_SWORD 0 Gain -32768 32767 SYMBOL_LINK "CalPrmLatDynsCoorrBrk01.TQS16_EHC_WSTR_DOT_ENT_MM_60K" 0 /end CHARACTERISTIC
/begin CHARACTERISTIC TQS16_EHC_WSTR_DOT_ENT_MM_80K "" VALUE 0x80020EA6 CalPrmLatDynsCoorrBrk_SWORD 0 Gain -32768 32767 SYMBOL_LINK "CalPrmLatDynsCoorrBrk01.TQS16_EHC_WSTR_DOT_ENT_MM_80K" 0 /end CHARACTERISTIC
/begin CHARACTERISTIC TQS16_EHC_WSTR_DOT_EXT_100K "" VALUE 0x80020CFC CalPrmLatDynsCoorrBrk_SWORD 0 Gain -32768 32767 SYMBOL_LINK "CalPrmLatDynsCoorrBrk01.TQS16_EHC_WSTR_DOT_EXT_100K" 0 /end CHARACTERISTIC
/begin CHARACTERISTIC TQS16_EHC_WSTR_DOT_EXT_40K "" VALUE 0x80020CF6 CalPrmLatDynsCoorrBrk_SWORD 0 Gain -32768 32767 SYMBOL_LINK "CalPrmLatDynsCoorrBrk01.TQS16_EHC_WSTR_DOT_EXT_40K" 0 /end CHARACTERISTIC
/begin CHARACTERISTIC TQS16_EHC_WSTR_DOT_EXT_60K "" VALUE 0x80020CF8 CalPrmLatDynsCoorrBrk_SWORD 0 Gain -32768 32767 SYMBOL_LINK "CalPrmLatDynsCoorrBrk01.TQS16_EHC_WSTR_DOT_EXT_60K" 0 /end CHARACTERISTIC
/begin CHARACTERISTIC TQS16_EHC_WSTR_DOT_EXT_80K "" VALUE 0x80020CFA CalPrmLatDynsCoorrBrk_SWORD 0 Gain -32768 32767 SYMBOL_LINK "CalPrmLatDynsCoorrBrk01.TQS16_EHC_WSTR_DOT_EXT_80K" 0 /end CHARACTERISTIC
/begin CHARACTERISTIC TQS16_EHC_WSTR_DOT_EXT_MM_100K "" VALUE 0x80020EB0 CalPrmLatDynsCoorrBrk_SWORD 0 Gain -32768 32767 SYMBOL_LINK "CalPrmLatDynsCoorrBrk01.TQS16_EHC_WSTR_DOT_EXT_MM_100K" 0 /end CHARACTERISTIC
/begin CHARACTERISTIC TQS16_EHC_WSTR_DOT_EXT_MM_40K "" VALUE 0x80020EAA CalPrmLatDynsCoorrBrk_SWORD 0 Gain -32768 32767 SYMBOL_LINK "CalPrmLatDynsCoorrBrk01.TQS16_EHC_WSTR_DOT_EXT_MM_40K" 0 /end CHARACTERISTIC
/begin CHARACTERISTIC TQS16_EHC_WSTR_DOT_EXT_MM_60K "" VALUE 0x80020EAC CalPrmLatDynsCoorrBrk_SWORD 0 Gain -32768 32767 SYMBOL_LINK "CalPrmLatDynsCoorrBrk01.TQS16_EHC_WSTR_DOT_EXT_MM_60K" 0 /end CHARACTERISTIC
/begin CHARACTERISTIC TQS16_EHC_WSTR_DOT_EXT_MM_80K "" VALUE 0x80020EAE CalPrmLatDynsCoorrBrk_SWORD 0 Gain -32768 32767 SYMBOL_LINK "CalPrmLatDynsCoorrBrk01.TQS16_EHC_WSTR_DOT_EXT_MM_80K" 0 /end CHARACTERISTIC
/begin CHARACTERISTIC TQS16_EHC_WSTR_PEAK_HM_100K "" VALUE 0x80020EC8 CalPrmLatDynsCoorrBrk_SWORD 0 Gain -32768 32767 SYMBOL_LINK "CalPrmLatDynsCoorrBrk01.TQS16_EHC_WSTR_PEAK_HM_100K" 0 /end CHARACTERISTIC
/begin CHARACTERISTIC TQS16_EHC_WSTR_PEAK_HM_40K "" VALUE 0x80020EC2 CalPrmLatDynsCoorrBrk_SWORD 0 Gain -32768 32767 SYMBOL_LINK "CalPrmLatDynsCoorrBrk01.TQS16_EHC_WSTR_PEAK_HM_40K" 0 /end CHARACTERISTIC
/begin CHARACTERISTIC TQS16_EHC_WSTR_PEAK_HM_60K "" VALUE 0x80020EC4 CalPrmLatDynsCoorrBrk_SWORD 0 Gain -32768 32767 SYMBOL_LINK "CalPrmLatDynsCoorrBrk01.TQS16_EHC_WSTR_PEAK_HM_60K" 0 /end CHARACTERISTIC
/begin CHARACTERISTIC TQS16_EHC_WSTR_PEAK_HM_80K "" VALUE 0x80020EC6 CalPrmLatDynsCoorrBrk_SWORD 0 Gain -32768 32767 SYMBOL_LINK "CalPrmLatDynsCoorrBrk01.TQS16_EHC_WSTR_PEAK_HM_80K" 0 /end CHARACTERISTIC
/begin CHARACTERISTIC TQS16_EHC_WSTR_PEAK_MM_100K "" VALUE 0x80020ED0 CalPrmLatDynsCoorrBrk_SWORD 0 Gain -32768 32767 SYMBOL_LINK "CalPrmLatDynsCoorrBrk01.TQS16_EHC_WSTR_PEAK_MM_100K" 0 /end CHARACTERISTIC
/begin CHARACTERISTIC TQS16_EHC_WSTR_PEAK_MM_40K "" VALUE 0x80020ECA CalPrmLatDynsCoorrBrk_SWORD 0 Gain -32768 32767 SYMBOL_LINK "CalPrmLatDynsCoorrBrk01.TQS16_EHC_WSTR_PEAK_MM_40K" 0 /end CHARACTERISTIC
/begin CHARACTERISTIC TQS16_EHC_WSTR_PEAK_MM_60K "" VALUE 0x80020ECC CalPrmLatDynsCoorrBrk_SWORD 0 Gain -32768 32767 SYMBOL_LINK "CalPrmLatDynsCoorrBrk01.TQS16_EHC_WSTR_PEAK_MM_60K" 0 /end CHARACTERISTIC
/begin CHARACTERISTIC TQS16_EHC_WSTR_PEAK_MM_80K "" VALUE 0x80020ECE CalPrmLatDynsCoorrBrk_SWORD 0 Gain -32768 32767 SYMBOL_LINK "CalPrmLatDynsCoorrBrk01.TQS16_EHC_WSTR_PEAK_MM_80K" 0 /end CHARACTERISTIC
/begin CHARACTERISTIC TQS16_EHC_YAW_DOT_ENT_100K "" VALUE 0x80020D04 CalPrmLatDynsCoorrBrk_SWORD 0 Gain -32768 32767 SYMBOL_LINK "CalPrmLatDynsCoorrBrk01.TQS16_EHC_YAW_DOT_ENT_100K" 0 /end CHARACTERISTIC
/begin CHARACTERISTIC TQS16_EHC_YAW_DOT_ENT_40K "" VALUE 0x80020CFE CalPrmLatDynsCoorrBrk_SWORD 0 Gain -32768 32767 SYMBOL_LINK "CalPrmLatDynsCoorrBrk01.TQS16_EHC_YAW_DOT_ENT_40K" 0 /end CHARACTERISTIC
/begin CHARACTERISTIC TQS16_EHC_YAW_DOT_ENT_60K "" VALUE 0x80020D00 CalPrmLatDynsCoorrBrk_SWORD 0 Gain -32768 32767 SYMBOL_LINK "CalPrmLatDynsCoorrBrk01.TQS16_EHC_YAW_DOT_ENT_60K" 0 /end CHARACTERISTIC
/begin CHARACTERISTIC TQS16_EHC_YAW_DOT_ENT_80K "" VALUE 0x80020D02 CalPrmLatDynsCoorrBrk_SWORD 0 Gain -32768 32767 SYMBOL_LINK "CalPrmLatDynsCoorrBrk01.TQS16_EHC_YAW_DOT_ENT_80K" 0 /end CHARACTERISTIC
/begin CHARACTERISTIC TQS16_EHC_YAW_DOT_ENT_MM_100K "" VALUE 0x80020EB8 CalPrmLatDynsCoorrBrk_SWORD 0 Gain -32768 32767 SYMBOL_LINK "CalPrmLatDynsCoorrBrk01.TQS16_EHC_YAW_DOT_ENT_MM_100K" 0 /end CHARACTERISTIC
/begin CHARACTERISTIC TQS16_EHC_YAW_DOT_ENT_MM_40K "" VALUE 0x80020EB2 CalPrmLatDynsCoorrBrk_SWORD 0 Gain -32768 32767 SYMBOL_LINK "CalPrmLatDynsCoorrBrk01.TQS16_EHC_YAW_DOT_ENT_MM_40K" 0 /end CHARACTERISTIC
/begin CHARACTERISTIC TQS16_EHC_YAW_DOT_ENT_MM_60K "" VALUE 0x80020EB4 CalPrmLatDynsCoorrBrk_SWORD 0 Gain -32768 32767 SYMBOL_LINK "CalPrmLatDynsCoorrBrk01.TQS16_EHC_YAW_DOT_ENT_MM_60K" 0 /end CHARACTERISTIC
/begin CHARACTERISTIC TQS16_EHC_YAW_DOT_ENT_MM_80K "" VALUE 0x80020EB6 CalPrmLatDynsCoorrBrk_SWORD 0 Gain -32768 32767 SYMBOL_LINK "CalPrmLatDynsCoorrBrk01.TQS16_EHC_YAW_DOT_ENT_MM_80K" 0 /end CHARACTERISTIC
/begin CHARACTERISTIC TQS16_EHC_YAW_DOT_EXT_100K "" VALUE 0x80020D0C CalPrmLatDynsCoorrBrk_SWORD 0 Gain -32768 32767 SYMBOL_LINK "CalPrmLatDynsCoorrBrk01.TQS16_EHC_YAW_DOT_EXT_100K" 0 /end CHARACTERISTIC
/begin CHARACTERISTIC TQS16_EHC_YAW_DOT_EXT_40K "" VALUE 0x80020D06 CalPrmLatDynsCoorrBrk_SWORD 0 Gain -32768 32767 SYMBOL_LINK "CalPrmLatDynsCoorrBrk01.TQS16_EHC_YAW_DOT_EXT_40K" 0 /end CHARACTERISTIC
/begin CHARACTERISTIC TQS16_EHC_YAW_DOT_EXT_60K "" VALUE 0x80020D08 CalPrmLatDynsCoorrBrk_SWORD 0 Gain -32768 32767 SYMBOL_LINK "CalPrmLatDynsCoorrBrk01.TQS16_EHC_YAW_DOT_EXT_60K" 0 /end CHARACTERISTIC
/begin CHARACTERISTIC TQS16_EHC_YAW_DOT_EXT_80K "" VALUE 0x80020D0A CalPrmLatDynsCoorrBrk_SWORD 0 Gain -32768 32767 SYMBOL_LINK "CalPrmLatDynsCoorrBrk01.TQS16_EHC_YAW_DOT_EXT_80K" 0 /end CHARACTERISTIC
/begin CHARACTERISTIC TQS16_EHC_YAW_DOT_EXT_MM_100K "" VALUE 0x80020EC0 CalPrmLatDynsCoorrBrk_SWORD 0 Gain -32768 32767 SYMBOL_LINK "CalPrmLatDynsCoorrBrk01.TQS16_EHC_YAW_DOT_EXT_MM_100K" 0 /end CHARACTERISTIC
/begin CHARACTERISTIC TQS16_EHC_YAW_DOT_EXT_MM_40K "" VALUE 0x80020EBA CalPrmLatDynsCoorrBrk_SWORD 0 Gain -32768 32767 SYMBOL_LINK "CalPrmLatDynsCoorrBrk01.TQS16_EHC_YAW_DOT_EXT_MM_40K" 0 /end CHARACTERISTIC
/begin CHARACTERISTIC TQS16_EHC_YAW_DOT_EXT_MM_60K "" VALUE 0x80020EBC CalPrmLatDynsCoorrBrk_SWORD 0 Gain -32768 32767 SYMBOL_LINK "CalPrmLatDynsCoorrBrk01.TQS16_EHC_YAW_DOT_EXT_MM_60K" 0 /end CHARACTERISTIC
/begin CHARACTERISTIC TQS16_EHC_YAW_DOT_EXT_MM_80K "" VALUE 0x80020EBE CalPrmLatDynsCoorrBrk_SWORD 0 Gain -32768 32767 SYMBOL_LINK "CalPrmLatDynsCoorrBrk01.TQS16_EHC_YAW_DOT_EXT_MM_80K" 0 /end CHARACTERISTIC
/begin CHARACTERISTIC TQS16_EHC_YAW_PEAK_HM_100K "" VALUE 0x80020ED8 CalPrmLatDynsCoorrBrk_SWORD 0 Gain -32768 32767 SYMBOL_LINK "CalPrmLatDynsCoorrBrk01.TQS16_EHC_YAW_PEAK_HM_100K" 0 /end CHARACTERISTIC
/begin CHARACTERISTIC TQS16_EHC_YAW_PEAK_HM_40K "" VALUE 0x80020ED2 CalPrmLatDynsCoorrBrk_SWORD 0 Gain -32768 32767 SYMBOL_LINK "CalPrmLatDynsCoorrBrk01.TQS16_EHC_YAW_PEAK_HM_40K" 0 /end CHARACTERISTIC
/begin CHARACTERISTIC TQS16_EHC_YAW_PEAK_HM_60K "" VALUE 0x80020ED4 CalPrmLatDynsCoorrBrk_SWORD 0 Gain -32768 32767 SYMBOL_LINK "CalPrmLatDynsCoorrBrk01.TQS16_EHC_YAW_PEAK_HM_60K" 0 /end CHARACTERISTIC
/begin CHARACTERISTIC TQS16_EHC_YAW_PEAK_HM_80K "" VALUE 0x80020ED6 CalPrmLatDynsCoorrBrk_SWORD 0 Gain -32768 32767 SYMBOL_LINK "CalPrmLatDynsCoorrBrk01.TQS16_EHC_YAW_PEAK_HM_80K" 0 /end CHARACTERISTIC
/begin CHARACTERISTIC TQS16_EHC_YAW_PEAK_MM_100K "" VALUE 0x80020EE0 CalPrmLatDynsCoorrBrk_SWORD 0 Gain -32768 32767 SYMBOL_LINK "CalPrmLatDynsCoorrBrk01.TQS16_EHC_YAW_PEAK_MM_100K" 0 /end CHARACTERISTIC
/begin CHARACTERISTIC TQS16_EHC_YAW_PEAK_MM_40K "" VALUE 0x80020EDA CalPrmLatDynsCoorrBrk_SWORD 0 Gain -32768 32767 SYMBOL_LINK "CalPrmLatDynsCoorrBrk01.TQS16_EHC_YAW_PEAK_MM_40K" 0 /end CHARACTERISTIC
/begin CHARACTERISTIC TQS16_EHC_YAW_PEAK_MM_60K "" VALUE 0x80020EDC CalPrmLatDynsCoorrBrk_SWORD 0 Gain -32768 32767 SYMBOL_LINK "CalPrmLatDynsCoorrBrk01.TQS16_EHC_YAW_PEAK_MM_60K" 0 /end CHARACTERISTIC
/begin CHARACTERISTIC TQS16_EHC_YAW_PEAK_MM_80K "" VALUE 0x80020EDE CalPrmLatDynsCoorrBrk_SWORD 0 Gain -32768 32767 SYMBOL_LINK "CalPrmLatDynsCoorrBrk01.TQS16_EHC_YAW_PEAK_MM_80K" 0 /end CHARACTERISTIC
/begin CHARACTERISTIC TQS16_GAIN_BETA_D_BETA "" VALUE 0x80020020 CalPrmCmnBrk_SWORD 0 Gain -32768 32767 SYMBOL_LINK "CalPrmCmnBrk01.TQS16_GAIN_BETA_D_BETA" 0 /end CHARACTERISTIC
/begin CHARACTERISTIC TQS16_GAIN_BETA_D_DELTA "" VALUE 0x80020024 CalPrmCmnBrk_SWORD 0 Gain -32768 32767 SYMBOL_LINK "CalPrmCmnBrk01.TQS16_GAIN_BETA_D_DELTA" 0 /end CHARACTERISTIC
/begin CHARACTERISTIC TQS16_GAIN_YAW_D_BETA "" VALUE 0x80020026 CalPrmCmnBrk_SWORD 0 Gain -32768 32767 SYMBOL_LINK "CalPrmCmnBrk01.TQS16_GAIN_YAW_D_BETA" 0 /end CHARACTERISTIC
/begin CHARACTERISTIC TQS16_GAIN_YAW_D_DELTA "" VALUE 0x8002002A CalPrmCmnBrk_SWORD 0 Gain -32768 32767 SYMBOL_LINK "CalPrmCmnBrk01.TQS16_GAIN_YAW_D_DELTA" 0 /end CHARACTERISTIC
/begin CHARACTERISTIC TQS16_GAIN_YAW_D_YAW "" VALUE 0x80020028 CalPrmCmnBrk_SWORD 0 Gain -32768 32767 SYMBOL_LINK "CalPrmCmnBrk01.TQS16_GAIN_YAW_D_YAW" 0 /end CHARACTERISTIC
/begin CHARACTERISTIC TQS16_LAT_G_CAL_SCALE "" VALUE 0x8002002C CalPrmCmnBrk_SWORD 0 Gain -32768 32767 SYMBOL_LINK "CalPrmCmnBrk01.TQS16_LAT_G_CAL_SCALE" 0 /end CHARACTERISTIC
/begin CHARACTERISTIC TQS16_LAT_G_EXTRA_100 "" VALUE 0x80020066 CalPrmCmnBrk_SWORD 0 Gain -32768 32767 SYMBOL_LINK "CalPrmCmnBrk01.TQS16_LAT_G_EXTRA_100" 0 /end CHARACTERISTIC
/begin CHARACTERISTIC TQS16_LAT_G_EXTRA_120 "" VALUE 0x80020068 CalPrmCmnBrk_SWORD 0 Gain -32768 32767 SYMBOL_LINK "CalPrmCmnBrk01.TQS16_LAT_G_EXTRA_120" 0 /end CHARACTERISTIC
/begin CHARACTERISTIC TQS16_LAT_G_EXTRA_150 "" VALUE 0x8002006A CalPrmCmnBrk_SWORD 0 Gain -32768 32767 SYMBOL_LINK "CalPrmCmnBrk01.TQS16_LAT_G_EXTRA_150" 0 /end CHARACTERISTIC
/begin CHARACTERISTIC TQS16_LAT_G_EXTRA_40 "" VALUE 0x80020060 CalPrmCmnBrk_SWORD 0 Gain -32768 32767 SYMBOL_LINK "CalPrmCmnBrk01.TQS16_LAT_G_EXTRA_40" 0 /end CHARACTERISTIC
/begin CHARACTERISTIC TQS16_LAT_G_EXTRA_60 "" VALUE 0x80020062 CalPrmCmnBrk_SWORD 0 Gain -32768 32767 SYMBOL_LINK "CalPrmCmnBrk01.TQS16_LAT_G_EXTRA_60" 0 /end CHARACTERISTIC
/begin CHARACTERISTIC TQS16_LAT_G_EXTRA_80 "" VALUE 0x80020064 CalPrmCmnBrk_SWORD 0 Gain -32768 32767 SYMBOL_LINK "CalPrmCmnBrk01.TQS16_LAT_G_EXTRA_80" 0 /end CHARACTERISTIC
/begin CHARACTERISTIC TQS16_LAT_G_FILTER_100 "" VALUE 0x8002003C CalPrmCmnBrk_SWORD 0 Gain -32768 32767 SYMBOL_LINK "CalPrmCmnBrk01.TQS16_LAT_G_FILTER_100" 0 /end CHARACTERISTIC
/begin CHARACTERISTIC TQS16_LAT_G_FILTER_120 "" VALUE 0x8002003E CalPrmCmnBrk_SWORD 0 Gain -32768 32767 SYMBOL_LINK "CalPrmCmnBrk01.TQS16_LAT_G_FILTER_120" 0 /end CHARACTERISTIC
/begin CHARACTERISTIC TQS16_LAT_G_FILTER_150 "" VALUE 0x80020040 CalPrmCmnBrk_SWORD 0 Gain -32768 32767 SYMBOL_LINK "CalPrmCmnBrk01.TQS16_LAT_G_FILTER_150" 0 /end CHARACTERISTIC
/begin CHARACTERISTIC TQS16_LAT_G_FILTER_20 "" VALUE 0x80020034 CalPrmCmnBrk_SWORD 0 Gain -32768 32767 SYMBOL_LINK "CalPrmCmnBrk01.TQS16_LAT_G_FILTER_20" 0 /end CHARACTERISTIC
/begin CHARACTERISTIC TQS16_LAT_G_FILTER_40 "" VALUE 0x80020036 CalPrmCmnBrk_SWORD 0 Gain -32768 32767 SYMBOL_LINK "CalPrmCmnBrk01.TQS16_LAT_G_FILTER_40" 0 /end CHARACTERISTIC
/begin CHARACTERISTIC TQS16_LAT_G_FILTER_60 "" VALUE 0x80020038 CalPrmCmnBrk_SWORD 0 Gain -32768 32767 SYMBOL_LINK "CalPrmCmnBrk01.TQS16_LAT_G_FILTER_60" 0 /end CHARACTERISTIC
/begin CHARACTERISTIC TQS16_LAT_G_FILTER_80 "" VALUE 0x8002003A CalPrmCmnBrk_SWORD 0 Gain -32768 32767 SYMBOL_LINK "CalPrmCmnBrk01.TQS16_LAT_G_FILTER_80" 0 /end CHARACTERISTIC
/begin CHARACTERISTIC TQS16_LENGTH_CG_TO_FRONT "" VALUE 0x80020048 CalPrmCmnBrk_SWORD 0 Gain -32768 32767 SYMBOL_LINK "CalPrmCmnBrk01.TQS16_LENGTH_CG_TO_FRONT" 0 /end CHARACTERISTIC
/begin CHARACTERISTIC TQS16_LENGTH_CG_TO_REAR "" VALUE 0x8002004A CalPrmCmnBrk_SWORD 0 Gain -32768 32767 SYMBOL_LINK "CalPrmCmnBrk01.TQS16_LENGTH_CG_TO_REAR" 0 /end CHARACTERISTIC
/begin CHARACTERISTIC TQS16_MAX_ROAD_ADHESION "" VALUE 0x8002005C CalPrmCmnBrk_SWORD 0 Gain -32768 32767 SYMBOL_LINK "CalPrmCmnBrk01.TQS16_MAX_ROAD_ADHESION" 0 /end CHARACTERISTIC
/begin CHARACTERISTIC TQS16_MOMENT_OF_INERTIA "" VALUE 0x80020054 CalPrmCmnBrk_SWORD 0 Gain -32768 32767 SYMBOL_LINK "CalPrmCmnBrk01.TQS16_MOMENT_OF_INERTIA" 0 /end CHARACTERISTIC
/begin CHARACTERISTIC TQS16_STEERING_MAX_DEG "" VALUE 0x80020078 CalPrmCmnBrk_SWORD 0 Gain -32768 32767 SYMBOL_LINK "CalPrmCmnBrk01.TQS16_STEERING_MAX_DEG" 0 /end CHARACTERISTIC
/begin CHARACTERISTIC TQS16_STEERING_RATIO_10 "" VALUE 0x80020042 CalPrmCmnBrk_SWORD 0 Gain -32768 32767 SYMBOL_LINK "CalPrmCmnBrk01.TQS16_STEERING_RATIO_10" 0 /end CHARACTERISTIC
/begin CHARACTERISTIC TQS16_STR_1st_Point "" VALUE 0x8002006E CalPrmCmnBrk_SWORD 0 Gain -32768 32767 SYMBOL_LINK "CalPrmCmnBrk01.TQS16_STR_1st_Point" 0 /end CHARACTERISTIC
/begin CHARACTERISTIC TQS16_STR_2nd_Point "" VALUE 0x80020070 CalPrmCmnBrk_SWORD 0 Gain -32768 32767 SYMBOL_LINK "CalPrmCmnBrk01.TQS16_STR_2nd_Point" 0 /end CHARACTERISTIC
/begin CHARACTERISTIC TQS16_STR_3rd_Point "" VALUE 0x80020072 CalPrmCmnBrk_SWORD 0 Gain -32768 32767 SYMBOL_LINK "CalPrmCmnBrk01.TQS16_STR_3rd_Point" 0 /end CHARACTERISTIC
/begin CHARACTERISTIC TQS16_STR_4th_Point "" VALUE 0x80020074 CalPrmCmnBrk_SWORD 0 Gain -32768 32767 SYMBOL_LINK "CalPrmCmnBrk01.TQS16_STR_4th_Point" 0 /end CHARACTERISTIC
/begin CHARACTERISTIC TQS16_STR_5th_Point "" VALUE 0x80020076 CalPrmCmnBrk_SWORD 0 Gain -32768 32767 SYMBOL_LINK "CalPrmCmnBrk01.TQS16_STR_5th_Point" 0 /end CHARACTERISTIC
/begin CHARACTERISTIC TQS16_STR_RATIO_10_1st "" VALUE 0x8002007A CalPrmCmnBrk_SWORD 0 Gain -32768 32767 SYMBOL_LINK "CalPrmCmnBrk01.TQS16_STR_RATIO_10_1st" 0 /end CHARACTERISTIC
/begin CHARACTERISTIC TQS16_STR_RATIO_10_2nd "" VALUE 0x8002007C CalPrmCmnBrk_SWORD 0 Gain -32768 32767 SYMBOL_LINK "CalPrmCmnBrk01.TQS16_STR_RATIO_10_2nd" 0 /end CHARACTERISTIC
/begin CHARACTERISTIC TQS16_STR_RATIO_10_3rd "" VALUE 0x8002007E CalPrmCmnBrk_SWORD 0 Gain -32768 32767 SYMBOL_LINK "CalPrmCmnBrk01.TQS16_STR_RATIO_10_3rd" 0 /end CHARACTERISTIC
/begin CHARACTERISTIC TQS16_STR_RATIO_10_4th "" VALUE 0x80020080 CalPrmCmnBrk_SWORD 0 Gain -32768 32767 SYMBOL_LINK "CalPrmCmnBrk01.TQS16_STR_RATIO_10_4th" 0 /end CHARACTERISTIC
/begin CHARACTERISTIC TQS16_STR_RATIO_10_5th "" VALUE 0x80020082 CalPrmCmnBrk_SWORD 0 Gain -32768 32767 SYMBOL_LINK "CalPrmCmnBrk01.TQS16_STR_RATIO_10_5th" 0 /end CHARACTERISTIC
/begin CHARACTERISTIC TQS16_STR_RATIO_10_MAX "" VALUE 0x80020084 CalPrmCmnBrk_SWORD 0 Gain -32768 32767 SYMBOL_LINK "CalPrmCmnBrk01.TQS16_STR_RATIO_10_MAX" 0 /end CHARACTERISTIC
/begin CHARACTERISTIC TQS16_UNDERSTEER_GRADIENT "" VALUE 0x8002005A CalPrmCmnBrk_SWORD 0 Gain -32768 32767 SYMBOL_LINK "CalPrmCmnBrk01.TQS16_UNDERSTEER_GRADIENT" 0 /end CHARACTERISTIC
/begin CHARACTERISTIC TQS16_VEHICLE_MASS_FL "" VALUE 0x8002004C CalPrmCmnBrk_SWORD 0 Gain -32768 32767 SYMBOL_LINK "CalPrmCmnBrk01.TQS16_VEHICLE_MASS_FL" 0 /end CHARACTERISTIC
/begin CHARACTERISTIC TQS16_VEHICLE_MASS_FR "" VALUE 0x8002004E CalPrmCmnBrk_SWORD 0 Gain -32768 32767 SYMBOL_LINK "CalPrmCmnBrk01.TQS16_VEHICLE_MASS_FR" 0 /end CHARACTERISTIC
/begin CHARACTERISTIC TQS16_VEHICLE_MASS_RL "" VALUE 0x80020050 CalPrmCmnBrk_SWORD 0 Gain -32768 32767 SYMBOL_LINK "CalPrmCmnBrk01.TQS16_VEHICLE_MASS_RL" 0 /end CHARACTERISTIC
/begin CHARACTERISTIC TQS16_VEHICLE_MASS_RR "" VALUE 0x80020052 CalPrmCmnBrk_SWORD 0 Gain -32768 32767 SYMBOL_LINK "CalPrmCmnBrk01.TQS16_VEHICLE_MASS_RR" 0 /end CHARACTERISTIC
/begin CHARACTERISTIC TQS16_WHEEL_TREAD_FRONT "" VALUE 0x80020056 CalPrmCmnBrk_SWORD 0 Gain -32768 32767 SYMBOL_LINK "CalPrmCmnBrk01.TQS16_WHEEL_TREAD_FRONT" 0 /end CHARACTERISTIC
/begin CHARACTERISTIC TQS16_WHEEL_TREAD_REAR "" VALUE 0x80020058 CalPrmCmnBrk_SWORD 0 Gain -32768 32767 SYMBOL_LINK "CalPrmCmnBrk01.TQS16_WHEEL_TREAD_REAR" 0 /end CHARACTERISTIC
/begin CHARACTERISTIC TQS16_YAWC_FILTER_20 "" VALUE 0x8002002E CalPrmCmnBrk_SWORD 0 Gain -32768 32767 SYMBOL_LINK "CalPrmCmnBrk01.TQS16_YAWC_FILTER_20" 0 /end CHARACTERISTIC
/begin CHARACTERISTIC TQS16_YAWC_FILTER_40 "" VALUE 0x80020030 CalPrmCmnBrk_SWORD 0 Gain -32768 32767 SYMBOL_LINK "CalPrmCmnBrk01.TQS16_YAWC_FILTER_40" 0 /end CHARACTERISTIC
/begin CHARACTERISTIC TQS16_YAWC_FILTER_60 "" VALUE 0x80020032 CalPrmCmnBrk_SWORD 0 Gain -32768 32767 SYMBOL_LINK "CalPrmCmnBrk01.TQS16_YAWC_FILTER_60" 0 /end CHARACTERISTIC
/begin CHARACTERISTIC TQS16_Yawm_Filter_Gain_120kph "" VALUE 0x80020098 CalPrmCmnBrk_SWORD 0 Gain -32768 32767 SYMBOL_LINK "CalPrmCmnBrk01.TQS16_Yawm_Filter_Gain_120kph" 0 /end CHARACTERISTIC
/begin CHARACTERISTIC TQS16_Yawm_Filter_Gain_150kph "" VALUE 0x8002009A CalPrmCmnBrk_SWORD 0 Gain -32768 32767 SYMBOL_LINK "CalPrmCmnBrk01.TQS16_Yawm_Filter_Gain_150kph" 0 /end CHARACTERISTIC
/begin CHARACTERISTIC TQS16_Yawm_Filter_Gain_60kph "" VALUE 0x80020094 CalPrmCmnBrk_SWORD 0 Gain -32768 32767 SYMBOL_LINK "CalPrmCmnBrk01.TQS16_Yawm_Filter_Gain_60kph" 0 /end CHARACTERISTIC
/begin CHARACTERISTIC TQS16_Yawm_Filter_Gain_90kph "" VALUE 0x80020096 CalPrmCmnBrk_SWORD 0 Gain -32768 32767 SYMBOL_LINK "CalPrmCmnBrk01.TQS16_Yawm_Filter_Gain_90kph" 0 /end CHARACTERISTIC
/begin CHARACTERISTIC TQU16_GAIN_BETA_D_YAW "" VALUE 0x80020022 CalPrmCmnBrk_UWORD 0 Gain 0 65535 SYMBOL_LINK "CalPrmCmnBrk01.TQU16_GAIN_BETA_D_YAW" 0 /end CHARACTERISTIC
/begin CHARACTERISTIC TQYc_Map[0][0] "" VALUE 0x8002009C CalPrmCmnBrk_SWORD 0 Gain -32768 32767 SYMBOL_LINK "CalPrmCmnBrk01.TQYc_Map[0][0]" 0 /end CHARACTERISTIC
/begin CHARACTERISTIC TQYc_Map[0][10] "" VALUE 0x800200B0 CalPrmCmnBrk_SWORD 0 Gain -32768 32767 SYMBOL_LINK "CalPrmCmnBrk01.TQYc_Map[0][10]" 0 /end CHARACTERISTIC
/begin CHARACTERISTIC TQYc_Map[0][11] "" VALUE 0x800200B2 CalPrmCmnBrk_SWORD 0 Gain -32768 32767 SYMBOL_LINK "CalPrmCmnBrk01.TQYc_Map[0][11]" 0 /end CHARACTERISTIC
/begin CHARACTERISTIC TQYc_Map[0][1] "" VALUE 0x8002009E CalPrmCmnBrk_SWORD 0 Gain -32768 32767 SYMBOL_LINK "CalPrmCmnBrk01.TQYc_Map[0][1]" 0 /end CHARACTERISTIC
/begin CHARACTERISTIC TQYc_Map[0][2] "" VALUE 0x800200A0 CalPrmCmnBrk_SWORD 0 Gain -32768 32767 SYMBOL_LINK "CalPrmCmnBrk01.TQYc_Map[0][2]" 0 /end CHARACTERISTIC
/begin CHARACTERISTIC TQYc_Map[0][3] "" VALUE 0x800200A2 CalPrmCmnBrk_SWORD 0 Gain -32768 32767 SYMBOL_LINK "CalPrmCmnBrk01.TQYc_Map[0][3]" 0 /end CHARACTERISTIC
/begin CHARACTERISTIC TQYc_Map[0][4] "" VALUE 0x800200A4 CalPrmCmnBrk_SWORD 0 Gain -32768 32767 SYMBOL_LINK "CalPrmCmnBrk01.TQYc_Map[0][4]" 0 /end CHARACTERISTIC
/begin CHARACTERISTIC TQYc_Map[0][5] "" VALUE 0x800200A6 CalPrmCmnBrk_SWORD 0 Gain -32768 32767 SYMBOL_LINK "CalPrmCmnBrk01.TQYc_Map[0][5]" 0 /end CHARACTERISTIC
/begin CHARACTERISTIC TQYc_Map[0][6] "" VALUE 0x800200A8 CalPrmCmnBrk_SWORD 0 Gain -32768 32767 SYMBOL_LINK "CalPrmCmnBrk01.TQYc_Map[0][6]" 0 /end CHARACTERISTIC
/begin CHARACTERISTIC TQYc_Map[0][7] "" VALUE 0x800200AA CalPrmCmnBrk_SWORD 0 Gain -32768 32767 SYMBOL_LINK "CalPrmCmnBrk01.TQYc_Map[0][7]" 0 /end CHARACTERISTIC
/begin CHARACTERISTIC TQYc_Map[0][8] "" VALUE 0x800200AC CalPrmCmnBrk_SWORD 0 Gain -32768 32767 SYMBOL_LINK "CalPrmCmnBrk01.TQYc_Map[0][8]" 0 /end CHARACTERISTIC
/begin CHARACTERISTIC TQYc_Map[0][9] "" VALUE 0x800200AE CalPrmCmnBrk_SWORD 0 Gain -32768 32767 SYMBOL_LINK "CalPrmCmnBrk01.TQYc_Map[0][9]" 0 /end CHARACTERISTIC
/begin CHARACTERISTIC TQYc_Map[10][0] "" VALUE 0x8002018C CalPrmCmnBrk_SWORD 0 Gain -32768 32767 SYMBOL_LINK "CalPrmCmnBrk01.TQYc_Map[10][0]" 0 /end CHARACTERISTIC
/begin CHARACTERISTIC TQYc_Map[10][10] "" VALUE 0x800201A0 CalPrmCmnBrk_SWORD 0 Gain -32768 32767 SYMBOL_LINK "CalPrmCmnBrk01.TQYc_Map[10][10]" 0 /end CHARACTERISTIC
/begin CHARACTERISTIC TQYc_Map[10][11] "" VALUE 0x800201A2 CalPrmCmnBrk_SWORD 0 Gain -32768 32767 SYMBOL_LINK "CalPrmCmnBrk01.TQYc_Map[10][11]" 0 /end CHARACTERISTIC
/begin CHARACTERISTIC TQYc_Map[10][1] "" VALUE 0x8002018E CalPrmCmnBrk_SWORD 0 Gain -32768 32767 SYMBOL_LINK "CalPrmCmnBrk01.TQYc_Map[10][1]" 0 /end CHARACTERISTIC
/begin CHARACTERISTIC TQYc_Map[10][2] "" VALUE 0x80020190 CalPrmCmnBrk_SWORD 0 Gain -32768 32767 SYMBOL_LINK "CalPrmCmnBrk01.TQYc_Map[10][2]" 0 /end CHARACTERISTIC
/begin CHARACTERISTIC TQYc_Map[10][3] "" VALUE 0x80020192 CalPrmCmnBrk_SWORD 0 Gain -32768 32767 SYMBOL_LINK "CalPrmCmnBrk01.TQYc_Map[10][3]" 0 /end CHARACTERISTIC
/begin CHARACTERISTIC TQYc_Map[10][4] "" VALUE 0x80020194 CalPrmCmnBrk_SWORD 0 Gain -32768 32767 SYMBOL_LINK "CalPrmCmnBrk01.TQYc_Map[10][4]" 0 /end CHARACTERISTIC
/begin CHARACTERISTIC TQYc_Map[10][5] "" VALUE 0x80020196 CalPrmCmnBrk_SWORD 0 Gain -32768 32767 SYMBOL_LINK "CalPrmCmnBrk01.TQYc_Map[10][5]" 0 /end CHARACTERISTIC
/begin CHARACTERISTIC TQYc_Map[10][6] "" VALUE 0x80020198 CalPrmCmnBrk_SWORD 0 Gain -32768 32767 SYMBOL_LINK "CalPrmCmnBrk01.TQYc_Map[10][6]" 0 /end CHARACTERISTIC
/begin CHARACTERISTIC TQYc_Map[10][7] "" VALUE 0x8002019A CalPrmCmnBrk_SWORD 0 Gain -32768 32767 SYMBOL_LINK "CalPrmCmnBrk01.TQYc_Map[10][7]" 0 /end CHARACTERISTIC
/begin CHARACTERISTIC TQYc_Map[10][8] "" VALUE 0x8002019C CalPrmCmnBrk_SWORD 0 Gain -32768 32767 SYMBOL_LINK "CalPrmCmnBrk01.TQYc_Map[10][8]" 0 /end CHARACTERISTIC
/begin CHARACTERISTIC TQYc_Map[10][9] "" VALUE 0x8002019E CalPrmCmnBrk_SWORD 0 Gain -32768 32767 SYMBOL_LINK "CalPrmCmnBrk01.TQYc_Map[10][9]" 0 /end CHARACTERISTIC
/begin CHARACTERISTIC TQYc_Map[11][0] "" VALUE 0x800201A4 CalPrmCmnBrk_SWORD 0 Gain -32768 32767 SYMBOL_LINK "CalPrmCmnBrk01.TQYc_Map[11][0]" 0 /end CHARACTERISTIC
/begin CHARACTERISTIC TQYc_Map[11][10] "" VALUE 0x800201B8 CalPrmCmnBrk_SWORD 0 Gain -32768 32767 SYMBOL_LINK "CalPrmCmnBrk01.TQYc_Map[11][10]" 0 /end CHARACTERISTIC
/begin CHARACTERISTIC TQYc_Map[11][11] "" VALUE 0x800201BA CalPrmCmnBrk_SWORD 0 Gain -32768 32767 SYMBOL_LINK "CalPrmCmnBrk01.TQYc_Map[11][11]" 0 /end CHARACTERISTIC
/begin CHARACTERISTIC TQYc_Map[11][1] "" VALUE 0x800201A6 CalPrmCmnBrk_SWORD 0 Gain -32768 32767 SYMBOL_LINK "CalPrmCmnBrk01.TQYc_Map[11][1]" 0 /end CHARACTERISTIC
/begin CHARACTERISTIC TQYc_Map[11][2] "" VALUE 0x800201A8 CalPrmCmnBrk_SWORD 0 Gain -32768 32767 SYMBOL_LINK "CalPrmCmnBrk01.TQYc_Map[11][2]" 0 /end CHARACTERISTIC
/begin CHARACTERISTIC TQYc_Map[11][3] "" VALUE 0x800201AA CalPrmCmnBrk_SWORD 0 Gain -32768 32767 SYMBOL_LINK "CalPrmCmnBrk01.TQYc_Map[11][3]" 0 /end CHARACTERISTIC
/begin CHARACTERISTIC TQYc_Map[11][4] "" VALUE 0x800201AC CalPrmCmnBrk_SWORD 0 Gain -32768 32767 SYMBOL_LINK "CalPrmCmnBrk01.TQYc_Map[11][4]" 0 /end CHARACTERISTIC
/begin CHARACTERISTIC TQYc_Map[11][5] "" VALUE 0x800201AE CalPrmCmnBrk_SWORD 0 Gain -32768 32767 SYMBOL_LINK "CalPrmCmnBrk01.TQYc_Map[11][5]" 0 /end CHARACTERISTIC
/begin CHARACTERISTIC TQYc_Map[11][6] "" VALUE 0x800201B0 CalPrmCmnBrk_SWORD 0 Gain -32768 32767 SYMBOL_LINK "CalPrmCmnBrk01.TQYc_Map[11][6]" 0 /end CHARACTERISTIC
/begin CHARACTERISTIC TQYc_Map[11][7] "" VALUE 0x800201B2 CalPrmCmnBrk_SWORD 0 Gain -32768 32767 SYMBOL_LINK "CalPrmCmnBrk01.TQYc_Map[11][7]" 0 /end CHARACTERISTIC
/begin CHARACTERISTIC TQYc_Map[11][8] "" VALUE 0x800201B4 CalPrmCmnBrk_SWORD 0 Gain -32768 32767 SYMBOL_LINK "CalPrmCmnBrk01.TQYc_Map[11][8]" 0 /end CHARACTERISTIC
/begin CHARACTERISTIC TQYc_Map[11][9] "" VALUE 0x800201B6 CalPrmCmnBrk_SWORD 0 Gain -32768 32767 SYMBOL_LINK "CalPrmCmnBrk01.TQYc_Map[11][9]" 0 /end CHARACTERISTIC
/begin CHARACTERISTIC TQYc_Map[12][0] "" VALUE 0x800201BC CalPrmCmnBrk_SWORD 0 Gain -32768 32767 SYMBOL_LINK "CalPrmCmnBrk01.TQYc_Map[12][0]" 0 /end CHARACTERISTIC
/begin CHARACTERISTIC TQYc_Map[12][10] "" VALUE 0x800201D0 CalPrmCmnBrk_SWORD 0 Gain -32768 32767 SYMBOL_LINK "CalPrmCmnBrk01.TQYc_Map[12][10]" 0 /end CHARACTERISTIC
/begin CHARACTERISTIC TQYc_Map[12][11] "" VALUE 0x800201D2 CalPrmCmnBrk_SWORD 0 Gain -32768 32767 SYMBOL_LINK "CalPrmCmnBrk01.TQYc_Map[12][11]" 0 /end CHARACTERISTIC
/begin CHARACTERISTIC TQYc_Map[12][1] "" VALUE 0x800201BE CalPrmCmnBrk_SWORD 0 Gain -32768 32767 SYMBOL_LINK "CalPrmCmnBrk01.TQYc_Map[12][1]" 0 /end CHARACTERISTIC
/begin CHARACTERISTIC TQYc_Map[12][2] "" VALUE 0x800201C0 CalPrmCmnBrk_SWORD 0 Gain -32768 32767 SYMBOL_LINK "CalPrmCmnBrk01.TQYc_Map[12][2]" 0 /end CHARACTERISTIC
/begin CHARACTERISTIC TQYc_Map[12][3] "" VALUE 0x800201C2 CalPrmCmnBrk_SWORD 0 Gain -32768 32767 SYMBOL_LINK "CalPrmCmnBrk01.TQYc_Map[12][3]" 0 /end CHARACTERISTIC
/begin CHARACTERISTIC TQYc_Map[12][4] "" VALUE 0x800201C4 CalPrmCmnBrk_SWORD 0 Gain -32768 32767 SYMBOL_LINK "CalPrmCmnBrk01.TQYc_Map[12][4]" 0 /end CHARACTERISTIC
/begin CHARACTERISTIC TQYc_Map[12][5] "" VALUE 0x800201C6 CalPrmCmnBrk_SWORD 0 Gain -32768 32767 SYMBOL_LINK "CalPrmCmnBrk01.TQYc_Map[12][5]" 0 /end CHARACTERISTIC
/begin CHARACTERISTIC TQYc_Map[12][6] "" VALUE 0x800201C8 CalPrmCmnBrk_SWORD 0 Gain -32768 32767 SYMBOL_LINK "CalPrmCmnBrk01.TQYc_Map[12][6]" 0 /end CHARACTERISTIC
/begin CHARACTERISTIC TQYc_Map[12][7] "" VALUE 0x800201CA CalPrmCmnBrk_SWORD 0 Gain -32768 32767 SYMBOL_LINK "CalPrmCmnBrk01.TQYc_Map[12][7]" 0 /end CHARACTERISTIC
/begin CHARACTERISTIC TQYc_Map[12][8] "" VALUE 0x800201CC CalPrmCmnBrk_SWORD 0 Gain -32768 32767 SYMBOL_LINK "CalPrmCmnBrk01.TQYc_Map[12][8]" 0 /end CHARACTERISTIC
/begin CHARACTERISTIC TQYc_Map[12][9] "" VALUE 0x800201CE CalPrmCmnBrk_SWORD 0 Gain -32768 32767 SYMBOL_LINK "CalPrmCmnBrk01.TQYc_Map[12][9]" 0 /end CHARACTERISTIC
/begin CHARACTERISTIC TQYc_Map[13][0] "" VALUE 0x800201D4 CalPrmCmnBrk_SWORD 0 Gain -32768 32767 SYMBOL_LINK "CalPrmCmnBrk01.TQYc_Map[13][0]" 0 /end CHARACTERISTIC
/begin CHARACTERISTIC TQYc_Map[13][10] "" VALUE 0x800201E8 CalPrmCmnBrk_SWORD 0 Gain -32768 32767 SYMBOL_LINK "CalPrmCmnBrk01.TQYc_Map[13][10]" 0 /end CHARACTERISTIC
/begin CHARACTERISTIC TQYc_Map[13][11] "" VALUE 0x800201EA CalPrmCmnBrk_SWORD 0 Gain -32768 32767 SYMBOL_LINK "CalPrmCmnBrk01.TQYc_Map[13][11]" 0 /end CHARACTERISTIC
/begin CHARACTERISTIC TQYc_Map[13][1] "" VALUE 0x800201D6 CalPrmCmnBrk_SWORD 0 Gain -32768 32767 SYMBOL_LINK "CalPrmCmnBrk01.TQYc_Map[13][1]" 0 /end CHARACTERISTIC
/begin CHARACTERISTIC TQYc_Map[13][2] "" VALUE 0x800201D8 CalPrmCmnBrk_SWORD 0 Gain -32768 32767 SYMBOL_LINK "CalPrmCmnBrk01.TQYc_Map[13][2]" 0 /end CHARACTERISTIC
/begin CHARACTERISTIC TQYc_Map[13][3] "" VALUE 0x800201DA CalPrmCmnBrk_SWORD 0 Gain -32768 32767 SYMBOL_LINK "CalPrmCmnBrk01.TQYc_Map[13][3]" 0 /end CHARACTERISTIC
/begin CHARACTERISTIC TQYc_Map[13][4] "" VALUE 0x800201DC CalPrmCmnBrk_SWORD 0 Gain -32768 32767 SYMBOL_LINK "CalPrmCmnBrk01.TQYc_Map[13][4]" 0 /end CHARACTERISTIC
/begin CHARACTERISTIC TQYc_Map[13][5] "" VALUE 0x800201DE CalPrmCmnBrk_SWORD 0 Gain -32768 32767 SYMBOL_LINK "CalPrmCmnBrk01.TQYc_Map[13][5]" 0 /end CHARACTERISTIC
/begin CHARACTERISTIC TQYc_Map[13][6] "" VALUE 0x800201E0 CalPrmCmnBrk_SWORD 0 Gain -32768 32767 SYMBOL_LINK "CalPrmCmnBrk01.TQYc_Map[13][6]" 0 /end CHARACTERISTIC
/begin CHARACTERISTIC TQYc_Map[13][7] "" VALUE 0x800201E2 CalPrmCmnBrk_SWORD 0 Gain -32768 32767 SYMBOL_LINK "CalPrmCmnBrk01.TQYc_Map[13][7]" 0 /end CHARACTERISTIC
/begin CHARACTERISTIC TQYc_Map[13][8] "" VALUE 0x800201E4 CalPrmCmnBrk_SWORD 0 Gain -32768 32767 SYMBOL_LINK "CalPrmCmnBrk01.TQYc_Map[13][8]" 0 /end CHARACTERISTIC
/begin CHARACTERISTIC TQYc_Map[13][9] "" VALUE 0x800201E6 CalPrmCmnBrk_SWORD 0 Gain -32768 32767 SYMBOL_LINK "CalPrmCmnBrk01.TQYc_Map[13][9]" 0 /end CHARACTERISTIC
/begin CHARACTERISTIC TQYc_Map[14][0] "" VALUE 0x800201EC CalPrmCmnBrk_SWORD 0 Gain -32768 32767 SYMBOL_LINK "CalPrmCmnBrk01.TQYc_Map[14][0]" 0 /end CHARACTERISTIC
/begin CHARACTERISTIC TQYc_Map[14][10] "" VALUE 0x80020200 CalPrmCmnBrk_SWORD 0 Gain -32768 32767 SYMBOL_LINK "CalPrmCmnBrk01.TQYc_Map[14][10]" 0 /end CHARACTERISTIC
/begin CHARACTERISTIC TQYc_Map[14][11] "" VALUE 0x80020202 CalPrmCmnBrk_SWORD 0 Gain -32768 32767 SYMBOL_LINK "CalPrmCmnBrk01.TQYc_Map[14][11]" 0 /end CHARACTERISTIC
/begin CHARACTERISTIC TQYc_Map[14][1] "" VALUE 0x800201EE CalPrmCmnBrk_SWORD 0 Gain -32768 32767 SYMBOL_LINK "CalPrmCmnBrk01.TQYc_Map[14][1]" 0 /end CHARACTERISTIC
/begin CHARACTERISTIC TQYc_Map[14][2] "" VALUE 0x800201F0 CalPrmCmnBrk_SWORD 0 Gain -32768 32767 SYMBOL_LINK "CalPrmCmnBrk01.TQYc_Map[14][2]" 0 /end CHARACTERISTIC
/begin CHARACTERISTIC TQYc_Map[14][3] "" VALUE 0x800201F2 CalPrmCmnBrk_SWORD 0 Gain -32768 32767 SYMBOL_LINK "CalPrmCmnBrk01.TQYc_Map[14][3]" 0 /end CHARACTERISTIC
/begin CHARACTERISTIC TQYc_Map[14][4] "" VALUE 0x800201F4 CalPrmCmnBrk_SWORD 0 Gain -32768 32767 SYMBOL_LINK "CalPrmCmnBrk01.TQYc_Map[14][4]" 0 /end CHARACTERISTIC
/begin CHARACTERISTIC TQYc_Map[14][5] "" VALUE 0x800201F6 CalPrmCmnBrk_SWORD 0 Gain -32768 32767 SYMBOL_LINK "CalPrmCmnBrk01.TQYc_Map[14][5]" 0 /end CHARACTERISTIC
/begin CHARACTERISTIC TQYc_Map[14][6] "" VALUE 0x800201F8 CalPrmCmnBrk_SWORD 0 Gain -32768 32767 SYMBOL_LINK "CalPrmCmnBrk01.TQYc_Map[14][6]" 0 /end CHARACTERISTIC
/begin CHARACTERISTIC TQYc_Map[14][7] "" VALUE 0x800201FA CalPrmCmnBrk_SWORD 0 Gain -32768 32767 SYMBOL_LINK "CalPrmCmnBrk01.TQYc_Map[14][7]" 0 /end CHARACTERISTIC
/begin CHARACTERISTIC TQYc_Map[14][8] "" VALUE 0x800201FC CalPrmCmnBrk_SWORD 0 Gain -32768 32767 SYMBOL_LINK "CalPrmCmnBrk01.TQYc_Map[14][8]" 0 /end CHARACTERISTIC
/begin CHARACTERISTIC TQYc_Map[14][9] "" VALUE 0x800201FE CalPrmCmnBrk_SWORD 0 Gain -32768 32767 SYMBOL_LINK "CalPrmCmnBrk01.TQYc_Map[14][9]" 0 /end CHARACTERISTIC
/begin CHARACTERISTIC TQYc_Map[1][0] "" VALUE 0x800200B4 CalPrmCmnBrk_SWORD 0 Gain -32768 32767 SYMBOL_LINK "CalPrmCmnBrk01.TQYc_Map[1][0]" 0 /end CHARACTERISTIC
/begin CHARACTERISTIC TQYc_Map[1][10] "" VALUE 0x800200C8 CalPrmCmnBrk_SWORD 0 Gain -32768 32767 SYMBOL_LINK "CalPrmCmnBrk01.TQYc_Map[1][10]" 0 /end CHARACTERISTIC
/begin CHARACTERISTIC TQYc_Map[1][11] "" VALUE 0x800200CA CalPrmCmnBrk_SWORD 0 Gain -32768 32767 SYMBOL_LINK "CalPrmCmnBrk01.TQYc_Map[1][11]" 0 /end CHARACTERISTIC
/begin CHARACTERISTIC TQYc_Map[1][1] "" VALUE 0x800200B6 CalPrmCmnBrk_SWORD 0 Gain -32768 32767 SYMBOL_LINK "CalPrmCmnBrk01.TQYc_Map[1][1]" 0 /end CHARACTERISTIC
/begin CHARACTERISTIC TQYc_Map[1][2] "" VALUE 0x800200B8 CalPrmCmnBrk_SWORD 0 Gain -32768 32767 SYMBOL_LINK "CalPrmCmnBrk01.TQYc_Map[1][2]" 0 /end CHARACTERISTIC
/begin CHARACTERISTIC TQYc_Map[1][3] "" VALUE 0x800200BA CalPrmCmnBrk_SWORD 0 Gain -32768 32767 SYMBOL_LINK "CalPrmCmnBrk01.TQYc_Map[1][3]" 0 /end CHARACTERISTIC
/begin CHARACTERISTIC TQYc_Map[1][4] "" VALUE 0x800200BC CalPrmCmnBrk_SWORD 0 Gain -32768 32767 SYMBOL_LINK "CalPrmCmnBrk01.TQYc_Map[1][4]" 0 /end CHARACTERISTIC
/begin CHARACTERISTIC TQYc_Map[1][5] "" VALUE 0x800200BE CalPrmCmnBrk_SWORD 0 Gain -32768 32767 SYMBOL_LINK "CalPrmCmnBrk01.TQYc_Map[1][5]" 0 /end CHARACTERISTIC
/begin CHARACTERISTIC TQYc_Map[1][6] "" VALUE 0x800200C0 CalPrmCmnBrk_SWORD 0 Gain -32768 32767 SYMBOL_LINK "CalPrmCmnBrk01.TQYc_Map[1][6]" 0 /end CHARACTERISTIC
/begin CHARACTERISTIC TQYc_Map[1][7] "" VALUE 0x800200C2 CalPrmCmnBrk_SWORD 0 Gain -32768 32767 SYMBOL_LINK "CalPrmCmnBrk01.TQYc_Map[1][7]" 0 /end CHARACTERISTIC
/begin CHARACTERISTIC TQYc_Map[1][8] "" VALUE 0x800200C4 CalPrmCmnBrk_SWORD 0 Gain -32768 32767 SYMBOL_LINK "CalPrmCmnBrk01.TQYc_Map[1][8]" 0 /end CHARACTERISTIC
/begin CHARACTERISTIC TQYc_Map[1][9] "" VALUE 0x800200C6 CalPrmCmnBrk_SWORD 0 Gain -32768 32767 SYMBOL_LINK "CalPrmCmnBrk01.TQYc_Map[1][9]" 0 /end CHARACTERISTIC
/begin CHARACTERISTIC TQYc_Map[2][0] "" VALUE 0x800200CC CalPrmCmnBrk_SWORD 0 Gain -32768 32767 SYMBOL_LINK "CalPrmCmnBrk01.TQYc_Map[2][0]" 0 /end CHARACTERISTIC
/begin CHARACTERISTIC TQYc_Map[2][10] "" VALUE 0x800200E0 CalPrmCmnBrk_SWORD 0 Gain -32768 32767 SYMBOL_LINK "CalPrmCmnBrk01.TQYc_Map[2][10]" 0 /end CHARACTERISTIC
/begin CHARACTERISTIC TQYc_Map[2][11] "" VALUE 0x800200E2 CalPrmCmnBrk_SWORD 0 Gain -32768 32767 SYMBOL_LINK "CalPrmCmnBrk01.TQYc_Map[2][11]" 0 /end CHARACTERISTIC
/begin CHARACTERISTIC TQYc_Map[2][1] "" VALUE 0x800200CE CalPrmCmnBrk_SWORD 0 Gain -32768 32767 SYMBOL_LINK "CalPrmCmnBrk01.TQYc_Map[2][1]" 0 /end CHARACTERISTIC
/begin CHARACTERISTIC TQYc_Map[2][2] "" VALUE 0x800200D0 CalPrmCmnBrk_SWORD 0 Gain -32768 32767 SYMBOL_LINK "CalPrmCmnBrk01.TQYc_Map[2][2]" 0 /end CHARACTERISTIC
/begin CHARACTERISTIC TQYc_Map[2][3] "" VALUE 0x800200D2 CalPrmCmnBrk_SWORD 0 Gain -32768 32767 SYMBOL_LINK "CalPrmCmnBrk01.TQYc_Map[2][3]" 0 /end CHARACTERISTIC
/begin CHARACTERISTIC TQYc_Map[2][4] "" VALUE 0x800200D4 CalPrmCmnBrk_SWORD 0 Gain -32768 32767 SYMBOL_LINK "CalPrmCmnBrk01.TQYc_Map[2][4]" 0 /end CHARACTERISTIC
/begin CHARACTERISTIC TQYc_Map[2][5] "" VALUE 0x800200D6 CalPrmCmnBrk_SWORD 0 Gain -32768 32767 SYMBOL_LINK "CalPrmCmnBrk01.TQYc_Map[2][5]" 0 /end CHARACTERISTIC
/begin CHARACTERISTIC TQYc_Map[2][6] "" VALUE 0x800200D8 CalPrmCmnBrk_SWORD 0 Gain -32768 32767 SYMBOL_LINK "CalPrmCmnBrk01.TQYc_Map[2][6]" 0 /end CHARACTERISTIC
/begin CHARACTERISTIC TQYc_Map[2][7] "" VALUE 0x800200DA CalPrmCmnBrk_SWORD 0 Gain -32768 32767 SYMBOL_LINK "CalPrmCmnBrk01.TQYc_Map[2][7]" 0 /end CHARACTERISTIC
/begin CHARACTERISTIC TQYc_Map[2][8] "" VALUE 0x800200DC CalPrmCmnBrk_SWORD 0 Gain -32768 32767 SYMBOL_LINK "CalPrmCmnBrk01.TQYc_Map[2][8]" 0 /end CHARACTERISTIC
/begin CHARACTERISTIC TQYc_Map[2][9] "" VALUE 0x800200DE CalPrmCmnBrk_SWORD 0 Gain -32768 32767 SYMBOL_LINK "CalPrmCmnBrk01.TQYc_Map[2][9]" 0 /end CHARACTERISTIC
/begin CHARACTERISTIC TQYc_Map[3][0] "" VALUE 0x800200E4 CalPrmCmnBrk_SWORD 0 Gain -32768 32767 SYMBOL_LINK "CalPrmCmnBrk01.TQYc_Map[3][0]" 0 /end CHARACTERISTIC
/begin CHARACTERISTIC TQYc_Map[3][10] "" VALUE 0x800200F8 CalPrmCmnBrk_SWORD 0 Gain -32768 32767 SYMBOL_LINK "CalPrmCmnBrk01.TQYc_Map[3][10]" 0 /end CHARACTERISTIC
/begin CHARACTERISTIC TQYc_Map[3][11] "" VALUE 0x800200FA CalPrmCmnBrk_SWORD 0 Gain -32768 32767 SYMBOL_LINK "CalPrmCmnBrk01.TQYc_Map[3][11]" 0 /end CHARACTERISTIC
/begin CHARACTERISTIC TQYc_Map[3][1] "" VALUE 0x800200E6 CalPrmCmnBrk_SWORD 0 Gain -32768 32767 SYMBOL_LINK "CalPrmCmnBrk01.TQYc_Map[3][1]" 0 /end CHARACTERISTIC
/begin CHARACTERISTIC TQYc_Map[3][2] "" VALUE 0x800200E8 CalPrmCmnBrk_SWORD 0 Gain -32768 32767 SYMBOL_LINK "CalPrmCmnBrk01.TQYc_Map[3][2]" 0 /end CHARACTERISTIC
/begin CHARACTERISTIC TQYc_Map[3][3] "" VALUE 0x800200EA CalPrmCmnBrk_SWORD 0 Gain -32768 32767 SYMBOL_LINK "CalPrmCmnBrk01.TQYc_Map[3][3]" 0 /end CHARACTERISTIC
/begin CHARACTERISTIC TQYc_Map[3][4] "" VALUE 0x800200EC CalPrmCmnBrk_SWORD 0 Gain -32768 32767 SYMBOL_LINK "CalPrmCmnBrk01.TQYc_Map[3][4]" 0 /end CHARACTERISTIC
/begin CHARACTERISTIC TQYc_Map[3][5] "" VALUE 0x800200EE CalPrmCmnBrk_SWORD 0 Gain -32768 32767 SYMBOL_LINK "CalPrmCmnBrk01.TQYc_Map[3][5]" 0 /end CHARACTERISTIC
/begin CHARACTERISTIC TQYc_Map[3][6] "" VALUE 0x800200F0 CalPrmCmnBrk_SWORD 0 Gain -32768 32767 SYMBOL_LINK "CalPrmCmnBrk01.TQYc_Map[3][6]" 0 /end CHARACTERISTIC
/begin CHARACTERISTIC TQYc_Map[3][7] "" VALUE 0x800200F2 CalPrmCmnBrk_SWORD 0 Gain -32768 32767 SYMBOL_LINK "CalPrmCmnBrk01.TQYc_Map[3][7]" 0 /end CHARACTERISTIC
/begin CHARACTERISTIC TQYc_Map[3][8] "" VALUE 0x800200F4 CalPrmCmnBrk_SWORD 0 Gain -32768 32767 SYMBOL_LINK "CalPrmCmnBrk01.TQYc_Map[3][8]" 0 /end CHARACTERISTIC
/begin CHARACTERISTIC TQYc_Map[3][9] "" VALUE 0x800200F6 CalPrmCmnBrk_SWORD 0 Gain -32768 32767 SYMBOL_LINK "CalPrmCmnBrk01.TQYc_Map[3][9]" 0 /end CHARACTERISTIC
/begin CHARACTERISTIC TQYc_Map[4][0] "" VALUE 0x800200FC CalPrmCmnBrk_SWORD 0 Gain -32768 32767 SYMBOL_LINK "CalPrmCmnBrk01.TQYc_Map[4][0]" 0 /end CHARACTERISTIC
/begin CHARACTERISTIC TQYc_Map[4][10] "" VALUE 0x80020110 CalPrmCmnBrk_SWORD 0 Gain -32768 32767 SYMBOL_LINK "CalPrmCmnBrk01.TQYc_Map[4][10]" 0 /end CHARACTERISTIC
/begin CHARACTERISTIC TQYc_Map[4][11] "" VALUE 0x80020112 CalPrmCmnBrk_SWORD 0 Gain -32768 32767 SYMBOL_LINK "CalPrmCmnBrk01.TQYc_Map[4][11]" 0 /end CHARACTERISTIC
/begin CHARACTERISTIC TQYc_Map[4][1] "" VALUE 0x800200FE CalPrmCmnBrk_SWORD 0 Gain -32768 32767 SYMBOL_LINK "CalPrmCmnBrk01.TQYc_Map[4][1]" 0 /end CHARACTERISTIC
/begin CHARACTERISTIC TQYc_Map[4][2] "" VALUE 0x80020100 CalPrmCmnBrk_SWORD 0 Gain -32768 32767 SYMBOL_LINK "CalPrmCmnBrk01.TQYc_Map[4][2]" 0 /end CHARACTERISTIC
/begin CHARACTERISTIC TQYc_Map[4][3] "" VALUE 0x80020102 CalPrmCmnBrk_SWORD 0 Gain -32768 32767 SYMBOL_LINK "CalPrmCmnBrk01.TQYc_Map[4][3]" 0 /end CHARACTERISTIC
/begin CHARACTERISTIC TQYc_Map[4][4] "" VALUE 0x80020104 CalPrmCmnBrk_SWORD 0 Gain -32768 32767 SYMBOL_LINK "CalPrmCmnBrk01.TQYc_Map[4][4]" 0 /end CHARACTERISTIC
/begin CHARACTERISTIC TQYc_Map[4][5] "" VALUE 0x80020106 CalPrmCmnBrk_SWORD 0 Gain -32768 32767 SYMBOL_LINK "CalPrmCmnBrk01.TQYc_Map[4][5]" 0 /end CHARACTERISTIC
/begin CHARACTERISTIC TQYc_Map[4][6] "" VALUE 0x80020108 CalPrmCmnBrk_SWORD 0 Gain -32768 32767 SYMBOL_LINK "CalPrmCmnBrk01.TQYc_Map[4][6]" 0 /end CHARACTERISTIC
/begin CHARACTERISTIC TQYc_Map[4][7] "" VALUE 0x8002010A CalPrmCmnBrk_SWORD 0 Gain -32768 32767 SYMBOL_LINK "CalPrmCmnBrk01.TQYc_Map[4][7]" 0 /end CHARACTERISTIC
/begin CHARACTERISTIC TQYc_Map[4][8] "" VALUE 0x8002010C CalPrmCmnBrk_SWORD 0 Gain -32768 32767 SYMBOL_LINK "CalPrmCmnBrk01.TQYc_Map[4][8]" 0 /end CHARACTERISTIC
/begin CHARACTERISTIC TQYc_Map[4][9] "" VALUE 0x8002010E CalPrmCmnBrk_SWORD 0 Gain -32768 32767 SYMBOL_LINK "CalPrmCmnBrk01.TQYc_Map[4][9]" 0 /end CHARACTERISTIC
/begin CHARACTERISTIC TQYc_Map[5][0] "" VALUE 0x80020114 CalPrmCmnBrk_SWORD 0 Gain -32768 32767 SYMBOL_LINK "CalPrmCmnBrk01.TQYc_Map[5][0]" 0 /end CHARACTERISTIC
/begin CHARACTERISTIC TQYc_Map[5][10] "" VALUE 0x80020128 CalPrmCmnBrk_SWORD 0 Gain -32768 32767 SYMBOL_LINK "CalPrmCmnBrk01.TQYc_Map[5][10]" 0 /end CHARACTERISTIC
/begin CHARACTERISTIC TQYc_Map[5][11] "" VALUE 0x8002012A CalPrmCmnBrk_SWORD 0 Gain -32768 32767 SYMBOL_LINK "CalPrmCmnBrk01.TQYc_Map[5][11]" 0 /end CHARACTERISTIC
/begin CHARACTERISTIC TQYc_Map[5][1] "" VALUE 0x80020116 CalPrmCmnBrk_SWORD 0 Gain -32768 32767 SYMBOL_LINK "CalPrmCmnBrk01.TQYc_Map[5][1]" 0 /end CHARACTERISTIC
/begin CHARACTERISTIC TQYc_Map[5][2] "" VALUE 0x80020118 CalPrmCmnBrk_SWORD 0 Gain -32768 32767 SYMBOL_LINK "CalPrmCmnBrk01.TQYc_Map[5][2]" 0 /end CHARACTERISTIC
/begin CHARACTERISTIC TQYc_Map[5][3] "" VALUE 0x8002011A CalPrmCmnBrk_SWORD 0 Gain -32768 32767 SYMBOL_LINK "CalPrmCmnBrk01.TQYc_Map[5][3]" 0 /end CHARACTERISTIC
/begin CHARACTERISTIC TQYc_Map[5][4] "" VALUE 0x8002011C CalPrmCmnBrk_SWORD 0 Gain -32768 32767 SYMBOL_LINK "CalPrmCmnBrk01.TQYc_Map[5][4]" 0 /end CHARACTERISTIC
/begin CHARACTERISTIC TQYc_Map[5][5] "" VALUE 0x8002011E CalPrmCmnBrk_SWORD 0 Gain -32768 32767 SYMBOL_LINK "CalPrmCmnBrk01.TQYc_Map[5][5]" 0 /end CHARACTERISTIC
/begin CHARACTERISTIC TQYc_Map[5][6] "" VALUE 0x80020120 CalPrmCmnBrk_SWORD 0 Gain -32768 32767 SYMBOL_LINK "CalPrmCmnBrk01.TQYc_Map[5][6]" 0 /end CHARACTERISTIC
/begin CHARACTERISTIC TQYc_Map[5][7] "" VALUE 0x80020122 CalPrmCmnBrk_SWORD 0 Gain -32768 32767 SYMBOL_LINK "CalPrmCmnBrk01.TQYc_Map[5][7]" 0 /end CHARACTERISTIC
/begin CHARACTERISTIC TQYc_Map[5][8] "" VALUE 0x80020124 CalPrmCmnBrk_SWORD 0 Gain -32768 32767 SYMBOL_LINK "CalPrmCmnBrk01.TQYc_Map[5][8]" 0 /end CHARACTERISTIC
/begin CHARACTERISTIC TQYc_Map[5][9] "" VALUE 0x80020126 CalPrmCmnBrk_SWORD 0 Gain -32768 32767 SYMBOL_LINK "CalPrmCmnBrk01.TQYc_Map[5][9]" 0 /end CHARACTERISTIC
/begin CHARACTERISTIC TQYc_Map[6][0] "" VALUE 0x8002012C CalPrmCmnBrk_SWORD 0 Gain -32768 32767 SYMBOL_LINK "CalPrmCmnBrk01.TQYc_Map[6][0]" 0 /end CHARACTERISTIC
/begin CHARACTERISTIC TQYc_Map[6][10] "" VALUE 0x80020140 CalPrmCmnBrk_SWORD 0 Gain -32768 32767 SYMBOL_LINK "CalPrmCmnBrk01.TQYc_Map[6][10]" 0 /end CHARACTERISTIC
/begin CHARACTERISTIC TQYc_Map[6][11] "" VALUE 0x80020142 CalPrmCmnBrk_SWORD 0 Gain -32768 32767 SYMBOL_LINK "CalPrmCmnBrk01.TQYc_Map[6][11]" 0 /end CHARACTERISTIC
/begin CHARACTERISTIC TQYc_Map[6][1] "" VALUE 0x8002012E CalPrmCmnBrk_SWORD 0 Gain -32768 32767 SYMBOL_LINK "CalPrmCmnBrk01.TQYc_Map[6][1]" 0 /end CHARACTERISTIC
/begin CHARACTERISTIC TQYc_Map[6][2] "" VALUE 0x80020130 CalPrmCmnBrk_SWORD 0 Gain -32768 32767 SYMBOL_LINK "CalPrmCmnBrk01.TQYc_Map[6][2]" 0 /end CHARACTERISTIC
/begin CHARACTERISTIC TQYc_Map[6][3] "" VALUE 0x80020132 CalPrmCmnBrk_SWORD 0 Gain -32768 32767 SYMBOL_LINK "CalPrmCmnBrk01.TQYc_Map[6][3]" 0 /end CHARACTERISTIC
/begin CHARACTERISTIC TQYc_Map[6][4] "" VALUE 0x80020134 CalPrmCmnBrk_SWORD 0 Gain -32768 32767 SYMBOL_LINK "CalPrmCmnBrk01.TQYc_Map[6][4]" 0 /end CHARACTERISTIC
/begin CHARACTERISTIC TQYc_Map[6][5] "" VALUE 0x80020136 CalPrmCmnBrk_SWORD 0 Gain -32768 32767 SYMBOL_LINK "CalPrmCmnBrk01.TQYc_Map[6][5]" 0 /end CHARACTERISTIC
/begin CHARACTERISTIC TQYc_Map[6][6] "" VALUE 0x80020138 CalPrmCmnBrk_SWORD 0 Gain -32768 32767 SYMBOL_LINK "CalPrmCmnBrk01.TQYc_Map[6][6]" 0 /end CHARACTERISTIC
/begin CHARACTERISTIC TQYc_Map[6][7] "" VALUE 0x8002013A CalPrmCmnBrk_SWORD 0 Gain -32768 32767 SYMBOL_LINK "CalPrmCmnBrk01.TQYc_Map[6][7]" 0 /end CHARACTERISTIC
/begin CHARACTERISTIC TQYc_Map[6][8] "" VALUE 0x8002013C CalPrmCmnBrk_SWORD 0 Gain -32768 32767 SYMBOL_LINK "CalPrmCmnBrk01.TQYc_Map[6][8]" 0 /end CHARACTERISTIC
/begin CHARACTERISTIC TQYc_Map[6][9] "" VALUE 0x8002013E CalPrmCmnBrk_SWORD 0 Gain -32768 32767 SYMBOL_LINK "CalPrmCmnBrk01.TQYc_Map[6][9]" 0 /end CHARACTERISTIC
/begin CHARACTERISTIC TQYc_Map[7][0] "" VALUE 0x80020144 CalPrmCmnBrk_SWORD 0 Gain -32768 32767 SYMBOL_LINK "CalPrmCmnBrk01.TQYc_Map[7][0]" 0 /end CHARACTERISTIC
/begin CHARACTERISTIC TQYc_Map[7][10] "" VALUE 0x80020158 CalPrmCmnBrk_SWORD 0 Gain -32768 32767 SYMBOL_LINK "CalPrmCmnBrk01.TQYc_Map[7][10]" 0 /end CHARACTERISTIC
/begin CHARACTERISTIC TQYc_Map[7][11] "" VALUE 0x8002015A CalPrmCmnBrk_SWORD 0 Gain -32768 32767 SYMBOL_LINK "CalPrmCmnBrk01.TQYc_Map[7][11]" 0 /end CHARACTERISTIC
/begin CHARACTERISTIC TQYc_Map[7][1] "" VALUE 0x80020146 CalPrmCmnBrk_SWORD 0 Gain -32768 32767 SYMBOL_LINK "CalPrmCmnBrk01.TQYc_Map[7][1]" 0 /end CHARACTERISTIC
/begin CHARACTERISTIC TQYc_Map[7][2] "" VALUE 0x80020148 CalPrmCmnBrk_SWORD 0 Gain -32768 32767 SYMBOL_LINK "CalPrmCmnBrk01.TQYc_Map[7][2]" 0 /end CHARACTERISTIC
/begin CHARACTERISTIC TQYc_Map[7][3] "" VALUE 0x8002014A CalPrmCmnBrk_SWORD 0 Gain -32768 32767 SYMBOL_LINK "CalPrmCmnBrk01.TQYc_Map[7][3]" 0 /end CHARACTERISTIC
/begin CHARACTERISTIC TQYc_Map[7][4] "" VALUE 0x8002014C CalPrmCmnBrk_SWORD 0 Gain -32768 32767 SYMBOL_LINK "CalPrmCmnBrk01.TQYc_Map[7][4]" 0 /end CHARACTERISTIC
/begin CHARACTERISTIC TQYc_Map[7][5] "" VALUE 0x8002014E CalPrmCmnBrk_SWORD 0 Gain -32768 32767 SYMBOL_LINK "CalPrmCmnBrk01.TQYc_Map[7][5]" 0 /end CHARACTERISTIC
/begin CHARACTERISTIC TQYc_Map[7][6] "" VALUE 0x80020150 CalPrmCmnBrk_SWORD 0 Gain -32768 32767 SYMBOL_LINK "CalPrmCmnBrk01.TQYc_Map[7][6]" 0 /end CHARACTERISTIC
/begin CHARACTERISTIC TQYc_Map[7][7] "" VALUE 0x80020152 CalPrmCmnBrk_SWORD 0 Gain -32768 32767 SYMBOL_LINK "CalPrmCmnBrk01.TQYc_Map[7][7]" 0 /end CHARACTERISTIC
/begin CHARACTERISTIC TQYc_Map[7][8] "" VALUE 0x80020154 CalPrmCmnBrk_SWORD 0 Gain -32768 32767 SYMBOL_LINK "CalPrmCmnBrk01.TQYc_Map[7][8]" 0 /end CHARACTERISTIC
/begin CHARACTERISTIC TQYc_Map[7][9] "" VALUE 0x80020156 CalPrmCmnBrk_SWORD 0 Gain -32768 32767 SYMBOL_LINK "CalPrmCmnBrk01.TQYc_Map[7][9]" 0 /end CHARACTERISTIC
/begin CHARACTERISTIC TQYc_Map[8][0] "" VALUE 0x8002015C CalPrmCmnBrk_SWORD 0 Gain -32768 32767 SYMBOL_LINK "CalPrmCmnBrk01.TQYc_Map[8][0]" 0 /end CHARACTERISTIC
/begin CHARACTERISTIC TQYc_Map[8][10] "" VALUE 0x80020170 CalPrmCmnBrk_SWORD 0 Gain -32768 32767 SYMBOL_LINK "CalPrmCmnBrk01.TQYc_Map[8][10]" 0 /end CHARACTERISTIC
/begin CHARACTERISTIC TQYc_Map[8][11] "" VALUE 0x80020172 CalPrmCmnBrk_SWORD 0 Gain -32768 32767 SYMBOL_LINK "CalPrmCmnBrk01.TQYc_Map[8][11]" 0 /end CHARACTERISTIC
/begin CHARACTERISTIC TQYc_Map[8][1] "" VALUE 0x8002015E CalPrmCmnBrk_SWORD 0 Gain -32768 32767 SYMBOL_LINK "CalPrmCmnBrk01.TQYc_Map[8][1]" 0 /end CHARACTERISTIC
/begin CHARACTERISTIC TQYc_Map[8][2] "" VALUE 0x80020160 CalPrmCmnBrk_SWORD 0 Gain -32768 32767 SYMBOL_LINK "CalPrmCmnBrk01.TQYc_Map[8][2]" 0 /end CHARACTERISTIC
/begin CHARACTERISTIC TQYc_Map[8][3] "" VALUE 0x80020162 CalPrmCmnBrk_SWORD 0 Gain -32768 32767 SYMBOL_LINK "CalPrmCmnBrk01.TQYc_Map[8][3]" 0 /end CHARACTERISTIC
/begin CHARACTERISTIC TQYc_Map[8][4] "" VALUE 0x80020164 CalPrmCmnBrk_SWORD 0 Gain -32768 32767 SYMBOL_LINK "CalPrmCmnBrk01.TQYc_Map[8][4]" 0 /end CHARACTERISTIC
/begin CHARACTERISTIC TQYc_Map[8][5] "" VALUE 0x80020166 CalPrmCmnBrk_SWORD 0 Gain -32768 32767 SYMBOL_LINK "CalPrmCmnBrk01.TQYc_Map[8][5]" 0 /end CHARACTERISTIC
/begin CHARACTERISTIC TQYc_Map[8][6] "" VALUE 0x80020168 CalPrmCmnBrk_SWORD 0 Gain -32768 32767 SYMBOL_LINK "CalPrmCmnBrk01.TQYc_Map[8][6]" 0 /end CHARACTERISTIC
/begin CHARACTERISTIC TQYc_Map[8][7] "" VALUE 0x8002016A CalPrmCmnBrk_SWORD 0 Gain -32768 32767 SYMBOL_LINK "CalPrmCmnBrk01.TQYc_Map[8][7]" 0 /end CHARACTERISTIC
/begin CHARACTERISTIC TQYc_Map[8][8] "" VALUE 0x8002016C CalPrmCmnBrk_SWORD 0 Gain -32768 32767 SYMBOL_LINK "CalPrmCmnBrk01.TQYc_Map[8][8]" 0 /end CHARACTERISTIC
/begin CHARACTERISTIC TQYc_Map[8][9] "" VALUE 0x8002016E CalPrmCmnBrk_SWORD 0 Gain -32768 32767 SYMBOL_LINK "CalPrmCmnBrk01.TQYc_Map[8][9]" 0 /end CHARACTERISTIC
/begin CHARACTERISTIC TQYc_Map[9][0] "" VALUE 0x80020174 CalPrmCmnBrk_SWORD 0 Gain -32768 32767 SYMBOL_LINK "CalPrmCmnBrk01.TQYc_Map[9][0]" 0 /end CHARACTERISTIC
/begin CHARACTERISTIC TQYc_Map[9][10] "" VALUE 0x80020188 CalPrmCmnBrk_SWORD 0 Gain -32768 32767 SYMBOL_LINK "CalPrmCmnBrk01.TQYc_Map[9][10]" 0 /end CHARACTERISTIC
/begin CHARACTERISTIC TQYc_Map[9][11] "" VALUE 0x8002018A CalPrmCmnBrk_SWORD 0 Gain -32768 32767 SYMBOL_LINK "CalPrmCmnBrk01.TQYc_Map[9][11]" 0 /end CHARACTERISTIC
/begin CHARACTERISTIC TQYc_Map[9][1] "" VALUE 0x80020176 CalPrmCmnBrk_SWORD 0 Gain -32768 32767 SYMBOL_LINK "CalPrmCmnBrk01.TQYc_Map[9][1]" 0 /end CHARACTERISTIC
/begin CHARACTERISTIC TQYc_Map[9][2] "" VALUE 0x80020178 CalPrmCmnBrk_SWORD 0 Gain -32768 32767 SYMBOL_LINK "CalPrmCmnBrk01.TQYc_Map[9][2]" 0 /end CHARACTERISTIC
/begin CHARACTERISTIC TQYc_Map[9][3] "" VALUE 0x8002017A CalPrmCmnBrk_SWORD 0 Gain -32768 32767 SYMBOL_LINK "CalPrmCmnBrk01.TQYc_Map[9][3]" 0 /end CHARACTERISTIC
/begin CHARACTERISTIC TQYc_Map[9][4] "" VALUE 0x8002017C CalPrmCmnBrk_SWORD 0 Gain -32768 32767 SYMBOL_LINK "CalPrmCmnBrk01.TQYc_Map[9][4]" 0 /end CHARACTERISTIC
/begin CHARACTERISTIC TQYc_Map[9][5] "" VALUE 0x8002017E CalPrmCmnBrk_SWORD 0 Gain -32768 32767 SYMBOL_LINK "CalPrmCmnBrk01.TQYc_Map[9][5]" 0 /end CHARACTERISTIC
/begin CHARACTERISTIC TQYc_Map[9][6] "" VALUE 0x80020180 CalPrmCmnBrk_SWORD 0 Gain -32768 32767 SYMBOL_LINK "CalPrmCmnBrk01.TQYc_Map[9][6]" 0 /end CHARACTERISTIC
/begin CHARACTERISTIC TQYc_Map[9][7] "" VALUE 0x80020182 CalPrmCmnBrk_SWORD 0 Gain -32768 32767 SYMBOL_LINK "CalPrmCmnBrk01.TQYc_Map[9][7]" 0 /end CHARACTERISTIC
/begin CHARACTERISTIC TQYc_Map[9][8] "" VALUE 0x80020184 CalPrmCmnBrk_SWORD 0 Gain -32768 32767 SYMBOL_LINK "CalPrmCmnBrk01.TQYc_Map[9][8]" 0 /end CHARACTERISTIC
/begin CHARACTERISTIC TQYc_Map[9][9] "" VALUE 0x80020186 CalPrmCmnBrk_SWORD 0 Gain -32768 32767 SYMBOL_LINK "CalPrmCmnBrk01.TQYc_Map[9][9]" 0 /end CHARACTERISTIC
/begin CHARACTERISTIC U16CircBleedingMotU "" VALUE 0x800214DC CalPrmBrkTqCtrlrBrk_UWORD 0 U11 0 65.535 SYMBOL_LINK "CalPrmBrkTqCtrlrBrk01.U16CircBleedingMotU" 0 /end CHARACTERISTIC
/begin CHARACTERISTIC U16CircBleedingTcVlvCur "" VALUE 0x800214DA CalPrmBrkTqCtrlrBrk_UWORD 0 Amp2 0 65.535 SYMBOL_LINK "CalPrmBrkTqCtrlrBrk01.U16CircBleedingTcVlvCur" 0 /end CHARACTERISTIC
/begin CHARACTERISTIC U16LfcRiseNotSuctnNo1VlvCurPGrdt31 "Target brake pressure gradient for determine NO valve current at LFC rise mode without suction (1 point of 9 interpolation at pressure error 3 point)" VALUE 0x800212BA CalPrmBrkTqCtrlrBrk_UWORD 0 PGrdt11 0 6553.5 SYMBOL_LINK "CalPrmBrkTqCtrlrBrk01.U16LfcRiseNotSuctnNo1VlvCurPGrdt31" 0 /end CHARACTERISTIC
/begin CHARACTERISTIC U16LfcRiseNotSuctnNo1VlvCurPGrdt32 "Target brake pressure gradient for determine NO valve current at LFC rise mode without suction (2 point of 9 interpolation at pressure error 3 point)" VALUE 0x800212BC CalPrmBrkTqCtrlrBrk_UWORD 0 PGrdt11 0 6553.5 SYMBOL_LINK "CalPrmBrkTqCtrlrBrk01.U16LfcRiseNotSuctnNo1VlvCurPGrdt32" 0 /end CHARACTERISTIC
/begin CHARACTERISTIC U16LfcRiseNotSuctnNo1VlvCurPGrdt33 "Target brake pressure gradient for determine NO valve current at LFC rise mode without suction (3 point of 9 interpolation at pressure error 3 point)" VALUE 0x800212BE CalPrmBrkTqCtrlrBrk_UWORD 0 PGrdt11 0 6553.5 SYMBOL_LINK "CalPrmBrkTqCtrlrBrk01.U16LfcRiseNotSuctnNo1VlvCurPGrdt33" 0 /end CHARACTERISTIC
/begin CHARACTERISTIC U16LfcRiseNotSuctnNo1VlvCurPGrdt34 "Target brake pressure gradient for determine NO valve current at LFC rise mode without suction (4 point of 9 interpolation at pressure error 3 point)" VALUE 0x800212C0 CalPrmBrkTqCtrlrBrk_UWORD 0 PGrdt11 0 6553.5 SYMBOL_LINK "CalPrmBrkTqCtrlrBrk01.U16LfcRiseNotSuctnNo1VlvCurPGrdt34" 0 /end CHARACTERISTIC
/begin CHARACTERISTIC U16LfcRiseNotSuctnNo1VlvCurPGrdt35 "Target brake pressure gradient for determine NO valve current at LFC rise mode without suction (5 point of 9 interpolation at pressure error 3 point)" VALUE 0x800212C2 CalPrmBrkTqCtrlrBrk_UWORD 0 PGrdt11 0 6553.5 SYMBOL_LINK "CalPrmBrkTqCtrlrBrk01.U16LfcRiseNotSuctnNo1VlvCurPGrdt35" 0 /end CHARACTERISTIC
/begin CHARACTERISTIC U16LfcRiseNotSuctnNo1VlvCurPGrdt36 "Target brake pressure gradient for determine NO valve current at LFC rise mode without suction (6 point of 9 interpolation at pressure error 3 point)" VALUE 0x800212C4 CalPrmBrkTqCtrlrBrk_UWORD 0 PGrdt11 0 6553.5 SYMBOL_LINK "CalPrmBrkTqCtrlrBrk01.U16LfcRiseNotSuctnNo1VlvCurPGrdt36" 0 /end CHARACTERISTIC
/begin CHARACTERISTIC U16LfcRiseNotSuctnNo1VlvCurPGrdt37 "Target brake pressure gradient for determine NO valve current at LFC rise mode without suction (7 point of 9 interpolation at pressure error 3 point)" VALUE 0x800212C6 CalPrmBrkTqCtrlrBrk_UWORD 0 PGrdt11 0 6553.5 SYMBOL_LINK "CalPrmBrkTqCtrlrBrk01.U16LfcRiseNotSuctnNo1VlvCurPGrdt37" 0 /end CHARACTERISTIC
/begin CHARACTERISTIC U16LfcRiseNotSuctnNo1VlvCurPGrdt38 "Target brake pressure gradient for determine NO valve current at LFC rise mode without suction (8 point of 9 interpolation at pressure error 3 point)" VALUE 0x800212C8 CalPrmBrkTqCtrlrBrk_UWORD 0 PGrdt11 0 6553.5 SYMBOL_LINK "CalPrmBrkTqCtrlrBrk01.U16LfcRiseNotSuctnNo1VlvCurPGrdt38" 0 /end CHARACTERISTIC
/begin CHARACTERISTIC U16LfcRiseNotSuctnNo1VlvCurPGrdt39 "Target brake pressure gradient for determine NO valve current at LFC rise mode without suction (9 point of 9 interpolation at pressure error 3 point)" VALUE 0x800212CA CalPrmBrkTqCtrlrBrk_UWORD 0 PGrdt11 0 6553.5 SYMBOL_LINK "CalPrmBrkTqCtrlrBrk01.U16LfcRiseNotSuctnNo1VlvCurPGrdt39" 0 /end CHARACTERISTIC
/begin CHARACTERISTIC U16LfcRiseNotSuctnPGrdtNo1VlvCur31 "NO valve current at target brake pressure gradient 1 point at pressure error 3 point without suction" VALUE 0x800212CC CalPrmBrkTqCtrlrBrk_UWORD 0 Amp2 0 65.535 SYMBOL_LINK "CalPrmBrkTqCtrlrBrk01.U16LfcRiseNotSuctnPGrdtNo1VlvCur31" 0 /end CHARACTERISTIC
/begin CHARACTERISTIC U16LfcRiseNotSuctnPGrdtNo1VlvCur32 "NO valve current at target brake pressure gradient 2 point at pressure error 3 point without suction" VALUE 0x800212CE CalPrmBrkTqCtrlrBrk_UWORD 0 Amp2 0 65.535 SYMBOL_LINK "CalPrmBrkTqCtrlrBrk01.U16LfcRiseNotSuctnPGrdtNo1VlvCur32" 0 /end CHARACTERISTIC
/begin CHARACTERISTIC U16LfcRiseNotSuctnPGrdtNo1VlvCur33 "NO valve current at target brake pressure gradient 3 point at pressure error 3 point without suction" VALUE 0x800212D0 CalPrmBrkTqCtrlrBrk_UWORD 0 Amp2 0 65.535 SYMBOL_LINK "CalPrmBrkTqCtrlrBrk01.U16LfcRiseNotSuctnPGrdtNo1VlvCur33" 0 /end CHARACTERISTIC
/begin CHARACTERISTIC U16LfcRiseNotSuctnPGrdtNo1VlvCur34 "NO valve current at target brake pressure gradient 4 point at pressure error 3 point without suction" VALUE 0x800212D2 CalPrmBrkTqCtrlrBrk_UWORD 0 Amp2 0 65.535 SYMBOL_LINK "CalPrmBrkTqCtrlrBrk01.U16LfcRiseNotSuctnPGrdtNo1VlvCur34" 0 /end CHARACTERISTIC
/begin CHARACTERISTIC U16LfcRiseNotSuctnPGrdtNo1VlvCur35 "NO valve current at target brake pressure gradient 5 point at pressure error 3 point without suction" VALUE 0x800212D4 CalPrmBrkTqCtrlrBrk_UWORD 0 Amp2 0 65.535 SYMBOL_LINK "CalPrmBrkTqCtrlrBrk01.U16LfcRiseNotSuctnPGrdtNo1VlvCur35" 0 /end CHARACTERISTIC
/begin CHARACTERISTIC U16LfcRiseNotSuctnPGrdtNo1VlvCur36 "NO valve current at target brake pressure gradient 6 point at pressure error 3 point without suction" VALUE 0x800212D6 CalPrmBrkTqCtrlrBrk_UWORD 0 Amp2 0 65.535 SYMBOL_LINK "CalPrmBrkTqCtrlrBrk01.U16LfcRiseNotSuctnPGrdtNo1VlvCur36" 0 /end CHARACTERISTIC
/begin CHARACTERISTIC U16LfcRiseNotSuctnPGrdtNo1VlvCur37 "NO valve current at target brake pressure gradient 7 point at pressure error 3 point without suction" VALUE 0x800212D8 CalPrmBrkTqCtrlrBrk_UWORD 0 Amp2 0 65.535 SYMBOL_LINK "CalPrmBrkTqCtrlrBrk01.U16LfcRiseNotSuctnPGrdtNo1VlvCur37" 0 /end CHARACTERISTIC
/begin CHARACTERISTIC U16LfcRiseNotSuctnPGrdtNo1VlvCur38 "NO valve current at target brake pressure gradient 8 point at pressure error 3 point without suction" VALUE 0x800212DA CalPrmBrkTqCtrlrBrk_UWORD 0 Amp2 0 65.535 SYMBOL_LINK "CalPrmBrkTqCtrlrBrk01.U16LfcRiseNotSuctnPGrdtNo1VlvCur38" 0 /end CHARACTERISTIC
/begin CHARACTERISTIC U16LfcRiseNotSuctnPGrdtNo1VlvCur39 "NO valve current at target brake pressure gradient 9 point at pressure error 3 point without suction" VALUE 0x800212DC CalPrmBrkTqCtrlrBrk_UWORD 0 Amp2 0 65.535 SYMBOL_LINK "CalPrmBrkTqCtrlrBrk01.U16LfcRiseNotSuctnPGrdtNo1VlvCur39" 0 /end CHARACTERISTIC
/begin CHARACTERISTIC U16LfcTestIniCur "" VALUE 0x800214D4 CalPrmBrkTqCtrlrBrk_UWORD 0 Amp2 0 65.535 SYMBOL_LINK "CalPrmBrkTqCtrlrBrk01.U16LfcTestIniCur" 0 /end CHARACTERISTIC
/begin CHARACTERISTIC U16LfcTestIntlCur "" VALUE 0x800214D6 CalPrmBrkTqCtrlrBrk_UWORD 0 Amp2 0 65.535 SYMBOL_LINK "CalPrmBrkTqCtrlrBrk01.U16LfcTestIntlCur" 0 /end CHARACTERISTIC
/begin CHARACTERISTIC U16MotUVddU1 "Vdd voltage for determine compensation target motor voltage (1 point of 2 interpolation)" VALUE 0x80021484 CalPrmBrkTqCtrlrBrk_UWORD 0 U11 0 65.535 SYMBOL_LINK "CalPrmBrkTqCtrlrBrk01.U16MotUVddU1" 0 /end CHARACTERISTIC
/begin CHARACTERISTIC U16MotUVddU2 "Vdd voltage for determine compensation target motor voltage (2 point of 2 interpolation)" VALUE 0x80021486 CalPrmBrkTqCtrlrBrk_UWORD 0 U11 0 65.535 SYMBOL_LINK "CalPrmBrkTqCtrlrBrk01.U16MotUVddU2" 0 /end CHARACTERISTIC
/begin CHARACTERISTIC U16No1VlvCurTestActtnTi "" VALUE 0x800214CC CalPrmBrkTqCtrlrBrk_UWORD 0 Ti41 0 327.675 SYMBOL_LINK "CalPrmBrkTqCtrlrBrk01.U16No1VlvCurTestActtnTi" 0 /end CHARACTERISTIC
/begin CHARACTERISTIC U16No1VlvCurTestIniCur "" VALUE 0x800214CE CalPrmBrkTqCtrlrBrk_UWORD 0 Amp2 0 65.535 SYMBOL_LINK "CalPrmBrkTqCtrlrBrk01.U16No1VlvCurTestIniCur" 0 /end CHARACTERISTIC
/begin CHARACTERISTIC U16No1VlvCurTestIntlCur "" VALUE 0x800214D0 CalPrmBrkTqCtrlrBrk_UWORD 0 Amp2 0 65.535 SYMBOL_LINK "CalPrmBrkTqCtrlrBrk01.U16No1VlvCurTestIntlCur" 0 /end CHARACTERISTIC
/begin CHARACTERISTIC U16No1VlvCurTestMotU "" VALUE 0x800214D2 CalPrmBrkTqCtrlrBrk_UWORD 0 U11 0 65.535 SYMBOL_LINK "CalPrmBrkTqCtrlrBrk01.U16No1VlvCurTestMotU" 0 /end CHARACTERISTIC
/begin CHARACTERISTIC U16TcVlvCurMax "TC valve max current (for controller)" VALUE 0x80021300 CalPrmBrkTqCtrlrBrk_UWORD 0 Amp2 0 65.535 SYMBOL_LINK "CalPrmBrkTqCtrlrBrk01.U16TcVlvCurMax" 0 /end CHARACTERISTIC
/begin CHARACTERISTIC U16TcVlvCurMin "TC valve min current" VALUE 0x800212FE CalPrmBrkTqCtrlrBrk_UWORD 0 Amp2 0 65.535 SYMBOL_LINK "CalPrmBrkTqCtrlrBrk01.U16TcVlvCurMin" 0 /end CHARACTERISTIC
/begin CHARACTERISTIC U16TcVlvCurSysMax "TC valve max current (system limit)" VALUE 0x80021302 CalPrmBrkTqCtrlrBrk_UWORD 0 Amp2 0 65.535 SYMBOL_LINK "CalPrmBrkTqCtrlrBrk01.U16TcVlvCurSysMax" 0 /end CHARACTERISTIC
/begin CHARACTERISTIC U16TcVlvLeakTestHldCur1 "" VALUE 0x800214EE CalPrmBrkTqCtrlrBrk_UWORD 0 Amp2 0 65.535 SYMBOL_LINK "CalPrmBrkTqCtrlrBrk01.U16TcVlvLeakTestHldCur1" 0 /end CHARACTERISTIC
/begin CHARACTERISTIC U16TcVlvLeakTestHldCur2 "" VALUE 0x800214F0 CalPrmBrkTqCtrlrBrk_UWORD 0 Amp2 0 65.535 SYMBOL_LINK "CalPrmBrkTqCtrlrBrk01.U16TcVlvLeakTestHldCur2" 0 /end CHARACTERISTIC
/begin CHARACTERISTIC U16TcVlvLeakTestIniHldEndCur1 "" VALUE 0x800214EA CalPrmBrkTqCtrlrBrk_UWORD 0 Amp2 0 65.535 SYMBOL_LINK "CalPrmBrkTqCtrlrBrk01.U16TcVlvLeakTestIniHldEndCur1" 0 /end CHARACTERISTIC
/begin CHARACTERISTIC U16TcVlvLeakTestIniHldEndCur2 "" VALUE 0x800214EC CalPrmBrkTqCtrlrBrk_UWORD 0 Amp2 0 65.535 SYMBOL_LINK "CalPrmBrkTqCtrlrBrk01.U16TcVlvLeakTestIniHldEndCur2" 0 /end CHARACTERISTIC
/begin CHARACTERISTIC U16TcVlvLeakTestIniHldPeakCur "" VALUE 0x800214E8 CalPrmBrkTqCtrlrBrk_UWORD 0 Amp2 0 65.535 SYMBOL_LINK "CalPrmBrkTqCtrlrBrk01.U16TcVlvLeakTestIniHldPeakCur" 0 /end CHARACTERISTIC
/begin CHARACTERISTIC U16TcVlvLeakTestIniHldStrtCur "" VALUE 0x800214E6 CalPrmBrkTqCtrlrBrk_UWORD 0 Amp2 0 65.535 SYMBOL_LINK "CalPrmBrkTqCtrlrBrk01.U16TcVlvLeakTestIniHldStrtCur" 0 /end CHARACTERISTIC
/begin CHARACTERISTIC U16VddUMotU1 "Compensation target motor voltage at Vdd voltage 1 point" VALUE 0x80021488 CalPrmBrkTqCtrlrBrk_UWORD 0 U11 0 65.535 SYMBOL_LINK "CalPrmBrkTqCtrlrBrk01.U16VddUMotU1" 0 /end CHARACTERISTIC
/begin CHARACTERISTIC U16VddUMotU2 "Compensation target motor voltage at Vdd voltage 2 point" VALUE 0x8002148A CalPrmBrkTqCtrlrBrk_UWORD 0 U11 0 65.535 SYMBOL_LINK "CalPrmBrkTqCtrlrBrk01.U16VddUMotU2" 0 /end CHARACTERISTIC
/begin CHARACTERISTIC U16_ACC_I_ERROR_LEVEL_H "ACC threshold level of large error" VALUE 0x8003A8FE CalPrmVehLgtCoorrEng_UWORD 0 Fac31 0 65535 SYMBOL_LINK "CalPrmVehLgtCoorrEng01.U16_ACC_I_ERROR_LEVEL_H" 0 /end CHARACTERISTIC
/begin CHARACTERISTIC U16_ACC_I_ERROR_LEVEL_S "ACC threshold level of small error" VALUE 0x8003A900 CalPrmVehLgtCoorrEng_UWORD 0 Fac31 0 65535 SYMBOL_LINK "CalPrmVehLgtCoorrEng01.U16_ACC_I_ERROR_LEVEL_S" 0 /end CHARACTERISTIC
/begin CHARACTERISTIC U16_DPB_CTRL_PERIOD_MAX "DPB To be defined" VALUE 0x8002106C CalPrmVehLgtCoorrBrk_UWORD 0 Amp2 0 65.535 SYMBOL_LINK "CalPrmVehLgtCoorrBrk01.U16_DPB_CTRL_PERIOD_MAX" 0 /end CHARACTERISTIC
/begin CHARACTERISTIC U16_DPB_CTRL_PERIOD_MAX_A_ABS "DPB To be defined" VALUE 0x80021070 CalPrmVehLgtCoorrBrk_UWORD 0 PGrdt11 0 6553.5 SYMBOL_LINK "CalPrmVehLgtCoorrBrk01.U16_DPB_CTRL_PERIOD_MAX_A_ABS" 0 /end CHARACTERISTIC
/begin CHARACTERISTIC U16_DPB_CTRL_PERIOD_MIN "DPB To be defined" VALUE 0x8002106E CalPrmVehLgtCoorrBrk_UWORD 0 Amp2 0 65.535 SYMBOL_LINK "CalPrmVehLgtCoorrBrk01.U16_DPB_CTRL_PERIOD_MIN" 0 /end CHARACTERISTIC
/begin CHARACTERISTIC U16_DPB_CTRL_PERIOD_MIN_A_ABS "DPB To be defined" VALUE 0x80021072 CalPrmVehLgtCoorrBrk_UWORD 0 PGrdt11 0 6553.5 SYMBOL_LINK "CalPrmVehLgtCoorrBrk01.U16_DPB_CTRL_PERIOD_MIN_A_ABS" 0 /end CHARACTERISTIC
/begin CHARACTERISTIC U16_DPB_FF_CTRL_RISE_STEP "DPB To be defined" VALUE 0x80021068 CalPrmVehLgtCoorrBrk_UWORD 0 Amp2 0 65.535 SYMBOL_LINK "CalPrmVehLgtCoorrBrk01.U16_DPB_FF_CTRL_RISE_STEP" 0 /end CHARACTERISTIC
/begin CHARACTERISTIC U16_DPB_FF_MAX_TIME "DPB To be defined" VALUE 0x80021088 CalPrmVehLgtCoorrBrk_UWORD 0 Amp2 0 65.535 SYMBOL_LINK "CalPrmVehLgtCoorrBrk01.U16_DPB_FF_MAX_TIME" 0 /end CHARACTERISTIC
/begin CHARACTERISTIC U16_DPB_FF_TQ_GRD_INIT_TIME "DPB To be defined" VALUE 0x80021086 CalPrmVehLgtCoorrBrk_UWORD 0 Amp2 0 65.535 SYMBOL_LINK "CalPrmVehLgtCoorrBrk01.U16_DPB_FF_TQ_GRD_INIT_TIME" 0 /end CHARACTERISTIC
/begin CHARACTERISTIC U16_DPB_SMOOTHCLOSING_CTRL_TIME "DPB To be defined" VALUE 0x8002106A CalPrmVehLgtCoorrBrk_UWORD 0 Amp2 0 65.535 SYMBOL_LINK "CalPrmVehLgtCoorrBrk01.U16_DPB_SMOOTHCLOSING_CTRL_TIME" 0 /end CHARACTERISTIC
/begin CHARACTERISTIC U32TcVlvLeakTestActtnTi "" VALUE 0x800214E0 CalPrmBrkTqCtrlrBrk_ULONG 0 Ti41 0 21474836.475 SYMBOL_LINK "CalPrmBrkTqCtrlrBrk01.U32TcVlvLeakTestActtnTi" 0 /end CHARACTERISTIC
/begin CHARACTERISTIC U8CircBleedingTcVlvClsTi "" VALUE 0x800214D9 CalPrmBrkTqCtrlrBrk_UBYTE 0 Ti41 0 1.275 SYMBOL_LINK "CalPrmBrkTqCtrlrBrk01.U8CircBleedingTcVlvClsTi" 0 /end CHARACTERISTIC
/begin CHARACTERISTIC U8CircBleedingTcVlvOpenTi "" VALUE 0x800214D8 CalPrmBrkTqCtrlrBrk_UBYTE 0 Ti41 0 1.275 SYMBOL_LINK "CalPrmBrkTqCtrlrBrk01.U8CircBleedingTcVlvOpenTi" 0 /end CHARACTERISTIC
/begin CHARACTERISTIC U8EsvVlvCurMax "ESV valve max current (for controller)" VALUE 0x800213CA CalPrmBrkTqCtrlrBrk_UBYTE 0 Amp1 0 2.55 SYMBOL_LINK "CalPrmBrkTqCtrlrBrk01.U8EsvVlvCurMax" 0 /end CHARACTERISTIC
/begin CHARACTERISTIC U8EsvVlvCurSysMax "ESV valve max current (system limit)" VALUE 0x800213CB CalPrmBrkTqCtrlrBrk_UBYTE 0 Amp1 0 2.55 SYMBOL_LINK "CalPrmBrkTqCtrlrBrk01.U8EsvVlvCurSysMax" 0 /end CHARACTERISTIC
/begin CHARACTERISTIC U8HwTestMod "HW test mode" VALUE 0x800214AE CalPrmBrkTqCtrlrBrk_UBYTE 0 HwTestMod 0 255 SYMBOL_LINK "CalPrmBrkTqCtrlrBrk01.U8HwTestMod" 0 /end CHARACTERISTIC
/begin CHARACTERISTIC U8TcVlvLeakTestFadeOutTi "" VALUE 0x800214E4 CalPrmBrkTqCtrlrBrk_UBYTE 0 Ti41 0 1.275 SYMBOL_LINK "CalPrmBrkTqCtrlrBrk01.U8TcVlvLeakTestFadeOutTi" 0 /end CHARACTERISTIC
/begin CHARACTERISTIC U8TcVlvLeakTestIniHldFirstTi "" VALUE 0x800214DE CalPrmBrkTqCtrlrBrk_UBYTE 0 Ti41 0 1.275 SYMBOL_LINK "CalPrmBrkTqCtrlrBrk01.U8TcVlvLeakTestIniHldFirstTi" 0 /end CHARACTERISTIC
/begin CHARACTERISTIC U8TcVlvLeakTestIniHldSecTi "" VALUE 0x800214DF CalPrmBrkTqCtrlrBrk_UBYTE 0 Ti41 0 1.275 SYMBOL_LINK "CalPrmBrkTqCtrlrBrk01.U8TcVlvLeakTestIniHldSecTi" 0 /end CHARACTERISTIC
/begin CHARACTERISTIC U8_ACC_I_PSEUDO_GAIN_ERROR_BRAKE_H "ACC feedback torque pseudo gain of I for brake control at large error" VALUE 0x8003A902 CalPrmVehLgtCoorrEng_UBYTE 0 Fac31 0 255 SYMBOL_LINK "CalPrmVehLgtCoorrEng01.U8_ACC_I_PSEUDO_GAIN_ERROR_BRAKE_H" 0 /end CHARACTERISTIC
/begin CHARACTERISTIC U8_ACC_I_PSEUDO_GAIN_ERROR_BRAKE_S "ACC feedback torque pseudo gain of I for brake control at small error" VALUE 0x8003A903 CalPrmVehLgtCoorrEng_UBYTE 0 Fac31 0 255 SYMBOL_LINK "CalPrmVehLgtCoorrEng01.U8_ACC_I_PSEUDO_GAIN_ERROR_BRAKE_S" 0 /end CHARACTERISTIC
/begin CHARACTERISTIC U8_ACC_I_PSEUDO_GAIN_ERROR_NEG_H "ACC feedback torque pseudo gain of I for engine control at large error (negative error)" VALUE 0x8003A904 CalPrmVehLgtCoorrEng_UBYTE 0 Fac31 0 255 SYMBOL_LINK "CalPrmVehLgtCoorrEng01.U8_ACC_I_PSEUDO_GAIN_ERROR_NEG_H" 0 /end CHARACTERISTIC
/begin CHARACTERISTIC U8_ACC_I_PSEUDO_GAIN_ERROR_NEG_S "ACC feedback torque pseudo gain of I for engine control at small error (negative error)" VALUE 0x8003A905 CalPrmVehLgtCoorrEng_UBYTE 0 Fac31 0 255 SYMBOL_LINK "CalPrmVehLgtCoorrEng01.U8_ACC_I_PSEUDO_GAIN_ERROR_NEG_S" 0 /end CHARACTERISTIC
/begin CHARACTERISTIC U8_ACC_I_PSEUDO_GAIN_ERROR_POS_H "ACC feedback torque pseudo gain of I for engine control at large error (postive error)" VALUE 0x8003A906 CalPrmVehLgtCoorrEng_UBYTE 0 Fac31 0 255 SYMBOL_LINK "CalPrmVehLgtCoorrEng01.U8_ACC_I_PSEUDO_GAIN_ERROR_POS_H" 0 /end CHARACTERISTIC
/begin CHARACTERISTIC U8_ACC_I_PSEUDO_GAIN_ERROR_POS_S "ACC feedback torque pseudo gain of I for engine control at small error (postive error)" VALUE 0x8003A907 CalPrmVehLgtCoorrEng_UBYTE 0 Fac31 0 255 SYMBOL_LINK "CalPrmVehLgtCoorrEng01.U8_ACC_I_PSEUDO_GAIN_ERROR_POS_S" 0 /end CHARACTERISTIC
/begin CHARACTERISTIC U8_ACC_TEMP_01 "ACC temporary unsigned character parameter 01" VALUE 0x80021046 CalPrmVehLgtCoorrBrk_UBYTE 0 Fac31 0 255 SYMBOL_LINK "CalPrmVehLgtCoorrBrk01.U8_ACC_TEMP_01" 0 /end CHARACTERISTIC
/begin CHARACTERISTIC U8_ACC_TEMP_02 "ACC temporary unsigned character parameter 02" VALUE 0x80021047 CalPrmVehLgtCoorrBrk_UBYTE 0 Fac31 0 255 SYMBOL_LINK "CalPrmVehLgtCoorrBrk01.U8_ACC_TEMP_02" 0 /end CHARACTERISTIC
/begin CHARACTERISTIC U8_ACC_TEMP_03 "ACC temporary unsigned character parameter 03" VALUE 0x80021048 CalPrmVehLgtCoorrBrk_UBYTE 0 Fac31 0 255 SYMBOL_LINK "CalPrmVehLgtCoorrBrk01.U8_ACC_TEMP_03" 0 /end CHARACTERISTIC
/begin CHARACTERISTIC U8_ACC_TEMP_04 "ACC temporary unsigned character parameter 04" VALUE 0x80021049 CalPrmVehLgtCoorrBrk_UBYTE 0 Fac31 0 255 SYMBOL_LINK "CalPrmVehLgtCoorrBrk01.U8_ACC_TEMP_04" 0 /end CHARACTERISTIC
/begin CHARACTERISTIC U8_AEB_TEMP_01 "AEB temporary unsigned character parameter 01" VALUE 0x8002105C CalPrmVehLgtCoorrBrk_UBYTE 0 Fac31 0 255 SYMBOL_LINK "CalPrmVehLgtCoorrBrk01.U8_AEB_TEMP_01" 0 /end CHARACTERISTIC
/begin CHARACTERISTIC U8_AEB_TEMP_02 "AEB temporary unsigned character parameter 02" VALUE 0x8002105D CalPrmVehLgtCoorrBrk_UBYTE 0 Fac31 0 255 SYMBOL_LINK "CalPrmVehLgtCoorrBrk01.U8_AEB_TEMP_02" 0 /end CHARACTERISTIC
/begin CHARACTERISTIC U8_AEB_TEMP_03 "AEB temporary unsigned character parameter 03" VALUE 0x8002105E CalPrmVehLgtCoorrBrk_UBYTE 0 Fac31 0 255 SYMBOL_LINK "CalPrmVehLgtCoorrBrk01.U8_AEB_TEMP_03" 0 /end CHARACTERISTIC
/begin CHARACTERISTIC U8_DPB_FF_CTRL_DECEL_ERROR_PER "DPB To be defined" VALUE 0x80021066 CalPrmVehLgtCoorrBrk_UBYTE 0 Amp2 0 0.255 SYMBOL_LINK "CalPrmVehLgtCoorrBrk01.U8_DPB_FF_CTRL_DECEL_ERROR_PER" 0 /end CHARACTERISTIC
/begin CHARACTERISTIC U8_WPE_WPE_ESC_Rise_Hold_Comp_1st "Temp" VALUE 0x8002161F CalPrmBrkTqCtrlrBrk_UBYTE 0 Gain 0 255 SYMBOL_LINK "CalPrmBrkTqCtrlrBrk01.U8_WPE_WPE_ESC_Rise_Hold_Comp_1st" 0 /end CHARACTERISTIC
/begin CHARACTERISTIC U8_WPE_WPE_ESC_Rise_Hold_Comp_2nd "Temp" VALUE 0x80021620 CalPrmBrkTqCtrlrBrk_UBYTE 0 Gain 0 255 SYMBOL_LINK "CalPrmBrkTqCtrlrBrk01.U8_WPE_WPE_ESC_Rise_Hold_Comp_2nd" 0 /end CHARACTERISTIC
/begin CHARACTERISTIC U8_WPE_WPE_ESC_Rise_Hold_Thres_1st "Temp" VALUE 0x8002161C CalPrmBrkTqCtrlrBrk_UBYTE 0 Gain 0 255 SYMBOL_LINK "CalPrmBrkTqCtrlrBrk01.U8_WPE_WPE_ESC_Rise_Hold_Thres_1st" 0 /end CHARACTERISTIC
/begin CHARACTERISTIC U8_WPE_WPE_ESC_Rise_Hold_Thres_2nd "Temp" VALUE 0x8002161D CalPrmBrkTqCtrlrBrk_UBYTE 0 Gain 0 255 SYMBOL_LINK "CalPrmBrkTqCtrlrBrk01.U8_WPE_WPE_ESC_Rise_Hold_Thres_2nd" 0 /end CHARACTERISTIC
/begin CHARACTERISTIC U8_WPE_WPE_ESC_Rise_Hold_Thres_3rd "Temp" VALUE 0x8002161E CalPrmBrkTqCtrlrBrk_UBYTE 0 Gain 0 255 SYMBOL_LINK "CalPrmBrkTqCtrlrBrk01.U8_WPE_WPE_ESC_Rise_Hold_Thres_3rd" 0 /end CHARACTERISTIC
/begin CHARACTERISTIC U8_WPE_WPE_Straight_Cont_Comp_T "Temp" VALUE 0x80021553 CalPrmBrkTqCtrlrBrk_UBYTE 0 Gain 0 255 SYMBOL_LINK "CalPrmBrkTqCtrlrBrk01.U8_WPE_WPE_Straight_Cont_Comp_T" 0 /end CHARACTERISTIC
/begin CHARACTERISTIC U8_WPE_WPE_Straight_Cont_Comp_f "Temp" VALUE 0x80021554 CalPrmBrkTqCtrlrBrk_UBYTE 0 Gain 0 255 SYMBOL_LINK "CalPrmBrkTqCtrlrBrk01.U8_WPE_WPE_Straight_Cont_Comp_f" 0 /end CHARACTERISTIC
/begin CHARACTERISTIC U8_WPE_WPE_Straight_Cont_Comp_r "Temp" VALUE 0x80021555 CalPrmBrkTqCtrlrBrk_UBYTE 0 Gain 0 255 SYMBOL_LINK "CalPrmBrkTqCtrlrBrk01.U8_WPE_WPE_Straight_Cont_Comp_r" 0 /end CHARACTERISTIC
/begin COMPU_METHOD A42 "" LINEAR "%.15" "g" COEFFS_LINEAR 0.01 0 /end COMPU_METHOD
/begin COMPU_METHOD A48 "" LINEAR "%.15" "g" COEFFS_LINEAR 0.0001 0 /end COMPU_METHOD
/begin COMPU_METHOD Ag43 "" LINEAR "%.15" "deg" COEFFS_LINEAR 10 0 /end COMPU_METHOD
/begin COMPU_METHOD Amp1 "" LINEAR "%.15" "A" COEFFS_LINEAR 0.01 0 /end COMPU_METHOD
/begin COMPU_METHOD Amp2 "" LINEAR "%.15" "A" COEFFS_LINEAR 0.001 0 /end COMPU_METHOD
/begin COMPU_METHOD Fac31 "" LINEAR "%.15" "NA" COEFFS_LINEAR 1 0 /end COMPU_METHOD
/begin COMPU_METHOD Gain "" LINEAR "%.15" "NA" COEFFS_LINEAR 1 0 /end COMPU_METHOD
/begin COMPU_METHOD HwTestMod "" LINEAR "%.15" "NA" COEFFS_LINEAR 1 0 STATUS_STRING_REF HwTestModTable /end COMPU_METHOD
/begin COMPU_METHOD M1 "" LINEAR "%.15" "kg" COEFFS_LINEAR 1 0 /end COMPU_METHOD
/begin COMPU_METHOD N10 "" LINEAR "%.15" "RPM" COEFFS_LINEAR 1 0 /end COMPU_METHOD
/begin COMPU_METHOD OffsVldyIndcr1 "" LINEAR "%.15" "NA" COEFFS_LINEAR 1 0 STATUS_STRING_REF OffVldTable /end COMPU_METHOD
/begin COMPU_METHOD OnOff1 "" LINEAR "%.15" "NA" COEFFS_LINEAR 1 0 STATUS_STRING_REF OnOffTable /end COMPU_METHOD
/begin COMPU_METHOD OpendClsd2 "" LINEAR "%.15" "NA" COEFFS_LINEAR 1 0 STATUS_STRING_REF OpenTable /end COMPU_METHOD
/begin COMPU_METHOD OperModSts1 "" LINEAR "%.15" "NA" COEFFS_LINEAR 1 0 /end COMPU_METHOD
/begin COMPU_METHOD OverSteerSts1 "" LINEAR "%.15" "NA" COEFFS_LINEAR 1 0 STATUS_STRING_REF OverStrTable /end COMPU_METHOD
/begin COMPU_METHOD P41 "" LINEAR "%.15" "hPa" COEFFS_LINEAR 1 0 /end COMPU_METHOD
/begin COMPU_METHOD PCtrlMod "" LINEAR "%.15" "NA" COEFFS_LINEAR 1 0 STATUS_STRING_REF PCtrlModTable /end COMPU_METHOD
/begin COMPU_METHOD PCtrlModNotTcmf "" LINEAR "%.15" "NA" COEFFS_LINEAR 1 0 STATUS_STRING_REF PCtrlModNotTcmfTable /end COMPU_METHOD
/begin COMPU_METHOD PCtrlModTcmf "" LINEAR "%.15" "NA" COEFFS_LINEAR 1 0 STATUS_STRING_REF PCtrlModTcmfTable /end COMPU_METHOD
/begin COMPU_METHOD PCtrlModTcmfCmp "" LINEAR "%.15" "NA" COEFFS_LINEAR 1 0 STATUS_STRING_REF PCtrlModTcmfCmpTable /end COMPU_METHOD
/begin COMPU_METHOD PCtrlModTcmfIni "" LINEAR "%.15" "NA" COEFFS_LINEAR 1 0 STATUS_STRING_REF PCtrlModTcmfIniTable /end COMPU_METHOD
/begin COMPU_METHOD PCtrlModTcmfNorm "" LINEAR "%.15" "NA" COEFFS_LINEAR 1 0 STATUS_STRING_REF PCtrlModTcmfNormTable /end COMPU_METHOD
/begin COMPU_METHOD PGrdt11 "" LINEAR "%.15" "barPersec" COEFFS_LINEAR 0.1 0 /end COMPU_METHOD
/begin COMPU_METHOD PGrdt12 "" LINEAR "%.15" "barPersec" COEFFS_LINEAR 1 0 /end COMPU_METHOD
/begin COMPU_METHOD PGrdt14 "" LINEAR "%.15" "bar/50ms" COEFFS_LINEAR 0.1 0 /end COMPU_METHOD
/begin COMPU_METHOD PGrdt15 "" LINEAR "%.15" "bar/10ms" COEFFS_LINEAR 0.1 0 /end COMPU_METHOD
/begin COMPU_METHOD PdlPsd1 "" LINEAR "%.15" "NA" COEFFS_LINEAR 1 0 STATUS_STRING_REF PdlTable /end COMPU_METHOD
/begin COMPU_METHOD Perc2 "" LINEAR "%.15" "Percentage" COEFFS_LINEAR 0.5 0 /end COMPU_METHOD
/begin COMPU_METHOD Perc6 "" LINEAR "%.15" "Percentage" COEFFS_LINEAR 1 0 /end COMPU_METHOD
/begin COMPU_METHOD Perc9 "" LINEAR "%.15" "Percentage" COEFFS_LINEAR 0.1 0 /end COMPU_METHOD
/begin COMPU_METHOD PrkgBrkReq1 "" LINEAR "%.15" "NA" COEFFS_LINEAR 1 0 STATUS_STRING_REF PrkBrkReqTable /end COMPU_METHOD
/begin COMPU_METHOD PrkgBrkSts1 "" LINEAR "%.15" "NA" COEFFS_LINEAR 1 0 STATUS_STRING_REF PrkBrkStsTable /end COMPU_METHOD
/begin COMPU_METHOD Spd12 "" LINEAR "%.15" "kph" COEFFS_LINEAR 0.125 0 /end COMPU_METHOD
/begin COMPU_METHOD Ti11 "" LINEAR "%.15" "sec" COEFFS_LINEAR 1 0 /end COMPU_METHOD
/begin COMPU_METHOD Ti21 "" LINEAR "%.15" "sec" COEFFS_LINEAR 0.01 0 /end COMPU_METHOD
/begin COMPU_METHOD Ti41 "" LINEAR "%.15" "sec" COEFFS_LINEAR 0.005 0 /end COMPU_METHOD
/begin COMPU_METHOD Ti51 "" LINEAR "%.15" "sec" COEFFS_LINEAR 0.02 0 /end COMPU_METHOD
/begin COMPU_METHOD Tq2 "" LINEAR "%.15" "Nm" COEFFS_LINEAR 1 0 /end COMPU_METHOD
/begin COMPU_METHOD Tq51 "" LINEAR "%.15" "Nm" COEFFS_LINEAR 0.1 0 /end COMPU_METHOD
/begin COMPU_METHOD U11 "" LINEAR "%.15" "V" COEFFS_LINEAR 0.001 0 /end COMPU_METHOD
/begin COMPU_VTAB HwTestModTable "" TAB_VERB 9 0 "Not control" 1 "1 wheel rise test" 2 "4 wheel rise test" 3 "TC up-down test" 4 "TC relief test" 5 "NO valve current mapping test" 6 "LFC test" 7 "Circuit bleeding" 8 "TC leak test" DEFAULT_VALUE "" /end COMPU_VTAB
/begin COMPU_VTAB OffVldTable "" TAB_VERB 2 0 "Invalid" 1 "Valid" DEFAULT_VALUE "" /end COMPU_VTAB
/begin COMPU_VTAB OnOff1 "" TAB_VERB 2 0 "off" 1 "on" DEFAULT_VALUE "" /end COMPU_VTAB
/begin COMPU_VTAB OnOffTable "" TAB_VERB 2 0 "Off" 1 "On" DEFAULT_VALUE "" /end COMPU_VTAB
/begin COMPU_VTAB OpenTable "" TAB_VERB 2 0 "Closed" 1 "Opened" DEFAULT_VALUE "" /end COMPU_VTAB
/begin COMPU_VTAB OverStrTable "" TAB_VERB 2 0 "NotInOversteer" 1 "InOversteer" DEFAULT_VALUE "" /end COMPU_VTAB
/begin COMPU_VTAB PCtrlModNotTcmfTable "" TAB_VERB 7 0 "Not control" 1 "LFC rise control" 2 "Pulse-up rise control" 3 "Hold control" 4 "Dump control" 5 "WSLC control" 6 "TCMF control" DEFAULT_VALUE "" /end COMPU_VTAB
/begin COMPU_VTAB PCtrlModTable "" TAB_VERB 12 0 "Not control" 1 "TCMF initial rise control" 2 "TCMF rise control" 3 "TCMF hold control" 4 "TCMF dump control" 5 "TCMF initial hold control" 6 "TCMF compensation hold control" 7 "TCMF compensation dump control" 8 "LFC rise control" 9 "Pulse-up rise control" 10 "Hold control" 11 "Dump control" DEFAULT_VALUE "" /end COMPU_VTAB
/begin COMPU_VTAB PCtrlModTcmfCmpTable "" TAB_VERB 3 0 "Not control" 1 "TCMF compensation hold control" 2 "TCMF compensation dump control" DEFAULT_VALUE "" /end COMPU_VTAB
/begin COMPU_VTAB PCtrlModTcmfIniTable "" TAB_VERB 3 0 "Not control" 1 "TCMF initial rise control" 2 "TCMF Initial hold control" DEFAULT_VALUE "" /end COMPU_VTAB
/begin COMPU_VTAB PCtrlModTcmfNormTable "" TAB_VERB 4 0 "Not control" 1 "TCMF rise control" 2 "TCMF hold control" 3 "TCMF dump control" DEFAULT_VALUE "" /end COMPU_VTAB
/begin COMPU_VTAB PCtrlModTcmfTable "" TAB_VERB 8 0 "Not TCMF control" 1 "TCMF initial rise control" 2 "TCMF rise control" 3 "TCMF hold control" 4 "TCMF dump control" 5 "TCMF initial hold control" 6 "TCMF compensation hold control" 7 "TCMF compensation dump control" DEFAULT_VALUE "" /end COMPU_VTAB
/begin COMPU_VTAB PdlTable "" TAB_VERB 2 0 "PedalNotPressed" 1 "PedalPressed" DEFAULT_VALUE "" /end COMPU_VTAB
/begin COMPU_VTAB PrkBrkReqTable "" TAB_VERB 7 5 "None" 27 "ParkApply" 40 "HoldApply" 54 "Release" 66 "DynamicApply" 92 "RollerbenchApply" 111 "PadAdjustment" DEFAULT_VALUE "" /end COMPU_VTAB
/begin COMPU_VTAB PrkBrkStsTable "" TAB_VERB 7 27 "ParkApplied" 40 "HoldApplied" 54 "Released" 113 "Applying" 142 "Releasing" 144 "CompletelyReleased" 163 "Unknown" DEFAULT_VALUE "" /end COMPU_VTAB
/begin RECORD_LAYOUT CalPrmAwdCtrlrEng_UBYTE FNC_VALUES 1 UBYTE COLUMN_DIR DIRECT ALIGNMENT_BYTE 1 ALIGNMENT_WORD 1 ALIGNMENT_LONG 1 ALIGNMENT_FLOAT32_IEEE 1 ALIGNMENT_FLOAT64_IEEE 1 ALIGNMENT_INT64 1 /end RECORD_LAYOUT
/begin RECORD_LAYOUT CalPrmBrkTqCtrlrBrk_UBYTE FNC_VALUES 1 UBYTE COLUMN_DIR DIRECT ALIGNMENT_BYTE 1 ALIGNMENT_WORD 1 ALIGNMENT_LONG 1 ALIGNMENT_FLOAT32_IEEE 1 ALIGNMENT_FLOAT64_IEEE 1 ALIGNMENT_INT64 1 /end RECORD_LAYOUT
/begin RECORD_LAYOUT CalPrmBrkTqCtrlrBrk_ULONG FNC_VALUES 1 ULONG COLUMN_DIR DIRECT ALIGNMENT_BYTE 1 ALIGNMENT_WORD 1 ALIGNMENT_LONG 1 ALIGNMENT_FLOAT32_IEEE 1 ALIGNMENT_FLOAT64_IEEE 1 ALIGNMENT_INT64 1 /end RECORD_LAYOUT
/begin RECORD_LAYOUT CalPrmBrkTqCtrlrBrk_UWORD FNC_VALUES 1 UWORD COLUMN_DIR DIRECT ALIGNMENT_BYTE 1 ALIGNMENT_WORD 1 ALIGNMENT_LONG 1 ALIGNMENT_FLOAT32_IEEE 1 ALIGNMENT_FLOAT64_IEEE 1 ALIGNMENT_INT64 1 /end RECORD_LAYOUT
/begin RECORD_LAYOUT CalPrmCmnBrk_SWORD FNC_VALUES 1 SWORD COLUMN_DIR DIRECT ALIGNMENT_BYTE 1 ALIGNMENT_WORD 1 ALIGNMENT_LONG 1 ALIGNMENT_FLOAT32_IEEE 1 ALIGNMENT_FLOAT64_IEEE 1 ALIGNMENT_INT64 1 /end RECORD_LAYOUT
/begin RECORD_LAYOUT CalPrmCmnBrk_UWORD FNC_VALUES 1 UWORD COLUMN_DIR DIRECT ALIGNMENT_BYTE 1 ALIGNMENT_WORD 1 ALIGNMENT_LONG 1 ALIGNMENT_FLOAT32_IEEE 1 ALIGNMENT_FLOAT64_IEEE 1 ALIGNMENT_INT64 1 /end RECORD_LAYOUT
/begin RECORD_LAYOUT CalPrmEstmrEng_SWORD FNC_VALUES 1 SWORD COLUMN_DIR DIRECT ALIGNMENT_BYTE 1 ALIGNMENT_WORD 1 ALIGNMENT_LONG 1 ALIGNMENT_FLOAT32_IEEE 1 ALIGNMENT_FLOAT64_IEEE 1 ALIGNMENT_INT64 1 /end RECORD_LAYOUT
/begin RECORD_LAYOUT CalPrmLatDynsCoorrBrk_SWORD FNC_VALUES 1 SWORD COLUMN_DIR DIRECT ALIGNMENT_BYTE 1 ALIGNMENT_WORD 1 ALIGNMENT_LONG 1 ALIGNMENT_FLOAT32_IEEE 1 ALIGNMENT_FLOAT64_IEEE 1 ALIGNMENT_INT64 1 /end RECORD_LAYOUT
/begin RECORD_LAYOUT CalPrmSsmBrk_SWORD FNC_VALUES 1 SWORD COLUMN_DIR DIRECT ALIGNMENT_BYTE 1 ALIGNMENT_WORD 1 ALIGNMENT_LONG 1 ALIGNMENT_FLOAT32_IEEE 1 ALIGNMENT_FLOAT64_IEEE 1 ALIGNMENT_INT64 1 /end RECORD_LAYOUT
/begin RECORD_LAYOUT CalPrmSsmBrk_UBYTE FNC_VALUES 1 UBYTE COLUMN_DIR DIRECT ALIGNMENT_BYTE 1 ALIGNMENT_WORD 1 ALIGNMENT_LONG 1 ALIGNMENT_FLOAT32_IEEE 1 ALIGNMENT_FLOAT64_IEEE 1 ALIGNMENT_INT64 1 /end RECORD_LAYOUT
/begin RECORD_LAYOUT CalPrmSsmBrk_UWORD FNC_VALUES 1 UWORD COLUMN_DIR DIRECT ALIGNMENT_BYTE 1 ALIGNMENT_WORD 1 ALIGNMENT_LONG 1 ALIGNMENT_FLOAT32_IEEE 1 ALIGNMENT_FLOAT64_IEEE 1 ALIGNMENT_INT64 1 /end RECORD_LAYOUT
/begin RECORD_LAYOUT CalPrmVehLgtCoorrBrk_SWORD FNC_VALUES 1 SWORD COLUMN_DIR DIRECT ALIGNMENT_BYTE 1 ALIGNMENT_WORD 1 ALIGNMENT_LONG 1 ALIGNMENT_FLOAT32_IEEE 1 ALIGNMENT_FLOAT64_IEEE 1 ALIGNMENT_INT64 1 /end RECORD_LAYOUT
/begin RECORD_LAYOUT CalPrmVehLgtCoorrBrk_UBYTE FNC_VALUES 1 UBYTE COLUMN_DIR DIRECT ALIGNMENT_BYTE 1 ALIGNMENT_WORD 1 ALIGNMENT_LONG 1 ALIGNMENT_FLOAT32_IEEE 1 ALIGNMENT_FLOAT64_IEEE 1 ALIGNMENT_INT64 1 /end RECORD_LAYOUT
/begin RECORD_LAYOUT CalPrmVehLgtCoorrBrk_UWORD FNC_VALUES 1 UWORD COLUMN_DIR DIRECT ALIGNMENT_BYTE 1 ALIGNMENT_WORD 1 ALIGNMENT_LONG 1 ALIGNMENT_FLOAT32_IEEE 1 ALIGNMENT_FLOAT64_IEEE 1 ALIGNMENT_INT64 1 /end RECORD_LAYOUT
/begin RECORD_LAYOUT CalPrmVehLgtCoorrEng_SWORD FNC_VALUES 1 SWORD COLUMN_DIR DIRECT ALIGNMENT_BYTE 1 ALIGNMENT_WORD 1 ALIGNMENT_LONG 1 ALIGNMENT_FLOAT32_IEEE 1 ALIGNMENT_FLOAT64_IEEE 1 ALIGNMENT_INT64 1 /end RECORD_LAYOUT
/begin RECORD_LAYOUT CalPrmVehLgtCoorrEng_UBYTE FNC_VALUES 1 UBYTE COLUMN_DIR DIRECT ALIGNMENT_BYTE 1 ALIGNMENT_WORD 1 ALIGNMENT_LONG 1 ALIGNMENT_FLOAT32_IEEE 1 ALIGNMENT_FLOAT64_IEEE 1 ALIGNMENT_INT64 1 /end RECORD_LAYOUT
/begin RECORD_LAYOUT CalPrmVehLgtCoorrEng_UWORD FNC_VALUES 1 UWORD COLUMN_DIR DIRECT ALIGNMENT_BYTE 1 ALIGNMENT_WORD 1 ALIGNMENT_LONG 1 ALIGNMENT_FLOAT32_IEEE 1 ALIGNMENT_FLOAT64_IEEE 1 ALIGNMENT_INT64 1 /end RECORD_LAYOUT
/begin RECORD_LAYOUT CalPrmWslcEng_SBYTE FNC_VALUES 1 SBYTE COLUMN_DIR DIRECT ALIGNMENT_BYTE 1 ALIGNMENT_WORD 1 ALIGNMENT_LONG 1 ALIGNMENT_FLOAT32_IEEE 1 ALIGNMENT_FLOAT64_IEEE 1 ALIGNMENT_INT64 1 /end RECORD_LAYOUT
/begin RECORD_LAYOUT CalPrmWslcEng_SWORD FNC_VALUES 1 SWORD COLUMN_DIR DIRECT ALIGNMENT_BYTE 1 ALIGNMENT_WORD 1 ALIGNMENT_LONG 1 ALIGNMENT_FLOAT32_IEEE 1 ALIGNMENT_FLOAT64_IEEE 1 ALIGNMENT_INT64 1 /end RECORD_LAYOUT
/begin RECORD_LAYOUT CalPrmWslcEng_UBYTE FNC_VALUES 1 UBYTE COLUMN_DIR DIRECT ALIGNMENT_BYTE 1 ALIGNMENT_WORD 1 ALIGNMENT_LONG 1 ALIGNMENT_FLOAT32_IEEE 1 ALIGNMENT_FLOAT64_IEEE 1 ALIGNMENT_INT64 1 /end RECORD_LAYOUT
/begin RECORD_LAYOUT CalPrmWslcEng_UWORD FNC_VALUES 1 UWORD COLUMN_DIR DIRECT ALIGNMENT_BYTE 1 ALIGNMENT_WORD 1 ALIGNMENT_LONG 1 ALIGNMENT_FLOAT32_IEEE 1 ALIGNMENT_FLOAT64_IEEE 1 ALIGNMENT_INT64 1 /end RECORD_LAYOUT
/begin RECORD_LAYOUT CalPrmWspcEng_SBYTE FNC_VALUES 1 SBYTE COLUMN_DIR DIRECT ALIGNMENT_BYTE 1 ALIGNMENT_WORD 1 ALIGNMENT_LONG 1 ALIGNMENT_FLOAT32_IEEE 1 ALIGNMENT_FLOAT64_IEEE 1 ALIGNMENT_INT64 1 /end RECORD_LAYOUT
/begin RECORD_LAYOUT CalPrmWspcEng_SWORD FNC_VALUES 1 SWORD COLUMN_DIR DIRECT ALIGNMENT_BYTE 1 ALIGNMENT_WORD 1 ALIGNMENT_LONG 1 ALIGNMENT_FLOAT32_IEEE 1 ALIGNMENT_FLOAT64_IEEE 1 ALIGNMENT_INT64 1 /end RECORD_LAYOUT
/begin RECORD_LAYOUT CalPrmWspcEng_UBYTE FNC_VALUES 1 UBYTE COLUMN_DIR DIRECT ALIGNMENT_BYTE 1 ALIGNMENT_WORD 1 ALIGNMENT_LONG 1 ALIGNMENT_FLOAT32_IEEE 1 ALIGNMENT_FLOAT64_IEEE 1 ALIGNMENT_INT64 1 /end RECORD_LAYOUT
/begin RECORD_LAYOUT CalPrmWspcEng_UWORD FNC_VALUES 1 UWORD COLUMN_DIR DIRECT ALIGNMENT_BYTE 1 ALIGNMENT_WORD 1 ALIGNMENT_LONG 1 ALIGNMENT_FLOAT32_IEEE 1 ALIGNMENT_FLOAT64_IEEE 1 ALIGNMENT_INT64 1 /end RECORD_LAYOUT
/begin GROUP Ctl_TypicalTrqAndAccel ""
 /begin REF_CHARACTERISTIC TP_S16ETCSCpCdrnTrqAt[0] TP_S16ETCSCpCdrnTrqAt[1] TP_S16ETCSCpCdrnTrqAt[2] TP_S16ETCSCpEngTrq[0] TP_S16ETCSCpEngTrq[1] TP_S16ETCSCpEngTrq[2] TP_U8ETCSCpAxAt[0][0] TP_U8ETCSCpAxAt[0][1] TP_U8ETCSCpAxAt[0][2] TP_U8ETCSCpAxAt[0][3] TP_U8ETCSCpAxAt[0][4] TP_U8ETCSCpAxAt[1][0] TP_U8ETCSCpAxAt[1][1] TP_U8ETCSCpAxAt[1][2] TP_U8ETCSCpAxAt[1][3] TP_U8ETCSCpAxAt[1][4] TP_U8ETCSCpAxAt[2][0] TP_U8ETCSCpAxAt[2][1] TP_U8ETCSCpAxAt[2][2] TP_U8ETCSCpAxAt[2][3] TP_U8ETCSCpAxAt[2][4] /end REF_CHARACTERISTIC
/end GROUP
/begin GROUP D.Acc_BrkTqGrdt "" /begin SUB_GROUP A.AccBrk_InitCtrl B.AccBrk_GrdtMap /end SUB_GROUP /end GROUP
/begin GROUP D.Acc_PseudoGain ""
 /begin REF_CHARACTERISTIC U16_ACC_I_ERROR_LEVEL_H U16_ACC_I_ERROR_LEVEL_S U8_ACC_I_PSEUDO_GAIN_ERROR_BRAKE_H U8_ACC_I_PSEUDO_GAIN_ERROR_BRAKE_S U8_ACC_I_PSEUDO_GAIN_ERROR_NEG_H U8_ACC_I_PSEUDO_GAIN_ERROR_NEG_S U8_ACC_I_PSEUDO_GAIN_ERROR_POS_H U8_ACC_I_PSEUDO_GAIN_ERROR_POS_S /end REF_CHARACTERISTIC
/end GROUP
/begin GROUP D.Aeb_Temporary ""
 /begin REF_CHARACTERISTIC S16_AEB_TEMP_01 S16_AEB_TEMP_02 S16_AEB_TEMP_03 U8_AEB_TEMP_01 U8_AEB_TEMP_02 U8_AEB_TEMP_03 /end REF_CHARACTERISTIC
/end GROUP
/begin GROUP D.No1VlvCurTest ""
 /begin REF_CHARACTERISTIC U16No1VlvCurTestActtnTi U16No1VlvCurTestIniCur U16No1VlvCurTestIntlCur U16No1VlvCurTestMotU /end REF_CHARACTERISTIC
/end GROUP
/begin GROUP D.PErrNo1VlvMap3 ""
 /begin REF_CHARACTERISTIC U16LfcRiseNotSuctnNo1VlvCurPGrdt31 U16LfcRiseNotSuctnNo1VlvCurPGrdt32 U16LfcRiseNotSuctnNo1VlvCurPGrdt33 U16LfcRiseNotSuctnNo1VlvCurPGrdt34 U16LfcRiseNotSuctnNo1VlvCurPGrdt35 U16LfcRiseNotSuctnNo1VlvCurPGrdt36 U16LfcRiseNotSuctnNo1VlvCurPGrdt37 U16LfcRiseNotSuctnNo1VlvCurPGrdt38 U16LfcRiseNotSuctnNo1VlvCurPGrdt39 U16LfcRiseNotSuctnPGrdtNo1VlvCur31 U16LfcRiseNotSuctnPGrdtNo1VlvCur32 U16LfcRiseNotSuctnPGrdtNo1VlvCur33 U16LfcRiseNotSuctnPGrdtNo1VlvCur34 U16LfcRiseNotSuctnPGrdtNo1VlvCur35 U16LfcRiseNotSuctnPGrdtNo1VlvCur36 U16LfcRiseNotSuctnPGrdtNo1VlvCur37 U16LfcRiseNotSuctnPGrdtNo1VlvCur38 U16LfcRiseNotSuctnPGrdtNo1VlvCur39 /end REF_CHARACTERISTIC
/end GROUP
/begin GROUP D.ROP_Control "" /begin SUB_GROUP a.Rop_Model b.Rop_Enter_Exit c.Rop_Moment /end SUB_GROUP /end GROUP
/begin GROUP D.TOD_LimModeMap ""
 /begin REF_CHARACTERISTIC TP_U8_TOD_MODE_CST_OVER1 TP_U8_TOD_MODE_CST_OVER2 TP_U8_TOD_MODE_CST_STABL TP_U8_TOD_MODE_CST_UNDER1 TP_U8_TOD_MODE_CST_UNDER2 TP_U8_TOD_MODE_HOT_OVER1 TP_U8_TOD_MODE_HOT_OVER2 TP_U8_TOD_MODE_HOT_STABL TP_U8_TOD_MODE_HOT_UNDER1 TP_U8_TOD_MODE_HOT_UNDER2 TP_U8_TOD_MODE_WOT_OVER1 TP_U8_TOD_MODE_WOT_OVER2 TP_U8_TOD_MODE_WOT_STABL TP_U8_TOD_MODE_WOT_UNDER1 TP_U8_TOD_MODE_WOT_UNDER2 /end REF_CHARACTERISTIC
/end GROUP
/begin GROUP D.TcVlvCtrlCalPrm "" /begin REF_CHARACTERISTIC U16TcVlvCurMax U16TcVlvCurMin U16TcVlvCurSysMax /end REF_CHARACTERISTIC
 /begin SUB_GROUP A.TcmfMapCur B.TcmfIniRise C.TcmfIniHld D.TcmfRise E.TcmfHld F.TcmfDump /end SUB_GROUP
/end GROUP
/begin GROUP D.TcmfRise "" /begin SUB_GROUP A.TcmfRisePat B.TcmfRiseTcVlvCur /end SUB_GROUP /end GROUP
/begin GROUP D.VddFbMotU "" /begin REF_CHARACTERISTIC U16MotUVddU1 U16MotUVddU2 U16VddUMotU1 U16VddUMotU2 /end REF_CHARACTERISTIC /end GROUP
/begin GROUP D_EDC_Entry_Modify ""
 /begin REF_CHARACTERISTIC TP_S8_EDC_DEC_ENT_THR_INC_IN_CTL TP_S8_EDC_DEC_ENT_THR_IN_RR TP_S8_EDC_ENT_THR_REL_LAM TP_S8_EDC_ENT_THR_REL_LAM_AT_B_DCT /end REF_CHARACTERISTIC
/end GROUP
/begin GROUP D_EDC_GEAR_SHIFT_DOWN_DETECTION ""
 /begin REF_CHARACTERISTIC TP_S8_EDC_GSD_AVG_WHL_SLIP_DIFF_THR TP_S8_EDC_GSD_ENTRY_CNT TP_S8_EDC_GSD_ENTRY_WHL_SLIP TP_S8_EDC_GSD_EXIT_WHL_SLIP TP_S8_EDC_GSD_SLOPE_ENG_RPM_THR TP_U8_EDC_GSD_ENABLE_FLG /end REF_CHARACTERISTIC
/end GROUP
/begin GROUP D_EDC_Gain_Modify ""
 /begin REF_CHARACTERISTIC TP_U8_D_GAIN_DEC_FACTOR_IN_RR TP_U8_GAIN_DEC_FACTOR_IN_HIGH_MU /end REF_CHARACTERISTIC
/end GROUP
/begin GROUP D_EDC_TARGET_DELTA_V ""
 /begin SUB_GROUP A_EDC_SOLO_Target B_EDC_ABS_Target C_EDC_ESC_Target D_EDC_Target_Modify /end SUB_GROUP
/end GROUP
/begin GROUP D_EDC_Target_Modify "" /begin REF_CHARACTERISTIC TP_S8_EDC_DEC_TAR_DEL_V_IN_RR /end REF_CHARACTERISTIC /end GROUP
/begin GROUP D_EPB_Reserved ""
 /begin REF_CHARACTERISTIC SSM_EPB_lms16FS_Reserved1 SSM_EPB_lms16FS_Reserved2 SSM_EPB_lms16FS_Reserved3 SSM_EPB_lms16FS_Reserved4 SSM_EPB_lms16FS_Reserved5 SSM_EPB_lmu8FS_Reserved1 SSM_EPB_lmu8FS_Reserved2 SSM_EPB_lmu8FS_Reserved3 SSM_EPB_lmu8FS_Reserved4 SSM_EPB_lmu8FS_Reserved5 /end REF_CHARACTERISTIC
/end GROUP
/begin GROUP D_Turnning_Index ""
 /begin REF_CHARACTERISTIC TP_S16TCSCpDctTurnIndexEnterAyTh[0] TP_S16TCSCpDctTurnIndexEnterAyTh[1] TP_S16TCSCpDctTurnIndexEnterAyTh[2] TP_S16TCSCpDctTurnIndexEnterAyTh[3] TP_S16TCSCpDctTurnIndexEnterAyTh[4] TP_S16TCSCpDctTurnIndexFinalAyTh[0] TP_S16TCSCpDctTurnIndexFinalAyTh[1] TP_S16TCSCpDctTurnIndexFinalAyTh[2] TP_S16TCSCpDctTurnIndexFinalAyTh[3] TP_S16TCSCpDctTurnIndexFinalAyTh[4] /end REF_CHARACTERISTIC
/end GROUP
/begin GROUP D_WpeNoVlvPrm ""
 /begin REF_CHARACTERISTIC U8_WPE_WPE_ESC_Rise_Hold_Comp_1st U8_WPE_WPE_ESC_Rise_Hold_Comp_2nd U8_WPE_WPE_ESC_Rise_Hold_Thres_1st U8_WPE_WPE_ESC_Rise_Hold_Thres_2nd U8_WPE_WPE_ESC_Rise_Hold_Thres_3rd /end REF_CHARACTERISTIC
 /begin SUB_GROUP a_WpeLfcEscMpRise b_WpeLfcEscRise c_WpeLfcHoldFront d_WpeLfcHoldRear e_WpeLfcRiseFront f_WpeLfcRiseRear g_WpeMpRiseFront h_WpeMpRiseRear /end SUB_GROUP
/end GROUP
/begin GROUP Dct_1stDropTorq ""
 /begin REF_CHARACTERISTIC TP_S16ETCSCpCdrnTrqAt1stDrop[0][0] TP_S16ETCSCpCdrnTrqAt1stDrop[0][1] TP_S16ETCSCpCdrnTrqAt1stDrop[0][2] TP_S16ETCSCpCdrnTrqAt1stDrop[0][3] TP_S16ETCSCpCdrnTrqAt1stDrop[0][4] TP_S16ETCSCpCdrnTrqAt1stDrop[1][0] TP_S16ETCSCpCdrnTrqAt1stDrop[1][1] TP_S16ETCSCpCdrnTrqAt1stDrop[1][2] TP_S16ETCSCpCdrnTrqAt1stDrop[1][3] TP_S16ETCSCpCdrnTrqAt1stDrop[1][4] TP_S16ETCSCpCdrnTrqAt1stDrop[2][0] TP_S16ETCSCpCdrnTrqAt1stDrop[2][1] TP_S16ETCSCpCdrnTrqAt1stDrop[2][2] TP_S16ETCSCpCdrnTrqAt1stDrop[2][3] TP_S16ETCSCpCdrnTrqAt1stDrop[2][4] TP_S16ETCSCpDecCdrnTrqALmtCrng /end REF_CHARACTERISTIC
/end GROUP
/begin GROUP Dct_DeepSnow ""
 /begin REF_CHARACTERISTIC TP_S16ETCSCpMinEngCdrnTrqAtDepSnw TP_U8ETCSCpDetDepSnwHilCnt TP_U8ETCSCpHysDepSnwHilCnt TP_U8ETCSCpLmtStrDepSnwHil TP_U8ETCSCpYawCtlFacInDepSnw TP_U8ETCSCpYawThFacInDepSnw /end REF_CHARACTERISTIC
/end GROUP
/begin GROUP Dct_EngStall ""
 /begin REF_CHARACTERISTIC TP_S16ETCSCpHighRiskStallRpmFlat TP_S16ETCSCpHighRiskStallRpmHill TP_S16ETCSCpLowRiskStallRpmFlat TP_S16ETCSCpLowRiskStallRpmHill TP_S16ETCSCpMidRiskStallRpmFlat TP_S16ETCSCpMidRiskStallRpmHill TP_U8ETCSCpEngAvail TP_U8ETCSCpEngStallRpmOffset /end REF_CHARACTERISTIC
/end GROUP
/begin GROUP Dct_H2L ""
 /begin REF_CHARACTERISTIC TP_S16ETCSCpIGainIncFacH2L TP_S8ETCSCpH2LDctHiMuTh TP_S8ETCSCpH2LDctLwMuTh TP_S8ETCSCpHiSusResetTime TP_U8ETCSCpH2LDctHldTm TP_U8ETCSCpH2LDctSpnTh TP_U8ETCSCpPGainIncFacH2L /end REF_CHARACTERISTIC
/end GROUP
/begin GROUP Dct_HighMu ""
 /begin REF_CHARACTERISTIC TP_S16ETCSCpLow2HighDecel TP_S16ETCSCpPreHighRdDctCplCnt TP_S16ETCSCpPreHighRdDctStrtCnt TP_S16ETCSCpStrtCdrnTrqAtAsphalt TP_U8ETCSCpAdaptHighRdCplCnt TP_U8ETCSCpAdaptHighRdStrtCnt TP_U8ETCSCpAreaSetLwToHiSpin TP_U8ETCSCpLwToHiDetAreaCnt TP_U8ETCSCpLwToHiDetCnt TP_U8ETCSCpTrackHiRdCplCnt TP_U8ETCSCpTrackHiRdStCnt /end REF_CHARACTERISTIC
/end GROUP
/begin GROUP Dct_Hill ""
 /begin REF_CHARACTERISTIC TP_S16ETCSCpSplitHillClrEngSpd TP_S16ETCSCpSplitHillDctEngSpd TP_U8ETCSCpGradientTrstCplCnt TP_U8ETCSCpGradientTrstStCnt TP_U8ETCSCpGrdTransTme TP_U8ETCSCpHillClrTime TP_U8ETCSCpHillDctAlongTh TP_U8ETCSCpHillDctTime TP_U8ETCSCpHillDctTimeAx TP_U8ETCSCpHillDiffAx TP_U8ETCSCpHillTransTme TP_U8ETCSCpHsaHillTime TP_U8ETCSCpSplitHillClrAccel TP_U8ETCSCpSplitHillClrVehSpd TP_U8ETCSCpSplitHillDctAccel TP_U8ETCSCpSplitHillDctMinAx TP_U8ETCSCpSplitHillDctVehSpd TP_U8ETCSCpTarAddAcc /end REF_CHARACTERISTIC
/end GROUP
/begin GROUP Dct_JumpUpAndDown ""
 /begin REF_CHARACTERISTIC TP_U8ETCSCpFtr4JmpDnMax TP_U8ETCSCpFtr4JmpDnMin TP_U8ETCSCpFtr4JmpUpMax TP_U8ETCSCpFtr4JmpUpMin TP_U8ETCSCpFtr4JmpUpSpnAcclMax TP_U8ETCSCpFtr4JmpUpSpnAcclMin TP_U8ETCSCpFtr4RefTrqAt2ndCylStrt TP_U8ETCSCpRecTrqFacInBump TP_U8ETCSCpRefTrqVldTm /end REF_CHARACTERISTIC
/end GROUP
/begin GROUP Dct_L2Split ""
 /begin REF_CHARACTERISTIC TP_S16ETCSCpLwToSpltDctCplCnt TP_S16ETCSCpLwToSpltDctStrtCnt TP_S16ETCSCpOffsetTrq4LwToSplt TP_U16ETCSCpDctLwHmMaxCnt TP_U8ETCSCpAddRefRdCfFrci TP_U8ETCSCpHighBigSpnL2SpltTh TP_U8ETCSCpHighSpnL2SpltTh TP_U8ETCSCpLowSpnL2SpltTh TP_U8ETCSCpSpltDctBrkTrqCnt TP_U8ETCSCpSymSpnDifL2SpltTh /end REF_CHARACTERISTIC
/end GROUP
/begin GROUP Dct_LowSpin ""
 /begin REF_CHARACTERISTIC TP_U8ETCSCpLowWhlSpnCntDnTh TP_U8ETCSCpLowWhlSpnCntUpTh TP_U8ETCSCpLwSpnHldCntTh[0] TP_U8ETCSCpLwSpnHldCntTh[1] TP_U8ETCSCpLwSpnHldCntTh[2] /end REF_CHARACTERISTIC
/end GROUP
/begin GROUP Dct_Reset1stCycle ""
 /begin REF_CHARACTERISTIC TP_U8ETCSCpLwWhlSpnTh2ClrCyl1st TP_U8ETCSCpTimeTh2ClrCyl1st /end REF_CHARACTERISTIC
/end GROUP
/begin GROUP Dct_StrtAndExitOfCtl ""
 /begin REF_CHARACTERISTIC TP_S8ETCSCpCtlExitCntDnTh TP_S8ETCSCpCtlExitCntTh TP_S8ETCSCpCtlExitCntUpTh TP_U8ETCSCpCtlActCntThAtHiAxlAcc TP_U8ETCSCpCtlActCntThAtLwAxlAcc TP_U8ETCSCpCtlEnterAccPdlTh TP_U8ETCSCpCtlExitAccPdlTh TP_U8ETCSCpHiAxlAccTh TP_U8ETCSCpLwAxlAccTh /end REF_CHARACTERISTIC
/end GROUP
/begin GROUP Dct_VCA ""
 /begin REF_CHARACTERISTIC TP_S16ETCSCpReqVcaDctCnt TP_S16ETCSCpVcaTrqDrp[0][0] TP_S16ETCSCpVcaTrqDrp[0][1] TP_S16ETCSCpVcaTrqDrp[0][2] TP_S16ETCSCpVcaTrqDrp[1][0] TP_S16ETCSCpVcaTrqDrp[1][1] TP_S16ETCSCpVcaTrqDrp[1][2] TP_S16ETCSCpVcaTrqDrp[2][0] TP_S16ETCSCpVcaTrqDrp[2][1] TP_S16ETCSCpVcaTrqDrp[2][2] TP_U8ETCSCpAWDVehicle TP_U8ETCSCpFtr4RefTrqAtVcaOfCtl TP_U8ETCSCpHysDeltAcc TP_U8ETCSCpStDeltAcc /end REF_CHARACTERISTIC
/end GROUP
/begin GROUP Dct_Vib ""
 /begin REF_CHARACTERISTIC TP_S16ETCSCpTrqOffset4InhHldVib TP_U8ETCSCpAxOffset4InhHldVib /end REF_CHARACTERISTIC
/end GROUP
/begin GROUP DpbBrkCalPrm ""
 /begin REF_CHARACTERISTIC S16_DPB_DEAD_ZONE_ERROR_HIGH S16_DPB_DEAD_ZONE_ERROR_LOW S16_DPB_FF_TQ_GRD S16_DPB_FF_TQ_INIT_GRD S16_DPB_FINE_GAP_ERROR_HIGH S16_DPB_FINE_GAP_ERROR_LOW S16_DPB_TQ_D_GRD_D_GAIN S16_DPB_TQ_D_GRD_I_GAIN S16_DPB_TQ_GRD_DUMP_TH S16_DPB_TQ_P_GRD_P_GAIN U16_DPB_CTRL_PERIOD_MAX U16_DPB_CTRL_PERIOD_MAX_A_ABS U16_DPB_CTRL_PERIOD_MIN U16_DPB_CTRL_PERIOD_MIN_A_ABS U16_DPB_FF_CTRL_RISE_STEP U16_DPB_FF_MAX_TIME U16_DPB_FF_TQ_GRD_INIT_TIME U16_DPB_SMOOTHCLOSING_CTRL_TIME U8_DPB_FF_CTRL_DECEL_ERROR_PER /end REF_CHARACTERISTIC
/end GROUP
/begin GROUP DpbEngCalPrm "" /begin REF_CHARACTERISTIC S16_DPB_FORCED_HOLD_SPD S16_DPB_TARGET_DECEL /end REF_CHARACTERISTIC /begin SUB_GROUP A.DpbBrk_CtrlGain /end SUB_GROUP /end GROUP
/begin GROUP E.Acc_Temporary ""
 /begin REF_CHARACTERISTIC U8_ACC_TEMP_01 U8_ACC_TEMP_02 U8_ACC_TEMP_03 U8_ACC_TEMP_04 /end REF_CHARACTERISTIC
/end GROUP
/begin GROUP E.EsvVlvCtrlCalPrm "" /begin REF_CHARACTERISTIC U8EsvVlvCurMax U8EsvVlvCurSysMax /end REF_CHARACTERISTIC
 /begin SUB_GROUP A.EsvVlvCurPatCtrl B.EsvVlvActtnCtrlFinshd C.EsvVlvActtnWslcBac /end SUB_GROUP
/end GROUP
/begin GROUP E.LfcTest "" /begin REF_CHARACTERISTIC U16LfcTestIniCur U16LfcTestIntlCur /end REF_CHARACTERISTIC /end GROUP
/begin GROUP E.TcmfHld "" /begin SUB_GROUP B.TcmfCmpHldTcVlvCur /end SUB_GROUP /end GROUP
/begin GROUP EHC_Steer_Enter_HM ""
 /begin REF_CHARACTERISTIC TQS16_EHC_ENTER_STEER_HM_100K TQS16_EHC_ENTER_STEER_HM_40K TQS16_EHC_ENTER_STEER_HM_60K TQS16_EHC_ENTER_STEER_HM_80K /end REF_CHARACTERISTIC
/end GROUP
/begin GROUP EHC_Steer_Enter_MM ""
 /begin REF_CHARACTERISTIC TQS16_EHC_ENTER_STEER_MM_100K TQS16_EHC_ENTER_STEER_MM_40K TQS16_EHC_ENTER_STEER_MM_60K TQS16_EHC_ENTER_STEER_MM_80K /end REF_CHARACTERISTIC
/end GROUP
/begin GROUP EHC_Tq_Inc_HM ""
 /begin REF_CHARACTERISTIC TQS16_EHC_TORQ_INC_100K TQS16_EHC_TORQ_INC_40K TQS16_EHC_TORQ_INC_60K TQS16_EHC_TORQ_INC_80K /end REF_CHARACTERISTIC
/end GROUP
/begin GROUP EHC_Tq_Inc_MM ""
 /begin REF_CHARACTERISTIC TQS16_EHC_TORQ_INC_MM_100K TQS16_EHC_TORQ_INC_MM_40K TQS16_EHC_TORQ_INC_MM_60K TQS16_EHC_TORQ_INC_MM_80K /end REF_CHARACTERISTIC
/end GROUP
/begin GROUP EHC_Wstr_Dot_HM ""
 /begin REF_CHARACTERISTIC TQS16_EHC_WSTR_DOT_ENT_100K TQS16_EHC_WSTR_DOT_ENT_40K TQS16_EHC_WSTR_DOT_ENT_60K TQS16_EHC_WSTR_DOT_ENT_80K TQS16_EHC_WSTR_DOT_EXT_100K TQS16_EHC_WSTR_DOT_EXT_40K TQS16_EHC_WSTR_DOT_EXT_60K TQS16_EHC_WSTR_DOT_EXT_80K /end REF_CHARACTERISTIC
/end GROUP
/begin GROUP EHC_Wstr_Dot_MM ""
 /begin REF_CHARACTERISTIC TQS16_EHC_WSTR_DOT_ENT_MM_100K TQS16_EHC_WSTR_DOT_ENT_MM_40K TQS16_EHC_WSTR_DOT_ENT_MM_60K TQS16_EHC_WSTR_DOT_ENT_MM_80K TQS16_EHC_WSTR_DOT_EXT_MM_100K TQS16_EHC_WSTR_DOT_EXT_MM_40K TQS16_EHC_WSTR_DOT_EXT_MM_60K TQS16_EHC_WSTR_DOT_EXT_MM_80K /end REF_CHARACTERISTIC
/end GROUP
/begin GROUP EHC_Wstr_Peak_HM ""
 /begin REF_CHARACTERISTIC TQS16_EHC_WSTR_PEAK_HM_100K TQS16_EHC_WSTR_PEAK_HM_40K TQS16_EHC_WSTR_PEAK_HM_60K TQS16_EHC_WSTR_PEAK_HM_80K /end REF_CHARACTERISTIC
/end GROUP
/begin GROUP EHC_Wstr_Peak_MM ""
 /begin REF_CHARACTERISTIC TQS16_EHC_WSTR_PEAK_MM_100K TQS16_EHC_WSTR_PEAK_MM_40K TQS16_EHC_WSTR_PEAK_MM_60K TQS16_EHC_WSTR_PEAK_MM_80K /end REF_CHARACTERISTIC
/end GROUP
/begin GROUP EHC_Yaw_Dot_HM ""
 /begin REF_CHARACTERISTIC TQS16_EHC_YAW_DOT_ENT_100K TQS16_EHC_YAW_DOT_ENT_40K TQS16_EHC_YAW_DOT_ENT_60K TQS16_EHC_YAW_DOT_ENT_80K TQS16_EHC_YAW_DOT_EXT_100K TQS16_EHC_YAW_DOT_EXT_40K TQS16_EHC_YAW_DOT_EXT_60K TQS16_EHC_YAW_DOT_EXT_80K /end REF_CHARACTERISTIC
/end GROUP
/begin GROUP EHC_Yaw_Dot_MM ""
 /begin REF_CHARACTERISTIC TQS16_EHC_YAW_DOT_ENT_MM_100K TQS16_EHC_YAW_DOT_ENT_MM_40K TQS16_EHC_YAW_DOT_ENT_MM_60K TQS16_EHC_YAW_DOT_ENT_MM_80K TQS16_EHC_YAW_DOT_EXT_MM_100K TQS16_EHC_YAW_DOT_EXT_MM_40K TQS16_EHC_YAW_DOT_EXT_MM_60K TQS16_EHC_YAW_DOT_EXT_MM_80K /end REF_CHARACTERISTIC
/end GROUP
/begin GROUP EHC_Yaw_Peak_HM ""
 /begin REF_CHARACTERISTIC TQS16_EHC_YAW_PEAK_HM_100K TQS16_EHC_YAW_PEAK_HM_40K TQS16_EHC_YAW_PEAK_HM_60K TQS16_EHC_YAW_PEAK_HM_80K /end REF_CHARACTERISTIC
/end GROUP
/begin GROUP EHC_Yaw_Peak_MM ""
 /begin REF_CHARACTERISTIC TQS16_EHC_YAW_PEAK_MM_100K TQS16_EHC_YAW_PEAK_MM_40K TQS16_EHC_YAW_PEAK_MM_60K TQS16_EHC_YAW_PEAK_MM_80K /end REF_CHARACTERISTIC
/end GROUP
/begin GROUP ETCS_Calculation ""
 /begin SUB_GROUP Cal_AxSenAvail Cal_Cornering Cal_EngMdl Cal_GearEst Cal_LoadTrq Cal_StrtOfCtl Cal_SymBrkCtl Cal_TarWhlSpn Cal_TotalGearRatio Cal_VehPara Cal_VehSpdBrkPnts /end SUB_GROUP
/end GROUP
/begin GROUP ETCS_Control ""
 /begin SUB_GROUP Ctl_DeltaYaw Ctl_FctLamp Ctl_GainTransTm Ctl_IEffect Ctl_MinCtlCmd Ctl_PEffect Ctl_SplitPattern Ctl_SymBrkCtl Ctl_TrsmCrtl Ctl_TypicalTrqAndAccel /end SUB_GROUP
/end GROUP
/begin GROUP ETCS_Detection ""
 /begin SUB_GROUP Dct_1stDropTorq Dct_DeepSnow Dct_EngStall Dct_H2L Dct_HighMu Dct_Hill Dct_JumpUpAndDown Dct_L2Split Dct_LowSpin Dct_Reset1stCycle Dct_StrtAndExitOfCtl Dct_VCA Dct_Vib /end SUB_GROUP
/end GROUP
/begin GROUP ETCS_Reserved ""
 /begin REF_CHARACTERISTIC TP_S16ETCSCpAddCdrnTrq4BstMd TP_S16ETCSCpDctRdMemTqCntThr TP_S16ETCSCpIGainFacLmtStr[0] TP_S16ETCSCpIGainFacLmtStr[1] TP_S16ETCSCpIGainFacLmtStr[2] TP_S16ETCSCpLatbyDrivCrng TP_U8ETCSCpDelYawTransVal TP_U8ETCSCpFtr4RefTrqLmg2ndCylStrt TP_U8ETCSCpRdMemTqDecGainFac TP_U8ETCSCpRefTrqNvldTm TP_U8ETCSCpTarTransCplReBrkTrq2Sp TP_U8ETCSCpTarTransStReBrkTrq2Sp TP_ZS16ETCSCpReserved01 TP_ZS16ETCSCpReserved02 TP_ZS16ETCSCpReserved03 TP_ZS16ETCSCpReserved04 TP_ZS16ETCSCpReserved05 TP_ZS16ETCSCpReserved06 TP_ZS16ETCSCpReserved07 TP_ZS16ETCSCpReserved08 TP_ZS16ETCSCpReserved09 TP_ZS16ETCSCpReserved10 TP_ZS16ETCSCpReserved11 TP_ZS16ETCSCpReserved12 TP_ZS16ETCSCpReserved13 TP_ZS16ETCSCpReserved14 TP_ZS16ETCSCpReserved15 TP_ZS16ETCSCpReserved16 TP_ZS16ETCSCpReserved17 TP_ZS16ETCSCpReserved18 TP_ZS16ETCSCpReserved19 TP_ZS16ETCSCpReserved20 TP_ZS16ETCSCpReserved21 TP_ZS16ETCSCpReserved22 /end REF_CHARACTERISTIC
/end GROUP
/begin GROUP E_BTCS_Enter_Condition ""
 /begin REF_CHARACTERISTIC TP_U16TCSCpDriverAccelIntendSuspCntTh TP_U16_TCS_BRK_CLT_MAX_SPD TP_U16_TCS_START_ENGINE_TORQUE TP_U16_TCS_START_RPM TP_U8TCSCpBtcsEndByHuntingWhlSpnDiffThr /end REF_CHARACTERISTIC
 /begin SUB_GROUP a_Asymmetric b_Asymmetric_Driveline_Protect c_Turnning_Asymmetric d_modify_Threshold /end SUB_GROUP
/end GROUP
/begin GROUP E_EDC_PD_GAIN ""
 /begin SUB_GROUP A_EDC_SOLO_PD_GAIN B_EDC_ABS_PD_GAIN C_EDC_ESC_PD_GAIN D_EDC_Gain_Modify /end SUB_GROUP
/end GROUP
/begin GROUP E_WpeNcVlcPrm "" /begin SUB_GROUP a_WpeNcDumpFront b_WpeNcDumpRear /end SUB_GROUP /end GROUP
/begin GROUP EbdCalPrm "" /begin SUB_GROUP a_EBD_Apply b_EBD_Cut_in c_EBD_Dump d_EBD_Logic_Tuning /end SUB_GROUP /end GROUP
/begin GROUP Engine_RPM ""
 /begin REF_CHARACTERISTIC SSM_K_EPB_Release_Engine_RPM_Rate_Z1_Th SSM_K_EPB_Release_Engine_RPM_Rate_Z2_Th SSM_K_EPB_Release_Engine_RPM_Rate_Z3_Th SSM_K_EPB_Release_Engine_Rpm_Dot_LF_Gain /end REF_CHARACTERISTIC
/end GROUP
/begin GROUP Engine_Run ""
 /begin REF_CHARACTERISTIC SSM_K_EPB_Engine_Run_rpm_Th_H SSM_K_EPB_Engine_Run_rpm_Th_L /end REF_CHARACTERISTIC
/end GROUP
/begin GROUP Engine_Torq ""
 /begin REF_CHARACTERISTIC SSM_K_EPB_Release_Engine_Torq_AT_Back SSM_K_EPB_Release_Engine_Torq_AT_Idle SSM_K_EPB_Release_Engine_Torq_AT_Z1_Th SSM_K_EPB_Release_Engine_Torq_AT_Z2_Th SSM_K_EPB_Release_Engine_Torq_AT_Z3_Th SSM_K_EPB_Release_Engine_Torq_AT_ZU_Th SSM_K_EPB_Release_Engine_Torq_Delay_Z1_Th SSM_K_EPB_Release_Engine_Torq_Delay_Z2_Th SSM_K_EPB_Release_Engine_Torq_Delay_Z3_Th SSM_K_EPB_Release_Engine_Torq_Dot_LF_Gain1 SSM_K_EPB_Release_Engine_Torq_Dot_LF_Gain2 SSM_K_EPB_Release_Engine_Torq_MT_Back SSM_K_EPB_Release_Engine_Torq_MT_Idle SSM_K_EPB_Release_Engine_Torq_MT_Z1_Th SSM_K_EPB_Release_Engine_Torq_MT_Z2_Th SSM_K_EPB_Release_Engine_Torq_MT_Z3_Th SSM_K_EPB_Release_Engine_Torq_MT_ZU_Th SSM_K_EPB_Release_Engine_Torq_Rate_Z1_Th SSM_K_EPB_Release_Engine_Torq_Rate_Z2_Th SSM_K_EPB_Release_Engine_Torq_Rate_Z3_Th /end REF_CHARACTERISTIC
/end GROUP
/begin GROUP EpbCalPrm "" /begin SUB_GROUP A_EPB_Sys_Info B_EPB_Dect C_EPB_Ctrl D_EPB_Reserved /end SUB_GROUP /end GROUP
/begin GROUP Esc_Model ""
 /begin REF_CHARACTERISTIC TQCW_S16_STR_RATIO_10_1st TQCW_S16_STR_RATIO_10_2nd TQCW_S16_STR_RATIO_10_3rd TQCW_S16_STR_RATIO_10_4th TQCW_S16_STR_RATIO_10_5th TQCW_S16_STR_RATIO_10_MAX TQS16_ADM_VCH_NOMINAL TQS16_BANK_ALAT_Roll_Gain TQS16_CORNER_STIFF_FRONT TQS16_CORNER_STIFF_REAR TQS16_DELTA_STEER_FOR_BANK TQS16_GAIN_BETA_D_BETA TQS16_GAIN_BETA_D_DELTA TQS16_GAIN_YAW_D_BETA TQS16_GAIN_YAW_D_DELTA TQS16_GAIN_YAW_D_YAW TQS16_LAT_G_CAL_SCALE TQS16_LAT_G_EXTRA_100 TQS16_LAT_G_EXTRA_120 TQS16_LAT_G_EXTRA_150 TQS16_LAT_G_EXTRA_40 TQS16_LAT_G_EXTRA_60 TQS16_LAT_G_EXTRA_80 TQS16_LAT_G_FILTER_100 TQS16_LAT_G_FILTER_120 TQS16_LAT_G_FILTER_150 TQS16_LAT_G_FILTER_20 TQS16_LAT_G_FILTER_40 TQS16_LAT_G_FILTER_60 TQS16_LAT_G_FILTER_80 TQS16_LENGTH_CG_TO_FRONT TQS16_LENGTH_CG_TO_REAR TQS16_MAX_ROAD_ADHESION TQS16_MOMENT_OF_INERTIA TQS16_STEERING_MAX_DEG TQS16_STEERING_RATIO_10 TQS16_STR_1st_Point TQS16_STR_2nd_Point TQS16_STR_3rd_Point TQS16_STR_4th_Point TQS16_STR_5th_Point TQS16_STR_RATIO_10_1st TQS16_STR_RATIO_10_2nd TQS16_STR_RATIO_10_3rd TQS16_STR_RATIO_10_4th TQS16_STR_RATIO_10_5th TQS16_STR_RATIO_10_MAX TQS16_UNDERSTEER_GRADIENT TQS16_VEHICLE_MASS_FL TQS16_VEHICLE_MASS_FR TQS16_VEHICLE_MASS_RL TQS16_VEHICLE_MASS_RR TQS16_WHEEL_TREAD_FRONT TQS16_WHEEL_TREAD_REAR TQS16_YAWC_FILTER_20 TQS16_YAWC_FILTER_40 TQS16_YAWC_FILTER_60 TQS16_Yawm_Filter_Gain_120kph TQS16_Yawm_Filter_Gain_150kph TQS16_Yawm_Filter_Gain_60kph TQS16_Yawm_Filter_Gain_90kph TQU16_GAIN_BETA_D_YAW TQYc_Map[0][0] TQYc_Map[0][10] TQYc_Map[0][11] TQYc_Map[0][1] TQYc_Map[0][2] TQYc_Map[0][3] TQYc_Map[0][4] TQYc_Map[0][5] TQYc_Map[0][6] TQYc_Map[0][7] TQYc_Map[0][8] TQYc_Map[0][9] TQYc_Map[10][0] TQYc_Map[10][10] TQYc_Map[10][11] TQYc_Map[10][1] TQYc_Map[10][2] TQYc_Map[10][3] TQYc_Map[10][4] TQYc_Map[10][5] TQYc_Map[10][6] TQYc_Map[10][7] TQYc_Map[10][8] TQYc_Map[10][9] TQYc_Map[11][0] TQYc_Map[11][10] TQYc_Map[11][11] TQYc_Map[11][1] TQYc_Map[11][2] TQYc_Map[11][3] TQYc_Map[11][4] TQYc_Map[11][5] TQYc_Map[11][6] TQYc_Map[11][7] TQYc_Map[11][8] TQYc_Map[11][9] TQYc_Map[12][0] TQYc_Map[12][10] TQYc_Map[12][11] TQYc_Map[12][1] TQYc_Map[12][2] TQYc_Map[12][3] TQYc_Map[12][4] TQYc_Map[12][5] TQYc_Map[12][6] TQYc_Map[12][7] TQYc_Map[12][8] TQYc_Map[12][9] TQYc_Map[13][0] TQYc_Map[13][10] TQYc_Map[13][11] TQYc_Map[13][1] TQYc_Map[13][2] TQYc_Map[13][3] TQYc_Map[13][4] TQYc_Map[13][5] TQYc_Map[13][6] TQYc_Map[13][7] TQYc_Map[13][8] TQYc_Map[13][9] TQYc_Map[14][0] TQYc_Map[14][10] TQYc_Map[14][11] TQYc_Map[14][1] TQYc_Map[14][2] TQYc_Map[14][3] TQYc_Map[14][4] TQYc_Map[14][5] TQYc_Map[14][6] TQYc_Map[14][7] TQYc_Map[14][8] TQYc_Map[14][9] TQYc_Map[1][0] TQYc_Map[1][10] TQYc_Map[1][11] TQYc_Map[1][1] TQYc_Map[1][2] TQYc_Map[1][3] TQYc_Map[1][4] TQYc_Map[1][5] TQYc_Map[1][6] TQYc_Map[1][7] TQYc_Map[1][8] TQYc_Map[1][9] TQYc_Map[2][0] TQYc_Map[2][10] TQYc_Map[2][11] TQYc_Map[2][1] TQYc_Map[2][2] TQYc_Map[2][3] TQYc_Map[2][4] TQYc_Map[2][5] TQYc_Map[2][6] TQYc_Map[2][7] TQYc_Map[2][8] TQYc_Map[2][9] TQYc_Map[3][0] TQYc_Map[3][10] TQYc_Map[3][11] TQYc_Map[3][1] TQYc_Map[3][2] TQYc_Map[3][3] TQYc_Map[3][4] TQYc_Map[3][5] TQYc_Map[3][6] TQYc_Map[3][7] TQYc_Map[3][8] TQYc_Map[3][9] TQYc_Map[4][0] TQYc_Map[4][10] TQYc_Map[4][11] TQYc_Map[4][1] TQYc_Map[4][2] TQYc_Map[4][3] TQYc_Map[4][4] TQYc_Map[4][5] TQYc_Map[4][6] TQYc_Map[4][7] TQYc_Map[4][8] TQYc_Map[4][9] TQYc_Map[5][0] TQYc_Map[5][10] TQYc_Map[5][11] TQYc_Map[5][1] TQYc_Map[5][2] TQYc_Map[5][3] TQYc_Map[5][4] TQYc_Map[5][5] TQYc_Map[5][6] TQYc_Map[5][7] TQYc_Map[5][8] TQYc_Map[5][9] TQYc_Map[6][0] TQYc_Map[6][10] TQYc_Map[6][11] TQYc_Map[6][1] TQYc_Map[6][2] TQYc_Map[6][3] TQYc_Map[6][4] TQYc_Map[6][5] TQYc_Map[6][6] TQYc_Map[6][7] TQYc_Map[6][8] TQYc_Map[6][9] TQYc_Map[7][0] TQYc_Map[7][10] TQYc_Map[7][11] TQYc_Map[7][1] TQYc_Map[7][2] TQYc_Map[7][3] TQYc_Map[7][4] TQYc_Map[7][5] TQYc_Map[7][6] TQYc_Map[7][7] TQYc_Map[7][8] TQYc_Map[7][9] TQYc_Map[8][0] TQYc_Map[8][10] TQYc_Map[8][11] TQYc_Map[8][1] TQYc_Map[8][2] TQYc_Map[8][3] TQYc_Map[8][4] TQYc_Map[8][5] TQYc_Map[8][6] TQYc_Map[8][7] TQYc_Map[8][8] TQYc_Map[8][9] TQYc_Map[9][0] TQYc_Map[9][10] TQYc_Map[9][11] TQYc_Map[9][1] TQYc_Map[9][2] TQYc_Map[9][3] TQYc_Map[9][4] TQYc_Map[9][5] TQYc_Map[9][6] TQYc_Map[9][7] TQYc_Map[9][8] TQYc_Map[9][9] /end REF_CHARACTERISTIC
/end GROUP
/begin GROUP EstmrEngCalPrm ""
 /begin REF_CHARACTERISTIC TP_K_Brake_temperature_Overheated_Threshold TP_K_Brake_temperature_Overheated_Threshold_Low TP_S16_AIR_CONDUCTIVITY TP_S16_BRAKE_COOLING_COEFFIC_F TP_S16_BRAKE_COOLING_COEFFIC_R TP_S16_BRAKE_DISK_AREA_F TP_S16_BRAKE_DISK_AREA_R TP_S16_BRAKE_DISK_DIAMETER_F TP_S16_BRAKE_DISK_DIAMETER_R TP_S16_BRAKE_DISK_MASS_F TP_S16_BRAKE_DISK_MASS_R TP_S16_BRAKE_DISK_SPECIFIC_HEAT TP_S16_BRAKE_PAD_AREA_F TP_S16_BRAKE_PAD_AREA_R TP_S16_BRAKE_PAD_FRICTION_F TP_S16_BRAKE_PAD_FRICTION_R TP_S16_BRAKE_THERM_EFFIC_F TP_S16_BRAKE_THERM_EFFIC_R TP_S16_STOP_STATE_CONV_COEFFIC_F TP_S16_STOP_STATE_CONV_COEFFIC_R TP_S16_TIRE_DIAMETER TP_S16_WHEEL_RADIUS /end REF_CHARACTERISTIC
/end GROUP
/begin GROUP Estmr_EngCal "" /begin SUB_GROUP EstmrEngCalPrm /end SUB_GROUP /end GROUP
/begin GROUP EtcsCalPrm "" /begin SUB_GROUP ETCS_Calculation ETCS_Control ETCS_Detection ETCS_Reserved /end SUB_GROUP /end GROUP
/begin GROUP F.MotCtrlCalPrm "" /begin SUB_GROUP A.WslcMotCtrlr B.NotWlscMotCtrlr C.MotActr /end SUB_GROUP /end GROUP
/begin GROUP F.TcVlvLeakTest ""
 /begin REF_CHARACTERISTIC U16TcVlvLeakTestHldCur1 U16TcVlvLeakTestHldCur2 U16TcVlvLeakTestIniHldEndCur1 U16TcVlvLeakTestIniHldEndCur2 U16TcVlvLeakTestIniHldPeakCur U16TcVlvLeakTestIniHldStrtCur U32TcVlvLeakTestActtnTi U8TcVlvLeakTestFadeOutTi U8TcVlvLeakTestIniHldFirstTi U8TcVlvLeakTestIniHldSecTi /end REF_CHARACTERISTIC
/end GROUP
/begin GROUP F.TcmfDump "" /begin SUB_GROUP A.TcmfDumpTcVlvCur B.TcmfCmpDumpTcVlvCur /end SUB_GROUP /end GROUP
/begin GROUP F_BTCS_Target_Spin "" /begin SUB_GROUP a_TargetSpin_Straight b_TargetSpin_Hill c_TargetSpin_Turn /end SUB_GROUP /end GROUP
/begin GROUP F_EDC_INHIBITION "" /begin REF_CHARACTERISTIC TP_U16_EDC_ENG_RPM_LIMIT TP_U8_EDC_MTP_THR_FOR_EDC_INHIBIT /end REF_CHARACTERISTIC /end GROUP
/begin GROUP F_WpeCmnPrm ""
 /begin REF_CHARACTERISTIC U8_WPE_WPE_Straight_Cont_Comp_T U8_WPE_WPE_Straight_Cont_Comp_f U8_WPE_WPE_Straight_Cont_Comp_r /end REF_CHARACTERISTIC
/end GROUP
/begin GROUP G.Bleeding ""
 /begin REF_CHARACTERISTIC U16CircBleedingMotU U16CircBleedingTcVlvCur U8CircBleedingTcVlvClsTi U8CircBleedingTcVlvOpenTi /end REF_CHARACTERISTIC
/end GROUP
/begin GROUP G.FbCtrlCalPrm "" /begin SUB_GROUP A.PFbNo1VlvCur B.PFbTcVlvCur C.PFbMotU D.VddFbMotU /end SUB_GROUP /end GROUP
/begin GROUP G_BTCS_Torque_Control "" /begin SUB_GROUP a_Asymmetric_Torque b_Symmetric_Torque /end SUB_GROUP /end GROUP
/begin GROUP G_EDC_TORQ_DEC_RATE ""
 /begin REF_CHARACTERISTIC TP_U8_EDC_TORQ_DEC_RATE TP_U8_EDC_TORQ_DEC_RATE_EXIT_EAO TP_U8_EDC_TORQ_DEC_RATE_EXIT_EEO TP_U8_EDC_TORQ_DEC_RATE_EXIT_ESO TP_U8_EDC_TORQ_DEC_RATE_RPM TP_U8_EDC_TORQ_FAST_DEC_RATE_EXIT TP_U8_EDC_TORQ_SLOW_DEC_RATE_EXIT /end REF_CHARACTERISTIC
/end GROUP
/begin GROUP Gas_Pedal ""
 /begin REF_CHARACTERISTIC SSM_K_EPB_Release_Throttle_Per_AT_Back SSM_K_EPB_Release_Throttle_Per_AT_Th_L SSM_K_EPB_Release_Throttle_Per_AT_Z1_Th_H SSM_K_EPB_Release_Throttle_Per_AT_Z2_Th_H SSM_K_EPB_Release_Throttle_Per_AT_Z3_Th_H SSM_K_EPB_Release_Throttle_Per_AT_ZU_Th SSM_K_EPB_Release_Throttle_Per_MT_Back SSM_K_EPB_Release_Throttle_Per_MT_Th_L SSM_K_EPB_Release_Throttle_Per_MT_Z1_Th_H SSM_K_EPB_Release_Throttle_Per_MT_Z2_Th_H SSM_K_EPB_Release_Throttle_Per_MT_Z3_Th_H SSM_K_EPB_Release_Throttle_Per_MT_ZU_Th SSM_U8_EPB_TPS_Dect_Max_Speed_Threshold_H SSM_U8_EPB_TPS_Dect_Max_Speed_Threshold_L /end REF_CHARACTERISTIC
/end GROUP
/begin GROUP H.HwTestCalPrm "" /begin REF_CHARACTERISTIC U8HwTestMod /end REF_CHARACTERISTIC
 /begin SUB_GROUP A.RiseRateTest1Whl B.RiseRateTest4Whl C.TcVlvCurTest D.No1VlvCurTest E.LfcTest F.TcVlvLeakTest G.Bleeding /end SUB_GROUP
/end GROUP
/begin GROUP H_BTCS_Special_case "" /begin REF_CHARACTERISTIC TP_U8TCSCpDecBsTarBrkF4ESCBrkCtl /end REF_CHARACTERISTIC
 /begin SUB_GROUP a_Vibration b_Stuck c_VCA d_Pressure_limit e_Engine_stall f_Over_braking g_Fadeout h_HIgh_side_spin i_Gear_shift j_Hunting k_Feedforward_adaptation l_FrntAsymFacAtRearSym /end SUB_GROUP
/end GROUP
/begin GROUP H_EDC_TORQ_INC_LIMIT ""
 /begin REF_CHARACTERISTIC TP_U8_TORQ_HOLD_LV_IN_EDC_S1 TP_U8_TORQ_HOLD_LV_IN_EDC_S2 TP_U8_TORQ_HOLD_LV_IN_EDC_S3 TP_U8_TORQ_HOLD_LV_IN_EDC_S4 TP_U8_TORQ_UP_LIMIT_ABS TP_U8_TORQ_UP_LIMIT_ABS_HIGH_MU TP_U8_TORQ_UP_LIMIT_ESC TP_U8_TORQ_UP_LIMIT_SOLO /end REF_CHARACTERISTIC
/end GROUP
/begin GROUP Hill ""
 /begin REF_CHARACTERISTIC TP_S16TCSCpBrkPGrdtLimHillDecFr TP_S16TCSCpBrkPGrdtLimHillDecRe TP_S16TCSCpBrkPGrdtLimHillIncFr TP_S16TCSCpBrkPGrdtLimHillIncRe /end REF_CHARACTERISTIC
/end GROUP
/begin GROUP Hill_Initial ""
 /begin REF_CHARACTERISTIC TP_S16TCSCpBrkPGrdtLimHillIncIniFr TP_S16TCSCpBrkPGrdtLimHillIncIniRe /end REF_CHARACTERISTIC
/end GROUP
/begin GROUP I_EDC_TM_GEAR_RATIO ""
 /begin REF_CHARACTERISTIC TP_U8_EDC_TM_1_GEAR_RATIO TP_U8_EDC_TM_2_GEAR_RATIO TP_U8_EDC_TM_3_GEAR_RATIO TP_U8_EDC_TM_4_GEAR_RATIO TP_U8_EDC_TM_5_GEAR_RATIO TP_U8_EDC_TM_6_GEAR_RATIO TP_U8_EDC_TM_R_GEAR_RATIO /end REF_CHARACTERISTIC
/end GROUP
/begin GROUP I_TCS_LogicAppl "" /begin REF_CHARACTERISTIC TP_U8_TCS_MOVING_WINDOW_LENGTH /end REF_CHARACTERISTIC /begin SUB_GROUP TorqueBasedBTCS /end SUB_GROUP /end GROUP
/begin GROUP J_BTCS_SpeedCondition ""
 /begin REF_CHARACTERISTIC TP_U16_TCS_SPEED[0] TP_U16_TCS_SPEED[1] TP_U16_TCS_SPEED[2] TP_U16_TCS_SPEED[3] TP_U16_TCS_SPEED[4] /end REF_CHARACTERISTIC
/end GROUP
/begin GROUP J_EDC_LOGIC_PARAMETER ""
 /begin REF_CHARACTERISTIC TP_S16_EDC_INHIBIT_SPEED TP_S16_EDC_INHIBIT_SPEED_IN_EDC TP_S8_EDC_ENTRY_LIMIT TP_U16_EDC_GAIN_SCALING_FACTOR TP_U16_EDC_TIRE_L TP_U16_EDC_TIRE_L_R TP_U8_EDC_CONTROL_TIME_MAX TP_U8_VEL_GAP_MOVING_WINDOW_LENGTH /end REF_CHARACTERISTIC
 /begin SUB_GROUP A_EDC_PARKING_DETECTION B_EDC_GEAR_DETECTION C_EDC_ENG_STATUS_DETECTION D_EDC_GEAR_SHIFT_DOWN_DETECTION /end SUB_GROUP
/end GROUP
/begin GROUP KOA ""
 /begin REF_CHARACTERISTIC SSM_K_EPB_Automatic_Apply_AVH_On_Act SSM_K_EPB_Automatic_Apply_Eng_Off_Act SSM_K_EPB_Automatic_Apply_Ign_Feature_En SSM_K_EPB_Automatic_Apply_Ign_Off_Act SSM_K_EPB_Automatic_Apply_Key_Out_Act /end REF_CHARACTERISTIC
/end GROUP
/begin GROUP K_BTCS_Reserved ""
 /begin REF_CHARACTERISTIC TP_S16BtcsVehicleMassFL TP_S16BtcsVehicleMassFR TP_S16BtcsVehicleMassRL TP_S16BtcsVehicleMassRR TP_S16TCSCpADDBTCEntTh4ComPMod TP_S16TCSCpADDBTCTarSP4ComPMod TP_S16TCSCpDctTurnIndexBaseAyTh TP_ZS16BTCSCpReserved01 TP_ZS16BTCSCpReserved02 TP_ZS16BTCSCpReserved03 TP_ZS16BTCSCpReserved04 TP_ZS16BTCSCpReserved05 TP_ZS16BTCSCpReserved06 TP_ZS16BTCSCpReserved07 TP_ZS16BTCSCpReserved08 TP_ZS16BTCSCpReserved09 TP_ZS16BTCSCpReserved10 TP_ZS16BTCSCpReserved11 TP_ZS16BTCSCpReserved12 TP_ZS16BTCSCpReserved13 TP_ZS16BTCSCpReserved14 TP_ZS16BTCSCpReserved15 TP_ZS16BTCSCpReserved16 TP_ZS16BTCSCpReserved17 TP_ZS16BTCSCpReserved18 TP_ZS16BTCSCpReserved19 TP_ZS16BTCSCpReserved20 /end REF_CHARACTERISTIC
/end GROUP
/end MODULE
/end PROJECT
