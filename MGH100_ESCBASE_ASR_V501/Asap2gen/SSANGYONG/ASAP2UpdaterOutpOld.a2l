ASAP2_VERSION 1 60
/begin PROJECT Master ""
/begin MODULE CPP ""
/begin MOD_COMMON "" BYTE_ORDER MSB_LAST ALIGNMENT_BYTE 1 ALIGNMENT_WORD 1 ALIGNMENT_LONG 1 ALIGNMENT_FLOAT32_IEEE 1 ALIGNMENT_FLOAT64_IEEE 1 ALIGNMENT_INT64 1 /end MOD_COMMON
/begin VARIANT_CODING
 /begin VAR_CHARACTERISTIC TP_S16_CBC_FRONT_MEDIUM_DV_SPD_M BrkCalVariantCriterion
  /begin VAR_ADDRESS 0x800207A2 0x80023BA2 0x80026FA2 0x8002A3A2 0x8002D7A2 0x80030BA2 0x80033FA2 0x800373A2 /end VAR_ADDRESS
 /end VAR_CHARACTERISTIC
 /begin VAR_CHARACTERISTIC TP_S16_CBC_FRONT_MEDIUM_DV_SPD_S BrkCalVariantCriterion
  /begin VAR_ADDRESS 0x800207A4 0x80023BA4 0x80026FA4 0x8002A3A4 0x8002D7A4 0x80030BA4 0x80033FA4 0x800373A4 /end VAR_ADDRESS
 /end VAR_CHARACTERISTIC
 /begin VAR_CHARACTERISTIC TP_S16_CBC_MPRESS_ENTER BrkCalVariantCriterion
  /begin VAR_ADDRESS 0x8002073E 0x80023B3E 0x80026F3E 0x8002A33E 0x8002D73E 0x80030B3E 0x80033F3E 0x8003733E /end VAR_ADDRESS
 /end VAR_CHARACTERISTIC
 /begin VAR_CHARACTERISTIC TP_S16_CBC_MPRESS_ENTER_ABS BrkCalVariantCriterion
  /begin VAR_ADDRESS 0x800206F0 0x80023AF0 0x80026EF0 0x8002A2F0 0x8002D6F0 0x80030AF0 0x80033EF0 0x800372F0 /end VAR_ADDRESS
 /end VAR_CHARACTERISTIC
 /begin VAR_CHARACTERISTIC TP_S16_CBC_MPRESS_EXIT BrkCalVariantCriterion
  /begin VAR_ADDRESS 0x80020764 0x80023B64 0x80026F64 0x8002A364 0x8002D764 0x80030B64 0x80033F64 0x80037364 /end VAR_ADDRESS
 /end VAR_CHARACTERISTIC
 /begin VAR_CHARACTERISTIC TP_S16_CBC_MPRESS_EXIT_ABS BrkCalVariantCriterion
  /begin VAR_ADDRESS 0x800206F4 0x80023AF4 0x80026EF4 0x8002A2F4 0x8002D6F4 0x80030AF4 0x80033EF4 0x800372F4 /end VAR_ADDRESS
 /end VAR_CHARACTERISTIC
 /begin VAR_CHARACTERISTIC TP_S16_CBC_REAR_ENTER_DV_SPD_H BrkCalVariantCriterion
  /begin VAR_ADDRESS 0x800207B2 0x80023BB2 0x80026FB2 0x8002A3B2 0x8002D7B2 0x80030BB2 0x80033FB2 0x800373B2 /end VAR_ADDRESS
 /end VAR_CHARACTERISTIC
 /begin VAR_CHARACTERISTIC TP_S16_CBC_REAR_ENTER_DV_SPD_M BrkCalVariantCriterion
  /begin VAR_ADDRESS 0x800207B4 0x80023BB4 0x80026FB4 0x8002A3B4 0x8002D7B4 0x80030BB4 0x80033FB4 0x800373B4 /end VAR_ADDRESS
 /end VAR_CHARACTERISTIC
 /begin VAR_CHARACTERISTIC TP_S16_CBC_REAR_ENTER_DV_SPD_S BrkCalVariantCriterion
  /begin VAR_ADDRESS 0x800207B6 0x80023BB6 0x80026FB6 0x8002A3B6 0x8002D7B6 0x80030BB6 0x80033FB6 0x800373B6 /end VAR_ADDRESS
 /end VAR_CHARACTERISTIC
 /begin VAR_CHARACTERISTIC TP_S16_CBC_REAR_EXIT_DV BrkCalVariantCriterion
  /begin VAR_ADDRESS 0x800207B8 0x80023BB8 0x80026FB8 0x8002A3B8 0x8002D7B8 0x80030BB8 0x80033FB8 0x800373B8 /end VAR_ADDRESS
 /end VAR_CHARACTERISTIC
 /begin VAR_CHARACTERISTIC TP_S16_CBC_REAR_SLIP_DEL_P_SPD_H BrkCalVariantCriterion
  /begin VAR_ADDRESS 0x800207BA 0x80023BBA 0x80026FBA 0x8002A3BA 0x8002D7BA 0x80030BBA 0x80033FBA 0x800373BA /end VAR_ADDRESS
 /end VAR_CHARACTERISTIC
 /begin VAR_CHARACTERISTIC TP_S16_CBC_REAR_SLIP_DEL_P_SPD_M BrkCalVariantCriterion
  /begin VAR_ADDRESS 0x800207BC 0x80023BBC 0x80026FBC 0x8002A3BC 0x8002D7BC 0x80030BBC 0x80033FBC 0x800373BC /end VAR_ADDRESS
 /end VAR_CHARACTERISTIC
 /begin VAR_CHARACTERISTIC TP_S16_CBC_REAR_SLIP_DEL_P_SPD_S BrkCalVariantCriterion
  /begin VAR_ADDRESS 0x800207BE 0x80023BBE 0x80026FBE 0x8002A3BE 0x8002D7BE 0x80030BBE 0x80033FBE 0x800373BE /end VAR_ADDRESS
 /end VAR_CHARACTERISTIC
 /begin VAR_CHARACTERISTIC TP_S16_CBC_STEADY_MAX_ACCEL BrkCalVariantCriterion
  /begin VAR_ADDRESS 0x8002071E 0x80023B1E 0x80026F1E 0x8002A31E 0x8002D71E 0x80030B1E 0x80033F1E 0x8003731E /end VAR_ADDRESS
 /end VAR_CHARACTERISTIC
 /begin VAR_CHARACTERISTIC TP_S16_CBC_STEADY_MAX_DECEL BrkCalVariantCriterion
  /begin VAR_ADDRESS 0x80020720 0x80023B20 0x80026F20 0x8002A320 0x8002D720 0x80030B20 0x80033F20 0x80037320 /end VAR_ADDRESS
 /end VAR_CHARACTERISTIC
 /begin VAR_CHARACTERISTIC TP_S16_CBC_THRES_HIGH_SPEED BrkCalVariantCriterion
  /begin VAR_ADDRESS 0x800206E0 0x80023AE0 0x80026EE0 0x8002A2E0 0x8002D6E0 0x80030AE0 0x80033EE0 0x800372E0 /end VAR_ADDRESS
 /end VAR_CHARACTERISTIC
 /begin VAR_CHARACTERISTIC TP_S16_CBC_THRES_LOW_SPEED BrkCalVariantCriterion
  /begin VAR_ADDRESS 0x800206E2 0x80023AE2 0x80026EE2 0x8002A2E2 0x8002D6E2 0x80030AE2 0x80033EE2 0x800372E2 /end VAR_ADDRESS
 /end VAR_CHARACTERISTIC
 /begin VAR_CHARACTERISTIC TP_S16_CBC_THRES_MED_SPEED BrkCalVariantCriterion
  /begin VAR_ADDRESS 0x800206E4 0x80023AE4 0x80026EE4 0x8002A2E4 0x8002D6E4 0x80030AE4 0x80033EE4 0x800372E4 /end VAR_ADDRESS
 /end VAR_CHARACTERISTIC
 /begin VAR_CHARACTERISTIC TP_S16_DEFAULT_TARGET_dYAW2_SPEED_H BrkCalVariantCriterion
  /begin VAR_ADDRESS 0x800204E6 0x800238E6 0x80026CE6 0x8002A0E6 0x8002D4E6 0x800308E6 0x80033CE6 0x800370E6 /end VAR_ADDRESS
 /end VAR_CHARACTERISTIC
 /begin VAR_CHARACTERISTIC TP_S16_DEFAULT_TARGET_dYAW2_SPEED_L BrkCalVariantCriterion
  /begin VAR_ADDRESS 0x800204E8 0x800238E8 0x80026CE8 0x8002A0E8 0x8002D4E8 0x800308E8 0x80033CE8 0x800370E8 /end VAR_ADDRESS
 /end VAR_CHARACTERISTIC
 /begin VAR_CHARACTERISTIC TP_S16_DEFAULT_TARGET_dYAW2_SPEED_M BrkCalVariantCriterion
  /begin VAR_ADDRESS 0x800204EA 0x800238EA 0x80026CEA 0x8002A0EA 0x8002D4EA 0x800308EA 0x80033CEA 0x800370EA /end VAR_ADDRESS
 /end VAR_CHARACTERISTIC
 /begin VAR_CHARACTERISTIC TP_S16_DEFAULT_TARGET_dYAW_SPEED_H BrkCalVariantCriterion
  /begin VAR_ADDRESS 0x800204D4 0x800238D4 0x80026CD4 0x8002A0D4 0x8002D4D4 0x800308D4 0x80033CD4 0x800370D4 /end VAR_ADDRESS
 /end VAR_CHARACTERISTIC
 /begin VAR_CHARACTERISTIC TP_S16_DEFAULT_TARGET_dYAW_SPEED_L BrkCalVariantCriterion
  /begin VAR_ADDRESS 0x800204D6 0x800238D6 0x80026CD6 0x8002A0D6 0x8002D4D6 0x800308D6 0x80033CD6 0x800370D6 /end VAR_ADDRESS
 /end VAR_CHARACTERISTIC
 /begin VAR_CHARACTERISTIC TP_S16_DEFAULT_TARGET_dYAW_SPEED_M BrkCalVariantCriterion
  /begin VAR_ADDRESS 0x800204D8 0x800238D8 0x80026CD8 0x8002A0D8 0x8002D4D8 0x800308D8 0x80033CD8 0x800370D8 /end VAR_ADDRESS
 /end VAR_CHARACTERISTIC
 /begin VAR_CHARACTERISTIC TP_S16_DP_DUTY_COMP_REF_MPRESS BrkCalVariantCriterion
  /begin VAR_ADDRESS 0x80020554 0x80023954 0x80026D54 0x8002A154 0x8002D554 0x80030954 0x80033D54 0x80037154 /end VAR_ADDRESS
 /end VAR_CHARACTERISTIC
 /begin VAR_CHARACTERISTIC TP_S16_Decel_Gain_BFAFZOK_100_150_F BrkCalVariantCriterion
  /begin VAR_ADDRESS 0x800202E4 0x800236E4 0x80026AE4 0x80029EE4 0x8002D2E4 0x800306E4 0x80033AE4 0x80036EE4 /end VAR_ADDRESS
 /end VAR_CHARACTERISTIC
 /begin VAR_CHARACTERISTIC TP_S16_Decel_Gain_BFAFZOK_100_150_R BrkCalVariantCriterion
  /begin VAR_ADDRESS 0x80020300 0x80023700 0x80026B00 0x80029F00 0x8002D300 0x80030700 0x80033B00 0x80036F00 /end VAR_ADDRESS
 /end VAR_CHARACTERISTIC
 /begin VAR_CHARACTERISTIC TP_S16_Decel_Gain_BFAFZOK_10_20_F BrkCalVariantCriterion
  /begin VAR_ADDRESS 0x800202E6 0x800236E6 0x80026AE6 0x80029EE6 0x8002D2E6 0x800306E6 0x80033AE6 0x80036EE6 /end VAR_ADDRESS
 /end VAR_CHARACTERISTIC
 /begin VAR_CHARACTERISTIC TP_S16_Decel_Gain_BFAFZOK_10_20_R BrkCalVariantCriterion
  /begin VAR_ADDRESS 0x80020302 0x80023702 0x80026B02 0x80029F02 0x8002D302 0x80030702 0x80033B02 0x80036F02 /end VAR_ADDRESS
 /end VAR_CHARACTERISTIC
 /begin VAR_CHARACTERISTIC TP_S16_Decel_Gain_BFAFZOK_20_40_F BrkCalVariantCriterion
  /begin VAR_ADDRESS 0x800202E8 0x800236E8 0x80026AE8 0x80029EE8 0x8002D2E8 0x800306E8 0x80033AE8 0x80036EE8 /end VAR_ADDRESS
 /end VAR_CHARACTERISTIC
 /begin VAR_CHARACTERISTIC TP_S16_Decel_Gain_BFAFZOK_20_40_R BrkCalVariantCriterion
  /begin VAR_ADDRESS 0x80020304 0x80023704 0x80026B04 0x80029F04 0x8002D304 0x80030704 0x80033B04 0x80036F04 /end VAR_ADDRESS
 /end VAR_CHARACTERISTIC
 /begin VAR_CHARACTERISTIC TP_S16_Decel_Gain_BFAFZOK_40_60_F BrkCalVariantCriterion
  /begin VAR_ADDRESS 0x800202EA 0x800236EA 0x80026AEA 0x80029EEA 0x8002D2EA 0x800306EA 0x80033AEA 0x80036EEA /end VAR_ADDRESS
 /end VAR_CHARACTERISTIC
 /begin VAR_CHARACTERISTIC TP_S16_Decel_Gain_BFAFZOK_40_60_R BrkCalVariantCriterion
  /begin VAR_ADDRESS 0x80020306 0x80023706 0x80026B06 0x80029F06 0x8002D306 0x80030706 0x80033B06 0x80036F06 /end VAR_ADDRESS
 /end VAR_CHARACTERISTIC
 /begin VAR_CHARACTERISTIC TP_S16_Decel_Gain_BFAFZOK_60_100_F BrkCalVariantCriterion
  /begin VAR_ADDRESS 0x800202EC 0x800236EC 0x80026AEC 0x80029EEC 0x8002D2EC 0x800306EC 0x80033AEC 0x80036EEC /end VAR_ADDRESS
 /end VAR_CHARACTERISTIC
 /begin VAR_CHARACTERISTIC TP_S16_Decel_Gain_BFAFZOK_60_100_R BrkCalVariantCriterion
  /begin VAR_ADDRESS 0x80020308 0x80023708 0x80026B08 0x80029F08 0x8002D308 0x80030708 0x80033B08 0x80036F08 /end VAR_ADDRESS
 /end VAR_CHARACTERISTIC
 /begin VAR_CHARACTERISTIC TP_S16_Decel_Gain_BFAFZOK_Ab_150_F BrkCalVariantCriterion
  /begin VAR_ADDRESS 0x800202EE 0x800236EE 0x80026AEE 0x80029EEE 0x8002D2EE 0x800306EE 0x80033AEE 0x80036EEE /end VAR_ADDRESS
 /end VAR_CHARACTERISTIC
 /begin VAR_CHARACTERISTIC TP_S16_Decel_Gain_BFAFZOK_Ab_150_R BrkCalVariantCriterion
  /begin VAR_ADDRESS 0x8002030A 0x8002370A 0x80026B0A 0x80029F0A 0x8002D30A 0x8003070A 0x80033B0A 0x80036F0A /end VAR_ADDRESS
 /end VAR_CHARACTERISTIC
 /begin VAR_CHARACTERISTIC TP_S16_Decel_Gain_BFAFZOK_B_10_F BrkCalVariantCriterion
  /begin VAR_ADDRESS 0x800202F0 0x800236F0 0x80026AF0 0x80029EF0 0x8002D2F0 0x800306F0 0x80033AF0 0x80036EF0 /end VAR_ADDRESS
 /end VAR_CHARACTERISTIC
 /begin VAR_CHARACTERISTIC TP_S16_Decel_Gain_BFAFZOK_B_10_R BrkCalVariantCriterion
  /begin VAR_ADDRESS 0x8002030C 0x8002370C 0x80026B0C 0x80029F0C 0x8002D30C 0x8003070C 0x80033B0C 0x80036F0C /end VAR_ADDRESS
 /end VAR_CHARACTERISTIC
 /begin VAR_CHARACTERISTIC TP_S16_Decel_Gain_EBD_100_150kph_R BrkCalVariantCriterion
  /begin VAR_ADDRESS 0x800206C0 0x80023AC0 0x80026EC0 0x8002A2C0 0x8002D6C0 0x80030AC0 0x80033EC0 0x800372C0 /end VAR_ADDRESS
 /end VAR_CHARACTERISTIC
 /begin VAR_CHARACTERISTIC TP_S16_Decel_Gain_EBD_20_40kph_R BrkCalVariantCriterion
  /begin VAR_ADDRESS 0x800206C2 0x80023AC2 0x80026EC2 0x8002A2C2 0x8002D6C2 0x80030AC2 0x80033EC2 0x800372C2 /end VAR_ADDRESS
 /end VAR_CHARACTERISTIC
 /begin VAR_CHARACTERISTIC TP_S16_Decel_Gain_EBD_40_60kph_R BrkCalVariantCriterion
  /begin VAR_ADDRESS 0x800206C4 0x80023AC4 0x80026EC4 0x8002A2C4 0x8002D6C4 0x80030AC4 0x80033EC4 0x800372C4 /end VAR_ADDRESS
 /end VAR_CHARACTERISTIC
 /begin VAR_CHARACTERISTIC TP_S16_Decel_Gain_EBD_60_100kph_R BrkCalVariantCriterion
  /begin VAR_ADDRESS 0x800206C6 0x80023AC6 0x80026EC6 0x8002A2C6 0x8002D6C6 0x80030AC6 0x80033EC6 0x800372C6 /end VAR_ADDRESS
 /end VAR_CHARACTERISTIC
 /begin VAR_CHARACTERISTIC TP_S16_Decel_Gain_EBD_Ab_150kph_R BrkCalVariantCriterion
  /begin VAR_ADDRESS 0x800206C8 0x80023AC8 0x80026EC8 0x8002A2C8 0x8002D6C8 0x80030AC8 0x80033EC8 0x800372C8 /end VAR_ADDRESS
 /end VAR_CHARACTERISTIC
 /begin VAR_CHARACTERISTIC TP_S16_Decel_Gain_EBD_B_20kph_R BrkCalVariantCriterion
  /begin VAR_ADDRESS 0x800206CA 0x80023ACA 0x80026ECA 0x8002A2CA 0x8002D6CA 0x80030ACA 0x80033ECA 0x800372CA /end VAR_ADDRESS
 /end VAR_CHARACTERISTIC
 /begin VAR_CHARACTERISTIC TP_S16_Decel_Gain_HMu_100_150kph_F BrkCalVariantCriterion
  /begin VAR_ADDRESS 0x8002031C 0x8002371C 0x80026B1C 0x80029F1C 0x8002D31C 0x8003071C 0x80033B1C 0x80036F1C /end VAR_ADDRESS
 /end VAR_CHARACTERISTIC
 /begin VAR_CHARACTERISTIC TP_S16_Decel_Gain_HMu_100_150kph_R BrkCalVariantCriterion
  /begin VAR_ADDRESS 0x80020338 0x80023738 0x80026B38 0x80029F38 0x8002D338 0x80030738 0x80033B38 0x80036F38 /end VAR_ADDRESS
 /end VAR_CHARACTERISTIC
 /begin VAR_CHARACTERISTIC TP_S16_Decel_Gain_HMu_10_20kph_F BrkCalVariantCriterion
  /begin VAR_ADDRESS 0x8002031E 0x8002371E 0x80026B1E 0x80029F1E 0x8002D31E 0x8003071E 0x80033B1E 0x80036F1E /end VAR_ADDRESS
 /end VAR_CHARACTERISTIC
 /begin VAR_CHARACTERISTIC TP_S16_Decel_Gain_HMu_10_20kph_R BrkCalVariantCriterion
  /begin VAR_ADDRESS 0x8002033A 0x8002373A 0x80026B3A 0x80029F3A 0x8002D33A 0x8003073A 0x80033B3A 0x80036F3A /end VAR_ADDRESS
 /end VAR_CHARACTERISTIC
 /begin VAR_CHARACTERISTIC TP_S16_Decel_Gain_HMu_20_40kph_F BrkCalVariantCriterion
  /begin VAR_ADDRESS 0x80020320 0x80023720 0x80026B20 0x80029F20 0x8002D320 0x80030720 0x80033B20 0x80036F20 /end VAR_ADDRESS
 /end VAR_CHARACTERISTIC
 /begin VAR_CHARACTERISTIC TP_S16_Decel_Gain_HMu_20_40kph_R BrkCalVariantCriterion
  /begin VAR_ADDRESS 0x8002033C 0x8002373C 0x80026B3C 0x80029F3C 0x8002D33C 0x8003073C 0x80033B3C 0x80036F3C /end VAR_ADDRESS
 /end VAR_CHARACTERISTIC
 /begin VAR_CHARACTERISTIC TP_S16_Decel_Gain_HMu_40_60kph_F BrkCalVariantCriterion
  /begin VAR_ADDRESS 0x80020322 0x80023722 0x80026B22 0x80029F22 0x8002D322 0x80030722 0x80033B22 0x80036F22 /end VAR_ADDRESS
 /end VAR_CHARACTERISTIC
 /begin VAR_CHARACTERISTIC TP_S16_Decel_Gain_HMu_40_60kph_R BrkCalVariantCriterion
  /begin VAR_ADDRESS 0x8002033E 0x8002373E 0x80026B3E 0x80029F3E 0x8002D33E 0x8003073E 0x80033B3E 0x80036F3E /end VAR_ADDRESS
 /end VAR_CHARACTERISTIC
 /begin VAR_CHARACTERISTIC TP_S16_Decel_Gain_HMu_60_100kph_F BrkCalVariantCriterion
  /begin VAR_ADDRESS 0x80020324 0x80023724 0x80026B24 0x80029F24 0x8002D324 0x80030724 0x80033B24 0x80036F24 /end VAR_ADDRESS
 /end VAR_CHARACTERISTIC
 /begin VAR_CHARACTERISTIC TP_S16_Decel_Gain_HMu_60_100kph_R BrkCalVariantCriterion
  /begin VAR_ADDRESS 0x80020340 0x80023740 0x80026B40 0x80029F40 0x8002D340 0x80030740 0x80033B40 0x80036F40 /end VAR_ADDRESS
 /end VAR_CHARACTERISTIC
 /begin VAR_CHARACTERISTIC TP_S16_Decel_Gain_HMu_Ab_150kph_F BrkCalVariantCriterion
  /begin VAR_ADDRESS 0x80020326 0x80023726 0x80026B26 0x80029F26 0x8002D326 0x80030726 0x80033B26 0x80036F26 /end VAR_ADDRESS
 /end VAR_CHARACTERISTIC
 /begin VAR_CHARACTERISTIC TP_S16_Decel_Gain_HMu_Ab_150kph_R BrkCalVariantCriterion
  /begin VAR_ADDRESS 0x80020342 0x80023742 0x80026B42 0x80029F42 0x8002D342 0x80030742 0x80033B42 0x80036F42 /end VAR_ADDRESS
 /end VAR_CHARACTERISTIC
 /begin VAR_CHARACTERISTIC TP_S16_Decel_Gain_HMu_B_10kph_F BrkCalVariantCriterion
  /begin VAR_ADDRESS 0x80020328 0x80023728 0x80026B28 0x80029F28 0x8002D328 0x80030728 0x80033B28 0x80036F28 /end VAR_ADDRESS
 /end VAR_CHARACTERISTIC
 /begin VAR_CHARACTERISTIC TP_S16_Decel_Gain_HMu_B_10kph_R BrkCalVariantCriterion
  /begin VAR_ADDRESS 0x80020344 0x80023744 0x80026B44 0x80029F44 0x8002D344 0x80030744 0x80033B44 0x80036F44 /end VAR_ADDRESS
 /end VAR_CHARACTERISTIC
 /begin VAR_CHARACTERISTIC TP_S16_Decel_Gain_LMMu_100_150kph_F BrkCalVariantCriterion
  /begin VAR_ADDRESS 0x8002038C 0x8002378C 0x80026B8C 0x80029F8C 0x8002D38C 0x8003078C 0x80033B8C 0x80036F8C /end VAR_ADDRESS
 /end VAR_CHARACTERISTIC
 /begin VAR_CHARACTERISTIC TP_S16_Decel_Gain_LMMu_100_150kph_R BrkCalVariantCriterion
  /begin VAR_ADDRESS 0x800203A8 0x800237A8 0x80026BA8 0x80029FA8 0x8002D3A8 0x800307A8 0x80033BA8 0x80036FA8 /end VAR_ADDRESS
 /end VAR_CHARACTERISTIC
 /begin VAR_CHARACTERISTIC TP_S16_Decel_Gain_LMMu_10_20kph_F BrkCalVariantCriterion
  /begin VAR_ADDRESS 0x8002038E 0x8002378E 0x80026B8E 0x80029F8E 0x8002D38E 0x8003078E 0x80033B8E 0x80036F8E /end VAR_ADDRESS
 /end VAR_CHARACTERISTIC
 /begin VAR_CHARACTERISTIC TP_S16_Decel_Gain_LMMu_10_20kph_R BrkCalVariantCriterion
  /begin VAR_ADDRESS 0x800203AA 0x800237AA 0x80026BAA 0x80029FAA 0x8002D3AA 0x800307AA 0x80033BAA 0x80036FAA /end VAR_ADDRESS
 /end VAR_CHARACTERISTIC
 /begin VAR_CHARACTERISTIC TP_S16_Decel_Gain_LMMu_20_40kph_F BrkCalVariantCriterion
  /begin VAR_ADDRESS 0x80020390 0x80023790 0x80026B90 0x80029F90 0x8002D390 0x80030790 0x80033B90 0x80036F90 /end VAR_ADDRESS
 /end VAR_CHARACTERISTIC
 /begin VAR_CHARACTERISTIC TP_S16_Decel_Gain_LMMu_20_40kph_R BrkCalVariantCriterion
  /begin VAR_ADDRESS 0x800203AC 0x800237AC 0x80026BAC 0x80029FAC 0x8002D3AC 0x800307AC 0x80033BAC 0x80036FAC /end VAR_ADDRESS
 /end VAR_CHARACTERISTIC
 /begin VAR_CHARACTERISTIC TP_S16_Decel_Gain_LMMu_40_60kph_F BrkCalVariantCriterion
  /begin VAR_ADDRESS 0x80020392 0x80023792 0x80026B92 0x80029F92 0x8002D392 0x80030792 0x80033B92 0x80036F92 /end VAR_ADDRESS
 /end VAR_CHARACTERISTIC
 /begin VAR_CHARACTERISTIC TP_S16_Decel_Gain_LMMu_40_60kph_R BrkCalVariantCriterion
  /begin VAR_ADDRESS 0x800203AE 0x800237AE 0x80026BAE 0x80029FAE 0x8002D3AE 0x800307AE 0x80033BAE 0x80036FAE /end VAR_ADDRESS
 /end VAR_CHARACTERISTIC
 /begin VAR_CHARACTERISTIC TP_S16_Decel_Gain_LMMu_60_100kph_F BrkCalVariantCriterion
  /begin VAR_ADDRESS 0x80020394 0x80023794 0x80026B94 0x80029F94 0x8002D394 0x80030794 0x80033B94 0x80036F94 /end VAR_ADDRESS
 /end VAR_CHARACTERISTIC
 /begin VAR_CHARACTERISTIC TP_S16_Decel_Gain_LMMu_60_100kph_R BrkCalVariantCriterion
  /begin VAR_ADDRESS 0x800203B0 0x800237B0 0x80026BB0 0x80029FB0 0x8002D3B0 0x800307B0 0x80033BB0 0x80036FB0 /end VAR_ADDRESS
 /end VAR_CHARACTERISTIC
 /begin VAR_CHARACTERISTIC TP_S16_Decel_Gain_LMMu_Ab_150kph_F BrkCalVariantCriterion
  /begin VAR_ADDRESS 0x80020396 0x80023796 0x80026B96 0x80029F96 0x8002D396 0x80030796 0x80033B96 0x80036F96 /end VAR_ADDRESS
 /end VAR_CHARACTERISTIC
 /begin VAR_CHARACTERISTIC TP_S16_Decel_Gain_LMMu_Ab_150kph_R BrkCalVariantCriterion
  /begin VAR_ADDRESS 0x800203B2 0x800237B2 0x80026BB2 0x80029FB2 0x8002D3B2 0x800307B2 0x80033BB2 0x80036FB2 /end VAR_ADDRESS
 /end VAR_CHARACTERISTIC
 /begin VAR_CHARACTERISTIC TP_S16_Decel_Gain_LMMu_B_10kph_F BrkCalVariantCriterion
  /begin VAR_ADDRESS 0x80020398 0x80023798 0x80026B98 0x80029F98 0x8002D398 0x80030798 0x80033B98 0x80036F98 /end VAR_ADDRESS
 /end VAR_CHARACTERISTIC
 /begin VAR_CHARACTERISTIC TP_S16_Decel_Gain_LMMu_B_10kph_R BrkCalVariantCriterion
  /begin VAR_ADDRESS 0x800203B4 0x800237B4 0x80026BB4 0x80029FB4 0x8002D3B4 0x800307B4 0x80033BB4 0x80036FB4 /end VAR_ADDRESS
 /end VAR_CHARACTERISTIC
 /begin VAR_CHARACTERISTIC TP_S16_Decel_Gain_LMu_100_150kph_F BrkCalVariantCriterion
  /begin VAR_ADDRESS 0x800203C4 0x800237C4 0x80026BC4 0x80029FC4 0x8002D3C4 0x800307C4 0x80033BC4 0x80036FC4 /end VAR_ADDRESS
 /end VAR_CHARACTERISTIC
 /begin VAR_CHARACTERISTIC TP_S16_Decel_Gain_LMu_100_150kph_R BrkCalVariantCriterion
  /begin VAR_ADDRESS 0x800203E0 0x800237E0 0x80026BE0 0x80029FE0 0x8002D3E0 0x800307E0 0x80033BE0 0x80036FE0 /end VAR_ADDRESS
 /end VAR_CHARACTERISTIC
 /begin VAR_CHARACTERISTIC TP_S16_Decel_Gain_LMu_10_20kph_F BrkCalVariantCriterion
  /begin VAR_ADDRESS 0x800203C6 0x800237C6 0x80026BC6 0x80029FC6 0x8002D3C6 0x800307C6 0x80033BC6 0x80036FC6 /end VAR_ADDRESS
 /end VAR_CHARACTERISTIC
 /begin VAR_CHARACTERISTIC TP_S16_Decel_Gain_LMu_10_20kph_R BrkCalVariantCriterion
  /begin VAR_ADDRESS 0x800203E2 0x800237E2 0x80026BE2 0x80029FE2 0x8002D3E2 0x800307E2 0x80033BE2 0x80036FE2 /end VAR_ADDRESS
 /end VAR_CHARACTERISTIC
 /begin VAR_CHARACTERISTIC TP_S16_Decel_Gain_LMu_20_40kph_F BrkCalVariantCriterion
  /begin VAR_ADDRESS 0x800203C8 0x800237C8 0x80026BC8 0x80029FC8 0x8002D3C8 0x800307C8 0x80033BC8 0x80036FC8 /end VAR_ADDRESS
 /end VAR_CHARACTERISTIC
 /begin VAR_CHARACTERISTIC TP_S16_Decel_Gain_LMu_20_40kph_R BrkCalVariantCriterion
  /begin VAR_ADDRESS 0x800203E4 0x800237E4 0x80026BE4 0x80029FE4 0x8002D3E4 0x800307E4 0x80033BE4 0x80036FE4 /end VAR_ADDRESS
 /end VAR_CHARACTERISTIC
 /begin VAR_CHARACTERISTIC TP_S16_Decel_Gain_LMu_40_60kph_F BrkCalVariantCriterion
  /begin VAR_ADDRESS 0x800203CA 0x800237CA 0x80026BCA 0x80029FCA 0x8002D3CA 0x800307CA 0x80033BCA 0x80036FCA /end VAR_ADDRESS
 /end VAR_CHARACTERISTIC
 /begin VAR_CHARACTERISTIC TP_S16_Decel_Gain_LMu_40_60kph_R BrkCalVariantCriterion
  /begin VAR_ADDRESS 0x800203E6 0x800237E6 0x80026BE6 0x80029FE6 0x8002D3E6 0x800307E6 0x80033BE6 0x80036FE6 /end VAR_ADDRESS
 /end VAR_CHARACTERISTIC
 /begin VAR_CHARACTERISTIC TP_S16_Decel_Gain_LMu_60_100kph_F BrkCalVariantCriterion
  /begin VAR_ADDRESS 0x800203CC 0x800237CC 0x80026BCC 0x80029FCC 0x8002D3CC 0x800307CC 0x80033BCC 0x80036FCC /end VAR_ADDRESS
 /end VAR_CHARACTERISTIC
 /begin VAR_CHARACTERISTIC TP_S16_Decel_Gain_LMu_60_100kph_R BrkCalVariantCriterion
  /begin VAR_ADDRESS 0x800203E8 0x800237E8 0x80026BE8 0x80029FE8 0x8002D3E8 0x800307E8 0x80033BE8 0x80036FE8 /end VAR_ADDRESS
 /end VAR_CHARACTERISTIC
 /begin VAR_CHARACTERISTIC TP_S16_Decel_Gain_LMu_Ab_150kph_F BrkCalVariantCriterion
  /begin VAR_ADDRESS 0x800203CE 0x800237CE 0x80026BCE 0x80029FCE 0x8002D3CE 0x800307CE 0x80033BCE 0x80036FCE /end VAR_ADDRESS
 /end VAR_CHARACTERISTIC
 /begin VAR_CHARACTERISTIC TP_S16_Decel_Gain_LMu_Ab_150kph_R BrkCalVariantCriterion
  /begin VAR_ADDRESS 0x800203EA 0x800237EA 0x80026BEA 0x80029FEA 0x8002D3EA 0x800307EA 0x80033BEA 0x80036FEA /end VAR_ADDRESS
 /end VAR_CHARACTERISTIC
 /begin VAR_CHARACTERISTIC TP_S16_Decel_Gain_LMu_B_10kph_F BrkCalVariantCriterion
  /begin VAR_ADDRESS 0x800203D0 0x800237D0 0x80026BD0 0x80029FD0 0x8002D3D0 0x800307D0 0x80033BD0 0x80036FD0 /end VAR_ADDRESS
 /end VAR_CHARACTERISTIC
 /begin VAR_CHARACTERISTIC TP_S16_Decel_Gain_LMu_B_10kph_R BrkCalVariantCriterion
  /begin VAR_ADDRESS 0x800203EC 0x800237EC 0x80026BEC 0x80029FEC 0x8002D3EC 0x800307EC 0x80033BEC 0x80036FEC /end VAR_ADDRESS
 /end VAR_CHARACTERISTIC
 /begin VAR_CHARACTERISTIC TP_S16_Decel_Gain_MMu_100_150kph_F BrkCalVariantCriterion
  /begin VAR_ADDRESS 0x80020354 0x80023754 0x80026B54 0x80029F54 0x8002D354 0x80030754 0x80033B54 0x80036F54 /end VAR_ADDRESS
 /end VAR_CHARACTERISTIC
 /begin VAR_CHARACTERISTIC TP_S16_Decel_Gain_MMu_100_150kph_R BrkCalVariantCriterion
  /begin VAR_ADDRESS 0x80020370 0x80023770 0x80026B70 0x80029F70 0x8002D370 0x80030770 0x80033B70 0x80036F70 /end VAR_ADDRESS
 /end VAR_CHARACTERISTIC
 /begin VAR_CHARACTERISTIC TP_S16_Decel_Gain_MMu_10_20kph_F BrkCalVariantCriterion
  /begin VAR_ADDRESS 0x80020356 0x80023756 0x80026B56 0x80029F56 0x8002D356 0x80030756 0x80033B56 0x80036F56 /end VAR_ADDRESS
 /end VAR_CHARACTERISTIC
 /begin VAR_CHARACTERISTIC TP_S16_Decel_Gain_MMu_10_20kph_R BrkCalVariantCriterion
  /begin VAR_ADDRESS 0x80020372 0x80023772 0x80026B72 0x80029F72 0x8002D372 0x80030772 0x80033B72 0x80036F72 /end VAR_ADDRESS
 /end VAR_CHARACTERISTIC
 /begin VAR_CHARACTERISTIC TP_S16_Decel_Gain_MMu_20_40kph_F BrkCalVariantCriterion
  /begin VAR_ADDRESS 0x80020358 0x80023758 0x80026B58 0x80029F58 0x8002D358 0x80030758 0x80033B58 0x80036F58 /end VAR_ADDRESS
 /end VAR_CHARACTERISTIC
 /begin VAR_CHARACTERISTIC TP_S16_Decel_Gain_MMu_20_40kph_R BrkCalVariantCriterion
  /begin VAR_ADDRESS 0x80020374 0x80023774 0x80026B74 0x80029F74 0x8002D374 0x80030774 0x80033B74 0x80036F74 /end VAR_ADDRESS
 /end VAR_CHARACTERISTIC
 /begin VAR_CHARACTERISTIC TP_S16_Decel_Gain_MMu_40_60kph_F BrkCalVariantCriterion
  /begin VAR_ADDRESS 0x8002035A 0x8002375A 0x80026B5A 0x80029F5A 0x8002D35A 0x8003075A 0x80033B5A 0x80036F5A /end VAR_ADDRESS
 /end VAR_CHARACTERISTIC
 /begin VAR_CHARACTERISTIC TP_S16_Decel_Gain_MMu_40_60kph_R BrkCalVariantCriterion
  /begin VAR_ADDRESS 0x80020376 0x80023776 0x80026B76 0x80029F76 0x8002D376 0x80030776 0x80033B76 0x80036F76 /end VAR_ADDRESS
 /end VAR_CHARACTERISTIC
 /begin VAR_CHARACTERISTIC TP_S16_Decel_Gain_MMu_60_100kph_F BrkCalVariantCriterion
  /begin VAR_ADDRESS 0x8002035C 0x8002375C 0x80026B5C 0x80029F5C 0x8002D35C 0x8003075C 0x80033B5C 0x80036F5C /end VAR_ADDRESS
 /end VAR_CHARACTERISTIC
 /begin VAR_CHARACTERISTIC TP_S16_Decel_Gain_MMu_60_100kph_R BrkCalVariantCriterion
  /begin VAR_ADDRESS 0x80020378 0x80023778 0x80026B78 0x80029F78 0x8002D378 0x80030778 0x80033B78 0x80036F78 /end VAR_ADDRESS
 /end VAR_CHARACTERISTIC
 /begin VAR_CHARACTERISTIC TP_S16_Decel_Gain_MMu_Ab_150kph_F BrkCalVariantCriterion
  /begin VAR_ADDRESS 0x8002035E 0x8002375E 0x80026B5E 0x80029F5E 0x8002D35E 0x8003075E 0x80033B5E 0x80036F5E /end VAR_ADDRESS
 /end VAR_CHARACTERISTIC
 /begin VAR_CHARACTERISTIC TP_S16_Decel_Gain_MMu_Ab_150kph_R BrkCalVariantCriterion
  /begin VAR_ADDRESS 0x8002037A 0x8002377A 0x80026B7A 0x80029F7A 0x8002D37A 0x8003077A 0x80033B7A 0x80036F7A /end VAR_ADDRESS
 /end VAR_CHARACTERISTIC
 /begin VAR_CHARACTERISTIC TP_S16_Decel_Gain_MMu_B_10kph_F BrkCalVariantCriterion
  /begin VAR_ADDRESS 0x80020360 0x80023760 0x80026B60 0x80029F60 0x8002D360 0x80030760 0x80033B60 0x80036F60 /end VAR_ADDRESS
 /end VAR_CHARACTERISTIC
 /begin VAR_CHARACTERISTIC TP_S16_Decel_Gain_MMu_B_10kph_R BrkCalVariantCriterion
  /begin VAR_ADDRESS 0x8002037C 0x8002377C 0x80026B7C 0x80029F7C 0x8002D37C 0x8003077C 0x80033B7C 0x80036F7C /end VAR_ADDRESS
 /end VAR_CHARACTERISTIC
 /begin VAR_CHARACTERISTIC TP_S16_Decel_Gain_SpHMu_100_150_F BrkCalVariantCriterion
  /begin VAR_ADDRESS 0x800203FC 0x800237FC 0x80026BFC 0x80029FFC 0x8002D3FC 0x800307FC 0x80033BFC 0x80036FFC /end VAR_ADDRESS
 /end VAR_CHARACTERISTIC
 /begin VAR_CHARACTERISTIC TP_S16_Decel_Gain_SpHMu_10_20kph_F BrkCalVariantCriterion
  /begin VAR_ADDRESS 0x800203FE 0x800237FE 0x80026BFE 0x80029FFE 0x8002D3FE 0x800307FE 0x80033BFE 0x80036FFE /end VAR_ADDRESS
 /end VAR_CHARACTERISTIC
 /begin VAR_CHARACTERISTIC TP_S16_Decel_Gain_SpHMu_20_40kph_F BrkCalVariantCriterion
  /begin VAR_ADDRESS 0x80020400 0x80023800 0x80026C00 0x8002A000 0x8002D400 0x80030800 0x80033C00 0x80037000 /end VAR_ADDRESS
 /end VAR_CHARACTERISTIC
 /begin VAR_CHARACTERISTIC TP_S16_Decel_Gain_SpHMu_40_60kph_F BrkCalVariantCriterion
  /begin VAR_ADDRESS 0x80020402 0x80023802 0x80026C02 0x8002A002 0x8002D402 0x80030802 0x80033C02 0x80037002 /end VAR_ADDRESS
 /end VAR_CHARACTERISTIC
 /begin VAR_CHARACTERISTIC TP_S16_Decel_Gain_SpHMu_60_100kph_F BrkCalVariantCriterion
  /begin VAR_ADDRESS 0x80020404 0x80023804 0x80026C04 0x8002A004 0x8002D404 0x80030804 0x80033C04 0x80037004 /end VAR_ADDRESS
 /end VAR_CHARACTERISTIC
 /begin VAR_CHARACTERISTIC TP_S16_Decel_Gain_SpHMu_Ab_150kph_F BrkCalVariantCriterion
  /begin VAR_ADDRESS 0x80020406 0x80023806 0x80026C06 0x8002A006 0x8002D406 0x80030806 0x80033C06 0x80037006 /end VAR_ADDRESS
 /end VAR_CHARACTERISTIC
 /begin VAR_CHARACTERISTIC TP_S16_Decel_Gain_SpHMu_B_10kph_F BrkCalVariantCriterion
  /begin VAR_ADDRESS 0x80020408 0x80023808 0x80026C08 0x8002A008 0x8002D408 0x80030808 0x80033C08 0x80037008 /end VAR_ADDRESS
 /end VAR_CHARACTERISTIC
 /begin VAR_CHARACTERISTIC TP_S16_EBD_Dump_HDF_ref BrkCalVariantCriterion
  /begin VAR_ADDRESS 0x800206D8 0x80023AD8 0x80026ED8 0x8002A2D8 0x8002D6D8 0x80030AD8 0x80033ED8 0x800372D8 /end VAR_ADDRESS
 /end VAR_CHARACTERISTIC
 /begin VAR_CHARACTERISTIC TP_S16_EBD_Hold_Dump_ref BrkCalVariantCriterion
  /begin VAR_ADDRESS 0x800206DA 0x80023ADA 0x80026EDA 0x8002A2DA 0x8002D6DA 0x80030ADA 0x80033EDA 0x800372DA /end VAR_ADDRESS
 /end VAR_CHARACTERISTIC
 /begin VAR_CHARACTERISTIC TP_S16_EBD_KNEE_POINT BrkCalVariantCriterion
  /begin VAR_ADDRESS 0x800206DE 0x80023ADE 0x80026EDE 0x8002A2DE 0x8002D6DE 0x80030ADE 0x80033EDE 0x800372DE /end VAR_ADDRESS
 /end VAR_CHARACTERISTIC
 /begin VAR_CHARACTERISTIC TP_S16_EDC_DEL_ENG_RPM_FOR_PARK EngCalVariantCriterion
  /begin VAR_ADDRESS 0x8003A14E 0x8003AF4E 0x8003BD4E 0x8003CB4E 0x8003D94E 0x8003E74E 0x8003F54E 0x8004034E 0x8004114E 0x80041F4E 0x80042D4E 0x80043B4E 0x8004494E 0x8004574E 0x8004654E 0x8004734E 0x8004814E 0x80048F4E 0x80049D4E 0x8004AB4E 0x8004B94E 0x8004C74E 0x8004D54E 0x8004E34E /end VAR_ADDRESS
 /end VAR_CHARACTERISTIC
 /begin VAR_CHARACTERISTIC TP_S16_EDC_INHIBIT_SPEED EngCalVariantCriterion
  /begin VAR_ADDRESS 0x8003A140 0x8003AF40 0x8003BD40 0x8003CB40 0x8003D940 0x8003E740 0x8003F540 0x80040340 0x80041140 0x80041F40 0x80042D40 0x80043B40 0x80044940 0x80045740 0x80046540 0x80047340 0x80048140 0x80048F40 0x80049D40 0x8004AB40 0x8004B940 0x8004C740 0x8004D540 0x8004E340 /end VAR_ADDRESS
 /end VAR_CHARACTERISTIC
 /begin VAR_CHARACTERISTIC TP_S16_EDC_INHIBIT_SPEED_IN_EDC EngCalVariantCriterion
  /begin VAR_ADDRESS 0x8003A142 0x8003AF42 0x8003BD42 0x8003CB42 0x8003D942 0x8003E742 0x8003F542 0x80040342 0x80041142 0x80041F42 0x80042D42 0x80043B42 0x80044942 0x80045742 0x80046542 0x80047342 0x80048142 0x80048F42 0x80049D42 0x8004AB42 0x8004B942 0x8004C742 0x8004D542 0x8004E342 /end VAR_ADDRESS
 /end VAR_CHARACTERISTIC
 /begin VAR_CHARACTERISTIC TP_S16_EDC_PARK_ENTRY_RPM_DIFF EngCalVariantCriterion
  /begin VAR_ADDRESS 0x8003A150 0x8003AF50 0x8003BD50 0x8003CB50 0x8003D950 0x8003E750 0x8003F550 0x80040350 0x80041150 0x80041F50 0x80042D50 0x80043B50 0x80044950 0x80045750 0x80046550 0x80047350 0x80048150 0x80048F50 0x80049D50 0x8004AB50 0x8004B950 0x8004C750 0x8004D550 0x8004E350 /end VAR_ADDRESS
 /end VAR_CHARACTERISTIC
 /begin VAR_CHARACTERISTIC TP_S16_EDC_PARK_ENTRY_TC_RPM EngCalVariantCriterion
  /begin VAR_ADDRESS 0x8003A152 0x8003AF52 0x8003BD52 0x8003CB52 0x8003D952 0x8003E752 0x8003F552 0x80040352 0x80041152 0x80041F52 0x80042D52 0x80043B52 0x80044952 0x80045752 0x80046552 0x80047352 0x80048152 0x80048F52 0x80049D52 0x8004AB52 0x8004B952 0x8004C752 0x8004D552 0x8004E352 /end VAR_ADDRESS
 /end VAR_CHARACTERISTIC
 /begin VAR_CHARACTERISTIC TP_S16_FRNT_GMA_STB_DMP_THR_YDF_B_L BrkCalVariantCriterion
  /begin VAR_ADDRESS 0x80020532 0x80023932 0x80026D32 0x8002A132 0x8002D532 0x80030932 0x80033D32 0x80037132 /end VAR_ADDRESS
 /end VAR_CHARACTERISTIC
 /begin VAR_CHARACTERISTIC TP_S16_FRNT_GMA_STB_DMP_THR_YDF_H BrkCalVariantCriterion
  /begin VAR_ADDRESS 0x80020534 0x80023934 0x80026D34 0x8002A134 0x8002D534 0x80030934 0x80033D34 0x80037134 /end VAR_ADDRESS
 /end VAR_CHARACTERISTIC
 /begin VAR_CHARACTERISTIC TP_S16_FRNT_GMA_STB_DMP_THR_YDF_L BrkCalVariantCriterion
  /begin VAR_ADDRESS 0x80020536 0x80023936 0x80026D36 0x8002A136 0x8002D536 0x80030936 0x80033D36 0x80037136 /end VAR_ADDRESS
 /end VAR_CHARACTERISTIC
 /begin VAR_CHARACTERISTIC TP_S16_FRNT_GMA_STB_DMP_THR_YDF_M BrkCalVariantCriterion
  /begin VAR_ADDRESS 0x80020538 0x80023938 0x80026D38 0x8002A138 0x8002D538 0x80030938 0x80033D38 0x80037138 /end VAR_ADDRESS
 /end VAR_CHARACTERISTIC
 /begin VAR_CHARACTERISTIC TP_S16_GMA_ALLOWED_LIMIT_SPEED BrkCalVariantCriterion
  /begin VAR_ADDRESS 0x80020602 0x80023A02 0x80026E02 0x8002A202 0x8002D602 0x80030A02 0x80033E02 0x80037202 /end VAR_ADDRESS
 /end VAR_CHARACTERISTIC
 /begin VAR_CHARACTERISTIC TP_S16_GMA_DCT_SPEED_DIFF_0_50KPH BrkCalVariantCriterion
  /begin VAR_ADDRESS 0x800205F6 0x800239F6 0x80026DF6 0x8002A1F6 0x8002D5F6 0x800309F6 0x80033DF6 0x800371F6 /end VAR_ADDRESS
 /end VAR_CHARACTERISTIC
 /begin VAR_CHARACTERISTIC TP_S16_GMA_DCT_SPEED_DIFF_50_70KPH BrkCalVariantCriterion
  /begin VAR_ADDRESS 0x800205F8 0x800239F8 0x80026DF8 0x8002A1F8 0x8002D5F8 0x800309F8 0x80033DF8 0x800371F8 /end VAR_ADDRESS
 /end VAR_CHARACTERISTIC
 /begin VAR_CHARACTERISTIC TP_S16_GMA_DCT_SPEED_DIFF_70_90KPH BrkCalVariantCriterion
  /begin VAR_ADDRESS 0x800205FA 0x800239FA 0x80026DFA 0x8002A1FA 0x8002D5FA 0x800309FA 0x80033DFA 0x800371FA /end VAR_ADDRESS
 /end VAR_CHARACTERISTIC
 /begin VAR_CHARACTERISTIC TP_S16_GMA_DCT_SPEED_DIFF_90_M_KPH BrkCalVariantCriterion
  /begin VAR_ADDRESS 0x800205FC 0x800239FC 0x80026DFC 0x8002A1FC 0x8002D5FC 0x800309FC 0x80033DFC 0x800371FC /end VAR_ADDRESS
 /end VAR_CHARACTERISTIC
 /begin VAR_CHARACTERISTIC TP_S16_GMA_DCT_SP_DIFF_0_50_BABS BrkCalVariantCriterion
  /begin VAR_ADDRESS 0x800205EC 0x800239EC 0x80026DEC 0x8002A1EC 0x8002D5EC 0x800309EC 0x80033DEC 0x800371EC /end VAR_ADDRESS
 /end VAR_CHARACTERISTIC
 /begin VAR_CHARACTERISTIC TP_S16_GMA_DCT_SP_DIFF_50_80_BABS BrkCalVariantCriterion
  /begin VAR_ADDRESS 0x800205EE 0x800239EE 0x80026DEE 0x8002A1EE 0x8002D5EE 0x800309EE 0x80033DEE 0x800371EE /end VAR_ADDRESS
 /end VAR_CHARACTERISTIC
 /begin VAR_CHARACTERISTIC TP_S16_GMA_DCT_SP_DIFF_80_M_BABS BrkCalVariantCriterion
  /begin VAR_ADDRESS 0x800205F0 0x800239F0 0x80026DF0 0x8002A1F0 0x8002D5F0 0x800309F0 0x80033DF0 0x800371F0 /end VAR_ADDRESS
 /end VAR_CHARACTERISTIC
 /begin VAR_CHARACTERISTIC TP_S16_GMA_H_SPEED BrkCalVariantCriterion
  /begin VAR_ADDRESS 0x8002028C 0x8002368C 0x80026A8C 0x80029E8C 0x8002D28C 0x8003068C 0x80033A8C 0x80036E8C /end VAR_ADDRESS
 /end VAR_CHARACTERISTIC
 /begin VAR_CHARACTERISTIC TP_S16_GMA_L_SPEED BrkCalVariantCriterion
  /begin VAR_ADDRESS 0x8002028E 0x8002368E 0x80026A8E 0x80029E8E 0x8002D28E 0x8003068E 0x80033A8E 0x80036E8E /end VAR_ADDRESS
 /end VAR_CHARACTERISTIC
 /begin VAR_CHARACTERISTIC TP_S16_GMA_M_SPEED BrkCalVariantCriterion
  /begin VAR_ADDRESS 0x80020290 0x80023690 0x80026A90 0x80029E90 0x8002D290 0x80030690 0x80033A90 0x80036E90 /end VAR_ADDRESS
 /end VAR_CHARACTERISTIC
 /begin VAR_CHARACTERISTIC TP_S16_H2SP_DETECT_FRONT_VRAD_DIFF1 BrkCalVariantCriterion
  /begin VAR_ADDRESS 0x8002059E 0x8002399E 0x80026D9E 0x8002A19E 0x8002D59E 0x8003099E 0x80033D9E 0x8003719E /end VAR_ADDRESS
 /end VAR_CHARACTERISTIC
 /begin VAR_CHARACTERISTIC TP_S16_H2SP_DETECT_FRONT_VRAD_DIFF2 BrkCalVariantCriterion
  /begin VAR_ADDRESS 0x800205A0 0x800239A0 0x80026DA0 0x8002A1A0 0x8002D5A0 0x800309A0 0x80033DA0 0x800371A0 /end VAR_ADDRESS
 /end VAR_CHARACTERISTIC
 /begin VAR_CHARACTERISTIC TP_S16_HDF_REF_LMu_40_60kph_F BrkCalVariantCriterion
  /begin VAR_ADDRESS 0x800205B6 0x800239B6 0x80026DB6 0x8002A1B6 0x8002D5B6 0x800309B6 0x80033DB6 0x800371B6 /end VAR_ADDRESS
 /end VAR_CHARACTERISTIC
 /begin VAR_CHARACTERISTIC TP_S16_HDF_REF_LMu_40_60kph_R BrkCalVariantCriterion
  /begin VAR_ADDRESS 0x800205BC 0x800239BC 0x80026DBC 0x8002A1BC 0x8002D5BC 0x800309BC 0x80033DBC 0x800371BC /end VAR_ADDRESS
 /end VAR_CHARACTERISTIC
 /begin VAR_CHARACTERISTIC TP_S16_HDF_REF_LMu_Ab_60kph_F BrkCalVariantCriterion
  /begin VAR_ADDRESS 0x800205B8 0x800239B8 0x80026DB8 0x8002A1B8 0x8002D5B8 0x800309B8 0x80033DB8 0x800371B8 /end VAR_ADDRESS
 /end VAR_CHARACTERISTIC
 /begin VAR_CHARACTERISTIC TP_S16_HDF_REF_LMu_Ab_60kph_R BrkCalVariantCriterion
  /begin VAR_ADDRESS 0x800205BE 0x800239BE 0x80026DBE 0x8002A1BE 0x8002D5BE 0x800309BE 0x80033DBE 0x800371BE /end VAR_ADDRESS
 /end VAR_CHARACTERISTIC
 /begin VAR_CHARACTERISTIC TP_S16_HDF_REF_LMu_B_40kph_F BrkCalVariantCriterion
  /begin VAR_ADDRESS 0x800205BA 0x800239BA 0x80026DBA 0x8002A1BA 0x8002D5BA 0x800309BA 0x80033DBA 0x800371BA /end VAR_ADDRESS
 /end VAR_CHARACTERISTIC
 /begin VAR_CHARACTERISTIC TP_S16_HDF_REF_LMu_B_40kph_R BrkCalVariantCriterion
  /begin VAR_ADDRESS 0x800205C0 0x800239C0 0x80026DC0 0x8002A1C0 0x8002D5C0 0x800309C0 0x80033DC0 0x800371C0 /end VAR_ADDRESS
 /end VAR_CHARACTERISTIC
 /begin VAR_CHARACTERISTIC TP_S16_HDF_REF_MMu_40_60kph_F BrkCalVariantCriterion
  /begin VAR_ADDRESS 0x800205C2 0x800239C2 0x80026DC2 0x8002A1C2 0x8002D5C2 0x800309C2 0x80033DC2 0x800371C2 /end VAR_ADDRESS
 /end VAR_CHARACTERISTIC
 /begin VAR_CHARACTERISTIC TP_S16_HDF_REF_MMu_40_60kph_R BrkCalVariantCriterion
  /begin VAR_ADDRESS 0x800205C8 0x800239C8 0x80026DC8 0x8002A1C8 0x8002D5C8 0x800309C8 0x80033DC8 0x800371C8 /end VAR_ADDRESS
 /end VAR_CHARACTERISTIC
 /begin VAR_CHARACTERISTIC TP_S16_HDF_REF_MMu_Ab_60kph_F BrkCalVariantCriterion
  /begin VAR_ADDRESS 0x800205C4 0x800239C4 0x80026DC4 0x8002A1C4 0x8002D5C4 0x800309C4 0x80033DC4 0x800371C4 /end VAR_ADDRESS
 /end VAR_CHARACTERISTIC
 /begin VAR_CHARACTERISTIC TP_S16_HDF_REF_MMu_Ab_60kph_R BrkCalVariantCriterion
  /begin VAR_ADDRESS 0x800205CA 0x800239CA 0x80026DCA 0x8002A1CA 0x8002D5CA 0x800309CA 0x80033DCA 0x800371CA /end VAR_ADDRESS
 /end VAR_CHARACTERISTIC
 /begin VAR_CHARACTERISTIC TP_S16_HDF_REF_MMu_B_40kph_F BrkCalVariantCriterion
  /begin VAR_ADDRESS 0x800205C6 0x800239C6 0x80026DC6 0x8002A1C6 0x8002D5C6 0x800309C6 0x80033DC6 0x800371C6 /end VAR_ADDRESS
 /end VAR_CHARACTERISTIC
 /begin VAR_CHARACTERISTIC TP_S16_HDF_REF_MMu_B_40kph_R BrkCalVariantCriterion
  /begin VAR_ADDRESS 0x800205CC 0x800239CC 0x80026DCC 0x8002A1CC 0x8002D5CC 0x800309CC 0x80033DCC 0x800371CC /end VAR_ADDRESS
 /end VAR_CHARACTERISTIC
 /begin VAR_CHARACTERISTIC TP_S16_High_dump_factor_Lower_Limit BrkCalVariantCriterion
  /begin VAR_ADDRESS 0x800205CE 0x800239CE 0x80026DCE 0x8002A1CE 0x8002D5CE 0x800309CE 0x80033DCE 0x800371CE /end VAR_ADDRESS
 /end VAR_CHARACTERISTIC
 /begin VAR_CHARACTERISTIC TP_S16_High_dump_factor_Numerator BrkCalVariantCriterion
  /begin VAR_ADDRESS 0x800205D0 0x800239D0 0x80026DD0 0x8002A1D0 0x8002D5D0 0x800309D0 0x80033DD0 0x800371D0 /end VAR_ADDRESS
 /end VAR_CHARACTERISTIC
 /begin VAR_CHARACTERISTIC TP_S16_High_dump_factor_Upper_Limit BrkCalVariantCriterion
  /begin VAR_ADDRESS 0x800205D2 0x800239D2 0x80026DD2 0x8002A1D2 0x8002D5D2 0x800309D2 0x80033DD2 0x800371D2 /end VAR_ADDRESS
 /end VAR_CHARACTERISTIC
 /begin VAR_CHARACTERISTIC TP_S16_L2H_DCT_ALLOWED_AFZ BrkCalVariantCriterion
  /begin VAR_ADDRESS 0x80020630 0x80023A30 0x80026E30 0x8002A230 0x8002D630 0x80030A30 0x80033E30 0x80037230 /end VAR_ADDRESS
 /end VAR_CHARACTERISTIC
 /begin VAR_CHARACTERISTIC TP_S16_L2H_DCT_DIFF_DECEL BrkCalVariantCriterion
  /begin VAR_ADDRESS 0x80020632 0x80023A32 0x80026E32 0x8002A232 0x8002D632 0x80030A32 0x80033E32 0x80037232 /end VAR_ADDRESS
 /end VAR_CHARACTERISTIC
 /begin VAR_CHARACTERISTIC TP_S16_L2H_DCT_DIFF_DECEL_H BrkCalVariantCriterion
  /begin VAR_ADDRESS 0x80020634 0x80023A34 0x80026E34 0x8002A234 0x8002D634 0x80030A34 0x80033E34 0x80037234 /end VAR_ADDRESS
 /end VAR_CHARACTERISTIC
 /begin VAR_CHARACTERISTIC TP_S16_L2H_RESET_DIFF_DECEL BrkCalVariantCriterion
  /begin VAR_ADDRESS 0x80020636 0x80023A36 0x80026E36 0x8002A236 0x8002D636 0x80030A36 0x80033E36 0x80037236 /end VAR_ADDRESS
 /end VAR_CHARACTERISTIC
 /begin VAR_CHARACTERISTIC TP_S16_LCB_ENTER_MAX_LATERAL_G BrkCalVariantCriterion
  /begin VAR_ADDRESS 0x8002054C 0x8002394C 0x80026D4C 0x8002A14C 0x8002D54C 0x8003094C 0x80033D4C 0x8003714C /end VAR_ADDRESS
 /end VAR_CHARACTERISTIC
 /begin VAR_CHARACTERISTIC TP_S16_LCB_EXIT_MIN_LATERAL_G BrkCalVariantCriterion
  /begin VAR_ADDRESS 0x8002054E 0x8002394E 0x80026D4E 0x8002A14E 0x8002D54E 0x8003094E 0x80033D4E 0x8003714E /end VAR_ADDRESS
 /end VAR_CHARACTERISTIC
 /begin VAR_CHARACTERISTIC TP_S16_LMu_TARGET_dYAW2_SPEED_H BrkCalVariantCriterion
  /begin VAR_ADDRESS 0x800204EC 0x800238EC 0x80026CEC 0x8002A0EC 0x8002D4EC 0x800308EC 0x80033CEC 0x800370EC /end VAR_ADDRESS
 /end VAR_CHARACTERISTIC
 /begin VAR_CHARACTERISTIC TP_S16_LMu_TARGET_dYAW2_SPEED_L BrkCalVariantCriterion
  /begin VAR_ADDRESS 0x800204EE 0x800238EE 0x80026CEE 0x8002A0EE 0x8002D4EE 0x800308EE 0x80033CEE 0x800370EE /end VAR_ADDRESS
 /end VAR_CHARACTERISTIC
 /begin VAR_CHARACTERISTIC TP_S16_LMu_TARGET_dYAW2_SPEED_M BrkCalVariantCriterion
  /begin VAR_ADDRESS 0x800204F0 0x800238F0 0x80026CF0 0x8002A0F0 0x8002D4F0 0x800308F0 0x80033CF0 0x800370F0 /end VAR_ADDRESS
 /end VAR_CHARACTERISTIC
 /begin VAR_CHARACTERISTIC TP_S16_LMu_TARGET_dYAW_SPEED_H BrkCalVariantCriterion
  /begin VAR_ADDRESS 0x800204DA 0x800238DA 0x80026CDA 0x8002A0DA 0x8002D4DA 0x800308DA 0x80033CDA 0x800370DA /end VAR_ADDRESS
 /end VAR_CHARACTERISTIC
 /begin VAR_CHARACTERISTIC TP_S16_LMu_TARGET_dYAW_SPEED_L BrkCalVariantCriterion
  /begin VAR_ADDRESS 0x800204DC 0x800238DC 0x80026CDC 0x8002A0DC 0x8002D4DC 0x800308DC 0x80033CDC 0x800370DC /end VAR_ADDRESS
 /end VAR_CHARACTERISTIC
 /begin VAR_CHARACTERISTIC TP_S16_LMu_TARGET_dYAW_SPEED_M BrkCalVariantCriterion
  /begin VAR_ADDRESS 0x800204DE 0x800238DE 0x80026CDE 0x8002A0DE 0x8002D4DE 0x800308DE 0x80033CDE 0x800370DE /end VAR_ADDRESS
 /end VAR_CHARACTERISTIC
 /begin VAR_CHARACTERISTIC TP_S16_MINIMUM_EFFECTIVE_LFC_DUTY BrkCalVariantCriterion
  /begin VAR_ADDRESS 0x80020210 0x80023610 0x80026A10 0x80029E10 0x8002D210 0x80030610 0x80033A10 0x80036E10 /end VAR_ADDRESS
 /end VAR_CHARACTERISTIC
 /begin VAR_CHARACTERISTIC TP_S16_MT_In_Gear_Out_Vel_Threshold EngCalVariantCriterion
  /begin VAR_ADDRESS 0x8003A15A 0x8003AF5A 0x8003BD5A 0x8003CB5A 0x8003D95A 0x8003E75A 0x8003F55A 0x8004035A 0x8004115A 0x80041F5A 0x80042D5A 0x80043B5A 0x8004495A 0x8004575A 0x8004655A 0x8004735A 0x8004815A 0x80048F5A 0x80049D5A 0x8004AB5A 0x8004B95A 0x8004C75A 0x8004D55A 0x8004E35A /end VAR_ADDRESS
 /end VAR_CHARACTERISTIC
 /begin VAR_CHARACTERISTIC TP_S16_MT_In_Gear_Vel_Threshold_1to3 EngCalVariantCriterion
  /begin VAR_ADDRESS 0x8003A15C 0x8003AF5C 0x8003BD5C 0x8003CB5C 0x8003D95C 0x8003E75C 0x8003F55C 0x8004035C 0x8004115C 0x80041F5C 0x80042D5C 0x80043B5C 0x8004495C 0x8004575C 0x8004655C 0x8004735C 0x8004815C 0x80048F5C 0x80049D5C 0x8004AB5C 0x8004B95C 0x8004C75C 0x8004D55C 0x8004E35C /end VAR_ADDRESS
 /end VAR_CHARACTERISTIC
 /begin VAR_CHARACTERISTIC TP_S16_MT_In_Gear_Vel_Threshold_4to6 EngCalVariantCriterion
  /begin VAR_ADDRESS 0x8003A15E 0x8003AF5E 0x8003BD5E 0x8003CB5E 0x8003D95E 0x8003E75E 0x8003F55E 0x8004035E 0x8004115E 0x80041F5E 0x80042D5E 0x80043B5E 0x8004495E 0x8004575E 0x8004655E 0x8004735E 0x8004815E 0x80048F5E 0x80049D5E 0x8004AB5E 0x8004B95E 0x8004C75E 0x8004D55E 0x8004E35E /end VAR_ADDRESS
 /end VAR_CHARACTERISTIC
 /begin VAR_CHARACTERISTIC TP_S16_NEED_DEC_PRESS_YDF_L1 BrkCalVariantCriterion
  /begin VAR_ADDRESS 0x80020506 0x80023906 0x80026D06 0x8002A106 0x8002D506 0x80030906 0x80033D06 0x80037106 /end VAR_ADDRESS
 /end VAR_CHARACTERISTIC
 /begin VAR_CHARACTERISTIC TP_S16_NEED_DEC_PRESS_YDF_L2 BrkCalVariantCriterion
  /begin VAR_ADDRESS 0x80020508 0x80023908 0x80026D08 0x8002A108 0x8002D508 0x80030908 0x80033D08 0x80037108 /end VAR_ADDRESS
 /end VAR_CHARACTERISTIC
 /begin VAR_CHARACTERISTIC TP_S16_NEED_DEC_PRESS_YDF_L3 BrkCalVariantCriterion
  /begin VAR_ADDRESS 0x8002050A 0x8002390A 0x80026D0A 0x8002A10A 0x8002D50A 0x8003090A 0x80033D0A 0x8003710A /end VAR_ADDRESS
 /end VAR_CHARACTERISTIC
 /begin VAR_CHARACTERISTIC TP_S16_NEED_INC_PRESS_YDF_L1 BrkCalVariantCriterion
  /begin VAR_ADDRESS 0x80020510 0x80023910 0x80026D10 0x8002A110 0x8002D510 0x80030910 0x80033D10 0x80037110 /end VAR_ADDRESS
 /end VAR_CHARACTERISTIC
 /begin VAR_CHARACTERISTIC TP_S16_NEED_INC_PRESS_YDF_L2 BrkCalVariantCriterion
  /begin VAR_ADDRESS 0x80020512 0x80023912 0x80026D12 0x8002A112 0x8002D512 0x80030912 0x80033D12 0x80037112 /end VAR_ADDRESS
 /end VAR_CHARACTERISTIC
 /begin VAR_CHARACTERISTIC TP_S16_OUTABS_YMR_ALLOW_SPEED BrkCalVariantCriterion
  /begin VAR_ADDRESS 0x8002065C 0x80023A5C 0x80026E5C 0x8002A25C 0x8002D65C 0x80030A5C 0x80033E5C 0x8003725C /end VAR_ADDRESS
 /end VAR_CHARACTERISTIC
 /begin VAR_CHARACTERISTIC TP_S16_OUTABS_YMR_DUMP_ALLOW_SPEED BrkCalVariantCriterion
  /begin VAR_ADDRESS 0x8002065E 0x80023A5E 0x80026E5E 0x8002A25E 0x8002D65E 0x80030A5E 0x80033E5E 0x8003725E /end VAR_ADDRESS
 /end VAR_CHARACTERISTIC
 /begin VAR_CHARACTERISTIC TP_S16_OUTABS_YMR_DUMP_HIGH_SPEED BrkCalVariantCriterion
  /begin VAR_ADDRESS 0x80020660 0x80023A60 0x80026E60 0x8002A260 0x8002D660 0x80030A60 0x80033E60 0x80037260 /end VAR_ADDRESS
 /end VAR_CHARACTERISTIC
 /begin VAR_CHARACTERISTIC TP_S16_OUTABS_YMR_DUMP_MAX BrkCalVariantCriterion
  /begin VAR_ADDRESS 0x80020662 0x80023A62 0x80026E62 0x8002A262 0x8002D662 0x80030A62 0x80033E62 0x80037262 /end VAR_ADDRESS
 /end VAR_CHARACTERISTIC
 /begin VAR_CHARACTERISTIC TP_S16_OUTABS_YMR_DUMP_MIN BrkCalVariantCriterion
  /begin VAR_ADDRESS 0x80020664 0x80023A64 0x80026E64 0x8002A264 0x8002D664 0x80030A64 0x80033E64 0x80037264 /end VAR_ADDRESS
 /end VAR_CHARACTERISTIC
 /begin VAR_CHARACTERISTIC TP_S16_PEDAL_CHANGE_DCT_TH1 BrkCalVariantCriterion
  /begin VAR_ADDRESS 0x8002020C 0x8002360C 0x80026A0C 0x80029E0C 0x8002D20C 0x8003060C 0x80033A0C 0x80036E0C /end VAR_ADDRESS
 /end VAR_CHARACTERISTIC
 /begin VAR_CHARACTERISTIC TP_S16_PEDAL_CHANGE_DCT_TH2 BrkCalVariantCriterion
  /begin VAR_ADDRESS 0x8002020E 0x8002360E 0x80026A0E 0x80029E0E 0x8002D20E 0x8003060E 0x80033A0E 0x80036E0E /end VAR_ADDRESS
 /end VAR_CHARACTERISTIC
 /begin VAR_CHARACTERISTIC TP_S16_REAR_HOMO_SL_HLD_THR_YDF_B_L BrkCalVariantCriterion
  /begin VAR_ADDRESS 0x8002053A 0x8002393A 0x80026D3A 0x8002A13A 0x8002D53A 0x8003093A 0x80033D3A 0x8003713A /end VAR_ADDRESS
 /end VAR_CHARACTERISTIC
 /begin VAR_CHARACTERISTIC TP_S16_REAR_HOMO_SL_HLD_THR_YDF_H BrkCalVariantCriterion
  /begin VAR_ADDRESS 0x8002053C 0x8002393C 0x80026D3C 0x8002A13C 0x8002D53C 0x8003093C 0x80033D3C 0x8003713C /end VAR_ADDRESS
 /end VAR_CHARACTERISTIC
 /begin VAR_CHARACTERISTIC TP_S16_REAR_HOMO_SL_HLD_THR_YDF_L BrkCalVariantCriterion
  /begin VAR_ADDRESS 0x8002053E 0x8002393E 0x80026D3E 0x8002A13E 0x8002D53E 0x8003093E 0x80033D3E 0x8003713E /end VAR_ADDRESS
 /end VAR_CHARACTERISTIC
 /begin VAR_CHARACTERISTIC TP_S16_REAR_HOMO_SL_HLD_THR_YDF_M BrkCalVariantCriterion
  /begin VAR_ADDRESS 0x80020540 0x80023940 0x80026D40 0x8002A140 0x8002D540 0x80030940 0x80033D40 0x80037140 /end VAR_ADDRESS
 /end VAR_CHARACTERISTIC
 /begin VAR_CHARACTERISTIC TP_S16_REAR_SP_SL_HLD_THRES_YDF_B_L BrkCalVariantCriterion
  /begin VAR_ADDRESS 0x80020542 0x80023942 0x80026D42 0x8002A142 0x8002D542 0x80030942 0x80033D42 0x80037142 /end VAR_ADDRESS
 /end VAR_CHARACTERISTIC
 /begin VAR_CHARACTERISTIC TP_S16_REAR_SP_SL_HLD_THRES_YDF_H BrkCalVariantCriterion
  /begin VAR_ADDRESS 0x80020544 0x80023944 0x80026D44 0x8002A144 0x8002D544 0x80030944 0x80033D44 0x80037144 /end VAR_ADDRESS
 /end VAR_CHARACTERISTIC
 /begin VAR_CHARACTERISTIC TP_S16_REAR_SP_SL_HLD_THRES_YDF_L BrkCalVariantCriterion
  /begin VAR_ADDRESS 0x80020546 0x80023946 0x80026D46 0x8002A146 0x8002D546 0x80030946 0x80033D46 0x80037146 /end VAR_ADDRESS
 /end VAR_CHARACTERISTIC
 /begin VAR_CHARACTERISTIC TP_S16_REAR_SP_SL_HLD_THRES_YDF_M BrkCalVariantCriterion
  /begin VAR_ADDRESS 0x80020548 0x80023948 0x80026D48 0x8002A148 0x8002D548 0x80030948 0x80033D48 0x80037148 /end VAR_ADDRESS
 /end VAR_CHARACTERISTIC
 /begin VAR_CHARACTERISTIC TP_S16_SLIGHT_BRAKING_PRESS BrkCalVariantCriterion
  /begin VAR_ADDRESS 0x80020214 0x80023614 0x80026A14 0x80029E14 0x8002D214 0x80030614 0x80033A14 0x80036E14 /end VAR_ADDRESS
 /end VAR_CHARACTERISTIC
 /begin VAR_CHARACTERISTIC TP_S16_SPLIT_TARGET_dYAW2_SPEED_H BrkCalVariantCriterion
  /begin VAR_ADDRESS 0x800204F2 0x800238F2 0x80026CF2 0x8002A0F2 0x8002D4F2 0x800308F2 0x80033CF2 0x800370F2 /end VAR_ADDRESS
 /end VAR_CHARACTERISTIC
 /begin VAR_CHARACTERISTIC TP_S16_SPLIT_TARGET_dYAW2_SPEED_L BrkCalVariantCriterion
  /begin VAR_ADDRESS 0x800204F4 0x800238F4 0x80026CF4 0x8002A0F4 0x8002D4F4 0x800308F4 0x80033CF4 0x800370F4 /end VAR_ADDRESS
 /end VAR_CHARACTERISTIC
 /begin VAR_CHARACTERISTIC TP_S16_SPLIT_TARGET_dYAW2_SPEED_M BrkCalVariantCriterion
  /begin VAR_ADDRESS 0x800204F6 0x800238F6 0x80026CF6 0x8002A0F6 0x8002D4F6 0x800308F6 0x80033CF6 0x800370F6 /end VAR_ADDRESS
 /end VAR_CHARACTERISTIC
 /begin VAR_CHARACTERISTIC TP_S16_SPLIT_TARGET_dYAW_SPEED_H BrkCalVariantCriterion
  /begin VAR_ADDRESS 0x800204E0 0x800238E0 0x80026CE0 0x8002A0E0 0x8002D4E0 0x800308E0 0x80033CE0 0x800370E0 /end VAR_ADDRESS
 /end VAR_CHARACTERISTIC
 /begin VAR_CHARACTERISTIC TP_S16_SPLIT_TARGET_dYAW_SPEED_L BrkCalVariantCriterion
  /begin VAR_ADDRESS 0x800204E2 0x800238E2 0x80026CE2 0x8002A0E2 0x8002D4E2 0x800308E2 0x80033CE2 0x800370E2 /end VAR_ADDRESS
 /end VAR_CHARACTERISTIC
 /begin VAR_CHARACTERISTIC TP_S16_SPLIT_TARGET_dYAW_SPEED_M BrkCalVariantCriterion
  /begin VAR_ADDRESS 0x800204E4 0x800238E4 0x80026CE4 0x8002A0E4 0x8002D4E4 0x800308E4 0x80033CE4 0x800370E4 /end VAR_ADDRESS
 /end VAR_CHARACTERISTIC
 /begin VAR_CHARACTERISTIC TP_S16_SP_HI_SIDE_STB_DMP_YDF_TH_BL BrkCalVariantCriterion
  /begin VAR_ADDRESS 0x800204FE 0x800238FE 0x80026CFE 0x8002A0FE 0x8002D4FE 0x800308FE 0x80033CFE 0x800370FE /end VAR_ADDRESS
 /end VAR_CHARACTERISTIC
 /begin VAR_CHARACTERISTIC TP_S16_SP_HI_SIDE_STB_DMP_YDF_TH_H BrkCalVariantCriterion
  /begin VAR_ADDRESS 0x80020500 0x80023900 0x80026D00 0x8002A100 0x8002D500 0x80030900 0x80033D00 0x80037100 /end VAR_ADDRESS
 /end VAR_CHARACTERISTIC
 /begin VAR_CHARACTERISTIC TP_S16_SP_HI_SIDE_STB_DMP_YDF_TH_L BrkCalVariantCriterion
  /begin VAR_ADDRESS 0x80020502 0x80023902 0x80026D02 0x8002A102 0x8002D502 0x80030902 0x80033D02 0x80037102 /end VAR_ADDRESS
 /end VAR_CHARACTERISTIC
 /begin VAR_CHARACTERISTIC TP_S16_SP_HI_SIDE_STB_DMP_YDF_TH_M BrkCalVariantCriterion
  /begin VAR_ADDRESS 0x80020504 0x80023904 0x80026D04 0x8002A104 0x8002D504 0x80030904 0x80033D04 0x80037104 /end VAR_ADDRESS
 /end VAR_CHARACTERISTIC
 /begin VAR_CHARACTERISTIC TP_S16_STOP_STATE_CONV_COEFFIC_F EngCalVariantCriterion
  /begin VAR_ADDRESS 0x8003A060 0x8003AE60 0x8003BC60 0x8003CA60 0x8003D860 0x8003E660 0x8003F460 0x80040260 0x80041060 0x80041E60 0x80042C60 0x80043A60 0x80044860 0x80045660 0x80046460 0x80047260 0x80048060 0x80048E60 0x80049C60 0x8004AA60 0x8004B860 0x8004C660 0x8004D460 0x8004E260 /end VAR_ADDRESS
 /end VAR_CHARACTERISTIC
 /begin VAR_CHARACTERISTIC TP_S16_STOP_STATE_CONV_COEFFIC_R EngCalVariantCriterion
  /begin VAR_ADDRESS 0x8003A062 0x8003AE62 0x8003BC62 0x8003CA62 0x8003D862 0x8003E662 0x8003F462 0x80040262 0x80041062 0x80041E62 0x80042C62 0x80043A62 0x80044862 0x80045662 0x80046462 0x80047262 0x80048062 0x80048E62 0x80049C62 0x8004AA62 0x8004B862 0x8004C662 0x8004D462 0x8004E262 /end VAR_ADDRESS
 /end VAR_CHARACTERISTIC
 /begin VAR_CHARACTERISTIC TP_S16_Slip_Gain_BFAFZOK_100_150_F BrkCalVariantCriterion
  /begin VAR_ADDRESS 0x800202F2 0x800236F2 0x80026AF2 0x80029EF2 0x8002D2F2 0x800306F2 0x80033AF2 0x80036EF2 /end VAR_ADDRESS
 /end VAR_CHARACTERISTIC
 /begin VAR_CHARACTERISTIC TP_S16_Slip_Gain_BFAFZOK_100_150_R BrkCalVariantCriterion
  /begin VAR_ADDRESS 0x8002030E 0x8002370E 0x80026B0E 0x80029F0E 0x8002D30E 0x8003070E 0x80033B0E 0x80036F0E /end VAR_ADDRESS
 /end VAR_CHARACTERISTIC
 /begin VAR_CHARACTERISTIC TP_S16_Slip_Gain_BFAFZOK_10_20_F BrkCalVariantCriterion
  /begin VAR_ADDRESS 0x800202F4 0x800236F4 0x80026AF4 0x80029EF4 0x8002D2F4 0x800306F4 0x80033AF4 0x80036EF4 /end VAR_ADDRESS
 /end VAR_CHARACTERISTIC
 /begin VAR_CHARACTERISTIC TP_S16_Slip_Gain_BFAFZOK_10_20_R BrkCalVariantCriterion
  /begin VAR_ADDRESS 0x80020310 0x80023710 0x80026B10 0x80029F10 0x8002D310 0x80030710 0x80033B10 0x80036F10 /end VAR_ADDRESS
 /end VAR_CHARACTERISTIC
 /begin VAR_CHARACTERISTIC TP_S16_Slip_Gain_BFAFZOK_20_40_F BrkCalVariantCriterion
  /begin VAR_ADDRESS 0x800202F6 0x800236F6 0x80026AF6 0x80029EF6 0x8002D2F6 0x800306F6 0x80033AF6 0x80036EF6 /end VAR_ADDRESS
 /end VAR_CHARACTERISTIC
 /begin VAR_CHARACTERISTIC TP_S16_Slip_Gain_BFAFZOK_20_40_R BrkCalVariantCriterion
  /begin VAR_ADDRESS 0x80020312 0x80023712 0x80026B12 0x80029F12 0x8002D312 0x80030712 0x80033B12 0x80036F12 /end VAR_ADDRESS
 /end VAR_CHARACTERISTIC
 /begin VAR_CHARACTERISTIC TP_S16_Slip_Gain_BFAFZOK_40_60_F BrkCalVariantCriterion
  /begin VAR_ADDRESS 0x800202F8 0x800236F8 0x80026AF8 0x80029EF8 0x8002D2F8 0x800306F8 0x80033AF8 0x80036EF8 /end VAR_ADDRESS
 /end VAR_CHARACTERISTIC
 /begin VAR_CHARACTERISTIC TP_S16_Slip_Gain_BFAFZOK_40_60_R BrkCalVariantCriterion
  /begin VAR_ADDRESS 0x80020314 0x80023714 0x80026B14 0x80029F14 0x8002D314 0x80030714 0x80033B14 0x80036F14 /end VAR_ADDRESS
 /end VAR_CHARACTERISTIC
 /begin VAR_CHARACTERISTIC TP_S16_Slip_Gain_BFAFZOK_60_100_F BrkCalVariantCriterion
  /begin VAR_ADDRESS 0x800202FA 0x800236FA 0x80026AFA 0x80029EFA 0x8002D2FA 0x800306FA 0x80033AFA 0x80036EFA /end VAR_ADDRESS
 /end VAR_CHARACTERISTIC
 /begin VAR_CHARACTERISTIC TP_S16_Slip_Gain_BFAFZOK_60_100_R BrkCalVariantCriterion
  /begin VAR_ADDRESS 0x80020316 0x80023716 0x80026B16 0x80029F16 0x8002D316 0x80030716 0x80033B16 0x80036F16 /end VAR_ADDRESS
 /end VAR_CHARACTERISTIC
 /begin VAR_CHARACTERISTIC TP_S16_Slip_Gain_BFAFZOK_Ab_150_F BrkCalVariantCriterion
  /begin VAR_ADDRESS 0x800202FC 0x800236FC 0x80026AFC 0x80029EFC 0x8002D2FC 0x800306FC 0x80033AFC 0x80036EFC /end VAR_ADDRESS
 /end VAR_CHARACTERISTIC
 /begin VAR_CHARACTERISTIC TP_S16_Slip_Gain_BFAFZOK_Ab_150_R BrkCalVariantCriterion
  /begin VAR_ADDRESS 0x80020318 0x80023718 0x80026B18 0x80029F18 0x8002D318 0x80030718 0x80033B18 0x80036F18 /end VAR_ADDRESS
 /end VAR_CHARACTERISTIC
 /begin VAR_CHARACTERISTIC TP_S16_Slip_Gain_BFAFZOK_B_10_F BrkCalVariantCriterion
  /begin VAR_ADDRESS 0x800202FE 0x800236FE 0x80026AFE 0x80029EFE 0x8002D2FE 0x800306FE 0x80033AFE 0x80036EFE /end VAR_ADDRESS
 /end VAR_CHARACTERISTIC
 /begin VAR_CHARACTERISTIC TP_S16_Slip_Gain_BFAFZOK_B_10_R BrkCalVariantCriterion
  /begin VAR_ADDRESS 0x8002031A 0x8002371A 0x80026B1A 0x80029F1A 0x8002D31A 0x8003071A 0x80033B1A 0x80036F1A /end VAR_ADDRESS
 /end VAR_CHARACTERISTIC
 /begin VAR_CHARACTERISTIC TP_S16_Slip_Gain_EBD_100_150kph_R BrkCalVariantCriterion
  /begin VAR_ADDRESS 0x800206CC 0x80023ACC 0x80026ECC 0x8002A2CC 0x8002D6CC 0x80030ACC 0x80033ECC 0x800372CC /end VAR_ADDRESS
 /end VAR_CHARACTERISTIC
 /begin VAR_CHARACTERISTIC TP_S16_Slip_Gain_EBD_20_40kph_R BrkCalVariantCriterion
  /begin VAR_ADDRESS 0x800206CE 0x80023ACE 0x80026ECE 0x8002A2CE 0x8002D6CE 0x80030ACE 0x80033ECE 0x800372CE /end VAR_ADDRESS
 /end VAR_CHARACTERISTIC
 /begin VAR_CHARACTERISTIC TP_S16_Slip_Gain_EBD_40_60kph_R BrkCalVariantCriterion
  /begin VAR_ADDRESS 0x800206D0 0x80023AD0 0x80026ED0 0x8002A2D0 0x8002D6D0 0x80030AD0 0x80033ED0 0x800372D0 /end VAR_ADDRESS
 /end VAR_CHARACTERISTIC
 /begin VAR_CHARACTERISTIC TP_S16_Slip_Gain_EBD_60_100kph_R BrkCalVariantCriterion
  /begin VAR_ADDRESS 0x800206D2 0x80023AD2 0x80026ED2 0x8002A2D2 0x8002D6D2 0x80030AD2 0x80033ED2 0x800372D2 /end VAR_ADDRESS
 /end VAR_CHARACTERISTIC
 /begin VAR_CHARACTERISTIC TP_S16_Slip_Gain_EBD_Ab_150kph_R BrkCalVariantCriterion
  /begin VAR_ADDRESS 0x800206D4 0x80023AD4 0x80026ED4 0x8002A2D4 0x8002D6D4 0x80030AD4 0x80033ED4 0x800372D4 /end VAR_ADDRESS
 /end VAR_CHARACTERISTIC
 /begin VAR_CHARACTERISTIC TP_S16_Slip_Gain_EBD_B_20kph_R BrkCalVariantCriterion
  /begin VAR_ADDRESS 0x800206D6 0x80023AD6 0x80026ED6 0x8002A2D6 0x8002D6D6 0x80030AD6 0x80033ED6 0x800372D6 /end VAR_ADDRESS
 /end VAR_CHARACTERISTIC
 /begin VAR_CHARACTERISTIC TP_S16_Slip_Gain_HMu_100_150kph_F BrkCalVariantCriterion
  /begin VAR_ADDRESS 0x8002032A 0x8002372A 0x80026B2A 0x80029F2A 0x8002D32A 0x8003072A 0x80033B2A 0x80036F2A /end VAR_ADDRESS
 /end VAR_CHARACTERISTIC
 /begin VAR_CHARACTERISTIC TP_S16_Slip_Gain_HMu_100_150kph_R BrkCalVariantCriterion
  /begin VAR_ADDRESS 0x80020346 0x80023746 0x80026B46 0x80029F46 0x8002D346 0x80030746 0x80033B46 0x80036F46 /end VAR_ADDRESS
 /end VAR_CHARACTERISTIC
 /begin VAR_CHARACTERISTIC TP_S16_Slip_Gain_HMu_10_20kph_F BrkCalVariantCriterion
  /begin VAR_ADDRESS 0x8002032C 0x8002372C 0x80026B2C 0x80029F2C 0x8002D32C 0x8003072C 0x80033B2C 0x80036F2C /end VAR_ADDRESS
 /end VAR_CHARACTERISTIC
 /begin VAR_CHARACTERISTIC TP_S16_Slip_Gain_HMu_10_20kph_R BrkCalVariantCriterion
  /begin VAR_ADDRESS 0x80020348 0x80023748 0x80026B48 0x80029F48 0x8002D348 0x80030748 0x80033B48 0x80036F48 /end VAR_ADDRESS
 /end VAR_CHARACTERISTIC
 /begin VAR_CHARACTERISTIC TP_S16_Slip_Gain_HMu_20_40kph_F BrkCalVariantCriterion
  /begin VAR_ADDRESS 0x8002032E 0x8002372E 0x80026B2E 0x80029F2E 0x8002D32E 0x8003072E 0x80033B2E 0x80036F2E /end VAR_ADDRESS
 /end VAR_CHARACTERISTIC
 /begin VAR_CHARACTERISTIC TP_S16_Slip_Gain_HMu_20_40kph_R BrkCalVariantCriterion
  /begin VAR_ADDRESS 0x8002034A 0x8002374A 0x80026B4A 0x80029F4A 0x8002D34A 0x8003074A 0x80033B4A 0x80036F4A /end VAR_ADDRESS
 /end VAR_CHARACTERISTIC
 /begin VAR_CHARACTERISTIC TP_S16_Slip_Gain_HMu_40_60kph_F BrkCalVariantCriterion
  /begin VAR_ADDRESS 0x80020330 0x80023730 0x80026B30 0x80029F30 0x8002D330 0x80030730 0x80033B30 0x80036F30 /end VAR_ADDRESS
 /end VAR_CHARACTERISTIC
 /begin VAR_CHARACTERISTIC TP_S16_Slip_Gain_HMu_40_60kph_R BrkCalVariantCriterion
  /begin VAR_ADDRESS 0x8002034C 0x8002374C 0x80026B4C 0x80029F4C 0x8002D34C 0x8003074C 0x80033B4C 0x80036F4C /end VAR_ADDRESS
 /end VAR_CHARACTERISTIC
 /begin VAR_CHARACTERISTIC TP_S16_Slip_Gain_HMu_60_100kph_F BrkCalVariantCriterion
  /begin VAR_ADDRESS 0x80020332 0x80023732 0x80026B32 0x80029F32 0x8002D332 0x80030732 0x80033B32 0x80036F32 /end VAR_ADDRESS
 /end VAR_CHARACTERISTIC
 /begin VAR_CHARACTERISTIC TP_S16_Slip_Gain_HMu_60_100kph_R BrkCalVariantCriterion
  /begin VAR_ADDRESS 0x8002034E 0x8002374E 0x80026B4E 0x80029F4E 0x8002D34E 0x8003074E 0x80033B4E 0x80036F4E /end VAR_ADDRESS
 /end VAR_CHARACTERISTIC
 /begin VAR_CHARACTERISTIC TP_S16_Slip_Gain_HMu_Ab_150kph_F BrkCalVariantCriterion
  /begin VAR_ADDRESS 0x80020334 0x80023734 0x80026B34 0x80029F34 0x8002D334 0x80030734 0x80033B34 0x80036F34 /end VAR_ADDRESS
 /end VAR_CHARACTERISTIC
 /begin VAR_CHARACTERISTIC TP_S16_Slip_Gain_HMu_Ab_150kph_R BrkCalVariantCriterion
  /begin VAR_ADDRESS 0x80020350 0x80023750 0x80026B50 0x80029F50 0x8002D350 0x80030750 0x80033B50 0x80036F50 /end VAR_ADDRESS
 /end VAR_CHARACTERISTIC
 /begin VAR_CHARACTERISTIC TP_S16_Slip_Gain_HMu_B_10kph_F BrkCalVariantCriterion
  /begin VAR_ADDRESS 0x80020336 0x80023736 0x80026B36 0x80029F36 0x8002D336 0x80030736 0x80033B36 0x80036F36 /end VAR_ADDRESS
 /end VAR_CHARACTERISTIC
 /begin VAR_CHARACTERISTIC TP_S16_Slip_Gain_HMu_B_10kph_R BrkCalVariantCriterion
  /begin VAR_ADDRESS 0x80020352 0x80023752 0x80026B52 0x80029F52 0x8002D352 0x80030752 0x80033B52 0x80036F52 /end VAR_ADDRESS
 /end VAR_CHARACTERISTIC
 /begin VAR_CHARACTERISTIC TP_S16_Slip_Gain_LMMu_100_150kph_F BrkCalVariantCriterion
  /begin VAR_ADDRESS 0x8002039A 0x8002379A 0x80026B9A 0x80029F9A 0x8002D39A 0x8003079A 0x80033B9A 0x80036F9A /end VAR_ADDRESS
 /end VAR_CHARACTERISTIC
 /begin VAR_CHARACTERISTIC TP_S16_Slip_Gain_LMMu_100_150kph_R BrkCalVariantCriterion
  /begin VAR_ADDRESS 0x800203B6 0x800237B6 0x80026BB6 0x80029FB6 0x8002D3B6 0x800307B6 0x80033BB6 0x80036FB6 /end VAR_ADDRESS
 /end VAR_CHARACTERISTIC
 /begin VAR_CHARACTERISTIC TP_S16_Slip_Gain_LMMu_10_20kph_F BrkCalVariantCriterion
  /begin VAR_ADDRESS 0x8002039C 0x8002379C 0x80026B9C 0x80029F9C 0x8002D39C 0x8003079C 0x80033B9C 0x80036F9C /end VAR_ADDRESS
 /end VAR_CHARACTERISTIC
 /begin VAR_CHARACTERISTIC TP_S16_Slip_Gain_LMMu_10_20kph_R BrkCalVariantCriterion
  /begin VAR_ADDRESS 0x800203B8 0x800237B8 0x80026BB8 0x80029FB8 0x8002D3B8 0x800307B8 0x80033BB8 0x80036FB8 /end VAR_ADDRESS
 /end VAR_CHARACTERISTIC
 /begin VAR_CHARACTERISTIC TP_S16_Slip_Gain_LMMu_20_40kph_F BrkCalVariantCriterion
  /begin VAR_ADDRESS 0x8002039E 0x8002379E 0x80026B9E 0x80029F9E 0x8002D39E 0x8003079E 0x80033B9E 0x80036F9E /end VAR_ADDRESS
 /end VAR_CHARACTERISTIC
 /begin VAR_CHARACTERISTIC TP_S16_Slip_Gain_LMMu_20_40kph_R BrkCalVariantCriterion
  /begin VAR_ADDRESS 0x800203BA 0x800237BA 0x80026BBA 0x80029FBA 0x8002D3BA 0x800307BA 0x80033BBA 0x80036FBA /end VAR_ADDRESS
 /end VAR_CHARACTERISTIC
 /begin VAR_CHARACTERISTIC TP_S16_Slip_Gain_LMMu_40_60kph_F BrkCalVariantCriterion
  /begin VAR_ADDRESS 0x800203A0 0x800237A0 0x80026BA0 0x80029FA0 0x8002D3A0 0x800307A0 0x80033BA0 0x80036FA0 /end VAR_ADDRESS
 /end VAR_CHARACTERISTIC
 /begin VAR_CHARACTERISTIC TP_S16_Slip_Gain_LMMu_40_60kph_R BrkCalVariantCriterion
  /begin VAR_ADDRESS 0x800203BC 0x800237BC 0x80026BBC 0x80029FBC 0x8002D3BC 0x800307BC 0x80033BBC 0x80036FBC /end VAR_ADDRESS
 /end VAR_CHARACTERISTIC
 /begin VAR_CHARACTERISTIC TP_S16_Slip_Gain_LMMu_60_100kph_F BrkCalVariantCriterion
  /begin VAR_ADDRESS 0x800203A2 0x800237A2 0x80026BA2 0x80029FA2 0x8002D3A2 0x800307A2 0x80033BA2 0x80036FA2 /end VAR_ADDRESS
 /end VAR_CHARACTERISTIC
 /begin VAR_CHARACTERISTIC TP_S16_Slip_Gain_LMMu_60_100kph_R BrkCalVariantCriterion
  /begin VAR_ADDRESS 0x800203BE 0x800237BE 0x80026BBE 0x80029FBE 0x8002D3BE 0x800307BE 0x80033BBE 0x80036FBE /end VAR_ADDRESS
 /end VAR_CHARACTERISTIC
 /begin VAR_CHARACTERISTIC TP_S16_Slip_Gain_LMMu_Ab_150kph_F BrkCalVariantCriterion
  /begin VAR_ADDRESS 0x800203A4 0x800237A4 0x80026BA4 0x80029FA4 0x8002D3A4 0x800307A4 0x80033BA4 0x80036FA4 /end VAR_ADDRESS
 /end VAR_CHARACTERISTIC
 /begin VAR_CHARACTERISTIC TP_S16_Slip_Gain_LMMu_Ab_150kph_R BrkCalVariantCriterion
  /begin VAR_ADDRESS 0x800203C0 0x800237C0 0x80026BC0 0x80029FC0 0x8002D3C0 0x800307C0 0x80033BC0 0x80036FC0 /end VAR_ADDRESS
 /end VAR_CHARACTERISTIC
 /begin VAR_CHARACTERISTIC TP_S16_Slip_Gain_LMMu_B_10kph_F BrkCalVariantCriterion
  /begin VAR_ADDRESS 0x800203A6 0x800237A6 0x80026BA6 0x80029FA6 0x8002D3A6 0x800307A6 0x80033BA6 0x80036FA6 /end VAR_ADDRESS
 /end VAR_CHARACTERISTIC
 /begin VAR_CHARACTERISTIC TP_S16_Slip_Gain_LMMu_B_10kph_R BrkCalVariantCriterion
  /begin VAR_ADDRESS 0x800203C2 0x800237C2 0x80026BC2 0x80029FC2 0x8002D3C2 0x800307C2 0x80033BC2 0x80036FC2 /end VAR_ADDRESS
 /end VAR_CHARACTERISTIC
 /begin VAR_CHARACTERISTIC TP_S16_Slip_Gain_LMu_100_150kph_F BrkCalVariantCriterion
  /begin VAR_ADDRESS 0x800203D2 0x800237D2 0x80026BD2 0x80029FD2 0x8002D3D2 0x800307D2 0x80033BD2 0x80036FD2 /end VAR_ADDRESS
 /end VAR_CHARACTERISTIC
 /begin VAR_CHARACTERISTIC TP_S16_Slip_Gain_LMu_100_150kph_R BrkCalVariantCriterion
  /begin VAR_ADDRESS 0x800203EE 0x800237EE 0x80026BEE 0x80029FEE 0x8002D3EE 0x800307EE 0x80033BEE 0x80036FEE /end VAR_ADDRESS
 /end VAR_CHARACTERISTIC
 /begin VAR_CHARACTERISTIC TP_S16_Slip_Gain_LMu_10_20kph_F BrkCalVariantCriterion
  /begin VAR_ADDRESS 0x800203D4 0x800237D4 0x80026BD4 0x80029FD4 0x8002D3D4 0x800307D4 0x80033BD4 0x80036FD4 /end VAR_ADDRESS
 /end VAR_CHARACTERISTIC
 /begin VAR_CHARACTERISTIC TP_S16_Slip_Gain_LMu_10_20kph_R BrkCalVariantCriterion
  /begin VAR_ADDRESS 0x800203F0 0x800237F0 0x80026BF0 0x80029FF0 0x8002D3F0 0x800307F0 0x80033BF0 0x80036FF0 /end VAR_ADDRESS
 /end VAR_CHARACTERISTIC
 /begin VAR_CHARACTERISTIC TP_S16_Slip_Gain_LMu_20_40kph_F BrkCalVariantCriterion
  /begin VAR_ADDRESS 0x800203D6 0x800237D6 0x80026BD6 0x80029FD6 0x8002D3D6 0x800307D6 0x80033BD6 0x80036FD6 /end VAR_ADDRESS
 /end VAR_CHARACTERISTIC
 /begin VAR_CHARACTERISTIC TP_S16_Slip_Gain_LMu_20_40kph_R BrkCalVariantCriterion
  /begin VAR_ADDRESS 0x800203F2 0x800237F2 0x80026BF2 0x80029FF2 0x8002D3F2 0x800307F2 0x80033BF2 0x80036FF2 /end VAR_ADDRESS
 /end VAR_CHARACTERISTIC
 /begin VAR_CHARACTERISTIC TP_S16_Slip_Gain_LMu_40_60kph_F BrkCalVariantCriterion
  /begin VAR_ADDRESS 0x800203D8 0x800237D8 0x80026BD8 0x80029FD8 0x8002D3D8 0x800307D8 0x80033BD8 0x80036FD8 /end VAR_ADDRESS
 /end VAR_CHARACTERISTIC
 /begin VAR_CHARACTERISTIC TP_S16_Slip_Gain_LMu_40_60kph_R BrkCalVariantCriterion
  /begin VAR_ADDRESS 0x800203F4 0x800237F4 0x80026BF4 0x80029FF4 0x8002D3F4 0x800307F4 0x80033BF4 0x80036FF4 /end VAR_ADDRESS
 /end VAR_CHARACTERISTIC
 /begin VAR_CHARACTERISTIC TP_S16_Slip_Gain_LMu_60_100kph_F BrkCalVariantCriterion
  /begin VAR_ADDRESS 0x800203DA 0x800237DA 0x80026BDA 0x80029FDA 0x8002D3DA 0x800307DA 0x80033BDA 0x80036FDA /end VAR_ADDRESS
 /end VAR_CHARACTERISTIC
 /begin VAR_CHARACTERISTIC TP_S16_Slip_Gain_LMu_60_100kph_R BrkCalVariantCriterion
  /begin VAR_ADDRESS 0x800203F6 0x800237F6 0x80026BF6 0x80029FF6 0x8002D3F6 0x800307F6 0x80033BF6 0x80036FF6 /end VAR_ADDRESS
 /end VAR_CHARACTERISTIC
 /begin VAR_CHARACTERISTIC TP_S16_Slip_Gain_LMu_Ab_150kph_F BrkCalVariantCriterion
  /begin VAR_ADDRESS 0x800203DC 0x800237DC 0x80026BDC 0x80029FDC 0x8002D3DC 0x800307DC 0x80033BDC 0x80036FDC /end VAR_ADDRESS
 /end VAR_CHARACTERISTIC
 /begin VAR_CHARACTERISTIC TP_S16_Slip_Gain_LMu_Ab_150kph_R BrkCalVariantCriterion
  /begin VAR_ADDRESS 0x800203F8 0x800237F8 0x80026BF8 0x80029FF8 0x8002D3F8 0x800307F8 0x80033BF8 0x80036FF8 /end VAR_ADDRESS
 /end VAR_CHARACTERISTIC
 /begin VAR_CHARACTERISTIC TP_S16_Slip_Gain_LMu_B_10kph_F BrkCalVariantCriterion
  /begin VAR_ADDRESS 0x800203DE 0x800237DE 0x80026BDE 0x80029FDE 0x8002D3DE 0x800307DE 0x80033BDE 0x80036FDE /end VAR_ADDRESS
 /end VAR_CHARACTERISTIC
 /begin VAR_CHARACTERISTIC TP_S16_Slip_Gain_LMu_B_10kph_R BrkCalVariantCriterion
  /begin VAR_ADDRESS 0x800203FA 0x800237FA 0x80026BFA 0x80029FFA 0x8002D3FA 0x800307FA 0x80033BFA 0x80036FFA /end VAR_ADDRESS
 /end VAR_CHARACTERISTIC
 /begin VAR_CHARACTERISTIC TP_S16_Slip_Gain_MMu_100_150kph_F BrkCalVariantCriterion
  /begin VAR_ADDRESS 0x80020362 0x80023762 0x80026B62 0x80029F62 0x8002D362 0x80030762 0x80033B62 0x80036F62 /end VAR_ADDRESS
 /end VAR_CHARACTERISTIC
 /begin VAR_CHARACTERISTIC TP_S16_Slip_Gain_MMu_100_150kph_R BrkCalVariantCriterion
  /begin VAR_ADDRESS 0x8002037E 0x8002377E 0x80026B7E 0x80029F7E 0x8002D37E 0x8003077E 0x80033B7E 0x80036F7E /end VAR_ADDRESS
 /end VAR_CHARACTERISTIC
 /begin VAR_CHARACTERISTIC TP_S16_Slip_Gain_MMu_10_20kph_F BrkCalVariantCriterion
  /begin VAR_ADDRESS 0x80020364 0x80023764 0x80026B64 0x80029F64 0x8002D364 0x80030764 0x80033B64 0x80036F64 /end VAR_ADDRESS
 /end VAR_CHARACTERISTIC
 /begin VAR_CHARACTERISTIC TP_S16_Slip_Gain_MMu_10_20kph_R BrkCalVariantCriterion
  /begin VAR_ADDRESS 0x80020380 0x80023780 0x80026B80 0x80029F80 0x8002D380 0x80030780 0x80033B80 0x80036F80 /end VAR_ADDRESS
 /end VAR_CHARACTERISTIC
 /begin VAR_CHARACTERISTIC TP_S16_Slip_Gain_MMu_20_40kph_F BrkCalVariantCriterion
  /begin VAR_ADDRESS 0x80020366 0x80023766 0x80026B66 0x80029F66 0x8002D366 0x80030766 0x80033B66 0x80036F66 /end VAR_ADDRESS
 /end VAR_CHARACTERISTIC
 /begin VAR_CHARACTERISTIC TP_S16_Slip_Gain_MMu_20_40kph_R BrkCalVariantCriterion
  /begin VAR_ADDRESS 0x80020382 0x80023782 0x80026B82 0x80029F82 0x8002D382 0x80030782 0x80033B82 0x80036F82 /end VAR_ADDRESS
 /end VAR_CHARACTERISTIC
 /begin VAR_CHARACTERISTIC TP_S16_Slip_Gain_MMu_40_60kph_F BrkCalVariantCriterion
  /begin VAR_ADDRESS 0x80020368 0x80023768 0x80026B68 0x80029F68 0x8002D368 0x80030768 0x80033B68 0x80036F68 /end VAR_ADDRESS
 /end VAR_CHARACTERISTIC
 /begin VAR_CHARACTERISTIC TP_S16_Slip_Gain_MMu_40_60kph_R BrkCalVariantCriterion
  /begin VAR_ADDRESS 0x80020384 0x80023784 0x80026B84 0x80029F84 0x8002D384 0x80030784 0x80033B84 0x80036F84 /end VAR_ADDRESS
 /end VAR_CHARACTERISTIC
 /begin VAR_CHARACTERISTIC TP_S16_Slip_Gain_MMu_60_100kph_F BrkCalVariantCriterion
  /begin VAR_ADDRESS 0x8002036A 0x8002376A 0x80026B6A 0x80029F6A 0x8002D36A 0x8003076A 0x80033B6A 0x80036F6A /end VAR_ADDRESS
 /end VAR_CHARACTERISTIC
 /begin VAR_CHARACTERISTIC TP_S16_Slip_Gain_MMu_60_100kph_R BrkCalVariantCriterion
  /begin VAR_ADDRESS 0x80020386 0x80023786 0x80026B86 0x80029F86 0x8002D386 0x80030786 0x80033B86 0x80036F86 /end VAR_ADDRESS
 /end VAR_CHARACTERISTIC
 /begin VAR_CHARACTERISTIC TP_S16_Slip_Gain_MMu_Ab_150kph_F BrkCalVariantCriterion
  /begin VAR_ADDRESS 0x8002036C 0x8002376C 0x80026B6C 0x80029F6C 0x8002D36C 0x8003076C 0x80033B6C 0x80036F6C /end VAR_ADDRESS
 /end VAR_CHARACTERISTIC
 /begin VAR_CHARACTERISTIC TP_S16_Slip_Gain_MMu_Ab_150kph_R BrkCalVariantCriterion
  /begin VAR_ADDRESS 0x80020388 0x80023788 0x80026B88 0x80029F88 0x8002D388 0x80030788 0x80033B88 0x80036F88 /end VAR_ADDRESS
 /end VAR_CHARACTERISTIC
 /begin VAR_CHARACTERISTIC TP_S16_Slip_Gain_MMu_B_10kph_F BrkCalVariantCriterion
  /begin VAR_ADDRESS 0x8002036E 0x8002376E 0x80026B6E 0x80029F6E 0x8002D36E 0x8003076E 0x80033B6E 0x80036F6E /end VAR_ADDRESS
 /end VAR_CHARACTERISTIC
 /begin VAR_CHARACTERISTIC TP_S16_Slip_Gain_MMu_B_10kph_R BrkCalVariantCriterion
  /begin VAR_ADDRESS 0x8002038A 0x8002378A 0x80026B8A 0x80029F8A 0x8002D38A 0x8003078A 0x80033B8A 0x80036F8A /end VAR_ADDRESS
 /end VAR_CHARACTERISTIC
 /begin VAR_CHARACTERISTIC TP_S16_Slip_Gain_SpHMu_100_150_F BrkCalVariantCriterion
  /begin VAR_ADDRESS 0x8002040A 0x8002380A 0x80026C0A 0x8002A00A 0x8002D40A 0x8003080A 0x80033C0A 0x8003700A /end VAR_ADDRESS
 /end VAR_CHARACTERISTIC
 /begin VAR_CHARACTERISTIC TP_S16_Slip_Gain_SpHMu_10_20kph_F BrkCalVariantCriterion
  /begin VAR_ADDRESS 0x8002040C 0x8002380C 0x80026C0C 0x8002A00C 0x8002D40C 0x8003080C 0x80033C0C 0x8003700C /end VAR_ADDRESS
 /end VAR_CHARACTERISTIC
 /begin VAR_CHARACTERISTIC TP_S16_Slip_Gain_SpHMu_20_40kph_F BrkCalVariantCriterion
  /begin VAR_ADDRESS 0x8002040E 0x8002380E 0x80026C0E 0x8002A00E 0x8002D40E 0x8003080E 0x80033C0E 0x8003700E /end VAR_ADDRESS
 /end VAR_CHARACTERISTIC
 /begin VAR_CHARACTERISTIC TP_S16_Slip_Gain_SpHMu_40_60kph_F BrkCalVariantCriterion
  /begin VAR_ADDRESS 0x80020410 0x80023810 0x80026C10 0x8002A010 0x8002D410 0x80030810 0x80033C10 0x80037010 /end VAR_ADDRESS
 /end VAR_CHARACTERISTIC
 /begin VAR_CHARACTERISTIC TP_S16_Slip_Gain_SpHMu_60_100kph_F BrkCalVariantCriterion
  /begin VAR_ADDRESS 0x80020412 0x80023812 0x80026C12 0x8002A012 0x8002D412 0x80030812 0x80033C12 0x80037012 /end VAR_ADDRESS
 /end VAR_CHARACTERISTIC
 /begin VAR_CHARACTERISTIC TP_S16_Slip_Gain_SpHMu_Ab_150kph_F BrkCalVariantCriterion
  /begin VAR_ADDRESS 0x80020414 0x80023814 0x80026C14 0x8002A014 0x8002D414 0x80030814 0x80033C14 0x80037014 /end VAR_ADDRESS
 /end VAR_CHARACTERISTIC
 /begin VAR_CHARACTERISTIC TP_S16_Slip_Gain_SpHMu_B_10kph_F BrkCalVariantCriterion
  /begin VAR_ADDRESS 0x80020416 0x80023816 0x80026C16 0x8002A016 0x8002D416 0x80030816 0x80033C16 0x80037016 /end VAR_ADDRESS
 /end VAR_CHARACTERISTIC
 /begin VAR_CHARACTERISTIC TP_S16_TIRE_DIAMETER EngCalVariantCriterion
  /begin VAR_ADDRESS 0x8003A064 0x8003AE64 0x8003BC64 0x8003CA64 0x8003D864 0x8003E664 0x8003F464 0x80040264 0x80041064 0x80041E64 0x80042C64 0x80043A64 0x80044864 0x80045664 0x80046464 0x80047264 0x80048064 0x80048E64 0x80049C64 0x8004AA64 0x8004B864 0x8004C664 0x8004D464 0x8004E264 /end VAR_ADDRESS
 /end VAR_CHARACTERISTIC
 /begin VAR_CHARACTERISTIC TP_S16_TOD_MAX_TORQ EngCalVariantCriterion
  /begin VAR_ADDRESS 0x8003A6A8 0x8003B4A8 0x8003C2A8 0x8003D0A8 0x8003DEA8 0x8003ECA8 0x8003FAA8 0x800408A8 0x800416A8 0x800424A8 0x800432A8 0x800440A8 0x80044EA8 0x80045CA8 0x80046AA8 0x800478A8 0x800486A8 0x800494A8 0x8004A2A8 0x8004B0A8 0x8004BEA8 0x8004CCA8 0x8004DAA8 0x8004E8A8 /end VAR_ADDRESS
 /end VAR_CHARACTERISTIC
 /begin VAR_CHARACTERISTIC TP_S16_TOD_MIN_TORQ EngCalVariantCriterion
  /begin VAR_ADDRESS 0x8003A6AA 0x8003B4AA 0x8003C2AA 0x8003D0AA 0x8003DEAA 0x8003ECAA 0x8003FAAA 0x800408AA 0x800416AA 0x800424AA 0x800432AA 0x800440AA 0x80044EAA 0x80045CAA 0x80046AAA 0x800478AA 0x800486AA 0x800494AA 0x8004A2AA 0x8004B0AA 0x8004BEAA 0x8004CCAA 0x8004DAAA 0x8004E8AA /end VAR_ADDRESS
 /end VAR_CHARACTERISTIC
 /begin VAR_CHARACTERISTIC TP_S16_TOD_TORQ_CST_OVER1 EngCalVariantCriterion
  /begin VAR_ADDRESS 0x8003A6AC 0x8003B4AC 0x8003C2AC 0x8003D0AC 0x8003DEAC 0x8003ECAC 0x8003FAAC 0x800408AC 0x800416AC 0x800424AC 0x800432AC 0x800440AC 0x80044EAC 0x80045CAC 0x80046AAC 0x800478AC 0x800486AC 0x800494AC 0x8004A2AC 0x8004B0AC 0x8004BEAC 0x8004CCAC 0x8004DAAC 0x8004E8AC /end VAR_ADDRESS
 /end VAR_CHARACTERISTIC
 /begin VAR_CHARACTERISTIC TP_S16_TOD_TORQ_CST_OVER2 EngCalVariantCriterion
  /begin VAR_ADDRESS 0x8003A6AE 0x8003B4AE 0x8003C2AE 0x8003D0AE 0x8003DEAE 0x8003ECAE 0x8003FAAE 0x800408AE 0x800416AE 0x800424AE 0x800432AE 0x800440AE 0x80044EAE 0x80045CAE 0x80046AAE 0x800478AE 0x800486AE 0x800494AE 0x8004A2AE 0x8004B0AE 0x8004BEAE 0x8004CCAE 0x8004DAAE 0x8004E8AE /end VAR_ADDRESS
 /end VAR_CHARACTERISTIC
 /begin VAR_CHARACTERISTIC TP_S16_TOD_TORQ_CST_STABL EngCalVariantCriterion
  /begin VAR_ADDRESS 0x8003A6B0 0x8003B4B0 0x8003C2B0 0x8003D0B0 0x8003DEB0 0x8003ECB0 0x8003FAB0 0x800408B0 0x800416B0 0x800424B0 0x800432B0 0x800440B0 0x80044EB0 0x80045CB0 0x80046AB0 0x800478B0 0x800486B0 0x800494B0 0x8004A2B0 0x8004B0B0 0x8004BEB0 0x8004CCB0 0x8004DAB0 0x8004E8B0 /end VAR_ADDRESS
 /end VAR_CHARACTERISTIC
 /begin VAR_CHARACTERISTIC TP_S16_TOD_TORQ_CST_UNDER1 EngCalVariantCriterion
  /begin VAR_ADDRESS 0x8003A6B2 0x8003B4B2 0x8003C2B2 0x8003D0B2 0x8003DEB2 0x8003ECB2 0x8003FAB2 0x800408B2 0x800416B2 0x800424B2 0x800432B2 0x800440B2 0x80044EB2 0x80045CB2 0x80046AB2 0x800478B2 0x800486B2 0x800494B2 0x8004A2B2 0x8004B0B2 0x8004BEB2 0x8004CCB2 0x8004DAB2 0x8004E8B2 /end VAR_ADDRESS
 /end VAR_CHARACTERISTIC
 /begin VAR_CHARACTERISTIC TP_S16_TOD_TORQ_CST_UNDER2 EngCalVariantCriterion
  /begin VAR_ADDRESS 0x8003A6B4 0x8003B4B4 0x8003C2B4 0x8003D0B4 0x8003DEB4 0x8003ECB4 0x8003FAB4 0x800408B4 0x800416B4 0x800424B4 0x800432B4 0x800440B4 0x80044EB4 0x80045CB4 0x80046AB4 0x800478B4 0x800486B4 0x800494B4 0x8004A2B4 0x8004B0B4 0x8004BEB4 0x8004CCB4 0x8004DAB4 0x8004E8B4 /end VAR_ADDRESS
 /end VAR_CHARACTERISTIC
 /begin VAR_CHARACTERISTIC TP_S16_TOD_TORQ_HOT_OVER1 EngCalVariantCriterion
  /begin VAR_ADDRESS 0x8003A6B6 0x8003B4B6 0x8003C2B6 0x8003D0B6 0x8003DEB6 0x8003ECB6 0x8003FAB6 0x800408B6 0x800416B6 0x800424B6 0x800432B6 0x800440B6 0x80044EB6 0x80045CB6 0x80046AB6 0x800478B6 0x800486B6 0x800494B6 0x8004A2B6 0x8004B0B6 0x8004BEB6 0x8004CCB6 0x8004DAB6 0x8004E8B6 /end VAR_ADDRESS
 /end VAR_CHARACTERISTIC
 /begin VAR_CHARACTERISTIC TP_S16_TOD_TORQ_HOT_OVER2 EngCalVariantCriterion
  /begin VAR_ADDRESS 0x8003A6B8 0x8003B4B8 0x8003C2B8 0x8003D0B8 0x8003DEB8 0x8003ECB8 0x8003FAB8 0x800408B8 0x800416B8 0x800424B8 0x800432B8 0x800440B8 0x80044EB8 0x80045CB8 0x80046AB8 0x800478B8 0x800486B8 0x800494B8 0x8004A2B8 0x8004B0B8 0x8004BEB8 0x8004CCB8 0x8004DAB8 0x8004E8B8 /end VAR_ADDRESS
 /end VAR_CHARACTERISTIC
 /begin VAR_CHARACTERISTIC TP_S16_TOD_TORQ_HOT_STABL EngCalVariantCriterion
  /begin VAR_ADDRESS 0x8003A6BA 0x8003B4BA 0x8003C2BA 0x8003D0BA 0x8003DEBA 0x8003ECBA 0x8003FABA 0x800408BA 0x800416BA 0x800424BA 0x800432BA 0x800440BA 0x80044EBA 0x80045CBA 0x80046ABA 0x800478BA 0x800486BA 0x800494BA 0x8004A2BA 0x8004B0BA 0x8004BEBA 0x8004CCBA 0x8004DABA 0x8004E8BA /end VAR_ADDRESS
 /end VAR_CHARACTERISTIC
 /begin VAR_CHARACTERISTIC TP_S16_TOD_TORQ_HOT_UNDER1 EngCalVariantCriterion
  /begin VAR_ADDRESS 0x8003A6BC 0x8003B4BC 0x8003C2BC 0x8003D0BC 0x8003DEBC 0x8003ECBC 0x8003FABC 0x800408BC 0x800416BC 0x800424BC 0x800432BC 0x800440BC 0x80044EBC 0x80045CBC 0x80046ABC 0x800478BC 0x800486BC 0x800494BC 0x8004A2BC 0x8004B0BC 0x8004BEBC 0x8004CCBC 0x8004DABC 0x8004E8BC /end VAR_ADDRESS
 /end VAR_CHARACTERISTIC
 /begin VAR_CHARACTERISTIC TP_S16_TOD_TORQ_HOT_UNDER2 EngCalVariantCriterion
  /begin VAR_ADDRESS 0x8003A6BE 0x8003B4BE 0x8003C2BE 0x8003D0BE 0x8003DEBE 0x8003ECBE 0x8003FABE 0x800408BE 0x800416BE 0x800424BE 0x800432BE 0x800440BE 0x80044EBE 0x80045CBE 0x80046ABE 0x800478BE 0x800486BE 0x800494BE 0x8004A2BE 0x8004B0BE 0x8004BEBE 0x8004CCBE 0x8004DABE 0x8004E8BE /end VAR_ADDRESS
 /end VAR_CHARACTERISTIC
 /begin VAR_CHARACTERISTIC TP_S16_TOD_TORQ_WOT_OVER1 EngCalVariantCriterion
  /begin VAR_ADDRESS 0x8003A6C0 0x8003B4C0 0x8003C2C0 0x8003D0C0 0x8003DEC0 0x8003ECC0 0x8003FAC0 0x800408C0 0x800416C0 0x800424C0 0x800432C0 0x800440C0 0x80044EC0 0x80045CC0 0x80046AC0 0x800478C0 0x800486C0 0x800494C0 0x8004A2C0 0x8004B0C0 0x8004BEC0 0x8004CCC0 0x8004DAC0 0x8004E8C0 /end VAR_ADDRESS
 /end VAR_CHARACTERISTIC
 /begin VAR_CHARACTERISTIC TP_S16_TOD_TORQ_WOT_OVER2 EngCalVariantCriterion
  /begin VAR_ADDRESS 0x8003A6C2 0x8003B4C2 0x8003C2C2 0x8003D0C2 0x8003DEC2 0x8003ECC2 0x8003FAC2 0x800408C2 0x800416C2 0x800424C2 0x800432C2 0x800440C2 0x80044EC2 0x80045CC2 0x80046AC2 0x800478C2 0x800486C2 0x800494C2 0x8004A2C2 0x8004B0C2 0x8004BEC2 0x8004CCC2 0x8004DAC2 0x8004E8C2 /end VAR_ADDRESS
 /end VAR_CHARACTERISTIC
 /begin VAR_CHARACTERISTIC TP_S16_TOD_TORQ_WOT_STABL EngCalVariantCriterion
  /begin VAR_ADDRESS 0x8003A6C4 0x8003B4C4 0x8003C2C4 0x8003D0C4 0x8003DEC4 0x8003ECC4 0x8003FAC4 0x800408C4 0x800416C4 0x800424C4 0x800432C4 0x800440C4 0x80044EC4 0x80045CC4 0x80046AC4 0x800478C4 0x800486C4 0x800494C4 0x8004A2C4 0x8004B0C4 0x8004BEC4 0x8004CCC4 0x8004DAC4 0x8004E8C4 /end VAR_ADDRESS
 /end VAR_CHARACTERISTIC
 /begin VAR_CHARACTERISTIC TP_S16_TOD_TORQ_WOT_UNDER1 EngCalVariantCriterion
  /begin VAR_ADDRESS 0x8003A6C6 0x8003B4C6 0x8003C2C6 0x8003D0C6 0x8003DEC6 0x8003ECC6 0x8003FAC6 0x800408C6 0x800416C6 0x800424C6 0x800432C6 0x800440C6 0x80044EC6 0x80045CC6 0x80046AC6 0x800478C6 0x800486C6 0x800494C6 0x8004A2C6 0x8004B0C6 0x8004BEC6 0x8004CCC6 0x8004DAC6 0x8004E8C6 /end VAR_ADDRESS
 /end VAR_CHARACTERISTIC
 /begin VAR_CHARACTERISTIC TP_S16_TOD_TORQ_WOT_UNDER2 EngCalVariantCriterion
  /begin VAR_ADDRESS 0x8003A6C8 0x8003B4C8 0x8003C2C8 0x8003D0C8 0x8003DEC8 0x8003ECC8 0x8003FAC8 0x800408C8 0x800416C8 0x800424C8 0x800432C8 0x800440C8 0x80044EC8 0x80045CC8 0x80046AC8 0x800478C8 0x800486C8 0x800494C8 0x8004A2C8 0x8004B0C8 0x8004BEC8 0x8004CCC8 0x8004DAC8 0x8004E8C8 /end VAR_ADDRESS
 /end VAR_CHARACTERISTIC
 /begin VAR_CHARACTERISTIC TP_S16_VERY_SLIGHT_BRAKING_PRESS BrkCalVariantCriterion
  /begin VAR_ADDRESS 0x80020212 0x80023612 0x80026A12 0x80029E12 0x8002D212 0x80030612 0x80033A12 0x80036E12 /end VAR_ADDRESS
 /end VAR_CHARACTERISTIC
 /begin VAR_CHARACTERISTIC TP_S16_WHEEL_RADIUS EngCalVariantCriterion
  /begin VAR_ADDRESS 0x8003A066 0x8003AE66 0x8003BC66 0x8003CA66 0x8003D866 0x8003E666 0x8003F466 0x80040266 0x80041066 0x80041E66 0x80042C66 0x80043A66 0x80044866 0x80045666 0x80046466 0x80047266 0x80048066 0x80048E66 0x80049C66 0x8004AA66 0x8004B866 0x8004C666 0x8004D466 0x8004E266 /end VAR_ADDRESS
 /end VAR_CHARACTERISTIC
 /begin VAR_CHARACTERISTIC TP_S16_WPThres_for_IncDumptim_1st BrkCalVariantCriterion
  /begin VAR_ADDRESS 0x800204BE 0x800238BE 0x80026CBE 0x8002A0BE 0x8002D4BE 0x800308BE 0x80033CBE 0x800370BE /end VAR_ADDRESS
 /end VAR_CHARACTERISTIC
 /begin VAR_CHARACTERISTIC TP_S16_YDF_RISEHOLD_T_MAX_YDF BrkCalVariantCriterion
  /begin VAR_ADDRESS 0x80020514 0x80023914 0x80026D14 0x8002A114 0x8002D514 0x80030914 0x80033D14 0x80037114 /end VAR_ADDRESS
 /end VAR_CHARACTERISTIC
 /begin VAR_CHARACTERISTIC TP_S16_YDF_STB_HLD_TIME_MAX BrkCalVariantCriterion
  /begin VAR_ADDRESS 0x8002051A 0x8002391A 0x80026D1A 0x8002A11A 0x8002D51A 0x8003091A 0x80033D1A 0x8003711A /end VAR_ADDRESS
 /end VAR_CHARACTERISTIC
 /begin VAR_CHARACTERISTIC TP_S16_YDF_STB_HLD_TIME_MAX_F_OINR BrkCalVariantCriterion
  /begin VAR_ADDRESS 0x8002051C 0x8002391C 0x80026D1C 0x8002A11C 0x8002D51C 0x8003091C 0x80033D1C 0x8003711C /end VAR_ADDRESS
 /end VAR_CHARACTERISTIC
 /begin VAR_CHARACTERISTIC TP_S8ETCSCpCtlExitCntDnTh EngCalVariantCriterion
  /begin VAR_ADDRESS 0x8003A46E 0x8003B26E 0x8003C06E 0x8003CE6E 0x8003DC6E 0x8003EA6E 0x8003F86E 0x8004066E 0x8004146E 0x8004226E 0x8004306E 0x80043E6E 0x80044C6E 0x80045A6E 0x8004686E 0x8004766E 0x8004846E 0x8004926E 0x8004A06E 0x8004AE6E 0x8004BC6E 0x8004CA6E 0x8004D86E 0x8004E66E /end VAR_ADDRESS
 /end VAR_CHARACTERISTIC
 /begin VAR_CHARACTERISTIC TP_S8ETCSCpCtlExitCntTh EngCalVariantCriterion
  /begin VAR_ADDRESS 0x8003A46F 0x8003B26F 0x8003C06F 0x8003CE6F 0x8003DC6F 0x8003EA6F 0x8003F86F 0x8004066F 0x8004146F 0x8004226F 0x8004306F 0x80043E6F 0x80044C6F 0x80045A6F 0x8004686F 0x8004766F 0x8004846F 0x8004926F 0x8004A06F 0x8004AE6F 0x8004BC6F 0x8004CA6F 0x8004D86F 0x8004E66F /end VAR_ADDRESS
 /end VAR_CHARACTERISTIC
 /begin VAR_CHARACTERISTIC TP_S8ETCSCpCtlExitCntUpTh EngCalVariantCriterion
  /begin VAR_ADDRESS 0x8003A470 0x8003B270 0x8003C070 0x8003CE70 0x8003DC70 0x8003EA70 0x8003F870 0x80040670 0x80041470 0x80042270 0x80043070 0x80043E70 0x80044C70 0x80045A70 0x80046870 0x80047670 0x80048470 0x80049270 0x8004A070 0x8004AE70 0x8004BC70 0x8004CA70 0x8004D870 0x8004E670 /end VAR_ADDRESS
 /end VAR_CHARACTERISTIC
 /begin VAR_CHARACTERISTIC TP_S8ETCSCpH2LDctHiMuTh EngCalVariantCriterion
  /begin VAR_ADDRESS 0x8003A471 0x8003B271 0x8003C071 0x8003CE71 0x8003DC71 0x8003EA71 0x8003F871 0x80040671 0x80041471 0x80042271 0x80043071 0x80043E71 0x80044C71 0x80045A71 0x80046871 0x80047671 0x80048471 0x80049271 0x8004A071 0x8004AE71 0x8004BC71 0x8004CA71 0x8004D871 0x8004E671 /end VAR_ADDRESS
 /end VAR_CHARACTERISTIC
 /begin VAR_CHARACTERISTIC TP_S8ETCSCpH2LDctLwMuTh EngCalVariantCriterion
  /begin VAR_ADDRESS 0x8003A472 0x8003B272 0x8003C072 0x8003CE72 0x8003DC72 0x8003EA72 0x8003F872 0x80040672 0x80041472 0x80042272 0x80043072 0x80043E72 0x80044C72 0x80045A72 0x80046872 0x80047672 0x80048472 0x80049272 0x8004A072 0x8004AE72 0x8004BC72 0x8004CA72 0x8004D872 0x8004E672 /end VAR_ADDRESS
 /end VAR_CHARACTERISTIC
 /begin VAR_CHARACTERISTIC TP_S8ETCSCpHiSusResetTime EngCalVariantCriterion
  /begin VAR_ADDRESS 0x8003A473 0x8003B273 0x8003C073 0x8003CE73 0x8003DC73 0x8003EA73 0x8003F873 0x80040673 0x80041473 0x80042273 0x80043073 0x80043E73 0x80044C73 0x80045A73 0x80046873 0x80047673 0x80048473 0x80049273 0x8004A073 0x8004AE73 0x8004BC73 0x8004CA73 0x8004D873 0x8004E673 /end VAR_ADDRESS
 /end VAR_CHARACTERISTIC
 /begin VAR_CHARACTERISTIC TP_S8ETCSCpLmtCrngTarSpn[0][0] EngCalVariantCriterion
  /begin VAR_ADDRESS 0x8003A474 0x8003B274 0x8003C074 0x8003CE74 0x8003DC74 0x8003EA74 0x8003F874 0x80040674 0x80041474 0x80042274 0x80043074 0x80043E74 0x80044C74 0x80045A74 0x80046874 0x80047674 0x80048474 0x80049274 0x8004A074 0x8004AE74 0x8004BC74 0x8004CA74 0x8004D874 0x8004E674 /end VAR_ADDRESS
 /end VAR_CHARACTERISTIC
 /begin VAR_CHARACTERISTIC TP_S8ETCSCpLmtCrngTarSpn[0][1] EngCalVariantCriterion
  /begin VAR_ADDRESS 0x8003A475 0x8003B275 0x8003C075 0x8003CE75 0x8003DC75 0x8003EA75 0x8003F875 0x80040675 0x80041475 0x80042275 0x80043075 0x80043E75 0x80044C75 0x80045A75 0x80046875 0x80047675 0x80048475 0x80049275 0x8004A075 0x8004AE75 0x8004BC75 0x8004CA75 0x8004D875 0x8004E675 /end VAR_ADDRESS
 /end VAR_CHARACTERISTIC
 /begin VAR_CHARACTERISTIC TP_S8ETCSCpLmtCrngTarSpn[0][2] EngCalVariantCriterion
  /begin VAR_ADDRESS 0x8003A476 0x8003B276 0x8003C076 0x8003CE76 0x8003DC76 0x8003EA76 0x8003F876 0x80040676 0x80041476 0x80042276 0x80043076 0x80043E76 0x80044C76 0x80045A76 0x80046876 0x80047676 0x80048476 0x80049276 0x8004A076 0x8004AE76 0x8004BC76 0x8004CA76 0x8004D876 0x8004E676 /end VAR_ADDRESS
 /end VAR_CHARACTERISTIC
 /begin VAR_CHARACTERISTIC TP_S8ETCSCpLmtCrngTarSpn[0][3] EngCalVariantCriterion
  /begin VAR_ADDRESS 0x8003A477 0x8003B277 0x8003C077 0x8003CE77 0x8003DC77 0x8003EA77 0x8003F877 0x80040677 0x80041477 0x80042277 0x80043077 0x80043E77 0x80044C77 0x80045A77 0x80046877 0x80047677 0x80048477 0x80049277 0x8004A077 0x8004AE77 0x8004BC77 0x8004CA77 0x8004D877 0x8004E677 /end VAR_ADDRESS
 /end VAR_CHARACTERISTIC
 /begin VAR_CHARACTERISTIC TP_S8ETCSCpLmtCrngTarSpn[0][4] EngCalVariantCriterion
  /begin VAR_ADDRESS 0x8003A478 0x8003B278 0x8003C078 0x8003CE78 0x8003DC78 0x8003EA78 0x8003F878 0x80040678 0x80041478 0x80042278 0x80043078 0x80043E78 0x80044C78 0x80045A78 0x80046878 0x80047678 0x80048478 0x80049278 0x8004A078 0x8004AE78 0x8004BC78 0x8004CA78 0x8004D878 0x8004E678 /end VAR_ADDRESS
 /end VAR_CHARACTERISTIC
 /begin VAR_CHARACTERISTIC TP_S8ETCSCpLmtCrngTarSpn[1][0] EngCalVariantCriterion
  /begin VAR_ADDRESS 0x8003A479 0x8003B279 0x8003C079 0x8003CE79 0x8003DC79 0x8003EA79 0x8003F879 0x80040679 0x80041479 0x80042279 0x80043079 0x80043E79 0x80044C79 0x80045A79 0x80046879 0x80047679 0x80048479 0x80049279 0x8004A079 0x8004AE79 0x8004BC79 0x8004CA79 0x8004D879 0x8004E679 /end VAR_ADDRESS
 /end VAR_CHARACTERISTIC
 /begin VAR_CHARACTERISTIC TP_S8ETCSCpLmtCrngTarSpn[1][1] EngCalVariantCriterion
  /begin VAR_ADDRESS 0x8003A47A 0x8003B27A 0x8003C07A 0x8003CE7A 0x8003DC7A 0x8003EA7A 0x8003F87A 0x8004067A 0x8004147A 0x8004227A 0x8004307A 0x80043E7A 0x80044C7A 0x80045A7A 0x8004687A 0x8004767A 0x8004847A 0x8004927A 0x8004A07A 0x8004AE7A 0x8004BC7A 0x8004CA7A 0x8004D87A 0x8004E67A /end VAR_ADDRESS
 /end VAR_CHARACTERISTIC
 /begin VAR_CHARACTERISTIC TP_S8ETCSCpLmtCrngTarSpn[1][2] EngCalVariantCriterion
  /begin VAR_ADDRESS 0x8003A47B 0x8003B27B 0x8003C07B 0x8003CE7B 0x8003DC7B 0x8003EA7B 0x8003F87B 0x8004067B 0x8004147B 0x8004227B 0x8004307B 0x80043E7B 0x80044C7B 0x80045A7B 0x8004687B 0x8004767B 0x8004847B 0x8004927B 0x8004A07B 0x8004AE7B 0x8004BC7B 0x8004CA7B 0x8004D87B 0x8004E67B /end VAR_ADDRESS
 /end VAR_CHARACTERISTIC
 /begin VAR_CHARACTERISTIC TP_S8ETCSCpLmtCrngTarSpn[1][3] EngCalVariantCriterion
  /begin VAR_ADDRESS 0x8003A47C 0x8003B27C 0x8003C07C 0x8003CE7C 0x8003DC7C 0x8003EA7C 0x8003F87C 0x8004067C 0x8004147C 0x8004227C 0x8004307C 0x80043E7C 0x80044C7C 0x80045A7C 0x8004687C 0x8004767C 0x8004847C 0x8004927C 0x8004A07C 0x8004AE7C 0x8004BC7C 0x8004CA7C 0x8004D87C 0x8004E67C /end VAR_ADDRESS
 /end VAR_CHARACTERISTIC
 /begin VAR_CHARACTERISTIC TP_S8ETCSCpLmtCrngTarSpn[1][4] EngCalVariantCriterion
  /begin VAR_ADDRESS 0x8003A47D 0x8003B27D 0x8003C07D 0x8003CE7D 0x8003DC7D 0x8003EA7D 0x8003F87D 0x8004067D 0x8004147D 0x8004227D 0x8004307D 0x80043E7D 0x80044C7D 0x80045A7D 0x8004687D 0x8004767D 0x8004847D 0x8004927D 0x8004A07D 0x8004AE7D 0x8004BC7D 0x8004CA7D 0x8004D87D 0x8004E67D /end VAR_ADDRESS
 /end VAR_CHARACTERISTIC
 /begin VAR_CHARACTERISTIC TP_S8ETCSCpLmtCrngTarSpn[2][0] EngCalVariantCriterion
  /begin VAR_ADDRESS 0x8003A47E 0x8003B27E 0x8003C07E 0x8003CE7E 0x8003DC7E 0x8003EA7E 0x8003F87E 0x8004067E 0x8004147E 0x8004227E 0x8004307E 0x80043E7E 0x80044C7E 0x80045A7E 0x8004687E 0x8004767E 0x8004847E 0x8004927E 0x8004A07E 0x8004AE7E 0x8004BC7E 0x8004CA7E 0x8004D87E 0x8004E67E /end VAR_ADDRESS
 /end VAR_CHARACTERISTIC
 /begin VAR_CHARACTERISTIC TP_S8ETCSCpLmtCrngTarSpn[2][1] EngCalVariantCriterion
  /begin VAR_ADDRESS 0x8003A47F 0x8003B27F 0x8003C07F 0x8003CE7F 0x8003DC7F 0x8003EA7F 0x8003F87F 0x8004067F 0x8004147F 0x8004227F 0x8004307F 0x80043E7F 0x80044C7F 0x80045A7F 0x8004687F 0x8004767F 0x8004847F 0x8004927F 0x8004A07F 0x8004AE7F 0x8004BC7F 0x8004CA7F 0x8004D87F 0x8004E67F /end VAR_ADDRESS
 /end VAR_CHARACTERISTIC
 /begin VAR_CHARACTERISTIC TP_S8ETCSCpLmtCrngTarSpn[2][2] EngCalVariantCriterion
  /begin VAR_ADDRESS 0x8003A480 0x8003B280 0x8003C080 0x8003CE80 0x8003DC80 0x8003EA80 0x8003F880 0x80040680 0x80041480 0x80042280 0x80043080 0x80043E80 0x80044C80 0x80045A80 0x80046880 0x80047680 0x80048480 0x80049280 0x8004A080 0x8004AE80 0x8004BC80 0x8004CA80 0x8004D880 0x8004E680 /end VAR_ADDRESS
 /end VAR_CHARACTERISTIC
 /begin VAR_CHARACTERISTIC TP_S8ETCSCpLmtCrngTarSpn[2][3] EngCalVariantCriterion
  /begin VAR_ADDRESS 0x8003A481 0x8003B281 0x8003C081 0x8003CE81 0x8003DC81 0x8003EA81 0x8003F881 0x80040681 0x80041481 0x80042281 0x80043081 0x80043E81 0x80044C81 0x80045A81 0x80046881 0x80047681 0x80048481 0x80049281 0x8004A081 0x8004AE81 0x8004BC81 0x8004CA81 0x8004D881 0x8004E681 /end VAR_ADDRESS
 /end VAR_CHARACTERISTIC
 /begin VAR_CHARACTERISTIC TP_S8ETCSCpLmtCrngTarSpn[2][4] EngCalVariantCriterion
  /begin VAR_ADDRESS 0x8003A482 0x8003B282 0x8003C082 0x8003CE82 0x8003DC82 0x8003EA82 0x8003F882 0x80040682 0x80041482 0x80042282 0x80043082 0x80043E82 0x80044C82 0x80045A82 0x80046882 0x80047682 0x80048482 0x80049282 0x8004A082 0x8004AE82 0x8004BC82 0x8004CA82 0x8004D882 0x8004E682 /end VAR_ADDRESS
 /end VAR_CHARACTERISTIC
 /begin VAR_CHARACTERISTIC TP_S8ETCSCpPgTransTmDrvVib EngCalVariantCriterion
  /begin VAR_ADDRESS 0x8003A483 0x8003B283 0x8003C083 0x8003CE83 0x8003DC83 0x8003EA83 0x8003F883 0x80040683 0x80041483 0x80042283 0x80043083 0x80043E83 0x80044C83 0x80045A83 0x80046883 0x80047683 0x80048483 0x80049283 0x8004A083 0x8004AE83 0x8004BC83 0x8004CA83 0x8004D883 0x8004E683 /end VAR_ADDRESS
 /end VAR_CHARACTERISTIC
 /begin VAR_CHARACTERISTIC TP_S8ETCSCpTarSpnDec4Vib EngCalVariantCriterion
  /begin VAR_ADDRESS 0x8003A484 0x8003B284 0x8003C084 0x8003CE84 0x8003DC84 0x8003EA84 0x8003F884 0x80040684 0x80041484 0x80042284 0x80043084 0x80043E84 0x80044C84 0x80045A84 0x80046884 0x80047684 0x80048484 0x80049284 0x8004A084 0x8004AE84 0x8004BC84 0x8004CA84 0x8004D884 0x8004E684 /end VAR_ADDRESS
 /end VAR_CHARACTERISTIC
 /begin VAR_CHARACTERISTIC TP_S8ETCSCpTarSpnInc4Vib EngCalVariantCriterion
  /begin VAR_ADDRESS 0x8003A485 0x8003B285 0x8003C085 0x8003CE85 0x8003DC85 0x8003EA85 0x8003F885 0x80040685 0x80041485 0x80042285 0x80043085 0x80043E85 0x80044C85 0x80045A85 0x80046885 0x80047685 0x80048485 0x80049285 0x8004A085 0x8004AE85 0x8004BC85 0x8004CA85 0x8004D885 0x8004E685 /end VAR_ADDRESS
 /end VAR_CHARACTERISTIC
 /begin VAR_CHARACTERISTIC TP_S8TCSCpOverBrkTh EngCalVariantCriterion
  /begin VAR_ADDRESS 0x8003A240 0x8003B040 0x8003BE40 0x8003CC40 0x8003DA40 0x8003E840 0x8003F640 0x80040440 0x80041240 0x80042040 0x80042E40 0x80043C40 0x80044A40 0x80045840 0x80046640 0x80047440 0x80048240 0x80049040 0x80049E40 0x8004AC40 0x8004BA40 0x8004C840 0x8004D640 0x8004E440 /end VAR_ADDRESS
 /end VAR_CHARACTERISTIC
 /begin VAR_CHARACTERISTIC TP_S8_ABS_ALLOW_SLIP_HSPD BrkCalVariantCriterion
  /begin VAR_ADDRESS 0x80020574 0x80023974 0x80026D74 0x8002A174 0x8002D574 0x80030974 0x80033D74 0x80037174 /end VAR_ADDRESS
 /end VAR_CHARACTERISTIC
 /begin VAR_CHARACTERISTIC TP_S8_ABS_ALLOW_SLIP_HSPD_BEND BrkCalVariantCriterion
  /begin VAR_ADDRESS 0x80020575 0x80023975 0x80026D75 0x8002A175 0x8002D575 0x80030975 0x80033D75 0x80037175 /end VAR_ADDRESS
 /end VAR_CHARACTERISTIC
 /begin VAR_CHARACTERISTIC TP_S8_ABS_ALLOW_SLIP_HSPD_BEND_IN BrkCalVariantCriterion
  /begin VAR_ADDRESS 0x80020576 0x80023976 0x80026D76 0x8002A176 0x8002D576 0x80030976 0x80033D76 0x80037176 /end VAR_ADDRESS
 /end VAR_CHARACTERISTIC
 /begin VAR_CHARACTERISTIC TP_S8_ABS_ALLOW_SLIP_HSPD_BEND_OUT BrkCalVariantCriterion
  /begin VAR_ADDRESS 0x80020577 0x80023977 0x80026D77 0x8002A177 0x8002D577 0x80030977 0x80033D77 0x80037177 /end VAR_ADDRESS
 /end VAR_CHARACTERISTIC
 /begin VAR_CHARACTERISTIC TP_S8_ABS_ALLOW_SLIP_HSPD_IN BrkCalVariantCriterion
  /begin VAR_ADDRESS 0x80020578 0x80023978 0x80026D78 0x8002A178 0x8002D578 0x80030978 0x80033D78 0x80037178 /end VAR_ADDRESS
 /end VAR_CHARACTERISTIC
 /begin VAR_CHARACTERISTIC TP_S8_ABS_ALLOW_SLIP_LSPD BrkCalVariantCriterion
  /begin VAR_ADDRESS 0x80020579 0x80023979 0x80026D79 0x8002A179 0x8002D579 0x80030979 0x80033D79 0x80037179 /end VAR_ADDRESS
 /end VAR_CHARACTERISTIC
 /begin VAR_CHARACTERISTIC TP_S8_ABS_ALLOW_SLIP_LSPD_BEND BrkCalVariantCriterion
  /begin VAR_ADDRESS 0x8002057A 0x8002397A 0x80026D7A 0x8002A17A 0x8002D57A 0x8003097A 0x80033D7A 0x8003717A /end VAR_ADDRESS
 /end VAR_CHARACTERISTIC
 /begin VAR_CHARACTERISTIC TP_S8_ABS_ALLOW_SLIP_LSPD_BEND_IN BrkCalVariantCriterion
  /begin VAR_ADDRESS 0x8002057B 0x8002397B 0x80026D7B 0x8002A17B 0x8002D57B 0x8003097B 0x80033D7B 0x8003717B /end VAR_ADDRESS
 /end VAR_CHARACTERISTIC
 /begin VAR_CHARACTERISTIC TP_S8_ABS_ALLOW_SLIP_LSPD_BEND_OUT BrkCalVariantCriterion
  /begin VAR_ADDRESS 0x8002057C 0x8002397C 0x80026D7C 0x8002A17C 0x8002D57C 0x8003097C 0x80033D7C 0x8003717C /end VAR_ADDRESS
 /end VAR_CHARACTERISTIC
 /begin VAR_CHARACTERISTIC TP_S8_ABS_ALLOW_SLIP_LSPD_IN BrkCalVariantCriterion
  /begin VAR_ADDRESS 0x8002057D 0x8002397D 0x80026D7D 0x8002A17D 0x8002D57D 0x8003097D 0x80033D7D 0x8003717D /end VAR_ADDRESS
 /end VAR_CHARACTERISTIC
 /begin VAR_CHARACTERISTIC TP_S8_ADDON_TIME_FOR_LOW_MP_F BrkCalVariantCriterion
  /begin VAR_ADDRESS 0x8002055C 0x8002395C 0x80026D5C 0x8002A15C 0x8002D55C 0x8003095C 0x80033D5C 0x8003715C /end VAR_ADDRESS
 /end VAR_CHARACTERISTIC
 /begin VAR_CHARACTERISTIC TP_S8_ADDON_TIME_FOR_LOW_MP_R BrkCalVariantCriterion
  /begin VAR_ADDRESS 0x8002055D 0x8002395D 0x80026D5D 0x8002A15D 0x8002D55D 0x8003095D 0x80033D5D 0x8003715D /end VAR_ADDRESS
 /end VAR_CHARACTERISTIC
 /begin VAR_CHARACTERISTIC TP_S8_Arad_1stPoint_100_150KPH BrkCalVariantCriterion
  /begin VAR_ADDRESS 0x800206A5 0x80023AA5 0x80026EA5 0x8002A2A5 0x8002D6A5 0x80030AA5 0x80033EA5 0x800372A5 /end VAR_ADDRESS
 /end VAR_CHARACTERISTIC
 /begin VAR_CHARACTERISTIC TP_S8_Arad_1stPoint_20_40KPH BrkCalVariantCriterion
  /begin VAR_ADDRESS 0x80020690 0x80023A90 0x80026E90 0x8002A290 0x8002D690 0x80030A90 0x80033E90 0x80037290 /end VAR_ADDRESS
 /end VAR_CHARACTERISTIC
 /begin VAR_CHARACTERISTIC TP_S8_Arad_1stPoint_40_60KPH BrkCalVariantCriterion
  /begin VAR_ADDRESS 0x80020697 0x80023A97 0x80026E97 0x8002A297 0x8002D697 0x80030A97 0x80033E97 0x80037297 /end VAR_ADDRESS
 /end VAR_CHARACTERISTIC
 /begin VAR_CHARACTERISTIC TP_S8_Arad_1stPoint_60_100KPH BrkCalVariantCriterion
  /begin VAR_ADDRESS 0x8002069E 0x80023A9E 0x80026E9E 0x8002A29E 0x8002D69E 0x80030A9E 0x80033E9E 0x8003729E /end VAR_ADDRESS
 /end VAR_CHARACTERISTIC
 /begin VAR_CHARACTERISTIC TP_S8_Arad_1stPoint_Ab_150KPH BrkCalVariantCriterion
  /begin VAR_ADDRESS 0x800206AC 0x80023AAC 0x80026EAC 0x8002A2AC 0x8002D6AC 0x80030AAC 0x80033EAC 0x800372AC /end VAR_ADDRESS
 /end VAR_CHARACTERISTIC
 /begin VAR_CHARACTERISTIC TP_S8_Arad_1stPoint_B_20KPH BrkCalVariantCriterion
  /begin VAR_ADDRESS 0x80020689 0x80023A89 0x80026E89 0x8002A289 0x8002D689 0x80030A89 0x80033E89 0x80037289 /end VAR_ADDRESS
 /end VAR_CHARACTERISTIC
 /begin VAR_CHARACTERISTIC TP_S8_Arad_2ndPoint_100_150KPH BrkCalVariantCriterion
  /begin VAR_ADDRESS 0x800206A6 0x80023AA6 0x80026EA6 0x8002A2A6 0x8002D6A6 0x80030AA6 0x80033EA6 0x800372A6 /end VAR_ADDRESS
 /end VAR_CHARACTERISTIC
 /begin VAR_CHARACTERISTIC TP_S8_Arad_2ndPoint_20_40KPH BrkCalVariantCriterion
  /begin VAR_ADDRESS 0x80020691 0x80023A91 0x80026E91 0x8002A291 0x8002D691 0x80030A91 0x80033E91 0x80037291 /end VAR_ADDRESS
 /end VAR_CHARACTERISTIC
 /begin VAR_CHARACTERISTIC TP_S8_Arad_2ndPoint_40_60KPH BrkCalVariantCriterion
  /begin VAR_ADDRESS 0x80020698 0x80023A98 0x80026E98 0x8002A298 0x8002D698 0x80030A98 0x80033E98 0x80037298 /end VAR_ADDRESS
 /end VAR_CHARACTERISTIC
 /begin VAR_CHARACTERISTIC TP_S8_Arad_2ndPoint_60_100KPH BrkCalVariantCriterion
  /begin VAR_ADDRESS 0x8002069F 0x80023A9F 0x80026E9F 0x8002A29F 0x8002D69F 0x80030A9F 0x80033E9F 0x8003729F /end VAR_ADDRESS
 /end VAR_CHARACTERISTIC
 /begin VAR_CHARACTERISTIC TP_S8_Arad_2ndPoint_Ab_150KPH BrkCalVariantCriterion
  /begin VAR_ADDRESS 0x800206AD 0x80023AAD 0x80026EAD 0x8002A2AD 0x8002D6AD 0x80030AAD 0x80033EAD 0x800372AD /end VAR_ADDRESS
 /end VAR_CHARACTERISTIC
 /begin VAR_CHARACTERISTIC TP_S8_Arad_2ndPoint_B_20KPH BrkCalVariantCriterion
  /begin VAR_ADDRESS 0x8002068A 0x80023A8A 0x80026E8A 0x8002A28A 0x8002D68A 0x80030A8A 0x80033E8A 0x8003728A /end VAR_ADDRESS
 /end VAR_CHARACTERISTIC
 /begin VAR_CHARACTERISTIC TP_S8_Arad_3rdPoint_100_150KPH BrkCalVariantCriterion
  /begin VAR_ADDRESS 0x800206A7 0x80023AA7 0x80026EA7 0x8002A2A7 0x8002D6A7 0x80030AA7 0x80033EA7 0x800372A7 /end VAR_ADDRESS
 /end VAR_CHARACTERISTIC
 /begin VAR_CHARACTERISTIC TP_S8_Arad_3rdPoint_20_40KPH BrkCalVariantCriterion
  /begin VAR_ADDRESS 0x80020692 0x80023A92 0x80026E92 0x8002A292 0x8002D692 0x80030A92 0x80033E92 0x80037292 /end VAR_ADDRESS
 /end VAR_CHARACTERISTIC
 /begin VAR_CHARACTERISTIC TP_S8_Arad_3rdPoint_40_60KPH BrkCalVariantCriterion
  /begin VAR_ADDRESS 0x80020699 0x80023A99 0x80026E99 0x8002A299 0x8002D699 0x80030A99 0x80033E99 0x80037299 /end VAR_ADDRESS
 /end VAR_CHARACTERISTIC
 /begin VAR_CHARACTERISTIC TP_S8_Arad_3rdPoint_60_100KPH BrkCalVariantCriterion
  /begin VAR_ADDRESS 0x800206A0 0x80023AA0 0x80026EA0 0x8002A2A0 0x8002D6A0 0x80030AA0 0x80033EA0 0x800372A0 /end VAR_ADDRESS
 /end VAR_CHARACTERISTIC
 /begin VAR_CHARACTERISTIC TP_S8_Arad_3rdPoint_Ab_150KPH BrkCalVariantCriterion
  /begin VAR_ADDRESS 0x800206AE 0x80023AAE 0x80026EAE 0x8002A2AE 0x8002D6AE 0x80030AAE 0x80033EAE 0x800372AE /end VAR_ADDRESS
 /end VAR_CHARACTERISTIC
 /begin VAR_CHARACTERISTIC TP_S8_Arad_3rdPoint_B_20KPH BrkCalVariantCriterion
  /begin VAR_ADDRESS 0x8002068B 0x80023A8B 0x80026E8B 0x8002A28B 0x8002D68B 0x80030A8B 0x80033E8B 0x8003728B /end VAR_ADDRESS
 /end VAR_CHARACTERISTIC
 /begin VAR_CHARACTERISTIC TP_S8_Arad_Fact_1_2P_100_150KPH BrkCalVariantCriterion
  /begin VAR_ADDRESS 0x800206A8 0x80023AA8 0x80026EA8 0x8002A2A8 0x8002D6A8 0x80030AA8 0x80033EA8 0x800372A8 /end VAR_ADDRESS
 /end VAR_CHARACTERISTIC
 /begin VAR_CHARACTERISTIC TP_S8_Arad_Fact_1_2P_20_40KPH BrkCalVariantCriterion
  /begin VAR_ADDRESS 0x80020693 0x80023A93 0x80026E93 0x8002A293 0x8002D693 0x80030A93 0x80033E93 0x80037293 /end VAR_ADDRESS
 /end VAR_CHARACTERISTIC
 /begin VAR_CHARACTERISTIC TP_S8_Arad_Fact_1_2P_40_60KPH BrkCalVariantCriterion
  /begin VAR_ADDRESS 0x8002069A 0x80023A9A 0x80026E9A 0x8002A29A 0x8002D69A 0x80030A9A 0x80033E9A 0x8003729A /end VAR_ADDRESS
 /end VAR_CHARACTERISTIC
 /begin VAR_CHARACTERISTIC TP_S8_Arad_Fact_1_2P_60_100KPH BrkCalVariantCriterion
  /begin VAR_ADDRESS 0x800206A1 0x80023AA1 0x80026EA1 0x8002A2A1 0x8002D6A1 0x80030AA1 0x80033EA1 0x800372A1 /end VAR_ADDRESS
 /end VAR_CHARACTERISTIC
 /begin VAR_CHARACTERISTIC TP_S8_Arad_Fact_1_2P_Ab_150KPH BrkCalVariantCriterion
  /begin VAR_ADDRESS 0x800206AF 0x80023AAF 0x80026EAF 0x8002A2AF 0x8002D6AF 0x80030AAF 0x80033EAF 0x800372AF /end VAR_ADDRESS
 /end VAR_CHARACTERISTIC
 /begin VAR_CHARACTERISTIC TP_S8_Arad_Fact_1_2P_B_20KPH BrkCalVariantCriterion
  /begin VAR_ADDRESS 0x8002068C 0x80023A8C 0x80026E8C 0x8002A28C 0x8002D68C 0x80030A8C 0x80033E8C 0x8003728C /end VAR_ADDRESS
 /end VAR_CHARACTERISTIC
 /begin VAR_CHARACTERISTIC TP_S8_Arad_Fact_2_3P_100_150KPH BrkCalVariantCriterion
  /begin VAR_ADDRESS 0x800206A9 0x80023AA9 0x80026EA9 0x8002A2A9 0x8002D6A9 0x80030AA9 0x80033EA9 0x800372A9 /end VAR_ADDRESS
 /end VAR_CHARACTERISTIC
 /begin VAR_CHARACTERISTIC TP_S8_Arad_Fact_2_3P_20_40KPH BrkCalVariantCriterion
  /begin VAR_ADDRESS 0x80020694 0x80023A94 0x80026E94 0x8002A294 0x8002D694 0x80030A94 0x80033E94 0x80037294 /end VAR_ADDRESS
 /end VAR_CHARACTERISTIC
 /begin VAR_CHARACTERISTIC TP_S8_Arad_Fact_2_3P_40_60KPH BrkCalVariantCriterion
  /begin VAR_ADDRESS 0x8002069B 0x80023A9B 0x80026E9B 0x8002A29B 0x8002D69B 0x80030A9B 0x80033E9B 0x8003729B /end VAR_ADDRESS
 /end VAR_CHARACTERISTIC
 /begin VAR_CHARACTERISTIC TP_S8_Arad_Fact_2_3P_60_100KPH BrkCalVariantCriterion
  /begin VAR_ADDRESS 0x800206A2 0x80023AA2 0x80026EA2 0x8002A2A2 0x8002D6A2 0x80030AA2 0x80033EA2 0x800372A2 /end VAR_ADDRESS
 /end VAR_CHARACTERISTIC
 /begin VAR_CHARACTERISTIC TP_S8_Arad_Fact_2_3P_Ab_150KPH BrkCalVariantCriterion
  /begin VAR_ADDRESS 0x800206B0 0x80023AB0 0x80026EB0 0x8002A2B0 0x8002D6B0 0x80030AB0 0x80033EB0 0x800372B0 /end VAR_ADDRESS
 /end VAR_CHARACTERISTIC
 /begin VAR_CHARACTERISTIC TP_S8_Arad_Fact_2_3P_B_20KPH BrkCalVariantCriterion
  /begin VAR_ADDRESS 0x8002068D 0x80023A8D 0x80026E8D 0x8002A28D 0x8002D68D 0x80030A8D 0x80033E8D 0x8003728D /end VAR_ADDRESS
 /end VAR_CHARACTERISTIC
 /begin VAR_CHARACTERISTIC TP_S8_Arad_Fact_Ab_3P_100_150KPH BrkCalVariantCriterion
  /begin VAR_ADDRESS 0x800206AA 0x80023AAA 0x80026EAA 0x8002A2AA 0x8002D6AA 0x80030AAA 0x80033EAA 0x800372AA /end VAR_ADDRESS
 /end VAR_CHARACTERISTIC
 /begin VAR_CHARACTERISTIC TP_S8_Arad_Fact_Ab_3P_20_40KPH BrkCalVariantCriterion
  /begin VAR_ADDRESS 0x80020695 0x80023A95 0x80026E95 0x8002A295 0x8002D695 0x80030A95 0x80033E95 0x80037295 /end VAR_ADDRESS
 /end VAR_CHARACTERISTIC
 /begin VAR_CHARACTERISTIC TP_S8_Arad_Fact_Ab_3P_40_60KPH BrkCalVariantCriterion
  /begin VAR_ADDRESS 0x8002069C 0x80023A9C 0x80026E9C 0x8002A29C 0x8002D69C 0x80030A9C 0x80033E9C 0x8003729C /end VAR_ADDRESS
 /end VAR_CHARACTERISTIC
 /begin VAR_CHARACTERISTIC TP_S8_Arad_Fact_Ab_3P_60_100KPH BrkCalVariantCriterion
  /begin VAR_ADDRESS 0x800206A3 0x80023AA3 0x80026EA3 0x8002A2A3 0x8002D6A3 0x80030AA3 0x80033EA3 0x800372A3 /end VAR_ADDRESS
 /end VAR_CHARACTERISTIC
 /begin VAR_CHARACTERISTIC TP_S8_Arad_Fact_Ab_3P_Ab_150KPH BrkCalVariantCriterion
  /begin VAR_ADDRESS 0x800206B1 0x80023AB1 0x80026EB1 0x8002A2B1 0x8002D6B1 0x80030AB1 0x80033EB1 0x800372B1 /end VAR_ADDRESS
 /end VAR_CHARACTERISTIC
 /begin VAR_CHARACTERISTIC TP_S8_Arad_Fact_Ab_3P_B_20KPH BrkCalVariantCriterion
  /begin VAR_ADDRESS 0x8002068E 0x80023A8E 0x80026E8E 0x8002A28E 0x8002D68E 0x80030A8E 0x80033E8E 0x8003728E /end VAR_ADDRESS
 /end VAR_CHARACTERISTIC
 /begin VAR_CHARACTERISTIC TP_S8_Arad_Fact_B_1P_100_150KPH BrkCalVariantCriterion
  /begin VAR_ADDRESS 0x800206AB 0x80023AAB 0x80026EAB 0x8002A2AB 0x8002D6AB 0x80030AAB 0x80033EAB 0x800372AB /end VAR_ADDRESS
 /end VAR_CHARACTERISTIC
 /begin VAR_CHARACTERISTIC TP_S8_Arad_Fact_B_1P_20_40KPH BrkCalVariantCriterion
  /begin VAR_ADDRESS 0x80020696 0x80023A96 0x80026E96 0x8002A296 0x8002D696 0x80030A96 0x80033E96 0x80037296 /end VAR_ADDRESS
 /end VAR_CHARACTERISTIC
 /begin VAR_CHARACTERISTIC TP_S8_Arad_Fact_B_1P_40_60KPH BrkCalVariantCriterion
  /begin VAR_ADDRESS 0x8002069D 0x80023A9D 0x80026E9D 0x8002A29D 0x8002D69D 0x80030A9D 0x80033E9D 0x8003729D /end VAR_ADDRESS
 /end VAR_CHARACTERISTIC
 /begin VAR_CHARACTERISTIC TP_S8_Arad_Fact_B_1P_60_100KPH BrkCalVariantCriterion
  /begin VAR_ADDRESS 0x800206A4 0x80023AA4 0x80026EA4 0x8002A2A4 0x8002D6A4 0x80030AA4 0x80033EA4 0x800372A4 /end VAR_ADDRESS
 /end VAR_CHARACTERISTIC
 /begin VAR_CHARACTERISTIC TP_S8_Arad_Fact_B_1P_Ab_150KPH BrkCalVariantCriterion
  /begin VAR_ADDRESS 0x800206B2 0x80023AB2 0x80026EB2 0x8002A2B2 0x8002D6B2 0x80030AB2 0x80033EB2 0x800372B2 /end VAR_ADDRESS
 /end VAR_CHARACTERISTIC
 /begin VAR_CHARACTERISTIC TP_S8_Arad_Fact_B_1P_B_20KPH BrkCalVariantCriterion
  /begin VAR_ADDRESS 0x8002068F 0x80023A8F 0x80026E8F 0x8002A28F 0x8002D68F 0x80030A8F 0x80033E8F 0x8003728F /end VAR_ADDRESS
 /end VAR_CHARACTERISTIC
 /begin VAR_CHARACTERISTIC TP_S8_BMP_SUS_ARAD_GAUGE_THRES_F1 BrkCalVariantCriterion
  /begin VAR_ADDRESS 0x8002062C 0x80023A2C 0x80026E2C 0x8002A22C 0x8002D62C 0x80030A2C 0x80033E2C 0x8003722C /end VAR_ADDRESS
 /end VAR_CHARACTERISTIC
 /begin VAR_CHARACTERISTIC TP_S8_BMP_SUS_ARAD_GAUGE_THRES_F2 BrkCalVariantCriterion
  /begin VAR_ADDRESS 0x8002062E 0x80023A2E 0x80026E2E 0x8002A22E 0x8002D62E 0x80030A2E 0x80033E2E 0x8003722E /end VAR_ADDRESS
 /end VAR_CHARACTERISTIC
 /begin VAR_CHARACTERISTIC TP_S8_BMP_SUS_ARAD_GAUGE_THRES_R1 BrkCalVariantCriterion
  /begin VAR_ADDRESS 0x8002062D 0x80023A2D 0x80026E2D 0x8002A22D 0x8002D62D 0x80030A2D 0x80033E2D 0x8003722D /end VAR_ADDRESS
 /end VAR_CHARACTERISTIC
 /begin VAR_CHARACTERISTIC TP_S8_BMP_SUS_ARAD_GAUGE_THRES_R2 BrkCalVariantCriterion
  /begin VAR_ADDRESS 0x8002062F 0x80023A2F 0x80026E2F 0x8002A22F 0x8002D62F 0x80030A2F 0x80033E2F 0x8003722F /end VAR_ADDRESS
 /end VAR_CHARACTERISTIC
 /begin VAR_CHARACTERISTIC TP_S8_BMP_SUS_ARAD_THRES_F1 BrkCalVariantCriterion
  /begin VAR_ADDRESS 0x80020628 0x80023A28 0x80026E28 0x8002A228 0x8002D628 0x80030A28 0x80033E28 0x80037228 /end VAR_ADDRESS
 /end VAR_CHARACTERISTIC
 /begin VAR_CHARACTERISTIC TP_S8_BMP_SUS_ARAD_THRES_F2 BrkCalVariantCriterion
  /begin VAR_ADDRESS 0x8002062A 0x80023A2A 0x80026E2A 0x8002A22A 0x8002D62A 0x80030A2A 0x80033E2A 0x8003722A /end VAR_ADDRESS
 /end VAR_CHARACTERISTIC
 /begin VAR_CHARACTERISTIC TP_S8_BMP_SUS_ARAD_THRES_R1 BrkCalVariantCriterion
  /begin VAR_ADDRESS 0x80020629 0x80023A29 0x80026E29 0x8002A229 0x8002D629 0x80030A29 0x80033E29 0x80037229 /end VAR_ADDRESS
 /end VAR_CHARACTERISTIC
 /begin VAR_CHARACTERISTIC TP_S8_BMP_SUS_ARAD_THRES_R2 BrkCalVariantCriterion
  /begin VAR_ADDRESS 0x8002062B 0x80023A2B 0x80026E2B 0x8002A22B 0x8002D62B 0x80030A2B 0x80033E2B 0x8003722B /end VAR_ADDRESS
 /end VAR_CHARACTERISTIC
 /begin VAR_CHARACTERISTIC TP_S8_BUMP_PEAK_ACC_REF_1_DUMP BrkCalVariantCriterion
  /begin VAR_ADDRESS 0x80020622 0x80023A22 0x80026E22 0x8002A222 0x8002D622 0x80030A22 0x80033E22 0x80037222 /end VAR_ADDRESS
 /end VAR_CHARACTERISTIC
 /begin VAR_CHARACTERISTIC TP_S8_BUMP_PEAK_ACC_REF_MAX_DUMP BrkCalVariantCriterion
  /begin VAR_ADDRESS 0x80020623 0x80023A23 0x80026E23 0x8002A223 0x8002D623 0x80030A23 0x80033E23 0x80037223 /end VAR_ADDRESS
 /end VAR_CHARACTERISTIC
 /begin VAR_CHARACTERISTIC TP_S8_CBC_ARAD_THRES_COMP_H BrkCalVariantCriterion
  /begin VAR_ADDRESS 0x8002074C 0x80023B4C 0x80026F4C 0x8002A34C 0x8002D74C 0x80030B4C 0x80033F4C 0x8003734C /end VAR_ADDRESS
 /end VAR_CHARACTERISTIC
 /begin VAR_CHARACTERISTIC TP_S8_CBC_ARAD_THRES_COMP_M BrkCalVariantCriterion
  /begin VAR_ADDRESS 0x8002074D 0x80023B4D 0x80026F4D 0x8002A34D 0x8002D74D 0x80030B4D 0x80033F4D 0x8003734D /end VAR_ADDRESS
 /end VAR_CHARACTERISTIC
 /begin VAR_CHARACTERISTIC TP_S8_CBC_ARAD_THRES_H BrkCalVariantCriterion
  /begin VAR_ADDRESS 0x8002074E 0x80023B4E 0x80026F4E 0x8002A34E 0x8002D74E 0x80030B4E 0x80033F4E 0x8003734E /end VAR_ADDRESS
 /end VAR_CHARACTERISTIC
 /begin VAR_CHARACTERISTIC TP_S8_CBC_ARAD_THRES_L BrkCalVariantCriterion
  /begin VAR_ADDRESS 0x8002074F 0x80023B4F 0x80026F4F 0x8002A34F 0x8002D74F 0x80030B4F 0x80033F4F 0x8003734F /end VAR_ADDRESS
 /end VAR_CHARACTERISTIC
 /begin VAR_CHARACTERISTIC TP_S8_CBC_ARAD_THRES_M BrkCalVariantCriterion
  /begin VAR_ADDRESS 0x80020750 0x80023B50 0x80026F50 0x8002A350 0x8002D750 0x80030B50 0x80033F50 0x80037350 /end VAR_ADDRESS
 /end VAR_CHARACTERISTIC
 /begin VAR_CHARACTERISTIC TP_S8_CBC_REAPPLY_TIME_ABS_R BrkCalVariantCriterion
  /begin VAR_ADDRESS 0x80020700 0x80023B00 0x80026F00 0x8002A300 0x8002D700 0x80030B00 0x80033F00 0x80037300 /end VAR_ADDRESS
 /end VAR_CHARACTERISTIC
 /begin VAR_CHARACTERISTIC TP_S8_CBC_REAPPLY_TIME_FADEOUT_ABS_R BrkCalVariantCriterion
  /begin VAR_ADDRESS 0x80020701 0x80023B01 0x80026F01 0x8002A301 0x8002D701 0x80030B01 0x80033F01 0x80037301 /end VAR_ADDRESS
 /end VAR_CHARACTERISTIC
 /begin VAR_CHARACTERISTIC TP_S8_CBC_REAPPLY_TIME_FADEOUT_R BrkCalVariantCriterion
  /begin VAR_ADDRESS 0x8002078A 0x80023B8A 0x80026F8A 0x8002A38A 0x8002D78A 0x80030B8A 0x80033F8A 0x8003738A /end VAR_ADDRESS
 /end VAR_CHARACTERISTIC
 /begin VAR_CHARACTERISTIC TP_S8_CBC_REAPPLY_TIME_R BrkCalVariantCriterion
  /begin VAR_ADDRESS 0x8002078B 0x80023B8B 0x80026F8B 0x8002A38B 0x8002D78B 0x80030B8B 0x80033F8B 0x8003738B /end VAR_ADDRESS
 /end VAR_CHARACTERISTIC
 /begin VAR_CHARACTERISTIC TP_S8_CBC_SLIP_THRES_COMP_H BrkCalVariantCriterion
  /begin VAR_ADDRESS 0x8002075C 0x80023B5C 0x80026F5C 0x8002A35C 0x8002D75C 0x80030B5C 0x80033F5C 0x8003735C /end VAR_ADDRESS
 /end VAR_CHARACTERISTIC
 /begin VAR_CHARACTERISTIC TP_S8_CBC_SLIP_THRES_COMP_M BrkCalVariantCriterion
  /begin VAR_ADDRESS 0x8002075D 0x80023B5D 0x80026F5D 0x8002A35D 0x8002D75D 0x80030B5D 0x80033F5D 0x8003735D /end VAR_ADDRESS
 /end VAR_CHARACTERISTIC
 /begin VAR_CHARACTERISTIC TP_S8_CBC_SLIP_THRES_H BrkCalVariantCriterion
  /begin VAR_ADDRESS 0x8002075E 0x80023B5E 0x80026F5E 0x8002A35E 0x8002D75E 0x80030B5E 0x80033F5E 0x8003735E /end VAR_ADDRESS
 /end VAR_CHARACTERISTIC
 /begin VAR_CHARACTERISTIC TP_S8_CBC_SLIP_THRES_L BrkCalVariantCriterion
  /begin VAR_ADDRESS 0x8002075F 0x80023B5F 0x80026F5F 0x8002A35F 0x8002D75F 0x80030B5F 0x80033F5F 0x8003735F /end VAR_ADDRESS
 /end VAR_CHARACTERISTIC
 /begin VAR_CHARACTERISTIC TP_S8_CBC_SLIP_THRES_M BrkCalVariantCriterion
  /begin VAR_ADDRESS 0x80020760 0x80023B60 0x80026F60 0x8002A360 0x8002D760 0x80030B60 0x80033F60 0x80037360 /end VAR_ADDRESS
 /end VAR_CHARACTERISTIC
 /begin VAR_CHARACTERISTIC TP_S8_CBC_WHEEL_SPIN_OK_LEVEL BrkCalVariantCriterion
  /begin VAR_ADDRESS 0x80020722 0x80023B22 0x80026F22 0x8002A322 0x8002D722 0x80030B22 0x80033F22 0x80037322 /end VAR_ADDRESS
 /end VAR_CHARACTERISTIC
 /begin VAR_CHARACTERISTIC TP_S8_Clear_GMA_Max_Accel1 BrkCalVariantCriterion
  /begin VAR_ADDRESS 0x800202A8 0x800236A8 0x80026AA8 0x80029EA8 0x8002D2A8 0x800306A8 0x80033AA8 0x80036EA8 /end VAR_ADDRESS
 /end VAR_CHARACTERISTIC
 /begin VAR_CHARACTERISTIC TP_S8_Clear_GMA_Max_Accel2 BrkCalVariantCriterion
  /begin VAR_ADDRESS 0x800202A9 0x800236A9 0x80026AA9 0x80029EA9 0x8002D2A9 0x800306A9 0x80033AA9 0x80036EA9 /end VAR_ADDRESS
 /end VAR_CHARACTERISTIC
 /begin VAR_CHARACTERISTIC TP_S8_Comp_Duty_For_H2SP_Hside_F BrkCalVariantCriterion
  /begin VAR_ADDRESS 0x800205AE 0x800239AE 0x80026DAE 0x8002A1AE 0x8002D5AE 0x800309AE 0x80033DAE 0x800371AE /end VAR_ADDRESS
 /end VAR_CHARACTERISTIC
 /begin VAR_CHARACTERISTIC TP_S8_Comp_Duty_For_SPHside_F BrkCalVariantCriterion
  /begin VAR_ADDRESS 0x800202B0 0x800236B0 0x80026AB0 0x80029EB0 0x8002D2B0 0x800306B0 0x80033AB0 0x80036EB0 /end VAR_ADDRESS
 /end VAR_CHARACTERISTIC
 /begin VAR_CHARACTERISTIC TP_S8_Counter_threshold_Lower_Lim_F BrkCalVariantCriterion
  /begin VAR_ADDRESS 0x800204C0 0x800238C0 0x80026CC0 0x8002A0C0 0x8002D4C0 0x800308C0 0x80033CC0 0x800370C0 /end VAR_ADDRESS
 /end VAR_CHARACTERISTIC
 /begin VAR_CHARACTERISTIC TP_S8_Counter_threshold_Lower_Lim_R BrkCalVariantCriterion
  /begin VAR_ADDRESS 0x800204C1 0x800238C1 0x80026CC1 0x8002A0C1 0x8002D4C1 0x800308C1 0x80033CC1 0x800370C1 /end VAR_ADDRESS
 /end VAR_CHARACTERISTIC
 /begin VAR_CHARACTERISTIC TP_S8_Counter_threshold_Upper_Lim_F BrkCalVariantCriterion
  /begin VAR_ADDRESS 0x800204C2 0x800238C2 0x80026CC2 0x8002A0C2 0x8002D4C2 0x800308C2 0x80033CC2 0x800370C2 /end VAR_ADDRESS
 /end VAR_CHARACTERISTIC
 /begin VAR_CHARACTERISTIC TP_S8_Counter_threshold_Upper_Lim_R BrkCalVariantCriterion
  /begin VAR_ADDRESS 0x800204C3 0x800238C3 0x80026CC3 0x8002A0C3 0x8002D4C3 0x800308C3 0x80033CC3 0x800370C3 /end VAR_ADDRESS
 /end VAR_CHARACTERISTIC
 /begin VAR_CHARACTERISTIC TP_S8_Dec_Hump_Counting_arad BrkCalVariantCriterion
  /begin VAR_ADDRESS 0x800202DB 0x800236DB 0x80026ADB 0x80029EDB 0x8002D2DB 0x800306DB 0x80033ADB 0x80036EDB /end VAR_ADDRESS
 /end VAR_CHARACTERISTIC
 /begin VAR_CHARACTERISTIC TP_S8_Decel_Gain_LMu_10_20k_F_HDC BrkCalVariantCriterion
  /begin VAR_ADDRESS 0x80020560 0x80023960 0x80026D60 0x8002A160 0x8002D560 0x80030960 0x80033D60 0x80037160 /end VAR_ADDRESS
 /end VAR_CHARACTERISTIC
 /begin VAR_CHARACTERISTIC TP_S8_Decel_Gain_LMu_10_20k_R_HDC BrkCalVariantCriterion
  /begin VAR_ADDRESS 0x80020564 0x80023964 0x80026D64 0x8002A164 0x8002D564 0x80030964 0x80033D64 0x80037164 /end VAR_ADDRESS
 /end VAR_CHARACTERISTIC
 /begin VAR_CHARACTERISTIC TP_S8_Decel_Gain_LMu_B_10k_F_HDC BrkCalVariantCriterion
  /begin VAR_ADDRESS 0x80020561 0x80023961 0x80026D61 0x8002A161 0x8002D561 0x80030961 0x80033D61 0x80037161 /end VAR_ADDRESS
 /end VAR_CHARACTERISTIC
 /begin VAR_CHARACTERISTIC TP_S8_Decel_Gain_LMu_B_10k_R_HDC BrkCalVariantCriterion
  /begin VAR_ADDRESS 0x80020565 0x80023965 0x80026D65 0x8002A165 0x8002D565 0x80030965 0x80033D65 0x80037165 /end VAR_ADDRESS
 /end VAR_CHARACTERISTIC
 /begin VAR_CHARACTERISTIC TP_S8_DetectAccel_EngTorq_L1 BrkCalVariantCriterion
  /begin VAR_ADDRESS 0x80020614 0x80023A14 0x80026E14 0x8002A214 0x8002D614 0x80030A14 0x80033E14 0x80037214 /end VAR_ADDRESS
 /end VAR_CHARACTERISTIC
 /begin VAR_CHARACTERISTIC TP_S8_DetectAccel_EngTorq_L2 BrkCalVariantCriterion
  /begin VAR_ADDRESS 0x80020615 0x80023A15 0x80026E15 0x8002A215 0x8002D615 0x80030A15 0x80033E15 0x80037215 /end VAR_ADDRESS
 /end VAR_CHARACTERISTIC
 /begin VAR_CHARACTERISTIC TP_S8_DetectAccel_EngTorq_L3 BrkCalVariantCriterion
  /begin VAR_ADDRESS 0x80020616 0x80023A16 0x80026E16 0x8002A216 0x8002D616 0x80030A16 0x80033E16 0x80037216 /end VAR_ADDRESS
 /end VAR_CHARACTERISTIC
 /begin VAR_CHARACTERISTIC TP_S8_DetectAccel_Reset_EngTorq BrkCalVariantCriterion
  /begin VAR_ADDRESS 0x8002061A 0x80023A1A 0x80026E1A 0x8002A21A 0x8002D61A 0x80030A1A 0x80033E1A 0x8003721A /end VAR_ADDRESS
 /end VAR_CHARACTERISTIC
 /begin VAR_CHARACTERISTIC TP_S8_DetectAccel_Reset_Throttle BrkCalVariantCriterion
  /begin VAR_ADDRESS 0x8002061B 0x80023A1B 0x80026E1B 0x8002A21B 0x8002D61B 0x80030A1B 0x80033E1B 0x8003721B /end VAR_ADDRESS
 /end VAR_CHARACTERISTIC
 /begin VAR_CHARACTERISTIC TP_S8_DetectAccel_Throttle_P1 BrkCalVariantCriterion
  /begin VAR_ADDRESS 0x80020617 0x80023A17 0x80026E17 0x8002A217 0x8002D617 0x80030A17 0x80033E17 0x80037217 /end VAR_ADDRESS
 /end VAR_CHARACTERISTIC
 /begin VAR_CHARACTERISTIC TP_S8_DetectAccel_Throttle_P2 BrkCalVariantCriterion
  /begin VAR_ADDRESS 0x80020618 0x80023A18 0x80026E18 0x8002A218 0x8002D618 0x80030A18 0x80033E18 0x80037218 /end VAR_ADDRESS
 /end VAR_CHARACTERISTIC
 /begin VAR_CHARACTERISTIC TP_S8_DetectAccel_Throttle_P3 BrkCalVariantCriterion
  /begin VAR_ADDRESS 0x80020619 0x80023A19 0x80026E19 0x8002A219 0x8002D619 0x80030A19 0x80033E19 0x80037219 /end VAR_ADDRESS
 /end VAR_CHARACTERISTIC
 /begin VAR_CHARACTERISTIC TP_S8_EBD_Cut_Arad_100_150KPH BrkCalVariantCriterion
  /begin VAR_ADDRESS 0x80020677 0x80023A77 0x80026E77 0x8002A277 0x8002D677 0x80030A77 0x80033E77 0x80037277 /end VAR_ADDRESS
 /end VAR_CHARACTERISTIC
 /begin VAR_CHARACTERISTIC TP_S8_EBD_Cut_Arad_20_40KPH BrkCalVariantCriterion
  /begin VAR_ADDRESS 0x80020678 0x80023A78 0x80026E78 0x8002A278 0x8002D678 0x80030A78 0x80033E78 0x80037278 /end VAR_ADDRESS
 /end VAR_CHARACTERISTIC
 /begin VAR_CHARACTERISTIC TP_S8_EBD_Cut_Arad_40_60KPH BrkCalVariantCriterion
  /begin VAR_ADDRESS 0x80020679 0x80023A79 0x80026E79 0x8002A279 0x8002D679 0x80030A79 0x80033E79 0x80037279 /end VAR_ADDRESS
 /end VAR_CHARACTERISTIC
 /begin VAR_CHARACTERISTIC TP_S8_EBD_Cut_Arad_60_100KPH BrkCalVariantCriterion
  /begin VAR_ADDRESS 0x8002067A 0x80023A7A 0x80026E7A 0x8002A27A 0x8002D67A 0x80030A7A 0x80033E7A 0x8003727A /end VAR_ADDRESS
 /end VAR_CHARACTERISTIC
 /begin VAR_CHARACTERISTIC TP_S8_EBD_Cut_Arad_Ab_150KPH BrkCalVariantCriterion
  /begin VAR_ADDRESS 0x8002067B 0x80023A7B 0x80026E7B 0x8002A27B 0x8002D67B 0x80030A7B 0x80033E7B 0x8003727B /end VAR_ADDRESS
 /end VAR_CHARACTERISTIC
 /begin VAR_CHARACTERISTIC TP_S8_EBD_Cut_Arad_B_20KPH BrkCalVariantCriterion
  /begin VAR_ADDRESS 0x8002067C 0x80023A7C 0x80026E7C 0x8002A27C 0x8002D67C 0x80030A7C 0x80033E7C 0x8003727C /end VAR_ADDRESS
 /end VAR_CHARACTERISTIC
 /begin VAR_CHARACTERISTIC TP_S8_EBD_Cut_Vdiff_100_150KPH BrkCalVariantCriterion
  /begin VAR_ADDRESS 0x8002067D 0x80023A7D 0x80026E7D 0x8002A27D 0x8002D67D 0x80030A7D 0x80033E7D 0x8003727D /end VAR_ADDRESS
 /end VAR_CHARACTERISTIC
 /begin VAR_CHARACTERISTIC TP_S8_EBD_Cut_Vdiff_20_40KPH BrkCalVariantCriterion
  /begin VAR_ADDRESS 0x8002067E 0x80023A7E 0x80026E7E 0x8002A27E 0x8002D67E 0x80030A7E 0x80033E7E 0x8003727E /end VAR_ADDRESS
 /end VAR_CHARACTERISTIC
 /begin VAR_CHARACTERISTIC TP_S8_EBD_Cut_Vdiff_40_60KPH BrkCalVariantCriterion
  /begin VAR_ADDRESS 0x8002067F 0x80023A7F 0x80026E7F 0x8002A27F 0x8002D67F 0x80030A7F 0x80033E7F 0x8003727F /end VAR_ADDRESS
 /end VAR_CHARACTERISTIC
 /begin VAR_CHARACTERISTIC TP_S8_EBD_Cut_Vdiff_60_100KPH BrkCalVariantCriterion
  /begin VAR_ADDRESS 0x80020680 0x80023A80 0x80026E80 0x8002A280 0x8002D680 0x80030A80 0x80033E80 0x80037280 /end VAR_ADDRESS
 /end VAR_CHARACTERISTIC
 /begin VAR_CHARACTERISTIC TP_S8_EBD_Cut_Vdiff_Ab_150KPH BrkCalVariantCriterion
  /begin VAR_ADDRESS 0x80020681 0x80023A81 0x80026E81 0x8002A281 0x8002D681 0x80030A81 0x80033E81 0x80037281 /end VAR_ADDRESS
 /end VAR_CHARACTERISTIC
 /begin VAR_CHARACTERISTIC TP_S8_EBD_Cut_Vdiff_B_20KPH BrkCalVariantCriterion
  /begin VAR_ADDRESS 0x80020682 0x80023A82 0x80026E82 0x8002A282 0x8002D682 0x80030A82 0x80033E82 0x80037282 /end VAR_ADDRESS
 /end VAR_CHARACTERISTIC
 /begin VAR_CHARACTERISTIC TP_S8_EDC_DEC_ENT_THR_INC_IN_CTL EngCalVariantCriterion
  /begin VAR_ADDRESS 0x8003A0AF 0x8003AEAF 0x8003BCAF 0x8003CAAF 0x8003D8AF 0x8003E6AF 0x8003F4AF 0x800402AF 0x800410AF 0x80041EAF 0x80042CAF 0x80043AAF 0x800448AF 0x800456AF 0x800464AF 0x800472AF 0x800480AF 0x80048EAF 0x80049CAF 0x8004AAAF 0x8004B8AF 0x8004C6AF 0x8004D4AF 0x8004E2AF /end VAR_ADDRESS
 /end VAR_CHARACTERISTIC
 /begin VAR_CHARACTERISTIC TP_S8_EDC_DEC_ENT_THR_IN_RR EngCalVariantCriterion
  /begin VAR_ADDRESS 0x8003A0B0 0x8003AEB0 0x8003BCB0 0x8003CAB0 0x8003D8B0 0x8003E6B0 0x8003F4B0 0x800402B0 0x800410B0 0x80041EB0 0x80042CB0 0x80043AB0 0x800448B0 0x800456B0 0x800464B0 0x800472B0 0x800480B0 0x80048EB0 0x80049CB0 0x8004AAB0 0x8004B8B0 0x8004C6B0 0x8004D4B0 0x8004E2B0 /end VAR_ADDRESS
 /end VAR_CHARACTERISTIC
 /begin VAR_CHARACTERISTIC TP_S8_EDC_DEC_TAR_DEL_V_IN_RR EngCalVariantCriterion
  /begin VAR_ADDRESS 0x8003A0C3 0x8003AEC3 0x8003BCC3 0x8003CAC3 0x8003D8C3 0x8003E6C3 0x8003F4C3 0x800402C3 0x800410C3 0x80041EC3 0x80042CC3 0x80043AC3 0x800448C3 0x800456C3 0x800464C3 0x800472C3 0x800480C3 0x80048EC3 0x80049CC3 0x8004AAC3 0x8004B8C3 0x8004C6C3 0x8004D4C3 0x8004E2C3 /end VAR_ADDRESS
 /end VAR_CHARACTERISTIC
 /begin VAR_CHARACTERISTIC TP_S8_EDC_ENTRY_LIMIT EngCalVariantCriterion
  /begin VAR_ADDRESS 0x8003A144 0x8003AF44 0x8003BD44 0x8003CB44 0x8003D944 0x8003E744 0x8003F544 0x80040344 0x80041144 0x80041F44 0x80042D44 0x80043B44 0x80044944 0x80045744 0x80046544 0x80047344 0x80048144 0x80048F44 0x80049D44 0x8004AB44 0x8004B944 0x8004C744 0x8004D544 0x8004E344 /end VAR_ADDRESS
 /end VAR_CHARACTERISTIC
 /begin VAR_CHARACTERISTIC TP_S8_EDC_ENTRY_THR0_ABS_S1 EngCalVariantCriterion
  /begin VAR_ADDRESS 0x8003A097 0x8003AE97 0x8003BC97 0x8003CA97 0x8003D897 0x8003E697 0x8003F497 0x80040297 0x80041097 0x80041E97 0x80042C97 0x80043A97 0x80044897 0x80045697 0x80046497 0x80047297 0x80048097 0x80048E97 0x80049C97 0x8004AA97 0x8004B897 0x8004C697 0x8004D497 0x8004E297 /end VAR_ADDRESS
 /end VAR_CHARACTERISTIC
 /begin VAR_CHARACTERISTIC TP_S8_EDC_ENTRY_THR0_ABS_S2 EngCalVariantCriterion
  /begin VAR_ADDRESS 0x8003A098 0x8003AE98 0x8003BC98 0x8003CA98 0x8003D898 0x8003E698 0x8003F498 0x80040298 0x80041098 0x80041E98 0x80042C98 0x80043A98 0x80044898 0x80045698 0x80046498 0x80047298 0x80048098 0x80048E98 0x80049C98 0x8004AA98 0x8004B898 0x8004C698 0x8004D498 0x8004E298 /end VAR_ADDRESS
 /end VAR_CHARACTERISTIC
 /begin VAR_CHARACTERISTIC TP_S8_EDC_ENTRY_THR0_ABS_S3 EngCalVariantCriterion
  /begin VAR_ADDRESS 0x8003A099 0x8003AE99 0x8003BC99 0x8003CA99 0x8003D899 0x8003E699 0x8003F499 0x80040299 0x80041099 0x80041E99 0x80042C99 0x80043A99 0x80044899 0x80045699 0x80046499 0x80047299 0x80048099 0x80048E99 0x80049C99 0x8004AA99 0x8004B899 0x8004C699 0x8004D499 0x8004E299 /end VAR_ADDRESS
 /end VAR_CHARACTERISTIC
 /begin VAR_CHARACTERISTIC TP_S8_EDC_ENTRY_THR0_ABS_S4 EngCalVariantCriterion
  /begin VAR_ADDRESS 0x8003A09A 0x8003AE9A 0x8003BC9A 0x8003CA9A 0x8003D89A 0x8003E69A 0x8003F49A 0x8004029A 0x8004109A 0x80041E9A 0x80042C9A 0x80043A9A 0x8004489A 0x8004569A 0x8004649A 0x8004729A 0x8004809A 0x80048E9A 0x80049C9A 0x8004AA9A 0x8004B89A 0x8004C69A 0x8004D49A 0x8004E29A /end VAR_ADDRESS
 /end VAR_CHARACTERISTIC
 /begin VAR_CHARACTERISTIC TP_S8_EDC_ENTRY_THR0_ESC_S1 EngCalVariantCriterion
  /begin VAR_ADDRESS 0x8003A0A3 0x8003AEA3 0x8003BCA3 0x8003CAA3 0x8003D8A3 0x8003E6A3 0x8003F4A3 0x800402A3 0x800410A3 0x80041EA3 0x80042CA3 0x80043AA3 0x800448A3 0x800456A3 0x800464A3 0x800472A3 0x800480A3 0x80048EA3 0x80049CA3 0x8004AAA3 0x8004B8A3 0x8004C6A3 0x8004D4A3 0x8004E2A3 /end VAR_ADDRESS
 /end VAR_CHARACTERISTIC
 /begin VAR_CHARACTERISTIC TP_S8_EDC_ENTRY_THR0_ESC_S2 EngCalVariantCriterion
  /begin VAR_ADDRESS 0x8003A0A4 0x8003AEA4 0x8003BCA4 0x8003CAA4 0x8003D8A4 0x8003E6A4 0x8003F4A4 0x800402A4 0x800410A4 0x80041EA4 0x80042CA4 0x80043AA4 0x800448A4 0x800456A4 0x800464A4 0x800472A4 0x800480A4 0x80048EA4 0x80049CA4 0x8004AAA4 0x8004B8A4 0x8004C6A4 0x8004D4A4 0x8004E2A4 /end VAR_ADDRESS
 /end VAR_CHARACTERISTIC
 /begin VAR_CHARACTERISTIC TP_S8_EDC_ENTRY_THR0_ESC_S3 EngCalVariantCriterion
  /begin VAR_ADDRESS 0x8003A0A5 0x8003AEA5 0x8003BCA5 0x8003CAA5 0x8003D8A5 0x8003E6A5 0x8003F4A5 0x800402A5 0x800410A5 0x80041EA5 0x80042CA5 0x80043AA5 0x800448A5 0x800456A5 0x800464A5 0x800472A5 0x800480A5 0x80048EA5 0x80049CA5 0x8004AAA5 0x8004B8A5 0x8004C6A5 0x8004D4A5 0x8004E2A5 /end VAR_ADDRESS
 /end VAR_CHARACTERISTIC
 /begin VAR_CHARACTERISTIC TP_S8_EDC_ENTRY_THR0_ESC_S4 EngCalVariantCriterion
  /begin VAR_ADDRESS 0x8003A0A6 0x8003AEA6 0x8003BCA6 0x8003CAA6 0x8003D8A6 0x8003E6A6 0x8003F4A6 0x800402A6 0x800410A6 0x80041EA6 0x80042CA6 0x80043AA6 0x800448A6 0x800456A6 0x800464A6 0x800472A6 0x800480A6 0x80048EA6 0x80049CA6 0x8004AAA6 0x8004B8A6 0x8004C6A6 0x8004D4A6 0x8004E2A6 /end VAR_ADDRESS
 /end VAR_CHARACTERISTIC
 /begin VAR_CHARACTERISTIC TP_S8_EDC_ENTRY_THR0_S1 EngCalVariantCriterion
  /begin VAR_ADDRESS 0x8003A08A 0x8003AE8A 0x8003BC8A 0x8003CA8A 0x8003D88A 0x8003E68A 0x8003F48A 0x8004028A 0x8004108A 0x80041E8A 0x80042C8A 0x80043A8A 0x8004488A 0x8004568A 0x8004648A 0x8004728A 0x8004808A 0x80048E8A 0x80049C8A 0x8004AA8A 0x8004B88A 0x8004C68A 0x8004D48A 0x8004E28A /end VAR_ADDRESS
 /end VAR_CHARACTERISTIC
 /begin VAR_CHARACTERISTIC TP_S8_EDC_ENTRY_THR0_S2 EngCalVariantCriterion
  /begin VAR_ADDRESS 0x8003A08B 0x8003AE8B 0x8003BC8B 0x8003CA8B 0x8003D88B 0x8003E68B 0x8003F48B 0x8004028B 0x8004108B 0x80041E8B 0x80042C8B 0x80043A8B 0x8004488B 0x8004568B 0x8004648B 0x8004728B 0x8004808B 0x80048E8B 0x80049C8B 0x8004AA8B 0x8004B88B 0x8004C68B 0x8004D48B 0x8004E28B /end VAR_ADDRESS
 /end VAR_CHARACTERISTIC
 /begin VAR_CHARACTERISTIC TP_S8_EDC_ENTRY_THR0_S3 EngCalVariantCriterion
  /begin VAR_ADDRESS 0x8003A08C 0x8003AE8C 0x8003BC8C 0x8003CA8C 0x8003D88C 0x8003E68C 0x8003F48C 0x8004028C 0x8004108C 0x80041E8C 0x80042C8C 0x80043A8C 0x8004488C 0x8004568C 0x8004648C 0x8004728C 0x8004808C 0x80048E8C 0x80049C8C 0x8004AA8C 0x8004B88C 0x8004C68C 0x8004D48C 0x8004E28C /end VAR_ADDRESS
 /end VAR_CHARACTERISTIC
 /begin VAR_CHARACTERISTIC TP_S8_EDC_ENTRY_THR0_S4 EngCalVariantCriterion
  /begin VAR_ADDRESS 0x8003A08D 0x8003AE8D 0x8003BC8D 0x8003CA8D 0x8003D88D 0x8003E68D 0x8003F48D 0x8004028D 0x8004108D 0x80041E8D 0x80042C8D 0x80043A8D 0x8004488D 0x8004568D 0x8004648D 0x8004728D 0x8004808D 0x80048E8D 0x80049C8D 0x8004AA8D 0x8004B88D 0x8004C68D 0x8004D48D 0x8004E28D /end VAR_ADDRESS
 /end VAR_CHARACTERISTIC
 /begin VAR_CHARACTERISTIC TP_S8_EDC_ENTRY_THR1_ABS_S1 EngCalVariantCriterion
  /begin VAR_ADDRESS 0x8003A09B 0x8003AE9B 0x8003BC9B 0x8003CA9B 0x8003D89B 0x8003E69B 0x8003F49B 0x8004029B 0x8004109B 0x80041E9B 0x80042C9B 0x80043A9B 0x8004489B 0x8004569B 0x8004649B 0x8004729B 0x8004809B 0x80048E9B 0x80049C9B 0x8004AA9B 0x8004B89B 0x8004C69B 0x8004D49B 0x8004E29B /end VAR_ADDRESS
 /end VAR_CHARACTERISTIC
 /begin VAR_CHARACTERISTIC TP_S8_EDC_ENTRY_THR1_ABS_S2 EngCalVariantCriterion
  /begin VAR_ADDRESS 0x8003A09C 0x8003AE9C 0x8003BC9C 0x8003CA9C 0x8003D89C 0x8003E69C 0x8003F49C 0x8004029C 0x8004109C 0x80041E9C 0x80042C9C 0x80043A9C 0x8004489C 0x8004569C 0x8004649C 0x8004729C 0x8004809C 0x80048E9C 0x80049C9C 0x8004AA9C 0x8004B89C 0x8004C69C 0x8004D49C 0x8004E29C /end VAR_ADDRESS
 /end VAR_CHARACTERISTIC
 /begin VAR_CHARACTERISTIC TP_S8_EDC_ENTRY_THR1_ABS_S3 EngCalVariantCriterion
  /begin VAR_ADDRESS 0x8003A09D 0x8003AE9D 0x8003BC9D 0x8003CA9D 0x8003D89D 0x8003E69D 0x8003F49D 0x8004029D 0x8004109D 0x80041E9D 0x80042C9D 0x80043A9D 0x8004489D 0x8004569D 0x8004649D 0x8004729D 0x8004809D 0x80048E9D 0x80049C9D 0x8004AA9D 0x8004B89D 0x8004C69D 0x8004D49D 0x8004E29D /end VAR_ADDRESS
 /end VAR_CHARACTERISTIC
 /begin VAR_CHARACTERISTIC TP_S8_EDC_ENTRY_THR1_ABS_S4 EngCalVariantCriterion
  /begin VAR_ADDRESS 0x8003A09E 0x8003AE9E 0x8003BC9E 0x8003CA9E 0x8003D89E 0x8003E69E 0x8003F49E 0x8004029E 0x8004109E 0x80041E9E 0x80042C9E 0x80043A9E 0x8004489E 0x8004569E 0x8004649E 0x8004729E 0x8004809E 0x80048E9E 0x80049C9E 0x8004AA9E 0x8004B89E 0x8004C69E 0x8004D49E 0x8004E29E /end VAR_ADDRESS
 /end VAR_CHARACTERISTIC
 /begin VAR_CHARACTERISTIC TP_S8_EDC_ENTRY_THR1_ESC_S1 EngCalVariantCriterion
  /begin VAR_ADDRESS 0x8003A0A7 0x8003AEA7 0x8003BCA7 0x8003CAA7 0x8003D8A7 0x8003E6A7 0x8003F4A7 0x800402A7 0x800410A7 0x80041EA7 0x80042CA7 0x80043AA7 0x800448A7 0x800456A7 0x800464A7 0x800472A7 0x800480A7 0x80048EA7 0x80049CA7 0x8004AAA7 0x8004B8A7 0x8004C6A7 0x8004D4A7 0x8004E2A7 /end VAR_ADDRESS
 /end VAR_CHARACTERISTIC
 /begin VAR_CHARACTERISTIC TP_S8_EDC_ENTRY_THR1_ESC_S2 EngCalVariantCriterion
  /begin VAR_ADDRESS 0x8003A0A8 0x8003AEA8 0x8003BCA8 0x8003CAA8 0x8003D8A8 0x8003E6A8 0x8003F4A8 0x800402A8 0x800410A8 0x80041EA8 0x80042CA8 0x80043AA8 0x800448A8 0x800456A8 0x800464A8 0x800472A8 0x800480A8 0x80048EA8 0x80049CA8 0x8004AAA8 0x8004B8A8 0x8004C6A8 0x8004D4A8 0x8004E2A8 /end VAR_ADDRESS
 /end VAR_CHARACTERISTIC
 /begin VAR_CHARACTERISTIC TP_S8_EDC_ENTRY_THR1_ESC_S3 EngCalVariantCriterion
  /begin VAR_ADDRESS 0x8003A0A9 0x8003AEA9 0x8003BCA9 0x8003CAA9 0x8003D8A9 0x8003E6A9 0x8003F4A9 0x800402A9 0x800410A9 0x80041EA9 0x80042CA9 0x80043AA9 0x800448A9 0x800456A9 0x800464A9 0x800472A9 0x800480A9 0x80048EA9 0x80049CA9 0x8004AAA9 0x8004B8A9 0x8004C6A9 0x8004D4A9 0x8004E2A9 /end VAR_ADDRESS
 /end VAR_CHARACTERISTIC
 /begin VAR_CHARACTERISTIC TP_S8_EDC_ENTRY_THR1_ESC_S4 EngCalVariantCriterion
  /begin VAR_ADDRESS 0x8003A0AA 0x8003AEAA 0x8003BCAA 0x8003CAAA 0x8003D8AA 0x8003E6AA 0x8003F4AA 0x800402AA 0x800410AA 0x80041EAA 0x80042CAA 0x80043AAA 0x800448AA 0x800456AA 0x800464AA 0x800472AA 0x800480AA 0x80048EAA 0x80049CAA 0x8004AAAA 0x8004B8AA 0x8004C6AA 0x8004D4AA 0x8004E2AA /end VAR_ADDRESS
 /end VAR_CHARACTERISTIC
 /begin VAR_CHARACTERISTIC TP_S8_EDC_ENTRY_THR1_S1 EngCalVariantCriterion
  /begin VAR_ADDRESS 0x8003A08E 0x8003AE8E 0x8003BC8E 0x8003CA8E 0x8003D88E 0x8003E68E 0x8003F48E 0x8004028E 0x8004108E 0x80041E8E 0x80042C8E 0x80043A8E 0x8004488E 0x8004568E 0x8004648E 0x8004728E 0x8004808E 0x80048E8E 0x80049C8E 0x8004AA8E 0x8004B88E 0x8004C68E 0x8004D48E 0x8004E28E /end VAR_ADDRESS
 /end VAR_CHARACTERISTIC
 /begin VAR_CHARACTERISTIC TP_S8_EDC_ENTRY_THR1_S2 EngCalVariantCriterion
  /begin VAR_ADDRESS 0x8003A08F 0x8003AE8F 0x8003BC8F 0x8003CA8F 0x8003D88F 0x8003E68F 0x8003F48F 0x8004028F 0x8004108F 0x80041E8F 0x80042C8F 0x80043A8F 0x8004488F 0x8004568F 0x8004648F 0x8004728F 0x8004808F 0x80048E8F 0x80049C8F 0x8004AA8F 0x8004B88F 0x8004C68F 0x8004D48F 0x8004E28F /end VAR_ADDRESS
 /end VAR_CHARACTERISTIC
 /begin VAR_CHARACTERISTIC TP_S8_EDC_ENTRY_THR1_S3 EngCalVariantCriterion
  /begin VAR_ADDRESS 0x8003A090 0x8003AE90 0x8003BC90 0x8003CA90 0x8003D890 0x8003E690 0x8003F490 0x80040290 0x80041090 0x80041E90 0x80042C90 0x80043A90 0x80044890 0x80045690 0x80046490 0x80047290 0x80048090 0x80048E90 0x80049C90 0x8004AA90 0x8004B890 0x8004C690 0x8004D490 0x8004E290 /end VAR_ADDRESS
 /end VAR_CHARACTERISTIC
 /begin VAR_CHARACTERISTIC TP_S8_EDC_ENTRY_THR1_S4 EngCalVariantCriterion
  /begin VAR_ADDRESS 0x8003A091 0x8003AE91 0x8003BC91 0x8003CA91 0x8003D891 0x8003E691 0x8003F491 0x80040291 0x80041091 0x80041E91 0x80042C91 0x80043A91 0x80044891 0x80045691 0x80046491 0x80047291 0x80048091 0x80048E91 0x80049C91 0x8004AA91 0x8004B891 0x8004C691 0x8004D491 0x8004E291 /end VAR_ADDRESS
 /end VAR_CHARACTERISTIC
 /begin VAR_CHARACTERISTIC TP_S8_EDC_ENTRY_THR2_ABS_S1 EngCalVariantCriterion
  /begin VAR_ADDRESS 0x8003A09F 0x8003AE9F 0x8003BC9F 0x8003CA9F 0x8003D89F 0x8003E69F 0x8003F49F 0x8004029F 0x8004109F 0x80041E9F 0x80042C9F 0x80043A9F 0x8004489F 0x8004569F 0x8004649F 0x8004729F 0x8004809F 0x80048E9F 0x80049C9F 0x8004AA9F 0x8004B89F 0x8004C69F 0x8004D49F 0x8004E29F /end VAR_ADDRESS
 /end VAR_CHARACTERISTIC
 /begin VAR_CHARACTERISTIC TP_S8_EDC_ENTRY_THR2_ABS_S2 EngCalVariantCriterion
  /begin VAR_ADDRESS 0x8003A0A0 0x8003AEA0 0x8003BCA0 0x8003CAA0 0x8003D8A0 0x8003E6A0 0x8003F4A0 0x800402A0 0x800410A0 0x80041EA0 0x80042CA0 0x80043AA0 0x800448A0 0x800456A0 0x800464A0 0x800472A0 0x800480A0 0x80048EA0 0x80049CA0 0x8004AAA0 0x8004B8A0 0x8004C6A0 0x8004D4A0 0x8004E2A0 /end VAR_ADDRESS
 /end VAR_CHARACTERISTIC
 /begin VAR_CHARACTERISTIC TP_S8_EDC_ENTRY_THR2_ABS_S3 EngCalVariantCriterion
  /begin VAR_ADDRESS 0x8003A0A1 0x8003AEA1 0x8003BCA1 0x8003CAA1 0x8003D8A1 0x8003E6A1 0x8003F4A1 0x800402A1 0x800410A1 0x80041EA1 0x80042CA1 0x80043AA1 0x800448A1 0x800456A1 0x800464A1 0x800472A1 0x800480A1 0x80048EA1 0x80049CA1 0x8004AAA1 0x8004B8A1 0x8004C6A1 0x8004D4A1 0x8004E2A1 /end VAR_ADDRESS
 /end VAR_CHARACTERISTIC
 /begin VAR_CHARACTERISTIC TP_S8_EDC_ENTRY_THR2_ABS_S4 EngCalVariantCriterion
  /begin VAR_ADDRESS 0x8003A0A2 0x8003AEA2 0x8003BCA2 0x8003CAA2 0x8003D8A2 0x8003E6A2 0x8003F4A2 0x800402A2 0x800410A2 0x80041EA2 0x80042CA2 0x80043AA2 0x800448A2 0x800456A2 0x800464A2 0x800472A2 0x800480A2 0x80048EA2 0x80049CA2 0x8004AAA2 0x8004B8A2 0x8004C6A2 0x8004D4A2 0x8004E2A2 /end VAR_ADDRESS
 /end VAR_CHARACTERISTIC
 /begin VAR_CHARACTERISTIC TP_S8_EDC_ENTRY_THR2_ESC_S1 EngCalVariantCriterion
  /begin VAR_ADDRESS 0x8003A0AB 0x8003AEAB 0x8003BCAB 0x8003CAAB 0x8003D8AB 0x8003E6AB 0x8003F4AB 0x800402AB 0x800410AB 0x80041EAB 0x80042CAB 0x80043AAB 0x800448AB 0x800456AB 0x800464AB 0x800472AB 0x800480AB 0x80048EAB 0x80049CAB 0x8004AAAB 0x8004B8AB 0x8004C6AB 0x8004D4AB 0x8004E2AB /end VAR_ADDRESS
 /end VAR_CHARACTERISTIC
 /begin VAR_CHARACTERISTIC TP_S8_EDC_ENTRY_THR2_ESC_S2 EngCalVariantCriterion
  /begin VAR_ADDRESS 0x8003A0AC 0x8003AEAC 0x8003BCAC 0x8003CAAC 0x8003D8AC 0x8003E6AC 0x8003F4AC 0x800402AC 0x800410AC 0x80041EAC 0x80042CAC 0x80043AAC 0x800448AC 0x800456AC 0x800464AC 0x800472AC 0x800480AC 0x80048EAC 0x80049CAC 0x8004AAAC 0x8004B8AC 0x8004C6AC 0x8004D4AC 0x8004E2AC /end VAR_ADDRESS
 /end VAR_CHARACTERISTIC
 /begin VAR_CHARACTERISTIC TP_S8_EDC_ENTRY_THR2_ESC_S3 EngCalVariantCriterion
  /begin VAR_ADDRESS 0x8003A0AD 0x8003AEAD 0x8003BCAD 0x8003CAAD 0x8003D8AD 0x8003E6AD 0x8003F4AD 0x800402AD 0x800410AD 0x80041EAD 0x80042CAD 0x80043AAD 0x800448AD 0x800456AD 0x800464AD 0x800472AD 0x800480AD 0x80048EAD 0x80049CAD 0x8004AAAD 0x8004B8AD 0x8004C6AD 0x8004D4AD 0x8004E2AD /end VAR_ADDRESS
 /end VAR_CHARACTERISTIC
 /begin VAR_CHARACTERISTIC TP_S8_EDC_ENTRY_THR2_ESC_S4 EngCalVariantCriterion
  /begin VAR_ADDRESS 0x8003A0AE 0x8003AEAE 0x8003BCAE 0x8003CAAE 0x8003D8AE 0x8003E6AE 0x8003F4AE 0x800402AE 0x800410AE 0x80041EAE 0x80042CAE 0x80043AAE 0x800448AE 0x800456AE 0x800464AE 0x800472AE 0x800480AE 0x80048EAE 0x80049CAE 0x8004AAAE 0x8004B8AE 0x8004C6AE 0x8004D4AE 0x8004E2AE /end VAR_ADDRESS
 /end VAR_CHARACTERISTIC
 /begin VAR_CHARACTERISTIC TP_S8_EDC_ENTRY_THR2_S1 EngCalVariantCriterion
  /begin VAR_ADDRESS 0x8003A092 0x8003AE92 0x8003BC92 0x8003CA92 0x8003D892 0x8003E692 0x8003F492 0x80040292 0x80041092 0x80041E92 0x80042C92 0x80043A92 0x80044892 0x80045692 0x80046492 0x80047292 0x80048092 0x80048E92 0x80049C92 0x8004AA92 0x8004B892 0x8004C692 0x8004D492 0x8004E292 /end VAR_ADDRESS
 /end VAR_CHARACTERISTIC
 /begin VAR_CHARACTERISTIC TP_S8_EDC_ENTRY_THR2_S2 EngCalVariantCriterion
  /begin VAR_ADDRESS 0x8003A093 0x8003AE93 0x8003BC93 0x8003CA93 0x8003D893 0x8003E693 0x8003F493 0x80040293 0x80041093 0x80041E93 0x80042C93 0x80043A93 0x80044893 0x80045693 0x80046493 0x80047293 0x80048093 0x80048E93 0x80049C93 0x8004AA93 0x8004B893 0x8004C693 0x8004D493 0x8004E293 /end VAR_ADDRESS
 /end VAR_CHARACTERISTIC
 /begin VAR_CHARACTERISTIC TP_S8_EDC_ENTRY_THR2_S3 EngCalVariantCriterion
  /begin VAR_ADDRESS 0x8003A094 0x8003AE94 0x8003BC94 0x8003CA94 0x8003D894 0x8003E694 0x8003F494 0x80040294 0x80041094 0x80041E94 0x80042C94 0x80043A94 0x80044894 0x80045694 0x80046494 0x80047294 0x80048094 0x80048E94 0x80049C94 0x8004AA94 0x8004B894 0x8004C694 0x8004D494 0x8004E294 /end VAR_ADDRESS
 /end VAR_CHARACTERISTIC
 /begin VAR_CHARACTERISTIC TP_S8_EDC_ENTRY_THR2_S4 EngCalVariantCriterion
  /begin VAR_ADDRESS 0x8003A095 0x8003AE95 0x8003BC95 0x8003CA95 0x8003D895 0x8003E695 0x8003F495 0x80040295 0x80041095 0x80041E95 0x80042C95 0x80043A95 0x80044895 0x80045695 0x80046495 0x80047295 0x80048095 0x80048E95 0x80049C95 0x8004AA95 0x8004B895 0x8004C695 0x8004D495 0x8004E295 /end VAR_ADDRESS
 /end VAR_CHARACTERISTIC
 /begin VAR_CHARACTERISTIC TP_S8_EDC_ENT_THR_REL_LAM EngCalVariantCriterion
  /begin VAR_ADDRESS 0x8003A0B1 0x8003AEB1 0x8003BCB1 0x8003CAB1 0x8003D8B1 0x8003E6B1 0x8003F4B1 0x800402B1 0x800410B1 0x80041EB1 0x80042CB1 0x80043AB1 0x800448B1 0x800456B1 0x800464B1 0x800472B1 0x800480B1 0x80048EB1 0x80049CB1 0x8004AAB1 0x8004B8B1 0x8004C6B1 0x8004D4B1 0x8004E2B1 /end VAR_ADDRESS
 /end VAR_CHARACTERISTIC
 /begin VAR_CHARACTERISTIC TP_S8_EDC_ENT_THR_REL_LAM_AT_B_DCT EngCalVariantCriterion
  /begin VAR_ADDRESS 0x8003A0B2 0x8003AEB2 0x8003BCB2 0x8003CAB2 0x8003D8B2 0x8003E6B2 0x8003F4B2 0x800402B2 0x800410B2 0x80041EB2 0x80042CB2 0x80043AB2 0x800448B2 0x800456B2 0x800464B2 0x800472B2 0x800480B2 0x80048EB2 0x80049CB2 0x8004AAB2 0x8004B8B2 0x8004C6B2 0x8004D4B2 0x8004E2B2 /end VAR_ADDRESS
 /end VAR_CHARACTERISTIC
 /begin VAR_CHARACTERISTIC TP_S8_EDC_EXIT_RELLAM_THR EngCalVariantCriterion
  /begin VAR_ADDRESS 0x8003A0B3 0x8003AEB3 0x8003BCB3 0x8003CAB3 0x8003D8B3 0x8003E6B3 0x8003F4B3 0x800402B3 0x800410B3 0x80041EB3 0x80042CB3 0x80043AB3 0x800448B3 0x800456B3 0x800464B3 0x800472B3 0x800480B3 0x80048EB3 0x80049CB3 0x8004AAB3 0x8004B8B3 0x8004C6B3 0x8004D4B3 0x8004E2B3 /end VAR_ADDRESS
 /end VAR_CHARACTERISTIC
 /begin VAR_CHARACTERISTIC TP_S8_EDC_EXIT_RELLAM_THR_3G0 EngCalVariantCriterion
  /begin VAR_ADDRESS 0x8003A0B4 0x8003AEB4 0x8003BCB4 0x8003CAB4 0x8003D8B4 0x8003E6B4 0x8003F4B4 0x800402B4 0x800410B4 0x80041EB4 0x80042CB4 0x80043AB4 0x800448B4 0x800456B4 0x800464B4 0x800472B4 0x800480B4 0x80048EB4 0x80049CB4 0x8004AAB4 0x8004B8B4 0x8004C6B4 0x8004D4B4 0x8004E2B4 /end VAR_ADDRESS
 /end VAR_CHARACTERISTIC
 /begin VAR_CHARACTERISTIC TP_S8_EDC_EXIT_SPEED_THR EngCalVariantCriterion
  /begin VAR_ADDRESS 0x8003A0B5 0x8003AEB5 0x8003BCB5 0x8003CAB5 0x8003D8B5 0x8003E6B5 0x8003F4B5 0x800402B5 0x800410B5 0x80041EB5 0x80042CB5 0x80043AB5 0x800448B5 0x800456B5 0x800464B5 0x800472B5 0x800480B5 0x80048EB5 0x80049CB5 0x8004AAB5 0x8004B8B5 0x8004C6B5 0x8004D4B5 0x8004E2B5 /end VAR_ADDRESS
 /end VAR_CHARACTERISTIC
 /begin VAR_CHARACTERISTIC TP_S8_EDC_EXIT_SPEED_THR_3G0 EngCalVariantCriterion
  /begin VAR_ADDRESS 0x8003A0B6 0x8003AEB6 0x8003BCB6 0x8003CAB6 0x8003D8B6 0x8003E6B6 0x8003F4B6 0x800402B6 0x800410B6 0x80041EB6 0x80042CB6 0x80043AB6 0x800448B6 0x800456B6 0x800464B6 0x800472B6 0x800480B6 0x80048EB6 0x80049CB6 0x8004AAB6 0x8004B8B6 0x8004C6B6 0x8004D4B6 0x8004E2B6 /end VAR_ADDRESS
 /end VAR_CHARACTERISTIC
 /begin VAR_CHARACTERISTIC TP_S8_EDC_GSD_AVG_WHL_SLIP_DIFF_THR EngCalVariantCriterion
  /begin VAR_ADDRESS 0x8003A165 0x8003AF65 0x8003BD65 0x8003CB65 0x8003D965 0x8003E765 0x8003F565 0x80040365 0x80041165 0x80041F65 0x80042D65 0x80043B65 0x80044965 0x80045765 0x80046565 0x80047365 0x80048165 0x80048F65 0x80049D65 0x8004AB65 0x8004B965 0x8004C765 0x8004D565 0x8004E365 /end VAR_ADDRESS
 /end VAR_CHARACTERISTIC
 /begin VAR_CHARACTERISTIC TP_S8_EDC_GSD_ENTRY_CNT EngCalVariantCriterion
  /begin VAR_ADDRESS 0x8003A166 0x8003AF66 0x8003BD66 0x8003CB66 0x8003D966 0x8003E766 0x8003F566 0x80040366 0x80041166 0x80041F66 0x80042D66 0x80043B66 0x80044966 0x80045766 0x80046566 0x80047366 0x80048166 0x80048F66 0x80049D66 0x8004AB66 0x8004B966 0x8004C766 0x8004D566 0x8004E366 /end VAR_ADDRESS
 /end VAR_CHARACTERISTIC
 /begin VAR_CHARACTERISTIC TP_S8_EDC_GSD_ENTRY_WHL_SLIP EngCalVariantCriterion
  /begin VAR_ADDRESS 0x8003A167 0x8003AF67 0x8003BD67 0x8003CB67 0x8003D967 0x8003E767 0x8003F567 0x80040367 0x80041167 0x80041F67 0x80042D67 0x80043B67 0x80044967 0x80045767 0x80046567 0x80047367 0x80048167 0x80048F67 0x80049D67 0x8004AB67 0x8004B967 0x8004C767 0x8004D567 0x8004E367 /end VAR_ADDRESS
 /end VAR_CHARACTERISTIC
 /begin VAR_CHARACTERISTIC TP_S8_EDC_GSD_EXIT_WHL_SLIP EngCalVariantCriterion
  /begin VAR_ADDRESS 0x8003A168 0x8003AF68 0x8003BD68 0x8003CB68 0x8003D968 0x8003E768 0x8003F568 0x80040368 0x80041168 0x80041F68 0x80042D68 0x80043B68 0x80044968 0x80045768 0x80046568 0x80047368 0x80048168 0x80048F68 0x80049D68 0x8004AB68 0x8004B968 0x8004C768 0x8004D568 0x8004E368 /end VAR_ADDRESS
 /end VAR_CHARACTERISTIC
 /begin VAR_CHARACTERISTIC TP_S8_EDC_GSD_SLOPE_ENG_RPM_THR EngCalVariantCriterion
  /begin VAR_ADDRESS 0x8003A169 0x8003AF69 0x8003BD69 0x8003CB69 0x8003D969 0x8003E769 0x8003F569 0x80040369 0x80041169 0x80041F69 0x80042D69 0x80043B69 0x80044969 0x80045769 0x80046569 0x80047369 0x80048169 0x80048F69 0x80049D69 0x8004AB69 0x8004B969 0x8004C769 0x8004D569 0x8004E369 /end VAR_ADDRESS
 /end VAR_CHARACTERISTIC
 /begin VAR_CHARACTERISTIC TP_S8_EDC_PARKING_SUSPECT_LIMIT EngCalVariantCriterion
  /begin VAR_ADDRESS 0x8003A154 0x8003AF54 0x8003BD54 0x8003CB54 0x8003D954 0x8003E754 0x8003F554 0x80040354 0x80041154 0x80041F54 0x80042D54 0x80043B54 0x80044954 0x80045754 0x80046554 0x80047354 0x80048154 0x80048F54 0x80049D54 0x8004AB54 0x8004B954 0x8004C754 0x8004D554 0x8004E354 /end VAR_ADDRESS
 /end VAR_CHARACTERISTIC
 /begin VAR_CHARACTERISTIC TP_S8_EDC_TARGET_DELTA_V_ABS_S1 EngCalVariantCriterion
  /begin VAR_ADDRESS 0x8003A0BB 0x8003AEBB 0x8003BCBB 0x8003CABB 0x8003D8BB 0x8003E6BB 0x8003F4BB 0x800402BB 0x800410BB 0x80041EBB 0x80042CBB 0x80043ABB 0x800448BB 0x800456BB 0x800464BB 0x800472BB 0x800480BB 0x80048EBB 0x80049CBB 0x8004AABB 0x8004B8BB 0x8004C6BB 0x8004D4BB 0x8004E2BB /end VAR_ADDRESS
 /end VAR_CHARACTERISTIC
 /begin VAR_CHARACTERISTIC TP_S8_EDC_TARGET_DELTA_V_ABS_S2 EngCalVariantCriterion
  /begin VAR_ADDRESS 0x8003A0BC 0x8003AEBC 0x8003BCBC 0x8003CABC 0x8003D8BC 0x8003E6BC 0x8003F4BC 0x800402BC 0x800410BC 0x80041EBC 0x80042CBC 0x80043ABC 0x800448BC 0x800456BC 0x800464BC 0x800472BC 0x800480BC 0x80048EBC 0x80049CBC 0x8004AABC 0x8004B8BC 0x8004C6BC 0x8004D4BC 0x8004E2BC /end VAR_ADDRESS
 /end VAR_CHARACTERISTIC
 /begin VAR_CHARACTERISTIC TP_S8_EDC_TARGET_DELTA_V_ABS_S3 EngCalVariantCriterion
  /begin VAR_ADDRESS 0x8003A0BD 0x8003AEBD 0x8003BCBD 0x8003CABD 0x8003D8BD 0x8003E6BD 0x8003F4BD 0x800402BD 0x800410BD 0x80041EBD 0x80042CBD 0x80043ABD 0x800448BD 0x800456BD 0x800464BD 0x800472BD 0x800480BD 0x80048EBD 0x80049CBD 0x8004AABD 0x8004B8BD 0x8004C6BD 0x8004D4BD 0x8004E2BD /end VAR_ADDRESS
 /end VAR_CHARACTERISTIC
 /begin VAR_CHARACTERISTIC TP_S8_EDC_TARGET_DELTA_V_ABS_S4 EngCalVariantCriterion
  /begin VAR_ADDRESS 0x8003A0BE 0x8003AEBE 0x8003BCBE 0x8003CABE 0x8003D8BE 0x8003E6BE 0x8003F4BE 0x800402BE 0x800410BE 0x80041EBE 0x80042CBE 0x80043ABE 0x800448BE 0x800456BE 0x800464BE 0x800472BE 0x800480BE 0x80048EBE 0x80049CBE 0x8004AABE 0x8004B8BE 0x8004C6BE 0x8004D4BE 0x8004E2BE /end VAR_ADDRESS
 /end VAR_CHARACTERISTIC
 /begin VAR_CHARACTERISTIC TP_S8_EDC_TARGET_DELTA_V_ESC_S1 EngCalVariantCriterion
  /begin VAR_ADDRESS 0x8003A0BF 0x8003AEBF 0x8003BCBF 0x8003CABF 0x8003D8BF 0x8003E6BF 0x8003F4BF 0x800402BF 0x800410BF 0x80041EBF 0x80042CBF 0x80043ABF 0x800448BF 0x800456BF 0x800464BF 0x800472BF 0x800480BF 0x80048EBF 0x80049CBF 0x8004AABF 0x8004B8BF 0x8004C6BF 0x8004D4BF 0x8004E2BF /end VAR_ADDRESS
 /end VAR_CHARACTERISTIC
 /begin VAR_CHARACTERISTIC TP_S8_EDC_TARGET_DELTA_V_ESC_S2 EngCalVariantCriterion
  /begin VAR_ADDRESS 0x8003A0C0 0x8003AEC0 0x8003BCC0 0x8003CAC0 0x8003D8C0 0x8003E6C0 0x8003F4C0 0x800402C0 0x800410C0 0x80041EC0 0x80042CC0 0x80043AC0 0x800448C0 0x800456C0 0x800464C0 0x800472C0 0x800480C0 0x80048EC0 0x80049CC0 0x8004AAC0 0x8004B8C0 0x8004C6C0 0x8004D4C0 0x8004E2C0 /end VAR_ADDRESS
 /end VAR_CHARACTERISTIC
 /begin VAR_CHARACTERISTIC TP_S8_EDC_TARGET_DELTA_V_ESC_S3 EngCalVariantCriterion
  /begin VAR_ADDRESS 0x8003A0C1 0x8003AEC1 0x8003BCC1 0x8003CAC1 0x8003D8C1 0x8003E6C1 0x8003F4C1 0x800402C1 0x800410C1 0x80041EC1 0x80042CC1 0x80043AC1 0x800448C1 0x800456C1 0x800464C1 0x800472C1 0x800480C1 0x80048EC1 0x80049CC1 0x8004AAC1 0x8004B8C1 0x8004C6C1 0x8004D4C1 0x8004E2C1 /end VAR_ADDRESS
 /end VAR_CHARACTERISTIC
 /begin VAR_CHARACTERISTIC TP_S8_EDC_TARGET_DELTA_V_ESC_S4 EngCalVariantCriterion
  /begin VAR_ADDRESS 0x8003A0C2 0x8003AEC2 0x8003BCC2 0x8003CAC2 0x8003D8C2 0x8003E6C2 0x8003F4C2 0x800402C2 0x800410C2 0x80041EC2 0x80042CC2 0x80043AC2 0x800448C2 0x800456C2 0x800464C2 0x800472C2 0x800480C2 0x80048EC2 0x80049CC2 0x8004AAC2 0x8004B8C2 0x8004C6C2 0x8004D4C2 0x8004E2C2 /end VAR_ADDRESS
 /end VAR_CHARACTERISTIC
 /begin VAR_CHARACTERISTIC TP_S8_EDC_TARGET_DELTA_V_S1 EngCalVariantCriterion
  /begin VAR_ADDRESS 0x8003A0B7 0x8003AEB7 0x8003BCB7 0x8003CAB7 0x8003D8B7 0x8003E6B7 0x8003F4B7 0x800402B7 0x800410B7 0x80041EB7 0x80042CB7 0x80043AB7 0x800448B7 0x800456B7 0x800464B7 0x800472B7 0x800480B7 0x80048EB7 0x80049CB7 0x8004AAB7 0x8004B8B7 0x8004C6B7 0x8004D4B7 0x8004E2B7 /end VAR_ADDRESS
 /end VAR_CHARACTERISTIC
 /begin VAR_CHARACTERISTIC TP_S8_EDC_TARGET_DELTA_V_S2 EngCalVariantCriterion
  /begin VAR_ADDRESS 0x8003A0B8 0x8003AEB8 0x8003BCB8 0x8003CAB8 0x8003D8B8 0x8003E6B8 0x8003F4B8 0x800402B8 0x800410B8 0x80041EB8 0x80042CB8 0x80043AB8 0x800448B8 0x800456B8 0x800464B8 0x800472B8 0x800480B8 0x80048EB8 0x80049CB8 0x8004AAB8 0x8004B8B8 0x8004C6B8 0x8004D4B8 0x8004E2B8 /end VAR_ADDRESS
 /end VAR_CHARACTERISTIC
 /begin VAR_CHARACTERISTIC TP_S8_EDC_TARGET_DELTA_V_S3 EngCalVariantCriterion
  /begin VAR_ADDRESS 0x8003A0B9 0x8003AEB9 0x8003BCB9 0x8003CAB9 0x8003D8B9 0x8003E6B9 0x8003F4B9 0x800402B9 0x800410B9 0x80041EB9 0x80042CB9 0x80043AB9 0x800448B9 0x800456B9 0x800464B9 0x800472B9 0x800480B9 0x80048EB9 0x80049CB9 0x8004AAB9 0x8004B8B9 0x8004C6B9 0x8004D4B9 0x8004E2B9 /end VAR_ADDRESS
 /end VAR_CHARACTERISTIC
 /begin VAR_CHARACTERISTIC TP_S8_EDC_TARGET_DELTA_V_S4 EngCalVariantCriterion
  /begin VAR_ADDRESS 0x8003A0BA 0x8003AEBA 0x8003BCBA 0x8003CABA 0x8003D8BA 0x8003E6BA 0x8003F4BA 0x800402BA 0x800410BA 0x80041EBA 0x80042CBA 0x80043ABA 0x800448BA 0x800456BA 0x800464BA 0x800472BA 0x800480BA 0x80048EBA 0x80049CBA 0x8004AABA 0x8004B8BA 0x8004C6BA 0x8004D4BA 0x8004E2BA /end VAR_ADDRESS
 /end VAR_CHARACTERISTIC
 /begin VAR_CHARACTERISTIC TP_S8_FORCED_HLD_SLIP_CHMU_A80KPH_F BrkCalVariantCriterion
  /begin VAR_ADDRESS 0x80020611 0x80023A11 0x80026E11 0x8002A211 0x8002D611 0x80030A11 0x80033E11 0x80037211 /end VAR_ADDRESS
 /end VAR_CHARACTERISTIC
 /begin VAR_CHARACTERISTIC TP_S8_FORCED_HLD_SLIP_CHMU_B40KPH_F BrkCalVariantCriterion
  /begin VAR_ADDRESS 0x80020612 0x80023A12 0x80026E12 0x8002A212 0x8002D612 0x80030A12 0x80033E12 0x80037212 /end VAR_ADDRESS
 /end VAR_CHARACTERISTIC
 /begin VAR_CHARACTERISTIC TP_S8_FORCED_HLD_SLIP_CHMU_B80KPH_F BrkCalVariantCriterion
  /begin VAR_ADDRESS 0x80020613 0x80023A13 0x80026E13 0x8002A213 0x8002D613 0x80030A13 0x80033E13 0x80037213 /end VAR_ADDRESS
 /end VAR_CHARACTERISTIC
 /begin VAR_CHARACTERISTIC TP_S8_FORCED_HOLD_SLIP_BFAFZOK_F BrkCalVariantCriterion
  /begin VAR_ADDRESS 0x80020606 0x80023A06 0x80026E06 0x8002A206 0x8002D606 0x80030A06 0x80033E06 0x80037206 /end VAR_ADDRESS
 /end VAR_CHARACTERISTIC
 /begin VAR_CHARACTERISTIC TP_S8_FORCED_HOLD_SLIP_BFAFZOK_R BrkCalVariantCriterion
  /begin VAR_ADDRESS 0x80020607 0x80023A07 0x80026E07 0x8002A207 0x8002D607 0x80030A07 0x80033E07 0x80037207 /end VAR_ADDRESS
 /end VAR_CHARACTERISTIC
 /begin VAR_CHARACTERISTIC TP_S8_FORCED_HOLD_SLIP_HIGH_F BrkCalVariantCriterion
  /begin VAR_ADDRESS 0x80020608 0x80023A08 0x80026E08 0x8002A208 0x8002D608 0x80030A08 0x80033E08 0x80037208 /end VAR_ADDRESS
 /end VAR_CHARACTERISTIC
 /begin VAR_CHARACTERISTIC TP_S8_FORCED_HOLD_SLIP_HIGH_R BrkCalVariantCriterion
  /begin VAR_ADDRESS 0x80020609 0x80023A09 0x80026E09 0x8002A209 0x8002D609 0x80030A09 0x80033E09 0x80037209 /end VAR_ADDRESS
 /end VAR_CHARACTERISTIC
 /begin VAR_CHARACTERISTIC TP_S8_FORCED_HOLD_SLIP_LOW_F BrkCalVariantCriterion
  /begin VAR_ADDRESS 0x8002060A 0x80023A0A 0x80026E0A 0x8002A20A 0x8002D60A 0x80030A0A 0x80033E0A 0x8003720A /end VAR_ADDRESS
 /end VAR_CHARACTERISTIC
 /begin VAR_CHARACTERISTIC TP_S8_FORCED_HOLD_SLIP_LOW_R BrkCalVariantCriterion
  /begin VAR_ADDRESS 0x8002060B 0x80023A0B 0x80026E0B 0x8002A20B 0x8002D60B 0x80030A0B 0x80033E0B 0x8003720B /end VAR_ADDRESS
 /end VAR_CHARACTERISTIC
 /begin VAR_CHARACTERISTIC TP_S8_FORCED_HOLD_SLIP_MED_F BrkCalVariantCriterion
  /begin VAR_ADDRESS 0x8002060C 0x80023A0C 0x80026E0C 0x8002A20C 0x8002D60C 0x80030A0C 0x80033E0C 0x8003720C /end VAR_ADDRESS
 /end VAR_CHARACTERISTIC
 /begin VAR_CHARACTERISTIC TP_S8_FORCED_HOLD_SLIP_MED_R BrkCalVariantCriterion
  /begin VAR_ADDRESS 0x8002060D 0x80023A0D 0x80026E0D 0x8002A20D 0x8002D60D 0x80030A0D 0x80033E0D 0x8003720D /end VAR_ADDRESS
 /end VAR_CHARACTERISTIC
 /begin VAR_CHARACTERISTIC TP_S8_FORCED_HOLD_SLIP_SP_HIGH_F BrkCalVariantCriterion
  /begin VAR_ADDRESS 0x8002060E 0x80023A0E 0x80026E0E 0x8002A20E 0x8002D60E 0x80030A0E 0x80033E0E 0x8003720E /end VAR_ADDRESS
 /end VAR_CHARACTERISTIC
 /begin VAR_CHARACTERISTIC TP_S8_F_WL_Fact_ASum1G_Slip0_2P BrkCalVariantCriterion
  /begin VAR_ADDRESS 0x800206B6 0x80023AB6 0x80026EB6 0x8002A2B6 0x8002D6B6 0x80030AB6 0x80033EB6 0x800372B6 /end VAR_ADDRESS
 /end VAR_CHARACTERISTIC
 /begin VAR_CHARACTERISTIC TP_S8_F_WL_Fact_ASum1G_Slip2_5P BrkCalVariantCriterion
  /begin VAR_ADDRESS 0x800206B9 0x80023AB9 0x80026EB9 0x8002A2B9 0x8002D6B9 0x80030AB9 0x80033EB9 0x800372B9 /end VAR_ADDRESS
 /end VAR_CHARACTERISTIC
 /begin VAR_CHARACTERISTIC TP_S8_F_WL_Fact_ASum1G_SlipAb5P BrkCalVariantCriterion
  /begin VAR_ADDRESS 0x800206BC 0x80023ABC 0x80026EBC 0x8002A2BC 0x8002D6BC 0x80030ABC 0x80033EBC 0x800372BC /end VAR_ADDRESS
 /end VAR_CHARACTERISTIC
 /begin VAR_CHARACTERISTIC TP_S8_F_WL_Fact_ASum1G_SlipPos BrkCalVariantCriterion
  /begin VAR_ADDRESS 0x800206B3 0x80023AB3 0x80026EB3 0x8002A2B3 0x8002D6B3 0x80030AB3 0x80033EB3 0x800372B3 /end VAR_ADDRESS
 /end VAR_CHARACTERISTIC
 /begin VAR_CHARACTERISTIC TP_S8_F_WL_Fact_ASum3G_Slip0_2P BrkCalVariantCriterion
  /begin VAR_ADDRESS 0x800206B7 0x80023AB7 0x80026EB7 0x8002A2B7 0x8002D6B7 0x80030AB7 0x80033EB7 0x800372B7 /end VAR_ADDRESS
 /end VAR_CHARACTERISTIC
 /begin VAR_CHARACTERISTIC TP_S8_F_WL_Fact_ASum3G_Slip2_5P BrkCalVariantCriterion
  /begin VAR_ADDRESS 0x800206BA 0x80023ABA 0x80026EBA 0x8002A2BA 0x8002D6BA 0x80030ABA 0x80033EBA 0x800372BA /end VAR_ADDRESS
 /end VAR_CHARACTERISTIC
 /begin VAR_CHARACTERISTIC TP_S8_F_WL_Fact_ASum3G_SlipAb5P BrkCalVariantCriterion
  /begin VAR_ADDRESS 0x800206BD 0x80023ABD 0x80026EBD 0x8002A2BD 0x8002D6BD 0x80030ABD 0x80033EBD 0x800372BD /end VAR_ADDRESS
 /end VAR_CHARACTERISTIC
 /begin VAR_CHARACTERISTIC TP_S8_F_WL_Fact_ASum3G_SlipPos BrkCalVariantCriterion
  /begin VAR_ADDRESS 0x800206B4 0x80023AB4 0x80026EB4 0x8002A2B4 0x8002D6B4 0x80030AB4 0x80033EB4 0x800372B4 /end VAR_ADDRESS
 /end VAR_CHARACTERISTIC
 /begin VAR_CHARACTERISTIC TP_S8_F_WL_Fact_ASumAb3G_Slip0_2P BrkCalVariantCriterion
  /begin VAR_ADDRESS 0x800206B8 0x80023AB8 0x80026EB8 0x8002A2B8 0x8002D6B8 0x80030AB8 0x80033EB8 0x800372B8 /end VAR_ADDRESS
 /end VAR_CHARACTERISTIC
 /begin VAR_CHARACTERISTIC TP_S8_F_WL_Fact_ASumAb3G_Slip2_5P BrkCalVariantCriterion
  /begin VAR_ADDRESS 0x800206BB 0x80023ABB 0x80026EBB 0x8002A2BB 0x8002D6BB 0x80030ABB 0x80033EBB 0x800372BB /end VAR_ADDRESS
 /end VAR_CHARACTERISTIC
 /begin VAR_CHARACTERISTIC TP_S8_F_WL_Fact_ASumAb3G_SlipAb5P BrkCalVariantCriterion
  /begin VAR_ADDRESS 0x800206BE 0x80023ABE 0x80026EBE 0x8002A2BE 0x8002D6BE 0x80030ABE 0x80033EBE 0x800372BE /end VAR_ADDRESS
 /end VAR_CHARACTERISTIC
 /begin VAR_CHARACTERISTIC TP_S8_F_WL_Fact_ASumAb3G_SlipPos BrkCalVariantCriterion
  /begin VAR_ADDRESS 0x800206B5 0x80023AB5 0x80026EB5 0x8002A2B5 0x8002D6B5 0x80030AB5 0x80033EB5 0x800372B5 /end VAR_ADDRESS
 /end VAR_CHARACTERISTIC
 /begin VAR_CHARACTERISTIC TP_S8_GMA_DCT_SLIP_DIFF_0_50KPH BrkCalVariantCriterion
  /begin VAR_ADDRESS 0x800205FE 0x800239FE 0x80026DFE 0x8002A1FE 0x8002D5FE 0x800309FE 0x80033DFE 0x800371FE /end VAR_ADDRESS
 /end VAR_CHARACTERISTIC
 /begin VAR_CHARACTERISTIC TP_S8_GMA_DCT_SLIP_DIFF_0_50_BABS BrkCalVariantCriterion
  /begin VAR_ADDRESS 0x800205F2 0x800239F2 0x80026DF2 0x8002A1F2 0x8002D5F2 0x800309F2 0x80033DF2 0x800371F2 /end VAR_ADDRESS
 /end VAR_CHARACTERISTIC
 /begin VAR_CHARACTERISTIC TP_S8_GMA_DCT_SLIP_DIFF_50_70KPH BrkCalVariantCriterion
  /begin VAR_ADDRESS 0x800205FF 0x800239FF 0x80026DFF 0x8002A1FF 0x8002D5FF 0x800309FF 0x80033DFF 0x800371FF /end VAR_ADDRESS
 /end VAR_CHARACTERISTIC
 /begin VAR_CHARACTERISTIC TP_S8_GMA_DCT_SLIP_DIFF_50_80_BABS BrkCalVariantCriterion
  /begin VAR_ADDRESS 0x800205F3 0x800239F3 0x80026DF3 0x8002A1F3 0x8002D5F3 0x800309F3 0x80033DF3 0x800371F3 /end VAR_ADDRESS
 /end VAR_CHARACTERISTIC
 /begin VAR_CHARACTERISTIC TP_S8_GMA_DCT_SLIP_DIFF_70_90KPH BrkCalVariantCriterion
  /begin VAR_ADDRESS 0x80020600 0x80023A00 0x80026E00 0x8002A200 0x8002D600 0x80030A00 0x80033E00 0x80037200 /end VAR_ADDRESS
 /end VAR_CHARACTERISTIC
 /begin VAR_CHARACTERISTIC TP_S8_GMA_DCT_SLIP_DIFF_80_M_BABS BrkCalVariantCriterion
  /begin VAR_ADDRESS 0x800205F4 0x800239F4 0x80026DF4 0x8002A1F4 0x8002D5F4 0x800309F4 0x80033DF4 0x800371F4 /end VAR_ADDRESS
 /end VAR_CHARACTERISTIC
 /begin VAR_CHARACTERISTIC TP_S8_GMA_DCT_SLIP_DIFF_90_M_KPH BrkCalVariantCriterion
  /begin VAR_ADDRESS 0x80020601 0x80023A01 0x80026E01 0x8002A201 0x8002D601 0x80030A01 0x80033E01 0x80037201 /end VAR_ADDRESS
 /end VAR_CHARACTERISTIC
 /begin VAR_CHARACTERISTIC TP_S8_GMA_RiseTime_H_SPEED_PHASE1 BrkCalVariantCriterion
  /begin VAR_ADDRESS 0x800202A2 0x800236A2 0x80026AA2 0x80029EA2 0x8002D2A2 0x800306A2 0x80033AA2 0x80036EA2 /end VAR_ADDRESS
 /end VAR_CHARACTERISTIC
 /begin VAR_CHARACTERISTIC TP_S8_GMA_RiseTime_H_SPEED_PHASE2 BrkCalVariantCriterion
  /begin VAR_ADDRESS 0x800202A3 0x800236A3 0x80026AA3 0x80029EA3 0x8002D2A3 0x800306A3 0x80033AA3 0x80036EA3 /end VAR_ADDRESS
 /end VAR_CHARACTERISTIC
 /begin VAR_CHARACTERISTIC TP_S8_GMA_RiseTime_H_SPEED_PHASE3 BrkCalVariantCriterion
  /begin VAR_ADDRESS 0x800202A4 0x800236A4 0x80026AA4 0x80029EA4 0x8002D2A4 0x800306A4 0x80033AA4 0x80036EA4 /end VAR_ADDRESS
 /end VAR_CHARACTERISTIC
 /begin VAR_CHARACTERISTIC TP_S8_GMA_RiseTime_ML_SPEED_PHASE1 BrkCalVariantCriterion
  /begin VAR_ADDRESS 0x800202A5 0x800236A5 0x80026AA5 0x80029EA5 0x8002D2A5 0x800306A5 0x80033AA5 0x80036EA5 /end VAR_ADDRESS
 /end VAR_CHARACTERISTIC
 /begin VAR_CHARACTERISTIC TP_S8_GMA_RiseTime_ML_SPEED_PHASE2 BrkCalVariantCriterion
  /begin VAR_ADDRESS 0x800202A6 0x800236A6 0x80026AA6 0x80029EA6 0x8002D2A6 0x800306A6 0x80033AA6 0x80036EA6 /end VAR_ADDRESS
 /end VAR_CHARACTERISTIC
 /begin VAR_CHARACTERISTIC TP_S8_GMA_RiseTime_ML_SPEED_PHASE3 BrkCalVariantCriterion
  /begin VAR_ADDRESS 0x800202A7 0x800236A7 0x80026AA7 0x80029EA7 0x8002D2A7 0x800306A7 0x80033AA7 0x80036EA7 /end VAR_ADDRESS
 /end VAR_CHARACTERISTIC
 /begin VAR_CHARACTERISTIC TP_S8_H2SP_DETECT_FRONT_DECEL1 BrkCalVariantCriterion
  /begin VAR_ADDRESS 0x800205A2 0x800239A2 0x80026DA2 0x8002A1A2 0x8002D5A2 0x800309A2 0x80033DA2 0x800371A2 /end VAR_ADDRESS
 /end VAR_CHARACTERISTIC
 /begin VAR_CHARACTERISTIC TP_S8_H2SP_DETECT_FRONT_DECEL2 BrkCalVariantCriterion
  /begin VAR_ADDRESS 0x800205A3 0x800239A3 0x80026DA3 0x8002A1A3 0x8002D5A3 0x800309A3 0x80033DA3 0x800371A3 /end VAR_ADDRESS
 /end VAR_CHARACTERISTIC
 /begin VAR_CHARACTERISTIC TP_S8_HOMO_dYAW_ABS_GAIN BrkCalVariantCriterion
  /begin VAR_ADDRESS 0x800204F8 0x800238F8 0x80026CF8 0x8002A0F8 0x8002D4F8 0x800308F8 0x80033CF8 0x800370F8 /end VAR_ADDRESS
 /end VAR_CHARACTERISTIC
 /begin VAR_CHARACTERISTIC TP_S8_HOMO_dYAW_DOT_ABS_GAIN BrkCalVariantCriterion
  /begin VAR_ADDRESS 0x800204F9 0x800238F9 0x80026CF9 0x8002A0F9 0x8002D4F9 0x800308F9 0x80033CF9 0x800370F9 /end VAR_ADDRESS
 /end VAR_CHARACTERISTIC
 /begin VAR_CHARACTERISTIC TP_S8_H_to_Split_Detection_AFZ BrkCalVariantCriterion
  /begin VAR_ADDRESS 0x800205A4 0x800239A4 0x80026DA4 0x8002A1A4 0x8002D5A4 0x800309A4 0x80033DA4 0x800371A4 /end VAR_ADDRESS
 /end VAR_CHARACTERISTIC
 /begin VAR_CHARACTERISTIC TP_S8_H_to_Split_Dump_Diff BrkCalVariantCriterion
  /begin VAR_ADDRESS 0x800205A5 0x800239A5 0x80026DA5 0x8002A1A5 0x8002D5A5 0x800309A5 0x80033DA5 0x800371A5 /end VAR_ADDRESS
 /end VAR_CHARACTERISTIC
 /begin VAR_CHARACTERISTIC TP_S8_IN_GEAR_Vib_Detect_arad1 BrkCalVariantCriterion
  /begin VAR_ADDRESS 0x800202DC 0x800236DC 0x80026ADC 0x80029EDC 0x8002D2DC 0x800306DC 0x80033ADC 0x80036EDC /end VAR_ADDRESS
 /end VAR_CHARACTERISTIC
 /begin VAR_CHARACTERISTIC TP_S8_IN_GEAR_Vib_Detect_arad2 BrkCalVariantCriterion
  /begin VAR_ADDRESS 0x800202DD 0x800236DD 0x80026ADD 0x80029EDD 0x8002D2DD 0x800306DD 0x80033ADD 0x80036EDD /end VAR_ADDRESS
 /end VAR_CHARACTERISTIC
 /begin VAR_CHARACTERISTIC TP_S8_L1_LOWSIDE_PEAK_DEC BrkCalVariantCriterion
  /begin VAR_ADDRESS 0x80020666 0x80023A66 0x80026E66 0x8002A266 0x8002D666 0x80030A66 0x80033E66 0x80037266 /end VAR_ADDRESS
 /end VAR_CHARACTERISTIC
 /begin VAR_CHARACTERISTIC TP_S8_L1_SLIP_DIFF_50_80 BrkCalVariantCriterion
  /begin VAR_ADDRESS 0x80020667 0x80023A67 0x80026E67 0x8002A267 0x8002D667 0x80030A67 0x80033E67 0x80037267 /end VAR_ADDRESS
 /end VAR_CHARACTERISTIC
 /begin VAR_CHARACTERISTIC TP_S8_L1_SLIP_DIFF_80_M BrkCalVariantCriterion
  /begin VAR_ADDRESS 0x80020668 0x80023A68 0x80026E68 0x8002A268 0x8002D668 0x80030A68 0x80033E68 0x80037268 /end VAR_ADDRESS
 /end VAR_CHARACTERISTIC
 /begin VAR_CHARACTERISTIC TP_S8_L2H_DCT_WPRESS_MIN_TIME BrkCalVariantCriterion
  /begin VAR_ADDRESS 0x80020657 0x80023A57 0x80026E57 0x8002A257 0x8002D657 0x80030A57 0x80033E57 0x80037257 /end VAR_ADDRESS
 /end VAR_CHARACTERISTIC
 /begin VAR_CHARACTERISTIC TP_S8_L2H_STABLE_THR_SLIP_F BrkCalVariantCriterion
  /begin VAR_ADDRESS 0x80020638 0x80023A38 0x80026E38 0x8002A238 0x8002D638 0x80030A38 0x80033E38 0x80037238 /end VAR_ADDRESS
 /end VAR_CHARACTERISTIC
 /begin VAR_CHARACTERISTIC TP_S8_L2H_STABLE_THR_SLIP_F_OPP BrkCalVariantCriterion
  /begin VAR_ADDRESS 0x80020639 0x80023A39 0x80026E39 0x8002A239 0x8002D639 0x80030A39 0x80033E39 0x80037239 /end VAR_ADDRESS
 /end VAR_CHARACTERISTIC
 /begin VAR_CHARACTERISTIC TP_S8_L2H_STABLE_THR_SLIP_R BrkCalVariantCriterion
  /begin VAR_ADDRESS 0x8002063A 0x80023A3A 0x80026E3A 0x8002A23A 0x8002D63A 0x80030A3A 0x80033E3A 0x8003723A /end VAR_ADDRESS
 /end VAR_CHARACTERISTIC
 /begin VAR_CHARACTERISTIC TP_S8_L2H_STABLE_THR_SLIP_R_OPP BrkCalVariantCriterion
  /begin VAR_ADDRESS 0x8002063B 0x80023A3B 0x80026E3B 0x8002A23B 0x8002D63B 0x80030A3B 0x80033E3B 0x8003723B /end VAR_ADDRESS
 /end VAR_CHARACTERISTIC
 /begin VAR_CHARACTERISTIC TP_S8_L2H_UNSTABLE_THR_SLIP_F BrkCalVariantCriterion
  /begin VAR_ADDRESS 0x8002063C 0x80023A3C 0x80026E3C 0x8002A23C 0x8002D63C 0x80030A3C 0x80033E3C 0x8003723C /end VAR_ADDRESS
 /end VAR_CHARACTERISTIC
 /begin VAR_CHARACTERISTIC TP_S8_L2H_UNSTABLE_THR_SLIP_F_1 BrkCalVariantCriterion
  /begin VAR_ADDRESS 0x8002063D 0x80023A3D 0x80026E3D 0x8002A23D 0x8002D63D 0x80030A3D 0x80033E3D 0x8003723D /end VAR_ADDRESS
 /end VAR_CHARACTERISTIC
 /begin VAR_CHARACTERISTIC TP_S8_L2H_UNSTABLE_THR_SLIP_F_2 BrkCalVariantCriterion
  /begin VAR_ADDRESS 0x8002063E 0x80023A3E 0x80026E3E 0x8002A23E 0x8002D63E 0x80030A3E 0x80033E3E 0x8003723E /end VAR_ADDRESS
 /end VAR_CHARACTERISTIC
 /begin VAR_CHARACTERISTIC TP_S8_L2H_UNSTABLE_THR_SLIP_F_3 BrkCalVariantCriterion
  /begin VAR_ADDRESS 0x8002063F 0x80023A3F 0x80026E3F 0x8002A23F 0x8002D63F 0x80030A3F 0x80033E3F 0x8003723F /end VAR_ADDRESS
 /end VAR_CHARACTERISTIC
 /begin VAR_CHARACTERISTIC TP_S8_L2H_UNSTABLE_THR_SLIP_F_OPP BrkCalVariantCriterion
  /begin VAR_ADDRESS 0x80020640 0x80023A40 0x80026E40 0x8002A240 0x8002D640 0x80030A40 0x80033E40 0x80037240 /end VAR_ADDRESS
 /end VAR_CHARACTERISTIC
 /begin VAR_CHARACTERISTIC TP_S8_L2H_UNSTABLE_THR_SLIP_R BrkCalVariantCriterion
  /begin VAR_ADDRESS 0x80020641 0x80023A41 0x80026E41 0x8002A241 0x8002D641 0x80030A41 0x80033E41 0x80037241 /end VAR_ADDRESS
 /end VAR_CHARACTERISTIC
 /begin VAR_CHARACTERISTIC TP_S8_L2H_UNSTABLE_THR_SLIP_R_OPP BrkCalVariantCriterion
  /begin VAR_ADDRESS 0x80020642 0x80023A42 0x80026E42 0x8002A242 0x8002D642 0x80030A42 0x80033E42 0x80037242 /end VAR_ADDRESS
 /end VAR_CHARACTERISTIC
 /begin VAR_CHARACTERISTIC TP_S8_L2_LOWSIDE_PEAK_DEC BrkCalVariantCriterion
  /begin VAR_ADDRESS 0x80020669 0x80023A69 0x80026E69 0x8002A269 0x8002D669 0x80030A69 0x80033E69 0x80037269 /end VAR_ADDRESS
 /end VAR_CHARACTERISTIC
 /begin VAR_CHARACTERISTIC TP_S8_L2_SLIP_DIFF_50_80 BrkCalVariantCriterion
  /begin VAR_ADDRESS 0x8002066A 0x80023A6A 0x80026E6A 0x8002A26A 0x8002D66A 0x80030A6A 0x80033E6A 0x8003726A /end VAR_ADDRESS
 /end VAR_CHARACTERISTIC
 /begin VAR_CHARACTERISTIC TP_S8_L2_SLIP_DIFF_80_M BrkCalVariantCriterion
  /begin VAR_ADDRESS 0x8002066B 0x80023A6B 0x80026E6B 0x8002A26B 0x8002D66B 0x80030A6B 0x80033E6B 0x8003726B /end VAR_ADDRESS
 /end VAR_CHARACTERISTIC
 /begin VAR_CHARACTERISTIC TP_S8_LCB_ENTER_DEL_YAW_THRES BrkCalVariantCriterion
  /begin VAR_ADDRESS 0x80020550 0x80023950 0x80026D50 0x8002A150 0x8002D550 0x80030950 0x80033D50 0x80037150 /end VAR_ADDRESS
 /end VAR_CHARACTERISTIC
 /begin VAR_CHARACTERISTIC TP_S8_LCB_EXIT_DEL_YAW_THRES BrkCalVariantCriterion
  /begin VAR_ADDRESS 0x80020551 0x80023951 0x80026D51 0x8002A151 0x8002D551 0x80030951 0x80033D51 0x80037151 /end VAR_ADDRESS
 /end VAR_CHARACTERISTIC
 /begin VAR_CHARACTERISTIC TP_S8_LFC_Conven_Reapply_Time_F BrkCalVariantCriterion
  /begin VAR_ADDRESS 0x800202AE 0x800236AE 0x80026AAE 0x80029EAE 0x8002D2AE 0x800306AE 0x80033AAE 0x80036EAE /end VAR_ADDRESS
 /end VAR_CHARACTERISTIC
 /begin VAR_CHARACTERISTIC TP_S8_LFC_Conven_Reapply_Time_R BrkCalVariantCriterion
  /begin VAR_ADDRESS 0x800202AF 0x800236AF 0x80026AAF 0x80029EAF 0x8002D2AF 0x800306AF 0x80033AAF 0x80036EAF /end VAR_ADDRESS
 /end VAR_CHARACTERISTIC
 /begin VAR_CHARACTERISTIC TP_S8_LFC_Conven_Reapply_Time_R_EBD BrkCalVariantCriterion
  /begin VAR_ADDRESS 0x80020674 0x80023A74 0x80026E74 0x8002A274 0x8002D674 0x80030A74 0x80033E74 0x80037274 /end VAR_ADDRESS
 /end VAR_CHARACTERISTIC
 /begin VAR_CHARACTERISTIC TP_S8_LFC_Dump_Slip_Jump_Mu BrkCalVariantCriterion
  /begin VAR_ADDRESS 0x800202CF 0x800236CF 0x80026ACF 0x80029ECF 0x8002D2CF 0x800306CF 0x80033ACF 0x80036ECF /end VAR_ADDRESS
 /end VAR_CHARACTERISTIC
 /begin VAR_CHARACTERISTIC TP_S8_LFC_HIGH_PEAK_ACCEL BrkCalVariantCriterion
  /begin VAR_ADDRESS 0x80020589 0x80023989 0x80026D89 0x8002A189 0x8002D589 0x80030989 0x80033D89 0x80037189 /end VAR_ADDRESS
 /end VAR_CHARACTERISTIC
 /begin VAR_CHARACTERISTIC TP_S8_LFC_Initial_Dump_Slip_Low BrkCalVariantCriterion
  /begin VAR_ADDRESS 0x800202CA 0x800236CA 0x80026ACA 0x80029ECA 0x8002D2CA 0x800306CA 0x80033ACA 0x80036ECA /end VAR_ADDRESS
 /end VAR_CHARACTERISTIC
 /begin VAR_CHARACTERISTIC TP_S8_LFC_Initial_Peak_Slip_Low BrkCalVariantCriterion
  /begin VAR_ADDRESS 0x800202CB 0x800236CB 0x80026ACB 0x80029ECB 0x8002D2CB 0x800306CB 0x80033ACB 0x80036ECB /end VAR_ADDRESS
 /end VAR_CHARACTERISTIC
 /begin VAR_CHARACTERISTIC TP_S8_LFC_Initial_Slip_Ratio_Low BrkCalVariantCriterion
  /begin VAR_ADDRESS 0x800202CC 0x800236CC 0x80026ACC 0x80029ECC 0x8002D2CC 0x800306CC 0x80033ACC 0x80036ECC /end VAR_ADDRESS
 /end VAR_CHARACTERISTIC
 /begin VAR_CHARACTERISTIC TP_S8_LFC_MED_PEAK_ACCEL BrkCalVariantCriterion
  /begin VAR_ADDRESS 0x8002058A 0x8002398A 0x80026D8A 0x8002A18A 0x8002D58A 0x8003098A 0x80033D8A 0x8003718A /end VAR_ADDRESS
 /end VAR_CHARACTERISTIC
 /begin VAR_CHARACTERISTIC TP_S8_LFC_Peak_Slip_Jump_Mu BrkCalVariantCriterion
  /begin VAR_ADDRESS 0x800202D0 0x800236D0 0x80026AD0 0x80029ED0 0x8002D2D0 0x800306D0 0x80033AD0 0x80036ED0 /end VAR_ADDRESS
 /end VAR_CHARACTERISTIC
 /begin VAR_CHARACTERISTIC TP_S8_LFC_Slip_Ratio_Jump_Mu BrkCalVariantCriterion
  /begin VAR_ADDRESS 0x800202D1 0x800236D1 0x80026AD1 0x80029ED1 0x8002D2D1 0x800306D1 0x80033AD1 0x80036ED1 /end VAR_ADDRESS
 /end VAR_CHARACTERISTIC
 /begin VAR_CHARACTERISTIC TP_S8_L_to_Split_Duty_Diff1 BrkCalVariantCriterion
  /begin VAR_ADDRESS 0x800205AC 0x800239AC 0x80026DAC 0x8002A1AC 0x8002D5AC 0x800309AC 0x80033DAC 0x800371AC /end VAR_ADDRESS
 /end VAR_CHARACTERISTIC
 /begin VAR_CHARACTERISTIC TP_S8_L_to_Split_Duty_Diff2 BrkCalVariantCriterion
  /begin VAR_ADDRESS 0x800205AD 0x800239AD 0x80026DAD 0x8002A1AD 0x8002D5AD 0x800309AD 0x80033DAD 0x800371AD /end VAR_ADDRESS
 /end VAR_CHARACTERISTIC
 /begin VAR_CHARACTERISTIC TP_S8_MAXIMUM_FORCED_HOLD_SCAN BrkCalVariantCriterion
  /begin VAR_ADDRESS 0x8002060F 0x80023A0F 0x80026E0F 0x8002A20F 0x8002D60F 0x80030A0F 0x80033E0F 0x8003720F /end VAR_ADDRESS
 /end VAR_CHARACTERISTIC
 /begin VAR_CHARACTERISTIC TP_S8_MT_Eng_Status_Threshold EngCalVariantCriterion
  /begin VAR_ADDRESS 0x8003A164 0x8003AF64 0x8003BD64 0x8003CB64 0x8003D964 0x8003E764 0x8003F564 0x80040364 0x80041164 0x80041F64 0x80042D64 0x80043B64 0x80044964 0x80045764 0x80046564 0x80047364 0x80048164 0x80048F64 0x80049D64 0x8004AB64 0x8004B964 0x8004C764 0x8004D564 0x8004E364 /end VAR_ADDRESS
 /end VAR_CHARACTERISTIC
 /begin VAR_CHARACTERISTIC TP_S8_MT_In_Gear_Accel_Threshold EngCalVariantCriterion
  /begin VAR_ADDRESS 0x8003A160 0x8003AF60 0x8003BD60 0x8003CB60 0x8003D960 0x8003E760 0x8003F560 0x80040360 0x80041160 0x80041F60 0x80042D60 0x80043B60 0x80044960 0x80045760 0x80046560 0x80047360 0x80048160 0x80048F60 0x80049D60 0x8004AB60 0x8004B960 0x8004C760 0x8004D560 0x8004E360 /end VAR_ADDRESS
 /end VAR_CHARACTERISTIC
 /begin VAR_CHARACTERISTIC TP_S8_MT_In_Gear_Out_Accel_Threshold EngCalVariantCriterion
  /begin VAR_ADDRESS 0x8003A161 0x8003AF61 0x8003BD61 0x8003CB61 0x8003D961 0x8003E761 0x8003F561 0x80040361 0x80041161 0x80041F61 0x80042D61 0x80043B61 0x80044961 0x80045761 0x80046561 0x80047361 0x80048161 0x80048F61 0x80049D61 0x8004AB61 0x8004B961 0x8004C761 0x8004D561 0x8004E361 /end VAR_ADDRESS
 /end VAR_CHARACTERISTIC
 /begin VAR_CHARACTERISTIC TP_S8_Pulse_Down_Gain_Front_Decel BrkCalVariantCriterion
  /begin VAR_ADDRESS 0x800202E2 0x800236E2 0x80026AE2 0x80029EE2 0x8002D2E2 0x800306E2 0x80033AE2 0x80036EE2 /end VAR_ADDRESS
 /end VAR_CHARACTERISTIC
 /begin VAR_CHARACTERISTIC TP_S8_Pulse_Down_Gain_Rear_Decel BrkCalVariantCriterion
  /begin VAR_ADDRESS 0x800202E3 0x800236E3 0x80026AE3 0x80029EE3 0x8002D2E3 0x800306E3 0x80033AE3 0x80036EE3 /end VAR_ADDRESS
 /end VAR_CHARACTERISTIC
 /begin VAR_CHARACTERISTIC TP_S8_REAR_HOMO_SL_HOLD_THRES_SLIP BrkCalVariantCriterion
  /begin VAR_ADDRESS 0x8002054A 0x8002394A 0x80026D4A 0x8002A14A 0x8002D54A 0x8003094A 0x80033D4A 0x8003714A /end VAR_ADDRESS
 /end VAR_CHARACTERISTIC
 /begin VAR_CHARACTERISTIC TP_S8_REAR_SP_SL_HOLD_THRES_SLIP BrkCalVariantCriterion
  /begin VAR_ADDRESS 0x8002054B 0x8002394B 0x80026D4B 0x8002A14B 0x8002D54B 0x8003094B 0x80033D4B 0x8003714B /end VAR_ADDRESS
 /end VAR_CHARACTERISTIC
 /begin VAR_CHARACTERISTIC TP_S8_Rough_Disab_Dump_BF_AFZOK_F BrkCalVariantCriterion
  /begin VAR_ADDRESS 0x8002057F 0x8002397F 0x80026D7F 0x8002A17F 0x8002D57F 0x8003097F 0x80033D7F 0x8003717F /end VAR_ADDRESS
 /end VAR_CHARACTERISTIC
 /begin VAR_CHARACTERISTIC TP_S8_Rough_Disab_Dump_BF_AFZOK_R BrkCalVariantCriterion
  /begin VAR_ADDRESS 0x80020580 0x80023980 0x80026D80 0x8002A180 0x8002D580 0x80030980 0x80033D80 0x80037180 /end VAR_ADDRESS
 /end VAR_CHARACTERISTIC
 /begin VAR_CHARACTERISTIC TP_S8_Rough_Disab_Dump_High_F BrkCalVariantCriterion
  /begin VAR_ADDRESS 0x80020581 0x80023981 0x80026D81 0x8002A181 0x8002D581 0x80030981 0x80033D81 0x80037181 /end VAR_ADDRESS
 /end VAR_CHARACTERISTIC
 /begin VAR_CHARACTERISTIC TP_S8_Rough_Disab_Dump_High_R BrkCalVariantCriterion
  /begin VAR_ADDRESS 0x80020582 0x80023982 0x80026D82 0x8002A182 0x8002D582 0x80030982 0x80033D82 0x80037182 /end VAR_ADDRESS
 /end VAR_CHARACTERISTIC
 /begin VAR_CHARACTERISTIC TP_S8_Rough_Disab_Dump_Low_F BrkCalVariantCriterion
  /begin VAR_ADDRESS 0x80020583 0x80023983 0x80026D83 0x8002A183 0x8002D583 0x80030983 0x80033D83 0x80037183 /end VAR_ADDRESS
 /end VAR_CHARACTERISTIC
 /begin VAR_CHARACTERISTIC TP_S8_Rough_Disab_Dump_Low_R BrkCalVariantCriterion
  /begin VAR_ADDRESS 0x80020584 0x80023984 0x80026D84 0x8002A184 0x8002D584 0x80030984 0x80033D84 0x80037184 /end VAR_ADDRESS
 /end VAR_CHARACTERISTIC
 /begin VAR_CHARACTERISTIC TP_S8_Rough_Disab_Dump_Med_F BrkCalVariantCriterion
  /begin VAR_ADDRESS 0x80020585 0x80023985 0x80026D85 0x8002A185 0x8002D585 0x80030985 0x80033D85 0x80037185 /end VAR_ADDRESS
 /end VAR_CHARACTERISTIC
 /begin VAR_CHARACTERISTIC TP_S8_Rough_Disab_Dump_Med_R BrkCalVariantCriterion
  /begin VAR_ADDRESS 0x80020586 0x80023986 0x80026D86 0x8002A186 0x8002D586 0x80030986 0x80033D86 0x80037186 /end VAR_ADDRESS
 /end VAR_CHARACTERISTIC
 /begin VAR_CHARACTERISTIC TP_S8_Rough_Disab_Dump_Ref_F BrkCalVariantCriterion
  /begin VAR_ADDRESS 0x80020587 0x80023987 0x80026D87 0x8002A187 0x8002D587 0x80030987 0x80033D87 0x80037187 /end VAR_ADDRESS
 /end VAR_CHARACTERISTIC
 /begin VAR_CHARACTERISTIC TP_S8_Rough_Disab_Dump_Ref_R BrkCalVariantCriterion
  /begin VAR_ADDRESS 0x80020588 0x80023988 0x80026D88 0x8002A188 0x8002D588 0x80030988 0x80033D88 0x80037188 /end VAR_ADDRESS
 /end VAR_CHARACTERISTIC
 /begin VAR_CHARACTERISTIC TP_S8_Rough_road_detector_F_level0 BrkCalVariantCriterion
  /begin VAR_ADDRESS 0x800204C4 0x800238C4 0x80026CC4 0x8002A0C4 0x8002D4C4 0x800308C4 0x80033CC4 0x800370C4 /end VAR_ADDRESS
 /end VAR_CHARACTERISTIC
 /begin VAR_CHARACTERISTIC TP_S8_Rough_road_detector_F_level1 BrkCalVariantCriterion
  /begin VAR_ADDRESS 0x800204C5 0x800238C5 0x80026CC5 0x8002A0C5 0x8002D4C5 0x800308C5 0x80033CC5 0x800370C5 /end VAR_ADDRESS
 /end VAR_CHARACTERISTIC
 /begin VAR_CHARACTERISTIC TP_S8_Rough_road_detector_F_level2 BrkCalVariantCriterion
  /begin VAR_ADDRESS 0x800204C6 0x800238C6 0x80026CC6 0x8002A0C6 0x8002D4C6 0x800308C6 0x80033CC6 0x800370C6 /end VAR_ADDRESS
 /end VAR_CHARACTERISTIC
 /begin VAR_CHARACTERISTIC TP_S8_Rough_road_detector_R_level0 BrkCalVariantCriterion
  /begin VAR_ADDRESS 0x800204C7 0x800238C7 0x80026CC7 0x8002A0C7 0x8002D4C7 0x800308C7 0x80033CC7 0x800370C7 /end VAR_ADDRESS
 /end VAR_CHARACTERISTIC
 /begin VAR_CHARACTERISTIC TP_S8_Rough_road_detector_R_level1 BrkCalVariantCriterion
  /begin VAR_ADDRESS 0x800204C8 0x800238C8 0x80026CC8 0x8002A0C8 0x8002D4C8 0x800308C8 0x80033CC8 0x800370C8 /end VAR_ADDRESS
 /end VAR_CHARACTERISTIC
 /begin VAR_CHARACTERISTIC TP_S8_Rough_road_detector_R_level2 BrkCalVariantCriterion
  /begin VAR_ADDRESS 0x800204C9 0x800238C9 0x80026CC9 0x8002A0C9 0x8002D4C9 0x800308C9 0x80033CC9 0x800370C9 /end VAR_ADDRESS
 /end VAR_CHARACTERISTIC
 /begin VAR_CHARACTERISTIC TP_S8_SPLIT_dYAW_ABS_GAIN_1 BrkCalVariantCriterion
  /begin VAR_ADDRESS 0x800204FA 0x800238FA 0x80026CFA 0x8002A0FA 0x8002D4FA 0x800308FA 0x80033CFA 0x800370FA /end VAR_ADDRESS
 /end VAR_CHARACTERISTIC
 /begin VAR_CHARACTERISTIC TP_S8_SPLIT_dYAW_ABS_GAIN_2 BrkCalVariantCriterion
  /begin VAR_ADDRESS 0x800204FB 0x800238FB 0x80026CFB 0x8002A0FB 0x8002D4FB 0x800308FB 0x80033CFB 0x800370FB /end VAR_ADDRESS
 /end VAR_CHARACTERISTIC
 /begin VAR_CHARACTERISTIC TP_S8_SPLIT_dYAW_DOT_ABS_GAIN_1 BrkCalVariantCriterion
  /begin VAR_ADDRESS 0x800204FC 0x800238FC 0x80026CFC 0x8002A0FC 0x8002D4FC 0x800308FC 0x80033CFC 0x800370FC /end VAR_ADDRESS
 /end VAR_CHARACTERISTIC
 /begin VAR_CHARACTERISTIC TP_S8_SPLIT_dYAW_DOT_ABS_GAIN_2 BrkCalVariantCriterion
  /begin VAR_ADDRESS 0x800204FD 0x800238FD 0x80026CFD 0x8002A0FD 0x8002D4FD 0x800308FD 0x80033CFD 0x800370FD /end VAR_ADDRESS
 /end VAR_CHARACTERISTIC
 /begin VAR_CHARACTERISTIC TP_S8_Slip_Gain_LMu_10_20k_F_HDC BrkCalVariantCriterion
  /begin VAR_ADDRESS 0x80020562 0x80023962 0x80026D62 0x8002A162 0x8002D562 0x80030962 0x80033D62 0x80037162 /end VAR_ADDRESS
 /end VAR_CHARACTERISTIC
 /begin VAR_CHARACTERISTIC TP_S8_Slip_Gain_LMu_10_20k_R_HDC BrkCalVariantCriterion
  /begin VAR_ADDRESS 0x80020566 0x80023966 0x80026D66 0x8002A166 0x8002D566 0x80030966 0x80033D66 0x80037166 /end VAR_ADDRESS
 /end VAR_CHARACTERISTIC
 /begin VAR_CHARACTERISTIC TP_S8_Slip_Gain_LMu_B_10k_F_HDC BrkCalVariantCriterion
  /begin VAR_ADDRESS 0x80020563 0x80023963 0x80026D63 0x8002A163 0x8002D563 0x80030963 0x80033D63 0x80037163 /end VAR_ADDRESS
 /end VAR_CHARACTERISTIC
 /begin VAR_CHARACTERISTIC TP_S8_Slip_Gain_LMu_B_10k_R_HDC BrkCalVariantCriterion
  /begin VAR_ADDRESS 0x80020567 0x80023967 0x80026D67 0x8002A167 0x8002D567 0x80030967 0x80033D67 0x80037167 /end VAR_ADDRESS
 /end VAR_CHARACTERISTIC
 /begin VAR_CHARACTERISTIC TP_S8_UNSTABLE_RISE_REF_ARAD_1st_F BrkCalVariantCriterion
  /begin VAR_ADDRESS 0x80020418 0x80023818 0x80026C18 0x8002A018 0x8002D418 0x80030818 0x80033C18 0x80037018 /end VAR_ADDRESS
 /end VAR_CHARACTERISTIC
 /begin VAR_CHARACTERISTIC TP_S8_UNSTABLE_RISE_REF_ARAD_1st_R BrkCalVariantCriterion
  /begin VAR_ADDRESS 0x80020419 0x80023819 0x80026C19 0x8002A019 0x8002D419 0x80030819 0x80033C19 0x80037019 /end VAR_ADDRESS
 /end VAR_CHARACTERISTIC
 /begin VAR_CHARACTERISTIC TP_S8_dP_Arad_Ref_Ab_HMu_F BrkCalVariantCriterion
  /begin VAR_ADDRESS 0x8002041C 0x8002381C 0x80026C1C 0x8002A01C 0x8002D41C 0x8003081C 0x80033C1C 0x8003701C /end VAR_ADDRESS
 /end VAR_CHARACTERISTIC
 /begin VAR_CHARACTERISTIC TP_S8_dP_Arad_Ref_Ab_HMu_R BrkCalVariantCriterion
  /begin VAR_ADDRESS 0x8002041E 0x8002381E 0x80026C1E 0x8002A01E 0x8002D41E 0x8003081E 0x80033C1E 0x8003701E /end VAR_ADDRESS
 /end VAR_CHARACTERISTIC
 /begin VAR_CHARACTERISTIC TP_S8_dP_Arad_Ref_Bw_LMu_F BrkCalVariantCriterion
  /begin VAR_ADDRESS 0x80020430 0x80023830 0x80026C30 0x8002A030 0x8002D430 0x80030830 0x80033C30 0x80037030 /end VAR_ADDRESS
 /end VAR_CHARACTERISTIC
 /begin VAR_CHARACTERISTIC TP_S8_dP_Arad_Ref_Bw_LMu_R BrkCalVariantCriterion
  /begin VAR_ADDRESS 0x80020432 0x80023832 0x80026C32 0x8002A032 0x8002D432 0x80030832 0x80033C32 0x80037032 /end VAR_ADDRESS
 /end VAR_CHARACTERISTIC
 /begin VAR_CHARACTERISTIC TP_S8_dP_Arad_Ref_LMMu_MMu_F BrkCalVariantCriterion
  /begin VAR_ADDRESS 0x80020428 0x80023828 0x80026C28 0x8002A028 0x8002D428 0x80030828 0x80033C28 0x80037028 /end VAR_ADDRESS
 /end VAR_CHARACTERISTIC
 /begin VAR_CHARACTERISTIC TP_S8_dP_Arad_Ref_LMMu_MMu_R BrkCalVariantCriterion
  /begin VAR_ADDRESS 0x8002042A 0x8002382A 0x80026C2A 0x8002A02A 0x8002D42A 0x8003082A 0x80033C2A 0x8003702A /end VAR_ADDRESS
 /end VAR_CHARACTERISTIC
 /begin VAR_CHARACTERISTIC TP_S8_dP_Arad_Ref_LMu_LMMu_F BrkCalVariantCriterion
  /begin VAR_ADDRESS 0x8002042C 0x8002382C 0x80026C2C 0x8002A02C 0x8002D42C 0x8003082C 0x80033C2C 0x8003702C /end VAR_ADDRESS
 /end VAR_CHARACTERISTIC
 /begin VAR_CHARACTERISTIC TP_S8_dP_Arad_Ref_LMu_LMMu_R BrkCalVariantCriterion
  /begin VAR_ADDRESS 0x8002042E 0x8002382E 0x80026C2E 0x8002A02E 0x8002D42E 0x8003082E 0x80033C2E 0x8003702E /end VAR_ADDRESS
 /end VAR_CHARACTERISTIC
 /begin VAR_CHARACTERISTIC TP_S8_dP_Arad_Ref_MHMu_HMu_F BrkCalVariantCriterion
  /begin VAR_ADDRESS 0x80020420 0x80023820 0x80026C20 0x8002A020 0x8002D420 0x80030820 0x80033C20 0x80037020 /end VAR_ADDRESS
 /end VAR_CHARACTERISTIC
 /begin VAR_CHARACTERISTIC TP_S8_dP_Arad_Ref_MHMu_HMu_R BrkCalVariantCriterion
  /begin VAR_ADDRESS 0x80020422 0x80023822 0x80026C22 0x8002A022 0x8002D422 0x80030822 0x80033C22 0x80037022 /end VAR_ADDRESS
 /end VAR_CHARACTERISTIC
 /begin VAR_CHARACTERISTIC TP_S8_dP_Arad_Ref_MMu_MHMu_F BrkCalVariantCriterion
  /begin VAR_ADDRESS 0x80020424 0x80023824 0x80026C24 0x8002A024 0x8002D424 0x80030824 0x80033C24 0x80037024 /end VAR_ADDRESS
 /end VAR_CHARACTERISTIC
 /begin VAR_CHARACTERISTIC TP_S8_dP_Arad_Ref_MMu_MHMu_R BrkCalVariantCriterion
  /begin VAR_ADDRESS 0x80020426 0x80023826 0x80026C26 0x8002A026 0x8002D426 0x80030826 0x80033C26 0x80037026 /end VAR_ADDRESS
 /end VAR_CHARACTERISTIC
 /begin VAR_CHARACTERISTIC TP_S8_dP_Arad_Ref_SpHMu_F BrkCalVariantCriterion
  /begin VAR_ADDRESS 0x80020434 0x80023834 0x80026C34 0x8002A034 0x8002D434 0x80030834 0x80033C34 0x80037034 /end VAR_ADDRESS
 /end VAR_CHARACTERISTIC
 /begin VAR_CHARACTERISTIC TP_S8_dV_F_slip_after_ABS_fz BrkCalVariantCriterion
  /begin VAR_ADDRESS 0x8002021C 0x8002361C 0x80026A1C 0x80029E1C 0x8002D21C 0x8003061C 0x80033A1C 0x80036E1C /end VAR_ADDRESS
 /end VAR_CHARACTERISTIC
 /begin VAR_CHARACTERISTIC TP_U16ETCSCpDctLwHmMaxCnt EngCalVariantCriterion
  /begin VAR_ADDRESS 0x8003A486 0x8003B286 0x8003C086 0x8003CE86 0x8003DC86 0x8003EA86 0x8003F886 0x80040686 0x80041486 0x80042286 0x80043086 0x80043E86 0x80044C86 0x80045A86 0x80046886 0x80047686 0x80048486 0x80049286 0x8004A086 0x8004AE86 0x8004BC86 0x8004CA86 0x8004D886 0x8004E686 /end VAR_ADDRESS
 /end VAR_CHARACTERISTIC
 /begin VAR_CHARACTERISTIC TP_U16ETCSCpStrCnvrgWhAngGrdThr EngCalVariantCriterion
  /begin VAR_ADDRESS 0x8003A488 0x8003B288 0x8003C088 0x8003CE88 0x8003DC88 0x8003EA88 0x8003F888 0x80040688 0x80041488 0x80042288 0x80043088 0x80043E88 0x80044C88 0x80045A88 0x80046888 0x80047688 0x80048488 0x80049288 0x8004A088 0x8004AE88 0x8004BC88 0x8004CA88 0x8004D888 0x8004E688 /end VAR_ADDRESS
 /end VAR_CHARACTERISTIC
 /begin VAR_CHARACTERISTIC TP_U16ETCSCpStrCnvrgWhAngThr EngCalVariantCriterion
  /begin VAR_ADDRESS 0x8003A48A 0x8003B28A 0x8003C08A 0x8003CE8A 0x8003DC8A 0x8003EA8A 0x8003F88A 0x8004068A 0x8004148A 0x8004228A 0x8004308A 0x80043E8A 0x80044C8A 0x80045A8A 0x8004688A 0x8004768A 0x8004848A 0x8004928A 0x8004A08A 0x8004AE8A 0x8004BC8A 0x8004CA8A 0x8004D88A 0x8004E68A /end VAR_ADDRESS
 /end VAR_CHARACTERISTIC
 /begin VAR_CHARACTERISTIC TP_U16ETCSCpTEGTimeAcclPdlThr EngCalVariantCriterion
  /begin VAR_ADDRESS 0x8003A48C 0x8003B28C 0x8003C08C 0x8003CE8C 0x8003DC8C 0x8003EA8C 0x8003F88C 0x8004068C 0x8004148C 0x8004228C 0x8004308C 0x80043E8C 0x80044C8C 0x80045A8C 0x8004688C 0x8004768C 0x8004848C 0x8004928C 0x8004A08C 0x8004AE8C 0x8004BC8C 0x8004CA8C 0x8004D88C 0x8004E68C /end VAR_ADDRESS
 /end VAR_CHARACTERISTIC
 /begin VAR_CHARACTERISTIC TP_U16TCSCpDriverAccelIntendSuspCntTh EngCalVariantCriterion
  /begin VAR_ADDRESS 0x8003A254 0x8003B054 0x8003BE54 0x8003CC54 0x8003DA54 0x8003E854 0x8003F654 0x80040454 0x80041254 0x80042054 0x80042E54 0x80043C54 0x80044A54 0x80045854 0x80046654 0x80047454 0x80048254 0x80049054 0x80049E54 0x8004AC54 0x8004BA54 0x8004C854 0x8004D654 0x8004E454 /end VAR_ADDRESS
 /end VAR_CHARACTERISTIC
 /begin VAR_CHARACTERISTIC TP_U16_AX_RANGE_MAX EngCalVariantCriterion
  /begin VAR_ADDRESS 0x8003A242 0x8003B042 0x8003BE42 0x8003CC42 0x8003DA42 0x8003E842 0x8003F642 0x80040442 0x80041242 0x80042042 0x80042E42 0x80043C42 0x80044A42 0x80045842 0x80046642 0x80047442 0x80048242 0x80049042 0x80049E42 0x8004AC42 0x8004BA42 0x8004C842 0x8004D642 0x8004E442 /end VAR_ADDRESS
 /end VAR_CHARACTERISTIC
 /begin VAR_CHARACTERISTIC TP_U16_EDC_ENG_RPM_LIMIT EngCalVariantCriterion
  /begin VAR_ADDRESS 0x8003A126 0x8003AF26 0x8003BD26 0x8003CB26 0x8003D926 0x8003E726 0x8003F526 0x80040326 0x80041126 0x80041F26 0x80042D26 0x80043B26 0x80044926 0x80045726 0x80046526 0x80047326 0x80048126 0x80048F26 0x80049D26 0x8004AB26 0x8004B926 0x8004C726 0x8004D526 0x8004E326 /end VAR_ADDRESS
 /end VAR_CHARACTERISTIC
 /begin VAR_CHARACTERISTIC TP_U16_EDC_GAIN_SCALING_FACTOR EngCalVariantCriterion
  /begin VAR_ADDRESS 0x8003A146 0x8003AF46 0x8003BD46 0x8003CB46 0x8003D946 0x8003E746 0x8003F546 0x80040346 0x80041146 0x80041F46 0x80042D46 0x80043B46 0x80044946 0x80045746 0x80046546 0x80047346 0x80048146 0x80048F46 0x80049D46 0x8004AB46 0x8004B946 0x8004C746 0x8004D546 0x8004E346 /end VAR_ADDRESS
 /end VAR_CHARACTERISTIC
 /begin VAR_CHARACTERISTIC TP_U16_EDC_SPEED1 EngCalVariantCriterion
  /begin VAR_ADDRESS 0x8003A082 0x8003AE82 0x8003BC82 0x8003CA82 0x8003D882 0x8003E682 0x8003F482 0x80040282 0x80041082 0x80041E82 0x80042C82 0x80043A82 0x80044882 0x80045682 0x80046482 0x80047282 0x80048082 0x80048E82 0x80049C82 0x8004AA82 0x8004B882 0x8004C682 0x8004D482 0x8004E282 /end VAR_ADDRESS
 /end VAR_CHARACTERISTIC
 /begin VAR_CHARACTERISTIC TP_U16_EDC_SPEED2 EngCalVariantCriterion
  /begin VAR_ADDRESS 0x8003A084 0x8003AE84 0x8003BC84 0x8003CA84 0x8003D884 0x8003E684 0x8003F484 0x80040284 0x80041084 0x80041E84 0x80042C84 0x80043A84 0x80044884 0x80045684 0x80046484 0x80047284 0x80048084 0x80048E84 0x80049C84 0x8004AA84 0x8004B884 0x8004C684 0x8004D484 0x8004E284 /end VAR_ADDRESS
 /end VAR_CHARACTERISTIC
 /begin VAR_CHARACTERISTIC TP_U16_EDC_SPEED3 EngCalVariantCriterion
  /begin VAR_ADDRESS 0x8003A086 0x8003AE86 0x8003BC86 0x8003CA86 0x8003D886 0x8003E686 0x8003F486 0x80040286 0x80041086 0x80041E86 0x80042C86 0x80043A86 0x80044886 0x80045686 0x80046486 0x80047286 0x80048086 0x80048E86 0x80049C86 0x8004AA86 0x8004B886 0x8004C686 0x8004D486 0x8004E286 /end VAR_ADDRESS
 /end VAR_CHARACTERISTIC
 /begin VAR_CHARACTERISTIC TP_U16_EDC_SPEED4 EngCalVariantCriterion
  /begin VAR_ADDRESS 0x8003A088 0x8003AE88 0x8003BC88 0x8003CA88 0x8003D888 0x8003E688 0x8003F488 0x80040288 0x80041088 0x80041E88 0x80042C88 0x80043A88 0x80044888 0x80045688 0x80046488 0x80047288 0x80048088 0x80048E88 0x80049C88 0x8004AA88 0x8004B888 0x8004C688 0x8004D488 0x8004E288 /end VAR_ADDRESS
 /end VAR_CHARACTERISTIC
 /begin VAR_CHARACTERISTIC TP_U16_EDC_TIRE_L EngCalVariantCriterion
  /begin VAR_ADDRESS 0x8003A14A 0x8003AF4A 0x8003BD4A 0x8003CB4A 0x8003D94A 0x8003E74A 0x8003F54A 0x8004034A 0x8004114A 0x80041F4A 0x80042D4A 0x80043B4A 0x8004494A 0x8004574A 0x8004654A 0x8004734A 0x8004814A 0x80048F4A 0x80049D4A 0x8004AB4A 0x8004B94A 0x8004C74A 0x8004D54A 0x8004E34A /end VAR_ADDRESS
 /end VAR_CHARACTERISTIC
 /begin VAR_CHARACTERISTIC TP_U16_EDC_TIRE_L_R EngCalVariantCriterion
  /begin VAR_ADDRESS 0x8003A14C 0x8003AF4C 0x8003BD4C 0x8003CB4C 0x8003D94C 0x8003E74C 0x8003F54C 0x8004034C 0x8004114C 0x80041F4C 0x80042D4C 0x80043B4C 0x8004494C 0x8004574C 0x8004654C 0x8004734C 0x8004814C 0x80048F4C 0x80049D4C 0x8004AB4C 0x8004B94C 0x8004C74C 0x8004D54C 0x8004E34C /end VAR_ADDRESS
 /end VAR_CHARACTERISTIC
 /begin VAR_CHARACTERISTIC TP_U16_LFC_H2L_UNSTABIL_TIME_H_V BrkCalVariantCriterion
  /begin VAR_ADDRESS 0x8002058C 0x8002398C 0x80026D8C 0x8002A18C 0x8002D58C 0x8003098C 0x80033D8C 0x8003718C /end VAR_ADDRESS
 /end VAR_CHARACTERISTIC
 /begin VAR_CHARACTERISTIC TP_U16_TCS_BRK_CLT_MAX_SPD EngCalVariantCriterion
  /begin VAR_ADDRESS 0x8003A244 0x8003B044 0x8003BE44 0x8003CC44 0x8003DA44 0x8003E844 0x8003F644 0x80040444 0x80041244 0x80042044 0x80042E44 0x80043C44 0x80044A44 0x80045844 0x80046644 0x80047444 0x80048244 0x80049044 0x80049E44 0x8004AC44 0x8004BA44 0x8004C844 0x8004D644 0x8004E444 /end VAR_ADDRESS
 /end VAR_CHARACTERISTIC
 /begin VAR_CHARACTERISTIC TP_U16_TCS_SPEED[0] EngCalVariantCriterion
  /begin VAR_ADDRESS 0x8003A246 0x8003B046 0x8003BE46 0x8003CC46 0x8003DA46 0x8003E846 0x8003F646 0x80040446 0x80041246 0x80042046 0x80042E46 0x80043C46 0x80044A46 0x80045846 0x80046646 0x80047446 0x80048246 0x80049046 0x80049E46 0x8004AC46 0x8004BA46 0x8004C846 0x8004D646 0x8004E446 /end VAR_ADDRESS
 /end VAR_CHARACTERISTIC
 /begin VAR_CHARACTERISTIC TP_U16_TCS_SPEED[1] EngCalVariantCriterion
  /begin VAR_ADDRESS 0x8003A248 0x8003B048 0x8003BE48 0x8003CC48 0x8003DA48 0x8003E848 0x8003F648 0x80040448 0x80041248 0x80042048 0x80042E48 0x80043C48 0x80044A48 0x80045848 0x80046648 0x80047448 0x80048248 0x80049048 0x80049E48 0x8004AC48 0x8004BA48 0x8004C848 0x8004D648 0x8004E448 /end VAR_ADDRESS
 /end VAR_CHARACTERISTIC
 /begin VAR_CHARACTERISTIC TP_U16_TCS_SPEED[2] EngCalVariantCriterion
  /begin VAR_ADDRESS 0x8003A24A 0x8003B04A 0x8003BE4A 0x8003CC4A 0x8003DA4A 0x8003E84A 0x8003F64A 0x8004044A 0x8004124A 0x8004204A 0x80042E4A 0x80043C4A 0x80044A4A 0x8004584A 0x8004664A 0x8004744A 0x8004824A 0x8004904A 0x80049E4A 0x8004AC4A 0x8004BA4A 0x8004C84A 0x8004D64A 0x8004E44A /end VAR_ADDRESS
 /end VAR_CHARACTERISTIC
 /begin VAR_CHARACTERISTIC TP_U16_TCS_SPEED[3] EngCalVariantCriterion
  /begin VAR_ADDRESS 0x8003A24C 0x8003B04C 0x8003BE4C 0x8003CC4C 0x8003DA4C 0x8003E84C 0x8003F64C 0x8004044C 0x8004124C 0x8004204C 0x80042E4C 0x80043C4C 0x80044A4C 0x8004584C 0x8004664C 0x8004744C 0x8004824C 0x8004904C 0x80049E4C 0x8004AC4C 0x8004BA4C 0x8004C84C 0x8004D64C 0x8004E44C /end VAR_ADDRESS
 /end VAR_CHARACTERISTIC
 /begin VAR_CHARACTERISTIC TP_U16_TCS_SPEED[4] EngCalVariantCriterion
  /begin VAR_ADDRESS 0x8003A24E 0x8003B04E 0x8003BE4E 0x8003CC4E 0x8003DA4E 0x8003E84E 0x8003F64E 0x8004044E 0x8004124E 0x8004204E 0x80042E4E 0x80043C4E 0x80044A4E 0x8004584E 0x8004664E 0x8004744E 0x8004824E 0x8004904E 0x80049E4E 0x8004AC4E 0x8004BA4E 0x8004C84E 0x8004D64E 0x8004E44E /end VAR_ADDRESS
 /end VAR_CHARACTERISTIC
 /begin VAR_CHARACTERISTIC TP_U16_TCS_START_ENGINE_TORQUE EngCalVariantCriterion
  /begin VAR_ADDRESS 0x8003A250 0x8003B050 0x8003BE50 0x8003CC50 0x8003DA50 0x8003E850 0x8003F650 0x80040450 0x80041250 0x80042050 0x80042E50 0x80043C50 0x80044A50 0x80045850 0x80046650 0x80047450 0x80048250 0x80049050 0x80049E50 0x8004AC50 0x8004BA50 0x8004C850 0x8004D650 0x8004E450 /end VAR_ADDRESS
 /end VAR_CHARACTERISTIC
 /begin VAR_CHARACTERISTIC TP_U16_TCS_START_RPM EngCalVariantCriterion
  /begin VAR_ADDRESS 0x8003A252 0x8003B052 0x8003BE52 0x8003CC52 0x8003DA52 0x8003E852 0x8003F652 0x80040452 0x80041252 0x80042052 0x80042E52 0x80043C52 0x80044A52 0x80045852 0x80046652 0x80047452 0x80048252 0x80049052 0x80049E52 0x8004AC52 0x8004BA52 0x8004C852 0x8004D652 0x8004E452 /end VAR_ADDRESS
 /end VAR_CHARACTERISTIC
 /begin VAR_CHARACTERISTIC TP_U8CpAfterHghMuUnstbCntTh EngCalVariantCriterion
  /begin VAR_ADDRESS 0x8003A26A 0x8003B06A 0x8003BE6A 0x8003CC6A 0x8003DA6A 0x8003E86A 0x8003F66A 0x8004046A 0x8004126A 0x8004206A 0x80042E6A 0x80043C6A 0x80044A6A 0x8004586A 0x8004666A 0x8004746A 0x8004826A 0x8004906A 0x80049E6A 0x8004AC6A 0x8004BA6A 0x8004C86A 0x8004D66A 0x8004E46A /end VAR_ADDRESS
 /end VAR_CHARACTERISTIC
 /begin VAR_CHARACTERISTIC TP_U8ETCSCpAWDVehicle EngCalVariantCriterion
  /begin VAR_ADDRESS 0x8003A498 0x8003B298 0x8003C098 0x8003CE98 0x8003DC98 0x8003EA98 0x8003F898 0x80040698 0x80041498 0x80042298 0x80043098 0x80043E98 0x80044C98 0x80045A98 0x80046898 0x80047698 0x80048498 0x80049298 0x8004A098 0x8004AE98 0x8004BC98 0x8004CA98 0x8004D898 0x8004E698 /end VAR_ADDRESS
 /end VAR_CHARACTERISTIC
 /begin VAR_CHARACTERISTIC TP_U8ETCSCpAdaptHighRdCplCnt EngCalVariantCriterion
  /begin VAR_ADDRESS 0x8003A48E 0x8003B28E 0x8003C08E 0x8003CE8E 0x8003DC8E 0x8003EA8E 0x8003F88E 0x8004068E 0x8004148E 0x8004228E 0x8004308E 0x80043E8E 0x80044C8E 0x80045A8E 0x8004688E 0x8004768E 0x8004848E 0x8004928E 0x8004A08E 0x8004AE8E 0x8004BC8E 0x8004CA8E 0x8004D88E 0x8004E68E /end VAR_ADDRESS
 /end VAR_CHARACTERISTIC
 /begin VAR_CHARACTERISTIC TP_U8ETCSCpAdaptHighRdStrtCnt EngCalVariantCriterion
  /begin VAR_ADDRESS 0x8003A48F 0x8003B28F 0x8003C08F 0x8003CE8F 0x8003DC8F 0x8003EA8F 0x8003F88F 0x8004068F 0x8004148F 0x8004228F 0x8004308F 0x80043E8F 0x80044C8F 0x80045A8F 0x8004688F 0x8004768F 0x8004848F 0x8004928F 0x8004A08F 0x8004AE8F 0x8004BC8F 0x8004CA8F 0x8004D88F 0x8004E68F /end VAR_ADDRESS
 /end VAR_CHARACTERISTIC
 /begin VAR_CHARACTERISTIC TP_U8ETCSCpAddBstTarWhlSpn[0] EngCalVariantCriterion
  /begin VAR_ADDRESS 0x8003A490 0x8003B290 0x8003C090 0x8003CE90 0x8003DC90 0x8003EA90 0x8003F890 0x80040690 0x80041490 0x80042290 0x80043090 0x80043E90 0x80044C90 0x80045A90 0x80046890 0x80047690 0x80048490 0x80049290 0x8004A090 0x8004AE90 0x8004BC90 0x8004CA90 0x8004D890 0x8004E690 /end VAR_ADDRESS
 /end VAR_CHARACTERISTIC
 /begin VAR_CHARACTERISTIC TP_U8ETCSCpAddBstTarWhlSpn[1] EngCalVariantCriterion
  /begin VAR_ADDRESS 0x8003A491 0x8003B291 0x8003C091 0x8003CE91 0x8003DC91 0x8003EA91 0x8003F891 0x80040691 0x80041491 0x80042291 0x80043091 0x80043E91 0x80044C91 0x80045A91 0x80046891 0x80047691 0x80048491 0x80049291 0x8004A091 0x8004AE91 0x8004BC91 0x8004CA91 0x8004D891 0x8004E691 /end VAR_ADDRESS
 /end VAR_CHARACTERISTIC
 /begin VAR_CHARACTERISTIC TP_U8ETCSCpAddBstTarWhlSpn[2] EngCalVariantCriterion
  /begin VAR_ADDRESS 0x8003A492 0x8003B292 0x8003C092 0x8003CE92 0x8003DC92 0x8003EA92 0x8003F892 0x80040692 0x80041492 0x80042292 0x80043092 0x80043E92 0x80044C92 0x80045A92 0x80046892 0x80047692 0x80048492 0x80049292 0x8004A092 0x8004AE92 0x8004BC92 0x8004CA92 0x8004D892 0x8004E692 /end VAR_ADDRESS
 /end VAR_CHARACTERISTIC
 /begin VAR_CHARACTERISTIC TP_U8ETCSCpAddRefRdCfFrci EngCalVariantCriterion
  /begin VAR_ADDRESS 0x8003A493 0x8003B293 0x8003C093 0x8003CE93 0x8003DC93 0x8003EA93 0x8003F893 0x80040693 0x80041493 0x80042293 0x80043093 0x80043E93 0x80044C93 0x80045A93 0x80046893 0x80047693 0x80048493 0x80049293 0x8004A093 0x8004AE93 0x8004BC93 0x8004CA93 0x8004D893 0x8004E693 /end VAR_ADDRESS
 /end VAR_CHARACTERISTIC
 /begin VAR_CHARACTERISTIC TP_U8ETCSCpAddTarWhlSpnLwToSp EngCalVariantCriterion
  /begin VAR_ADDRESS 0x8003A494 0x8003B294 0x8003C094 0x8003CE94 0x8003DC94 0x8003EA94 0x8003F894 0x80040694 0x80041494 0x80042294 0x80043094 0x80043E94 0x80044C94 0x80045A94 0x80046894 0x80047694 0x80048494 0x80049294 0x8004A094 0x8004AE94 0x8004BC94 0x8004CA94 0x8004D894 0x8004E694 /end VAR_ADDRESS
 /end VAR_CHARACTERISTIC
 /begin VAR_CHARACTERISTIC TP_U8ETCSCpAddTarWhlSpnSp EngCalVariantCriterion
  /begin VAR_ADDRESS 0x8003A495 0x8003B295 0x8003C095 0x8003CE95 0x8003DC95 0x8003EA95 0x8003F895 0x80040695 0x80041495 0x80042295 0x80043095 0x80043E95 0x80044C95 0x80045A95 0x80046895 0x80047695 0x80048495 0x80049295 0x8004A095 0x8004AE95 0x8004BC95 0x8004CA95 0x8004D895 0x8004E695 /end VAR_ADDRESS
 /end VAR_CHARACTERISTIC
 /begin VAR_CHARACTERISTIC TP_U8ETCSCpAlwAddTar4DepSnwSpd EngCalVariantCriterion
  /begin VAR_ADDRESS 0x8003A496 0x8003B296 0x8003C096 0x8003CE96 0x8003DC96 0x8003EA96 0x8003F896 0x80040696 0x80041496 0x80042296 0x80043096 0x80043E96 0x80044C96 0x80045A96 0x80046896 0x80047696 0x80048496 0x80049296 0x8004A096 0x8004AE96 0x8004BC96 0x8004CA96 0x8004D896 0x8004E696 /end VAR_ADDRESS
 /end VAR_CHARACTERISTIC
 /begin VAR_CHARACTERISTIC TP_U8ETCSCpAreaSetLwToHiSpin EngCalVariantCriterion
  /begin VAR_ADDRESS 0x8003A497 0x8003B297 0x8003C097 0x8003CE97 0x8003DC97 0x8003EA97 0x8003F897 0x80040697 0x80041497 0x80042297 0x80043097 0x80043E97 0x80044C97 0x80045A97 0x80046897 0x80047697 0x80048497 0x80049297 0x8004A097 0x8004AE97 0x8004BC97 0x8004CA97 0x8004D897 0x8004E697 /end VAR_ADDRESS
 /end VAR_CHARACTERISTIC
 /begin VAR_CHARACTERISTIC TP_U8ETCSCpAxAt[0][0] EngCalVariantCriterion
  /begin VAR_ADDRESS 0x8003A499 0x8003B299 0x8003C099 0x8003CE99 0x8003DC99 0x8003EA99 0x8003F899 0x80040699 0x80041499 0x80042299 0x80043099 0x80043E99 0x80044C99 0x80045A99 0x80046899 0x80047699 0x80048499 0x80049299 0x8004A099 0x8004AE99 0x8004BC99 0x8004CA99 0x8004D899 0x8004E699 /end VAR_ADDRESS
 /end VAR_CHARACTERISTIC
 /begin VAR_CHARACTERISTIC TP_U8ETCSCpAxAt[0][1] EngCalVariantCriterion
  /begin VAR_ADDRESS 0x8003A49A 0x8003B29A 0x8003C09A 0x8003CE9A 0x8003DC9A 0x8003EA9A 0x8003F89A 0x8004069A 0x8004149A 0x8004229A 0x8004309A 0x80043E9A 0x80044C9A 0x80045A9A 0x8004689A 0x8004769A 0x8004849A 0x8004929A 0x8004A09A 0x8004AE9A 0x8004BC9A 0x8004CA9A 0x8004D89A 0x8004E69A /end VAR_ADDRESS
 /end VAR_CHARACTERISTIC
 /begin VAR_CHARACTERISTIC TP_U8ETCSCpAxAt[0][2] EngCalVariantCriterion
  /begin VAR_ADDRESS 0x8003A49B 0x8003B29B 0x8003C09B 0x8003CE9B 0x8003DC9B 0x8003EA9B 0x8003F89B 0x8004069B 0x8004149B 0x8004229B 0x8004309B 0x80043E9B 0x80044C9B 0x80045A9B 0x8004689B 0x8004769B 0x8004849B 0x8004929B 0x8004A09B 0x8004AE9B 0x8004BC9B 0x8004CA9B 0x8004D89B 0x8004E69B /end VAR_ADDRESS
 /end VAR_CHARACTERISTIC
 /begin VAR_CHARACTERISTIC TP_U8ETCSCpAxAt[0][3] EngCalVariantCriterion
  /begin VAR_ADDRESS 0x8003A49C 0x8003B29C 0x8003C09C 0x8003CE9C 0x8003DC9C 0x8003EA9C 0x8003F89C 0x8004069C 0x8004149C 0x8004229C 0x8004309C 0x80043E9C 0x80044C9C 0x80045A9C 0x8004689C 0x8004769C 0x8004849C 0x8004929C 0x8004A09C 0x8004AE9C 0x8004BC9C 0x8004CA9C 0x8004D89C 0x8004E69C /end VAR_ADDRESS
 /end VAR_CHARACTERISTIC
 /begin VAR_CHARACTERISTIC TP_U8ETCSCpAxAt[0][4] EngCalVariantCriterion
  /begin VAR_ADDRESS 0x8003A49D 0x8003B29D 0x8003C09D 0x8003CE9D 0x8003DC9D 0x8003EA9D 0x8003F89D 0x8004069D 0x8004149D 0x8004229D 0x8004309D 0x80043E9D 0x80044C9D 0x80045A9D 0x8004689D 0x8004769D 0x8004849D 0x8004929D 0x8004A09D 0x8004AE9D 0x8004BC9D 0x8004CA9D 0x8004D89D 0x8004E69D /end VAR_ADDRESS
 /end VAR_CHARACTERISTIC
 /begin VAR_CHARACTERISTIC TP_U8ETCSCpAxAt[1][0] EngCalVariantCriterion
  /begin VAR_ADDRESS 0x8003A49E 0x8003B29E 0x8003C09E 0x8003CE9E 0x8003DC9E 0x8003EA9E 0x8003F89E 0x8004069E 0x8004149E 0x8004229E 0x8004309E 0x80043E9E 0x80044C9E 0x80045A9E 0x8004689E 0x8004769E 0x8004849E 0x8004929E 0x8004A09E 0x8004AE9E 0x8004BC9E 0x8004CA9E 0x8004D89E 0x8004E69E /end VAR_ADDRESS
 /end VAR_CHARACTERISTIC
 /begin VAR_CHARACTERISTIC TP_U8ETCSCpAxAt[1][1] EngCalVariantCriterion
  /begin VAR_ADDRESS 0x8003A49F 0x8003B29F 0x8003C09F 0x8003CE9F 0x8003DC9F 0x8003EA9F 0x8003F89F 0x8004069F 0x8004149F 0x8004229F 0x8004309F 0x80043E9F 0x80044C9F 0x80045A9F 0x8004689F 0x8004769F 0x8004849F 0x8004929F 0x8004A09F 0x8004AE9F 0x8004BC9F 0x8004CA9F 0x8004D89F 0x8004E69F /end VAR_ADDRESS
 /end VAR_CHARACTERISTIC
 /begin VAR_CHARACTERISTIC TP_U8ETCSCpAxAt[1][2] EngCalVariantCriterion
  /begin VAR_ADDRESS 0x8003A4A0 0x8003B2A0 0x8003C0A0 0x8003CEA0 0x8003DCA0 0x8003EAA0 0x8003F8A0 0x800406A0 0x800414A0 0x800422A0 0x800430A0 0x80043EA0 0x80044CA0 0x80045AA0 0x800468A0 0x800476A0 0x800484A0 0x800492A0 0x8004A0A0 0x8004AEA0 0x8004BCA0 0x8004CAA0 0x8004D8A0 0x8004E6A0 /end VAR_ADDRESS
 /end VAR_CHARACTERISTIC
 /begin VAR_CHARACTERISTIC TP_U8ETCSCpAxAt[1][3] EngCalVariantCriterion
  /begin VAR_ADDRESS 0x8003A4A1 0x8003B2A1 0x8003C0A1 0x8003CEA1 0x8003DCA1 0x8003EAA1 0x8003F8A1 0x800406A1 0x800414A1 0x800422A1 0x800430A1 0x80043EA1 0x80044CA1 0x80045AA1 0x800468A1 0x800476A1 0x800484A1 0x800492A1 0x8004A0A1 0x8004AEA1 0x8004BCA1 0x8004CAA1 0x8004D8A1 0x8004E6A1 /end VAR_ADDRESS
 /end VAR_CHARACTERISTIC
 /begin VAR_CHARACTERISTIC TP_U8ETCSCpAxAt[1][4] EngCalVariantCriterion
  /begin VAR_ADDRESS 0x8003A4A2 0x8003B2A2 0x8003C0A2 0x8003CEA2 0x8003DCA2 0x8003EAA2 0x8003F8A2 0x800406A2 0x800414A2 0x800422A2 0x800430A2 0x80043EA2 0x80044CA2 0x80045AA2 0x800468A2 0x800476A2 0x800484A2 0x800492A2 0x8004A0A2 0x8004AEA2 0x8004BCA2 0x8004CAA2 0x8004D8A2 0x8004E6A2 /end VAR_ADDRESS
 /end VAR_CHARACTERISTIC
 /begin VAR_CHARACTERISTIC TP_U8ETCSCpAxAt[2][0] EngCalVariantCriterion
  /begin VAR_ADDRESS 0x8003A4A3 0x8003B2A3 0x8003C0A3 0x8003CEA3 0x8003DCA3 0x8003EAA3 0x8003F8A3 0x800406A3 0x800414A3 0x800422A3 0x800430A3 0x80043EA3 0x80044CA3 0x80045AA3 0x800468A3 0x800476A3 0x800484A3 0x800492A3 0x8004A0A3 0x8004AEA3 0x8004BCA3 0x8004CAA3 0x8004D8A3 0x8004E6A3 /end VAR_ADDRESS
 /end VAR_CHARACTERISTIC
 /begin VAR_CHARACTERISTIC TP_U8ETCSCpAxAt[2][1] EngCalVariantCriterion
  /begin VAR_ADDRESS 0x8003A4A4 0x8003B2A4 0x8003C0A4 0x8003CEA4 0x8003DCA4 0x8003EAA4 0x8003F8A4 0x800406A4 0x800414A4 0x800422A4 0x800430A4 0x80043EA4 0x80044CA4 0x80045AA4 0x800468A4 0x800476A4 0x800484A4 0x800492A4 0x8004A0A4 0x8004AEA4 0x8004BCA4 0x8004CAA4 0x8004D8A4 0x8004E6A4 /end VAR_ADDRESS
 /end VAR_CHARACTERISTIC
 /begin VAR_CHARACTERISTIC TP_U8ETCSCpAxAt[2][2] EngCalVariantCriterion
  /begin VAR_ADDRESS 0x8003A4A5 0x8003B2A5 0x8003C0A5 0x8003CEA5 0x8003DCA5 0x8003EAA5 0x8003F8A5 0x800406A5 0x800414A5 0x800422A5 0x800430A5 0x80043EA5 0x80044CA5 0x80045AA5 0x800468A5 0x800476A5 0x800484A5 0x800492A5 0x8004A0A5 0x8004AEA5 0x8004BCA5 0x8004CAA5 0x8004D8A5 0x8004E6A5 /end VAR_ADDRESS
 /end VAR_CHARACTERISTIC
 /begin VAR_CHARACTERISTIC TP_U8ETCSCpAxAt[2][3] EngCalVariantCriterion
  /begin VAR_ADDRESS 0x8003A4A6 0x8003B2A6 0x8003C0A6 0x8003CEA6 0x8003DCA6 0x8003EAA6 0x8003F8A6 0x800406A6 0x800414A6 0x800422A6 0x800430A6 0x80043EA6 0x80044CA6 0x80045AA6 0x800468A6 0x800476A6 0x800484A6 0x800492A6 0x8004A0A6 0x8004AEA6 0x8004BCA6 0x8004CAA6 0x8004D8A6 0x8004E6A6 /end VAR_ADDRESS
 /end VAR_CHARACTERISTIC
 /begin VAR_CHARACTERISTIC TP_U8ETCSCpAxAt[2][4] EngCalVariantCriterion
  /begin VAR_ADDRESS 0x8003A4A7 0x8003B2A7 0x8003C0A7 0x8003CEA7 0x8003DCA7 0x8003EAA7 0x8003F8A7 0x800406A7 0x800414A7 0x800422A7 0x800430A7 0x80043EA7 0x80044CA7 0x80045AA7 0x800468A7 0x800476A7 0x800484A7 0x800492A7 0x8004A0A7 0x8004AEA7 0x8004BCA7 0x8004CAA7 0x8004D8A7 0x8004E6A7 /end VAR_ADDRESS
 /end VAR_CHARACTERISTIC
 /begin VAR_CHARACTERISTIC TP_U8ETCSCpAxOffset4InhHldVib EngCalVariantCriterion
  /begin VAR_ADDRESS 0x8003A4A8 0x8003B2A8 0x8003C0A8 0x8003CEA8 0x8003DCA8 0x8003EAA8 0x8003F8A8 0x800406A8 0x800414A8 0x800422A8 0x800430A8 0x80043EA8 0x80044CA8 0x80045AA8 0x800468A8 0x800476A8 0x800484A8 0x800492A8 0x8004A0A8 0x8004AEA8 0x8004BCA8 0x8004CAA8 0x8004D8A8 0x8004E6A8 /end VAR_ADDRESS
 /end VAR_CHARACTERISTIC
 /begin VAR_CHARACTERISTIC TP_U8ETCSCpAxSenAvail EngCalVariantCriterion
  /begin VAR_ADDRESS 0x8003A4A9 0x8003B2A9 0x8003C0A9 0x8003CEA9 0x8003DCA9 0x8003EAA9 0x8003F8A9 0x800406A9 0x800414A9 0x800422A9 0x800430A9 0x80043EA9 0x80044CA9 0x80045AA9 0x800468A9 0x800476A9 0x800484A9 0x800492A9 0x8004A0A9 0x8004AEA9 0x8004BCA9 0x8004CAA9 0x8004D8A9 0x8004E6A9 /end VAR_ADDRESS
 /end VAR_CHARACTERISTIC
 /begin VAR_CHARACTERISTIC TP_U8ETCSCpAy[0] EngCalVariantCriterion
  /begin VAR_ADDRESS 0x8003A4AA 0x8003B2AA 0x8003C0AA 0x8003CEAA 0x8003DCAA 0x8003EAAA 0x8003F8AA 0x800406AA 0x800414AA 0x800422AA 0x800430AA 0x80043EAA 0x80044CAA 0x80045AAA 0x800468AA 0x800476AA 0x800484AA 0x800492AA 0x8004A0AA 0x8004AEAA 0x8004BCAA 0x8004CAAA 0x8004D8AA 0x8004E6AA /end VAR_ADDRESS
 /end VAR_CHARACTERISTIC
 /begin VAR_CHARACTERISTIC TP_U8ETCSCpAy[1] EngCalVariantCriterion
  /begin VAR_ADDRESS 0x8003A4AB 0x8003B2AB 0x8003C0AB 0x8003CEAB 0x8003DCAB 0x8003EAAB 0x8003F8AB 0x800406AB 0x800414AB 0x800422AB 0x800430AB 0x80043EAB 0x80044CAB 0x80045AAB 0x800468AB 0x800476AB 0x800484AB 0x800492AB 0x8004A0AB 0x8004AEAB 0x8004BCAB 0x8004CAAB 0x8004D8AB 0x8004E6AB /end VAR_ADDRESS
 /end VAR_CHARACTERISTIC
 /begin VAR_CHARACTERISTIC TP_U8ETCSCpAy[2] EngCalVariantCriterion
  /begin VAR_ADDRESS 0x8003A4AC 0x8003B2AC 0x8003C0AC 0x8003CEAC 0x8003DCAC 0x8003EAAC 0x8003F8AC 0x800406AC 0x800414AC 0x800422AC 0x800430AC 0x80043EAC 0x80044CAC 0x80045AAC 0x800468AC 0x800476AC 0x800484AC 0x800492AC 0x8004A0AC 0x8004AEAC 0x8004BCAC 0x8004CAAC 0x8004D8AC 0x8004E6AC /end VAR_ADDRESS
 /end VAR_CHARACTERISTIC
 /begin VAR_CHARACTERISTIC TP_U8ETCSCpBigEngSpdIgFac[0][0] EngCalVariantCriterion
  /begin VAR_ADDRESS 0x8003A4AD 0x8003B2AD 0x8003C0AD 0x8003CEAD 0x8003DCAD 0x8003EAAD 0x8003F8AD 0x800406AD 0x800414AD 0x800422AD 0x800430AD 0x80043EAD 0x80044CAD 0x80045AAD 0x800468AD 0x800476AD 0x800484AD 0x800492AD 0x8004A0AD 0x8004AEAD 0x8004BCAD 0x8004CAAD 0x8004D8AD 0x8004E6AD /end VAR_ADDRESS
 /end VAR_CHARACTERISTIC
/end VARIANT_CODING
/end MODULE
/end PROJECT
