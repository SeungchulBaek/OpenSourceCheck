ASAP2_VERSION 1 60
/begin PROJECT Master ""
/begin MODULE CPP ""
/begin MOD_COMMON "" BYTE_ORDER MSB_LAST ALIGNMENT_BYTE 1 ALIGNMENT_WORD 1 ALIGNMENT_LONG 1 ALIGNMENT_FLOAT32_IEEE 1 ALIGNMENT_FLOAT64_IEEE 1 ALIGNMENT_INT64 1 /end MOD_COMMON
/begin CHARACTERISTIC BAC_PBA_EXIT_CONTROL_TIME "" VALUE 0x80020F60 CalPrmBrkAssisCoorrBrk_SWORD 0 Ti21 -327.68 327.67 SYMBOL_LINK "CalPrmBrkAssisCoorrBrk01.BAC_PBA_EXIT_CONTROL_TIME" 0 /end CHARACTERISTIC
/begin CHARACTERISTIC BAC_S16_PBA_MAX_TARGET_PRESS "" VALUE 0x80020F62 CalPrmBrkAssisCoorrBrk_SWORD 0 P34 -3276.8 3276.7 SYMBOL_LINK "CalPrmBrkAssisCoorrBrk01.BAC_S16_PBA_MAX_TARGET_PRESS" 0 /end CHARACTERISTIC
/begin CHARACTERISTIC BAC_U16_PBA_BIG_SLOPE_EXIT_TIME1 "" VALUE 0x80020F56 CalPrmBrkAssisCoorrBrk_UWORD 0 Ti21 0 655.35 SYMBOL_LINK "CalPrmBrkAssisCoorrBrk01.BAC_U16_PBA_BIG_SLOPE_EXIT_TIME1" 0 /end CHARACTERISTIC
/begin CHARACTERISTIC BAC_U16_PBA_BIG_SLOPE_EXIT_TIME2 "" VALUE 0x80020F58 CalPrmBrkAssisCoorrBrk_UWORD 0 Ti21 0 655.35 SYMBOL_LINK "CalPrmBrkAssisCoorrBrk01.BAC_U16_PBA_BIG_SLOPE_EXIT_TIME2" 0 /end CHARACTERISTIC
/begin CHARACTERISTIC BAC_U16_PBA_ESP_MU_HIGH "" VALUE 0x80020F48 CalPrmBrkAssisCoorrBrk_UWORD 0 A42 0 655.35 SYMBOL_LINK "CalPrmBrkAssisCoorrBrk01.BAC_U16_PBA_ESP_MU_HIGH" 0 /end CHARACTERISTIC
/begin CHARACTERISTIC BAC_U16_PBA_ESP_MU_LOW "" VALUE 0x80020F4A CalPrmBrkAssisCoorrBrk_UWORD 0 A42 0 655.35 SYMBOL_LINK "CalPrmBrkAssisCoorrBrk01.BAC_U16_PBA_ESP_MU_LOW" 0 /end CHARACTERISTIC
/begin CHARACTERISTIC BAC_U16_PBA_ESP_MU_MEDIUM "" VALUE 0x80020F4C CalPrmBrkAssisCoorrBrk_UWORD 0 A42 0 655.35 SYMBOL_LINK "CalPrmBrkAssisCoorrBrk01.BAC_U16_PBA_ESP_MU_MEDIUM" 0 /end CHARACTERISTIC
/begin CHARACTERISTIC BAC_U16_PBA_PRESS_ENTER_THR "" VALUE 0x80020F4E CalPrmBrkAssisCoorrBrk_UWORD 0 P34 0 6553.5 SYMBOL_LINK "CalPrmBrkAssisCoorrBrk01.BAC_U16_PBA_PRESS_ENTER_THR" 0 /end CHARACTERISTIC
/begin CHARACTERISTIC BAC_U16_PBA_PRESS_EXIT_THR1 "" VALUE 0x80020F5A CalPrmBrkAssisCoorrBrk_UWORD 0 P34 0 6553.5 SYMBOL_LINK "CalPrmBrkAssisCoorrBrk01.BAC_U16_PBA_PRESS_EXIT_THR1" 0 /end CHARACTERISTIC
/begin CHARACTERISTIC BAC_U16_PBA_PRESS_EXIT_THR2 "" VALUE 0x80020F5C CalPrmBrkAssisCoorrBrk_UWORD 0 P34 0 6553.5 SYMBOL_LINK "CalPrmBrkAssisCoorrBrk01.BAC_U16_PBA_PRESS_EXIT_THR2" 0 /end CHARACTERISTIC
/begin CHARACTERISTIC BAC_U16_PBA_PRESS_RISE_RATE_THR1 "" VALUE 0x80020F50 CalPrmBrkAssisCoorrBrk_UWORD 0 PGrdt13 0 6553.5 SYMBOL_LINK "CalPrmBrkAssisCoorrBrk01.BAC_U16_PBA_PRESS_RISE_RATE_THR1" 0 /end CHARACTERISTIC
/begin CHARACTERISTIC BAC_U16_PBA_PRESS_RISE_RATE_THR2 "" VALUE 0x80020F52 CalPrmBrkAssisCoorrBrk_UWORD 0 PGrdt13 0 6553.5 SYMBOL_LINK "CalPrmBrkAssisCoorrBrk01.BAC_U16_PBA_PRESS_RISE_RATE_THR2" 0 /end CHARACTERISTIC
/begin CHARACTERISTIC BAC_U16_PBA_SPEED_ENTER_THR "" VALUE 0x80020F54 CalPrmBrkAssisCoorrBrk_UWORD 0 Spd12 0 8191.875 SYMBOL_LINK "CalPrmBrkAssisCoorrBrk01.BAC_U16_PBA_SPEED_ENTER_THR" 0 /end CHARACTERISTIC
/begin CHARACTERISTIC BAC_U16_PBA_SPEED_EXIT_THR "" VALUE 0x80020F5E CalPrmBrkAssisCoorrBrk_UWORD 0 Spd12 0 8191.875 SYMBOL_LINK "CalPrmBrkAssisCoorrBrk01.BAC_U16_PBA_SPEED_EXIT_THR" 0 /end CHARACTERISTIC
/begin CHARACTERISTIC BAC_U8_PBA_APPLY_TIME "" VALUE 0x80020F64 CalPrmBrkAssisCoorrBrk_UBYTE 0 Ti21 0 2.55 SYMBOL_LINK "CalPrmBrkAssisCoorrBrk01.BAC_U8_PBA_APPLY_TIME" 0 /end CHARACTERISTIC
/begin CHARACTERISTIC LPC_S16_BDW_ACTIVE_TIME "" VALUE 0x80020FCA CalPrmLoPCoorrBrk_SWORD 0 Ti21 -327.68 327.67 SYMBOL_LINK "CalPrmLowPCoorrBrk01.LPC_S16_BDW_ACTIVE_TIME" 0 /end CHARACTERISTIC
/begin CHARACTERISTIC LPC_S16_BDW_DISABLE_DISK_TEMP "" VALUE 0x80020FCE CalPrmLoPCoorrBrk_SWORD 0 T32 -1023.1808 1023.149575 SYMBOL_LINK "CalPrmLowPCoorrBrk01.LPC_S16_BDW_DISABLE_DISK_TEMP" 0 /end CHARACTERISTIC
/begin CHARACTERISTIC LPC_S16_BDW_ENABLE_DISK_TEMP "" VALUE 0x80020FBC CalPrmLoPCoorrBrk_SWORD 0 T32 -1023.1808 1023.149575 SYMBOL_LINK "CalPrmLowPCoorrBrk01.LPC_S16_BDW_ENABLE_DISK_TEMP" 0 /end CHARACTERISTIC
/begin CHARACTERISTIC LPC_S16_BDW_ENT_ALATM "" VALUE 0x80020FBE CalPrmLoPCoorrBrk_SWORD 0 A41 -32.768 32.767 SYMBOL_LINK "CalPrmLowPCoorrBrk01.LPC_S16_BDW_ENT_ALATM" 0 /end CHARACTERISTIC
/begin CHARACTERISTIC LPC_S16_BDW_ENT_MPRESS "" VALUE 0x80020FC0 CalPrmLoPCoorrBrk_SWORD 0 P34 -3276.8 3276.7 SYMBOL_LINK "CalPrmLowPCoorrBrk01.LPC_S16_BDW_ENT_MPRESS" 0 /end CHARACTERISTIC
/begin CHARACTERISTIC LPC_S16_BDW_ENT_MTP "" VALUE 0x80020FC2 CalPrmLoPCoorrBrk_SWORD 0 Perc6 -32768 32767 SYMBOL_LINK "CalPrmLowPCoorrBrk01.LPC_S16_BDW_ENT_MTP" 0 /end CHARACTERISTIC
/begin CHARACTERISTIC LPC_S16_BDW_ENT_SPEED "" VALUE 0x80020FC4 CalPrmLoPCoorrBrk_SWORD 0 Spd12 -4096 4095.875 SYMBOL_LINK "CalPrmLowPCoorrBrk01.LPC_S16_BDW_ENT_SPEED" 0 /end CHARACTERISTIC
/begin CHARACTERISTIC LPC_S16_BDW_EXT_ALATM "" VALUE 0x80020FD0 CalPrmLoPCoorrBrk_SWORD 0 A41 -32.768 32.767 SYMBOL_LINK "CalPrmLowPCoorrBrk01.LPC_S16_BDW_EXT_ALATM" 0 /end CHARACTERISTIC
/begin CHARACTERISTIC LPC_S16_BDW_EXT_MPRESS "" VALUE 0x80020FD2 CalPrmLoPCoorrBrk_SWORD 0 P34 -3276.8 3276.7 SYMBOL_LINK "CalPrmLowPCoorrBrk01.LPC_S16_BDW_EXT_MPRESS" 0 /end CHARACTERISTIC
/begin CHARACTERISTIC LPC_S16_BDW_EXT_MTP "" VALUE 0x80020FD4 CalPrmLoPCoorrBrk_SWORD 0 Perc6 -32768 32767 SYMBOL_LINK "CalPrmLowPCoorrBrk01.LPC_S16_BDW_EXT_MTP" 0 /end CHARACTERISTIC
/begin CHARACTERISTIC LPC_S16_BDW_EXT_SPEED "" VALUE 0x80020FD6 CalPrmLoPCoorrBrk_SWORD 0 Spd12 -4096 4095.875 SYMBOL_LINK "CalPrmLowPCoorrBrk01.LPC_S16_BDW_EXT_SPEED" 0 /end CHARACTERISTIC
/begin CHARACTERISTIC LPC_S16_BDW_INTERVAL_TIME "" VALUE 0x80020FCC CalPrmLoPCoorrBrk_SWORD 0 Ti11 -32768 32767 SYMBOL_LINK "CalPrmLowPCoorrBrk01.LPC_S16_BDW_INTERVAL_TIME" 0 /end CHARACTERISTIC
/begin CHARACTERISTIC LPC_S16_BDW_RAIN_DETECT_TIME "" VALUE 0x80020FC6 CalPrmLoPCoorrBrk_SWORD 0 Ti11 -32768 32767 SYMBOL_LINK "CalPrmLowPCoorrBrk01.LPC_S16_BDW_RAIN_DETECT_TIME" 0 /end CHARACTERISTIC
/begin CHARACTERISTIC LPC_S16_BDW_Temp1 "" VALUE 0x80020FD8 CalPrmLoPCoorrBrk_SWORD 0 Fac31 -32768 32767 SYMBOL_LINK "CalPrmLowPCoorrBrk01.LPC_S16_BDW_Temp1" 0 /end CHARACTERISTIC
/begin CHARACTERISTIC LPC_S16_BDW_Temp2 "" VALUE 0x80020FDA CalPrmLoPCoorrBrk_SWORD 0 Fac31 -32768 32767 SYMBOL_LINK "CalPrmLowPCoorrBrk01.LPC_S16_BDW_Temp2" 0 /end CHARACTERISTIC
/begin CHARACTERISTIC LPC_S16_BDW_Temp3 "" VALUE 0x80020FDC CalPrmLoPCoorrBrk_SWORD 0 Fac31 -32768 32767 SYMBOL_LINK "CalPrmLowPCoorrBrk01.LPC_S16_BDW_Temp3" 0 /end CHARACTERISTIC
/begin CHARACTERISTIC LPC_S16_BDW_Temp4 "" VALUE 0x80020FDE CalPrmLoPCoorrBrk_SWORD 0 Fac31 -32768 32767 SYMBOL_LINK "CalPrmLowPCoorrBrk01.LPC_S16_BDW_Temp4" 0 /end CHARACTERISTIC
/begin CHARACTERISTIC LPC_S16_BDW_Temp5 "" VALUE 0x80020FE0 CalPrmLoPCoorrBrk_SWORD 0 Fac31 -32768 32767 SYMBOL_LINK "CalPrmLowPCoorrBrk01.LPC_S16_BDW_Temp5" 0 /end CHARACTERISTIC
/begin CHARACTERISTIC LPC_U8_BDW_Initial_Clean_Enable "" VALUE 0x80020FC8 CalPrmLoPCoorrBrk_UBYTE 0 OnOff1 0 255 SYMBOL_LINK "CalPrmLowPCoorrBrk01.LPC_U8_BDW_Initial_Clean_Enable" 0 /end CHARACTERISTIC
/begin CHARACTERISTIC S16_WPE_Caliper_Model_Press_1 "Temp" VALUE 0x8002155A CalPrmBrkTqCtrlrBrk_SWORD 0 P32 -327.68 327.67 SYMBOL_LINK "CalPrmBrkTqCtrlrBrk01.S16_WPE_Caliper_Model_Press_1" 0 /end CHARACTERISTIC
/begin CHARACTERISTIC S16_WPE_Caliper_Model_Press_10 "Temp" VALUE 0x8002156C CalPrmBrkTqCtrlrBrk_SWORD 0 P32 -327.68 327.67 SYMBOL_LINK "CalPrmBrkTqCtrlrBrk01.S16_WPE_Caliper_Model_Press_10" 0 /end CHARACTERISTIC
/begin CHARACTERISTIC S16_WPE_Caliper_Model_Press_11 "Temp" VALUE 0x8002156E CalPrmBrkTqCtrlrBrk_SWORD 0 P32 -327.68 327.67 SYMBOL_LINK "CalPrmBrkTqCtrlrBrk01.S16_WPE_Caliper_Model_Press_11" 0 /end CHARACTERISTIC
/begin CHARACTERISTIC S16_WPE_Caliper_Model_Press_12 "Temp" VALUE 0x80021570 CalPrmBrkTqCtrlrBrk_SWORD 0 P32 -327.68 327.67 SYMBOL_LINK "CalPrmBrkTqCtrlrBrk01.S16_WPE_Caliper_Model_Press_12" 0 /end CHARACTERISTIC
/begin CHARACTERISTIC S16_WPE_Caliper_Model_Press_13 "Temp" VALUE 0x80021572 CalPrmBrkTqCtrlrBrk_SWORD 0 P32 -327.68 327.67 SYMBOL_LINK "CalPrmBrkTqCtrlrBrk01.S16_WPE_Caliper_Model_Press_13" 0 /end CHARACTERISTIC
/begin CHARACTERISTIC S16_WPE_Caliper_Model_Press_14 "Temp" VALUE 0x80021574 CalPrmBrkTqCtrlrBrk_SWORD 0 P32 -327.68 327.67 SYMBOL_LINK "CalPrmBrkTqCtrlrBrk01.S16_WPE_Caliper_Model_Press_14" 0 /end CHARACTERISTIC
/begin CHARACTERISTIC S16_WPE_Caliper_Model_Press_15 "Temp" VALUE 0x80021576 CalPrmBrkTqCtrlrBrk_SWORD 0 P32 -327.68 327.67 SYMBOL_LINK "CalPrmBrkTqCtrlrBrk01.S16_WPE_Caliper_Model_Press_15" 0 /end CHARACTERISTIC
/begin CHARACTERISTIC S16_WPE_Caliper_Model_Press_16 "Temp" VALUE 0x80021578 CalPrmBrkTqCtrlrBrk_SWORD 0 P32 -327.68 327.67 SYMBOL_LINK "CalPrmBrkTqCtrlrBrk01.S16_WPE_Caliper_Model_Press_16" 0 /end CHARACTERISTIC
/begin CHARACTERISTIC S16_WPE_Caliper_Model_Press_2 "Temp" VALUE 0x8002155C CalPrmBrkTqCtrlrBrk_SWORD 0 P32 -327.68 327.67 SYMBOL_LINK "CalPrmBrkTqCtrlrBrk01.S16_WPE_Caliper_Model_Press_2" 0 /end CHARACTERISTIC
/begin CHARACTERISTIC S16_WPE_Caliper_Model_Press_3 "Temp" VALUE 0x8002155E CalPrmBrkTqCtrlrBrk_SWORD 0 P32 -327.68 327.67 SYMBOL_LINK "CalPrmBrkTqCtrlrBrk01.S16_WPE_Caliper_Model_Press_3" 0 /end CHARACTERISTIC
/begin CHARACTERISTIC S16_WPE_Caliper_Model_Press_4 "Temp" VALUE 0x80021560 CalPrmBrkTqCtrlrBrk_SWORD 0 P32 -327.68 327.67 SYMBOL_LINK "CalPrmBrkTqCtrlrBrk01.S16_WPE_Caliper_Model_Press_4" 0 /end CHARACTERISTIC
/begin CHARACTERISTIC S16_WPE_Caliper_Model_Press_5 "Temp" VALUE 0x80021562 CalPrmBrkTqCtrlrBrk_SWORD 0 P32 -327.68 327.67 SYMBOL_LINK "CalPrmBrkTqCtrlrBrk01.S16_WPE_Caliper_Model_Press_5" 0 /end CHARACTERISTIC
/begin CHARACTERISTIC S16_WPE_Caliper_Model_Press_6 "Temp" VALUE 0x80021564 CalPrmBrkTqCtrlrBrk_SWORD 0 P32 -327.68 327.67 SYMBOL_LINK "CalPrmBrkTqCtrlrBrk01.S16_WPE_Caliper_Model_Press_6" 0 /end CHARACTERISTIC
/begin CHARACTERISTIC S16_WPE_Caliper_Model_Press_7 "Temp" VALUE 0x80021566 CalPrmBrkTqCtrlrBrk_SWORD 0 P32 -327.68 327.67 SYMBOL_LINK "CalPrmBrkTqCtrlrBrk01.S16_WPE_Caliper_Model_Press_7" 0 /end CHARACTERISTIC
/begin CHARACTERISTIC S16_WPE_Caliper_Model_Press_8 "Temp" VALUE 0x80021568 CalPrmBrkTqCtrlrBrk_SWORD 0 P32 -327.68 327.67 SYMBOL_LINK "CalPrmBrkTqCtrlrBrk01.S16_WPE_Caliper_Model_Press_8" 0 /end CHARACTERISTIC
/begin CHARACTERISTIC S16_WPE_Caliper_Model_Press_9 "Temp" VALUE 0x8002156A CalPrmBrkTqCtrlrBrk_SWORD 0 P32 -327.68 327.67 SYMBOL_LINK "CalPrmBrkTqCtrlrBrk01.S16_WPE_Caliper_Model_Press_9" 0 /end CHARACTERISTIC
/begin CHARACTERISTIC S16_WPE_Caliper_Model_Volume_No_r "Temp" VALUE 0x80021558 CalPrmBrkTqCtrlrBrk_SWORD 0 Gain -32768 32767 SYMBOL_LINK "CalPrmBrkTqCtrlrBrk01.S16_WPE_Caliper_Model_Volume_No_r" 0 /end CHARACTERISTIC
/begin CHARACTERISTIC S16_WPE_Caliper_Model_Volume_r_1 "Temp" VALUE 0x8002159A CalPrmBrkTqCtrlrBrk_SWORD 0 Gain -32768 32767 SYMBOL_LINK "CalPrmBrkTqCtrlrBrk01.S16_WPE_Caliper_Model_Volume_r_1" 0 /end CHARACTERISTIC
/begin CHARACTERISTIC S16_WPE_Caliper_Model_Volume_r_10 "Temp" VALUE 0x800215AC CalPrmBrkTqCtrlrBrk_SWORD 0 Gain -32768 32767 SYMBOL_LINK "CalPrmBrkTqCtrlrBrk01.S16_WPE_Caliper_Model_Volume_r_10" 0 /end CHARACTERISTIC
/begin CHARACTERISTIC S16_WPE_Caliper_Model_Volume_r_11 "Temp" VALUE 0x800215AE CalPrmBrkTqCtrlrBrk_SWORD 0 Gain -32768 32767 SYMBOL_LINK "CalPrmBrkTqCtrlrBrk01.S16_WPE_Caliper_Model_Volume_r_11" 0 /end CHARACTERISTIC
/begin CHARACTERISTIC S16_WPE_Caliper_Model_Volume_r_12 "Temp" VALUE 0x800215B0 CalPrmBrkTqCtrlrBrk_SWORD 0 Gain -32768 32767 SYMBOL_LINK "CalPrmBrkTqCtrlrBrk01.S16_WPE_Caliper_Model_Volume_r_12" 0 /end CHARACTERISTIC
/begin CHARACTERISTIC S16_WPE_Caliper_Model_Volume_r_13 "Temp" VALUE 0x800215B2 CalPrmBrkTqCtrlrBrk_SWORD 0 Gain -32768 32767 SYMBOL_LINK "CalPrmBrkTqCtrlrBrk01.S16_WPE_Caliper_Model_Volume_r_13" 0 /end CHARACTERISTIC
/begin CHARACTERISTIC S16_WPE_Caliper_Model_Volume_r_14 "Temp" VALUE 0x800215B4 CalPrmBrkTqCtrlrBrk_SWORD 0 Gain -32768 32767 SYMBOL_LINK "CalPrmBrkTqCtrlrBrk01.S16_WPE_Caliper_Model_Volume_r_14" 0 /end CHARACTERISTIC
/begin CHARACTERISTIC S16_WPE_Caliper_Model_Volume_r_15 "Temp" VALUE 0x800215B6 CalPrmBrkTqCtrlrBrk_SWORD 0 Gain -32768 32767 SYMBOL_LINK "CalPrmBrkTqCtrlrBrk01.S16_WPE_Caliper_Model_Volume_r_15" 0 /end CHARACTERISTIC
/begin CHARACTERISTIC S16_WPE_Caliper_Model_Volume_r_16 "Temp" VALUE 0x800215B8 CalPrmBrkTqCtrlrBrk_SWORD 0 Gain -32768 32767 SYMBOL_LINK "CalPrmBrkTqCtrlrBrk01.S16_WPE_Caliper_Model_Volume_r_16" 0 /end CHARACTERISTIC
/begin CHARACTERISTIC S16_WPE_Caliper_Model_Volume_r_2 "Temp" VALUE 0x8002159C CalPrmBrkTqCtrlrBrk_SWORD 0 Gain -32768 32767 SYMBOL_LINK "CalPrmBrkTqCtrlrBrk01.S16_WPE_Caliper_Model_Volume_r_2" 0 /end CHARACTERISTIC
/begin CHARACTERISTIC S16_WPE_Caliper_Model_Volume_r_3 "Temp" VALUE 0x8002159E CalPrmBrkTqCtrlrBrk_SWORD 0 Gain -32768 32767 SYMBOL_LINK "CalPrmBrkTqCtrlrBrk01.S16_WPE_Caliper_Model_Volume_r_3" 0 /end CHARACTERISTIC
/begin CHARACTERISTIC S16_WPE_Caliper_Model_Volume_r_4 "Temp" VALUE 0x800215A0 CalPrmBrkTqCtrlrBrk_SWORD 0 Gain -32768 32767 SYMBOL_LINK "CalPrmBrkTqCtrlrBrk01.S16_WPE_Caliper_Model_Volume_r_4" 0 /end CHARACTERISTIC
/begin CHARACTERISTIC S16_WPE_Caliper_Model_Volume_r_5 "Temp" VALUE 0x800215A2 CalPrmBrkTqCtrlrBrk_SWORD 0 Gain -32768 32767 SYMBOL_LINK "CalPrmBrkTqCtrlrBrk01.S16_WPE_Caliper_Model_Volume_r_5" 0 /end CHARACTERISTIC
/begin CHARACTERISTIC S16_WPE_Caliper_Model_Volume_r_6 "Temp" VALUE 0x800215A4 CalPrmBrkTqCtrlrBrk_SWORD 0 Gain -32768 32767 SYMBOL_LINK "CalPrmBrkTqCtrlrBrk01.S16_WPE_Caliper_Model_Volume_r_6" 0 /end CHARACTERISTIC
/begin CHARACTERISTIC S16_WPE_Caliper_Model_Volume_r_7 "Temp" VALUE 0x800215A6 CalPrmBrkTqCtrlrBrk_SWORD 0 Gain -32768 32767 SYMBOL_LINK "CalPrmBrkTqCtrlrBrk01.S16_WPE_Caliper_Model_Volume_r_7" 0 /end CHARACTERISTIC
/begin CHARACTERISTIC S16_WPE_Caliper_Model_Volume_r_8 "Temp" VALUE 0x800215A8 CalPrmBrkTqCtrlrBrk_SWORD 0 Gain -32768 32767 SYMBOL_LINK "CalPrmBrkTqCtrlrBrk01.S16_WPE_Caliper_Model_Volume_r_8" 0 /end CHARACTERISTIC
/begin CHARACTERISTIC S16_WPE_Caliper_Model_Volume_r_9 "Temp" VALUE 0x800215AA CalPrmBrkTqCtrlrBrk_SWORD 0 Gain -32768 32767 SYMBOL_LINK "CalPrmBrkTqCtrlrBrk01.S16_WPE_Caliper_Model_Volume_r_9" 0 /end CHARACTERISTIC
/begin CHARACTERISTIC S16_WPE_LFC_ESC_Rise_Gain_2_f_1st "Temp" VALUE 0x80021726 CalPrmBrkTqCtrlrBrk_SWORD 0 Perc6 -32768 32767 SYMBOL_LINK "CalPrmBrkTqCtrlrBrk01.S16_WPE_LFC_ESC_Rise_Gain_2_f_1st" 0 /end CHARACTERISTIC
/begin CHARACTERISTIC S16_WPE_LFC_ESC_Rise_Gain_2_f_2nd "Temp" VALUE 0x80021728 CalPrmBrkTqCtrlrBrk_SWORD 0 Perc6 -32768 32767 SYMBOL_LINK "CalPrmBrkTqCtrlrBrk01.S16_WPE_LFC_ESC_Rise_Gain_2_f_2nd" 0 /end CHARACTERISTIC
/begin CHARACTERISTIC S16_WPE_LFC_ESC_Rise_Gain_2_f_3rd "Temp" VALUE 0x8002172A CalPrmBrkTqCtrlrBrk_SWORD 0 Perc6 -32768 32767 SYMBOL_LINK "CalPrmBrkTqCtrlrBrk01.S16_WPE_LFC_ESC_Rise_Gain_2_f_3rd" 0 /end CHARACTERISTIC
/begin CHARACTERISTIC S16_WPE_LFC_ESC_Rise_Gain_2_f_4th "Temp" VALUE 0x8002172C CalPrmBrkTqCtrlrBrk_SWORD 0 Perc6 -32768 32767 SYMBOL_LINK "CalPrmBrkTqCtrlrBrk01.S16_WPE_LFC_ESC_Rise_Gain_2_f_4th" 0 /end CHARACTERISTIC
/begin CHARACTERISTIC S16_WPE_LFC_ESC_Rise_Gain_2_f_5th "Temp" VALUE 0x8002172E CalPrmBrkTqCtrlrBrk_SWORD 0 Perc6 -32768 32767 SYMBOL_LINK "CalPrmBrkTqCtrlrBrk01.S16_WPE_LFC_ESC_Rise_Gain_2_f_5th" 0 /end CHARACTERISTIC
/begin CHARACTERISTIC S16_WPE_LFC_ESC_Rise_Gain_2_f_6th "Temp" VALUE 0x80021730 CalPrmBrkTqCtrlrBrk_SWORD 0 Perc6 -32768 32767 SYMBOL_LINK "CalPrmBrkTqCtrlrBrk01.S16_WPE_LFC_ESC_Rise_Gain_2_f_6th" 0 /end CHARACTERISTIC
/begin CHARACTERISTIC S16_WPE_LFC_ESC_Rise_Gain_2_r_1st "Temp" VALUE 0x8002173E CalPrmBrkTqCtrlrBrk_SWORD 0 Perc6 -32768 32767 SYMBOL_LINK "CalPrmBrkTqCtrlrBrk01.S16_WPE_LFC_ESC_Rise_Gain_2_r_1st" 0 /end CHARACTERISTIC
/begin CHARACTERISTIC S16_WPE_LFC_ESC_Rise_Gain_2_r_2nd "Temp" VALUE 0x80021740 CalPrmBrkTqCtrlrBrk_SWORD 0 Perc6 -32768 32767 SYMBOL_LINK "CalPrmBrkTqCtrlrBrk01.S16_WPE_LFC_ESC_Rise_Gain_2_r_2nd" 0 /end CHARACTERISTIC
/begin CHARACTERISTIC S16_WPE_LFC_ESC_Rise_Gain_2_r_3rd "Temp" VALUE 0x80021742 CalPrmBrkTqCtrlrBrk_SWORD 0 Perc6 -32768 32767 SYMBOL_LINK "CalPrmBrkTqCtrlrBrk01.S16_WPE_LFC_ESC_Rise_Gain_2_r_3rd" 0 /end CHARACTERISTIC
/begin CHARACTERISTIC S16_WPE_LFC_ESC_Rise_Gain_2_r_4th "Temp" VALUE 0x80021744 CalPrmBrkTqCtrlrBrk_SWORD 0 Perc6 -32768 32767 SYMBOL_LINK "CalPrmBrkTqCtrlrBrk01.S16_WPE_LFC_ESC_Rise_Gain_2_r_4th" 0 /end CHARACTERISTIC
/begin CHARACTERISTIC S16_WPE_LFC_ESC_Rise_Gain_2_r_5th "Temp" VALUE 0x80021746 CalPrmBrkTqCtrlrBrk_SWORD 0 Perc6 -32768 32767 SYMBOL_LINK "CalPrmBrkTqCtrlrBrk01.S16_WPE_LFC_ESC_Rise_Gain_2_r_5th" 0 /end CHARACTERISTIC
/begin CHARACTERISTIC S16_WPE_LFC_ESC_Rise_Gain_2_r_6th "Temp" VALUE 0x80021748 CalPrmBrkTqCtrlrBrk_SWORD 0 Perc6 -32768 32767 SYMBOL_LINK "CalPrmBrkTqCtrlrBrk01.S16_WPE_LFC_ESC_Rise_Gain_2_r_6th" 0 /end CHARACTERISTIC
/begin CHARACTERISTIC S16_WPE_LFC_ESC_Rise_Gain_f_1st "Temp" VALUE 0x800216FC CalPrmBrkTqCtrlrBrk_SWORD 0 Perc6 -32768 32767 SYMBOL_LINK "CalPrmBrkTqCtrlrBrk01.S16_WPE_LFC_ESC_Rise_Gain_f_1st" 0 /end CHARACTERISTIC
/begin CHARACTERISTIC S16_WPE_LFC_ESC_Rise_Gain_f_2nd "Temp" VALUE 0x800216FE CalPrmBrkTqCtrlrBrk_SWORD 0 Perc6 -32768 32767 SYMBOL_LINK "CalPrmBrkTqCtrlrBrk01.S16_WPE_LFC_ESC_Rise_Gain_f_2nd" 0 /end CHARACTERISTIC
/begin CHARACTERISTIC S16_WPE_LFC_ESC_Rise_Gain_f_3rd "Temp" VALUE 0x80021700 CalPrmBrkTqCtrlrBrk_SWORD 0 Perc6 -32768 32767 SYMBOL_LINK "CalPrmBrkTqCtrlrBrk01.S16_WPE_LFC_ESC_Rise_Gain_f_3rd" 0 /end CHARACTERISTIC
/begin CHARACTERISTIC S16_WPE_LFC_ESC_Rise_Gain_f_4th "Temp" VALUE 0x80021702 CalPrmBrkTqCtrlrBrk_SWORD 0 Perc6 -32768 32767 SYMBOL_LINK "CalPrmBrkTqCtrlrBrk01.S16_WPE_LFC_ESC_Rise_Gain_f_4th" 0 /end CHARACTERISTIC
/begin CHARACTERISTIC S16_WPE_LFC_ESC_Rise_Gain_f_5th "Temp" VALUE 0x80021704 CalPrmBrkTqCtrlrBrk_SWORD 0 Perc6 -32768 32767 SYMBOL_LINK "CalPrmBrkTqCtrlrBrk01.S16_WPE_LFC_ESC_Rise_Gain_f_5th" 0 /end CHARACTERISTIC
/begin CHARACTERISTIC S16_WPE_LFC_ESC_Rise_Gain_f_6th "Temp" VALUE 0x80021706 CalPrmBrkTqCtrlrBrk_SWORD 0 Perc6 -32768 32767 SYMBOL_LINK "CalPrmBrkTqCtrlrBrk01.S16_WPE_LFC_ESC_Rise_Gain_f_6th" 0 /end CHARACTERISTIC
/begin CHARACTERISTIC S16_WPE_LFC_ESC_Rise_Gain_r_1st "Temp" VALUE 0x8002170E CalPrmBrkTqCtrlrBrk_SWORD 0 Perc6 -32768 32767 SYMBOL_LINK "CalPrmBrkTqCtrlrBrk01.S16_WPE_LFC_ESC_Rise_Gain_r_1st" 0 /end CHARACTERISTIC
/begin CHARACTERISTIC S16_WPE_LFC_ESC_Rise_Gain_r_2nd "Temp" VALUE 0x80021710 CalPrmBrkTqCtrlrBrk_SWORD 0 Perc6 -32768 32767 SYMBOL_LINK "CalPrmBrkTqCtrlrBrk01.S16_WPE_LFC_ESC_Rise_Gain_r_2nd" 0 /end CHARACTERISTIC
/begin CHARACTERISTIC S16_WPE_LFC_ESC_Rise_Gain_r_3rd "Temp" VALUE 0x80021712 CalPrmBrkTqCtrlrBrk_SWORD 0 Perc6 -32768 32767 SYMBOL_LINK "CalPrmBrkTqCtrlrBrk01.S16_WPE_LFC_ESC_Rise_Gain_r_3rd" 0 /end CHARACTERISTIC
/begin CHARACTERISTIC S16_WPE_LFC_ESC_Rise_Gain_r_4th "Temp" VALUE 0x80021714 CalPrmBrkTqCtrlrBrk_SWORD 0 Perc6 -32768 32767 SYMBOL_LINK "CalPrmBrkTqCtrlrBrk01.S16_WPE_LFC_ESC_Rise_Gain_r_4th" 0 /end CHARACTERISTIC
/begin CHARACTERISTIC S16_WPE_LFC_ESC_Rise_Gain_r_5th "Temp" VALUE 0x80021716 CalPrmBrkTqCtrlrBrk_SWORD 0 Perc6 -32768 32767 SYMBOL_LINK "CalPrmBrkTqCtrlrBrk01.S16_WPE_LFC_ESC_Rise_Gain_r_5th" 0 /end CHARACTERISTIC
/begin CHARACTERISTIC S16_WPE_LFC_ESC_Rise_Gain_r_6th "Temp" VALUE 0x80021718 CalPrmBrkTqCtrlrBrk_SWORD 0 Perc6 -32768 32767 SYMBOL_LINK "CalPrmBrkTqCtrlrBrk01.S16_WPE_LFC_ESC_Rise_Gain_r_6th" 0 /end CHARACTERISTIC
/begin CHARACTERISTIC S16_WPE_LFC_ESC_Rise_Press_f_1st "Temp" VALUE 0x8002171A CalPrmBrkTqCtrlrBrk_SWORD 0 P32 -327.68 327.67 SYMBOL_LINK "CalPrmBrkTqCtrlrBrk01.S16_WPE_LFC_ESC_Rise_Press_f_1st" 0 /end CHARACTERISTIC
/begin CHARACTERISTIC S16_WPE_LFC_ESC_Rise_Press_f_2nd "Temp" VALUE 0x8002171C CalPrmBrkTqCtrlrBrk_SWORD 0 P32 -327.68 327.67 SYMBOL_LINK "CalPrmBrkTqCtrlrBrk01.S16_WPE_LFC_ESC_Rise_Press_f_2nd" 0 /end CHARACTERISTIC
/begin CHARACTERISTIC S16_WPE_LFC_ESC_Rise_Press_f_3rd "Temp" VALUE 0x8002171E CalPrmBrkTqCtrlrBrk_SWORD 0 P32 -327.68 327.67 SYMBOL_LINK "CalPrmBrkTqCtrlrBrk01.S16_WPE_LFC_ESC_Rise_Press_f_3rd" 0 /end CHARACTERISTIC
/begin CHARACTERISTIC S16_WPE_LFC_ESC_Rise_Press_f_4th "Temp" VALUE 0x80021720 CalPrmBrkTqCtrlrBrk_SWORD 0 P32 -327.68 327.67 SYMBOL_LINK "CalPrmBrkTqCtrlrBrk01.S16_WPE_LFC_ESC_Rise_Press_f_4th" 0 /end CHARACTERISTIC
/begin CHARACTERISTIC S16_WPE_LFC_ESC_Rise_Press_f_5th "Temp" VALUE 0x80021722 CalPrmBrkTqCtrlrBrk_SWORD 0 P32 -327.68 327.67 SYMBOL_LINK "CalPrmBrkTqCtrlrBrk01.S16_WPE_LFC_ESC_Rise_Press_f_5th" 0 /end CHARACTERISTIC
/begin CHARACTERISTIC S16_WPE_LFC_ESC_Rise_Press_f_6th "Temp" VALUE 0x80021724 CalPrmBrkTqCtrlrBrk_SWORD 0 P32 -327.68 327.67 SYMBOL_LINK "CalPrmBrkTqCtrlrBrk01.S16_WPE_LFC_ESC_Rise_Press_f_6th" 0 /end CHARACTERISTIC
/begin CHARACTERISTIC S16_WPE_LFC_ESC_Rise_Press_r_1st "Temp" VALUE 0x80021732 CalPrmBrkTqCtrlrBrk_SWORD 0 P32 -327.68 327.67 SYMBOL_LINK "CalPrmBrkTqCtrlrBrk01.S16_WPE_LFC_ESC_Rise_Press_r_1st" 0 /end CHARACTERISTIC
/begin CHARACTERISTIC S16_WPE_LFC_ESC_Rise_Press_r_2nd "Temp" VALUE 0x80021734 CalPrmBrkTqCtrlrBrk_SWORD 0 P32 -327.68 327.67 SYMBOL_LINK "CalPrmBrkTqCtrlrBrk01.S16_WPE_LFC_ESC_Rise_Press_r_2nd" 0 /end CHARACTERISTIC
/begin CHARACTERISTIC S16_WPE_LFC_ESC_Rise_Press_r_3rd "Temp" VALUE 0x80021736 CalPrmBrkTqCtrlrBrk_SWORD 0 P32 -327.68 327.67 SYMBOL_LINK "CalPrmBrkTqCtrlrBrk01.S16_WPE_LFC_ESC_Rise_Press_r_3rd" 0 /end CHARACTERISTIC
/begin CHARACTERISTIC S16_WPE_LFC_ESC_Rise_Press_r_4th "Temp" VALUE 0x80021738 CalPrmBrkTqCtrlrBrk_SWORD 0 P32 -327.68 327.67 SYMBOL_LINK "CalPrmBrkTqCtrlrBrk01.S16_WPE_LFC_ESC_Rise_Press_r_4th" 0 /end CHARACTERISTIC
/begin CHARACTERISTIC S16_WPE_LFC_ESC_Rise_Press_r_5th "Temp" VALUE 0x8002173A CalPrmBrkTqCtrlrBrk_SWORD 0 P32 -327.68 327.67 SYMBOL_LINK "CalPrmBrkTqCtrlrBrk01.S16_WPE_LFC_ESC_Rise_Press_r_5th" 0 /end CHARACTERISTIC
/begin CHARACTERISTIC S16_WPE_LFC_ESC_Rise_Press_r_6th "Temp" VALUE 0x8002173C CalPrmBrkTqCtrlrBrk_SWORD 0 P32 -327.68 327.67 SYMBOL_LINK "CalPrmBrkTqCtrlrBrk01.S16_WPE_LFC_ESC_Rise_Press_r_6th" 0 /end CHARACTERISTIC
/begin CHARACTERISTIC S16_WPE_LFC_Hold_press_f_10th "Temp" VALUE 0x80021674 CalPrmBrkTqCtrlrBrk_SWORD 0 P34 -3276.8 3276.7 SYMBOL_LINK "CalPrmBrkTqCtrlrBrk01.S16_WPE_LFC_Hold_press_f_10th" 0 /end CHARACTERISTIC
/begin CHARACTERISTIC S16_WPE_LFC_Hold_press_f_11th "Temp" VALUE 0x80021676 CalPrmBrkTqCtrlrBrk_SWORD 0 P34 -3276.8 3276.7 SYMBOL_LINK "CalPrmBrkTqCtrlrBrk01.S16_WPE_LFC_Hold_press_f_11th" 0 /end CHARACTERISTIC
/begin CHARACTERISTIC S16_WPE_LFC_Hold_press_f_12th "Temp" VALUE 0x80021678 CalPrmBrkTqCtrlrBrk_SWORD 0 P34 -3276.8 3276.7 SYMBOL_LINK "CalPrmBrkTqCtrlrBrk01.S16_WPE_LFC_Hold_press_f_12th" 0 /end CHARACTERISTIC
/begin CHARACTERISTIC S16_WPE_LFC_Hold_press_f_13th "Temp" VALUE 0x8002167A CalPrmBrkTqCtrlrBrk_SWORD 0 P34 -3276.8 3276.7 SYMBOL_LINK "CalPrmBrkTqCtrlrBrk01.S16_WPE_LFC_Hold_press_f_13th" 0 /end CHARACTERISTIC
/begin CHARACTERISTIC S16_WPE_LFC_Hold_press_f_14th "Temp" VALUE 0x8002167C CalPrmBrkTqCtrlrBrk_SWORD 0 P34 -3276.8 3276.7 SYMBOL_LINK "CalPrmBrkTqCtrlrBrk01.S16_WPE_LFC_Hold_press_f_14th" 0 /end CHARACTERISTIC
/begin CHARACTERISTIC S16_WPE_LFC_Hold_press_f_15th "Temp" VALUE 0x8002167E CalPrmBrkTqCtrlrBrk_SWORD 0 P34 -3276.8 3276.7 SYMBOL_LINK "CalPrmBrkTqCtrlrBrk01.S16_WPE_LFC_Hold_press_f_15th" 0 /end CHARACTERISTIC
/begin CHARACTERISTIC S16_WPE_LFC_Hold_press_f_16th "Temp" VALUE 0x80021680 CalPrmBrkTqCtrlrBrk_SWORD 0 P34 -3276.8 3276.7 SYMBOL_LINK "CalPrmBrkTqCtrlrBrk01.S16_WPE_LFC_Hold_press_f_16th" 0 /end CHARACTERISTIC
/begin CHARACTERISTIC S16_WPE_LFC_Hold_press_f_1st "Temp" VALUE 0x80021662 CalPrmBrkTqCtrlrBrk_SWORD 0 P34 -3276.8 3276.7 SYMBOL_LINK "CalPrmBrkTqCtrlrBrk01.S16_WPE_LFC_Hold_press_f_1st" 0 /end CHARACTERISTIC
/begin CHARACTERISTIC S16_WPE_LFC_Hold_press_f_2nd "Temp" VALUE 0x80021664 CalPrmBrkTqCtrlrBrk_SWORD 0 P34 -3276.8 3276.7 SYMBOL_LINK "CalPrmBrkTqCtrlrBrk01.S16_WPE_LFC_Hold_press_f_2nd" 0 /end CHARACTERISTIC
/begin CHARACTERISTIC S16_WPE_LFC_Hold_press_f_3rd "Temp" VALUE 0x80021666 CalPrmBrkTqCtrlrBrk_SWORD 0 P34 -3276.8 3276.7 SYMBOL_LINK "CalPrmBrkTqCtrlrBrk01.S16_WPE_LFC_Hold_press_f_3rd" 0 /end CHARACTERISTIC
/begin CHARACTERISTIC S16_WPE_LFC_Hold_press_f_4th "Temp" VALUE 0x80021668 CalPrmBrkTqCtrlrBrk_SWORD 0 P34 -3276.8 3276.7 SYMBOL_LINK "CalPrmBrkTqCtrlrBrk01.S16_WPE_LFC_Hold_press_f_4th" 0 /end CHARACTERISTIC
/begin CHARACTERISTIC S16_WPE_LFC_Hold_press_f_5th "Temp" VALUE 0x8002166A CalPrmBrkTqCtrlrBrk_SWORD 0 P34 -3276.8 3276.7 SYMBOL_LINK "CalPrmBrkTqCtrlrBrk01.S16_WPE_LFC_Hold_press_f_5th" 0 /end CHARACTERISTIC
/begin CHARACTERISTIC S16_WPE_LFC_Hold_press_f_6th "Temp" VALUE 0x8002166C CalPrmBrkTqCtrlrBrk_SWORD 0 P34 -3276.8 3276.7 SYMBOL_LINK "CalPrmBrkTqCtrlrBrk01.S16_WPE_LFC_Hold_press_f_6th" 0 /end CHARACTERISTIC
/begin CHARACTERISTIC S16_WPE_LFC_Hold_press_f_7th "Temp" VALUE 0x8002166E CalPrmBrkTqCtrlrBrk_SWORD 0 P34 -3276.8 3276.7 SYMBOL_LINK "CalPrmBrkTqCtrlrBrk01.S16_WPE_LFC_Hold_press_f_7th" 0 /end CHARACTERISTIC
/begin CHARACTERISTIC S16_WPE_LFC_Hold_press_f_8th "Temp" VALUE 0x80021670 CalPrmBrkTqCtrlrBrk_SWORD 0 P34 -3276.8 3276.7 SYMBOL_LINK "CalPrmBrkTqCtrlrBrk01.S16_WPE_LFC_Hold_press_f_8th" 0 /end CHARACTERISTIC
/begin CHARACTERISTIC S16_WPE_LFC_Hold_press_f_9th "Temp" VALUE 0x80021672 CalPrmBrkTqCtrlrBrk_SWORD 0 P34 -3276.8 3276.7 SYMBOL_LINK "CalPrmBrkTqCtrlrBrk01.S16_WPE_LFC_Hold_press_f_9th" 0 /end CHARACTERISTIC
/begin CHARACTERISTIC S16_WPE_NC_Dump_Gain_Press_r_1st "Temp" VALUE 0x80021786 CalPrmBrkTqCtrlrBrk_SWORD 0 P34 -3276.8 3276.7 SYMBOL_LINK "CalPrmBrkTqCtrlrBrk01.S16_WPE_NC_Dump_Gain_Press_r_1st" 0 /end CHARACTERISTIC
/begin CHARACTERISTIC S16_WPE_NC_Dump_Gain_Press_r_2nd "Temp" VALUE 0x80021788 CalPrmBrkTqCtrlrBrk_SWORD 0 P34 -3276.8 3276.7 SYMBOL_LINK "CalPrmBrkTqCtrlrBrk01.S16_WPE_NC_Dump_Gain_Press_r_2nd" 0 /end CHARACTERISTIC
/begin CHARACTERISTIC S16_WPE_NC_Dump_Gain_Press_r_3rd "Temp" VALUE 0x8002178A CalPrmBrkTqCtrlrBrk_SWORD 0 P34 -3276.8 3276.7 SYMBOL_LINK "CalPrmBrkTqCtrlrBrk01.S16_WPE_NC_Dump_Gain_Press_r_3rd" 0 /end CHARACTERISTIC
/begin CHARACTERISTIC S16_WPE_NC_Dump_Gain_Press_r_4th "Temp" VALUE 0x8002178C CalPrmBrkTqCtrlrBrk_SWORD 0 P34 -3276.8 3276.7 SYMBOL_LINK "CalPrmBrkTqCtrlrBrk01.S16_WPE_NC_Dump_Gain_Press_r_4th" 0 /end CHARACTERISTIC
/begin CHARACTERISTIC S16_WPE_NC_Dump_Gain_Press_r_5th "Temp" VALUE 0x8002178E CalPrmBrkTqCtrlrBrk_SWORD 0 P34 -3276.8 3276.7 SYMBOL_LINK "CalPrmBrkTqCtrlrBrk01.S16_WPE_NC_Dump_Gain_Press_r_5th" 0 /end CHARACTERISTIC
/begin CHARACTERISTIC S16_WPE_NC_Dump_Gain_Press_r_6th "Temp" VALUE 0x80021790 CalPrmBrkTqCtrlrBrk_SWORD 0 P34 -3276.8 3276.7 SYMBOL_LINK "CalPrmBrkTqCtrlrBrk01.S16_WPE_NC_Dump_Gain_Press_r_6th" 0 /end CHARACTERISTIC
/begin CHARACTERISTIC S16_WPE_NC_Dump_Gain_r_1st "Temp" VALUE 0x80021792 CalPrmBrkTqCtrlrBrk_SWORD 0 Perc6 -32768 32767 SYMBOL_LINK "CalPrmBrkTqCtrlrBrk01.S16_WPE_NC_Dump_Gain_r_1st" 0 /end CHARACTERISTIC
/begin CHARACTERISTIC S16_WPE_NC_Dump_Gain_r_2nd "Temp" VALUE 0x80021794 CalPrmBrkTqCtrlrBrk_SWORD 0 Perc6 -32768 32767 SYMBOL_LINK "CalPrmBrkTqCtrlrBrk01.S16_WPE_NC_Dump_Gain_r_2nd" 0 /end CHARACTERISTIC
/begin CHARACTERISTIC S16_WPE_NC_Dump_Gain_r_3rd "Temp" VALUE 0x80021796 CalPrmBrkTqCtrlrBrk_SWORD 0 Perc6 -32768 32767 SYMBOL_LINK "CalPrmBrkTqCtrlrBrk01.S16_WPE_NC_Dump_Gain_r_3rd" 0 /end CHARACTERISTIC
/begin CHARACTERISTIC S16_WPE_NC_Dump_Gain_r_4th "Temp" VALUE 0x80021798 CalPrmBrkTqCtrlrBrk_SWORD 0 Perc6 -32768 32767 SYMBOL_LINK "CalPrmBrkTqCtrlrBrk01.S16_WPE_NC_Dump_Gain_r_4th" 0 /end CHARACTERISTIC
/begin CHARACTERISTIC S16_WPE_NC_Dump_Gain_r_5th "Temp" VALUE 0x8002179A CalPrmBrkTqCtrlrBrk_SWORD 0 Perc6 -32768 32767 SYMBOL_LINK "CalPrmBrkTqCtrlrBrk01.S16_WPE_NC_Dump_Gain_r_5th" 0 /end CHARACTERISTIC
/begin CHARACTERISTIC S16_WPE_NC_Dump_Gain_r_6th "Temp" VALUE 0x8002179C CalPrmBrkTqCtrlrBrk_SWORD 0 Perc6 -32768 32767 SYMBOL_LINK "CalPrmBrkTqCtrlrBrk01.S16_WPE_NC_Dump_Gain_r_6th" 0 /end CHARACTERISTIC
/begin CHARACTERISTIC S16_WPE_TC_Dump_Gain_Press_r_1st "Temp" VALUE 0x80021602 CalPrmBrkTqCtrlrBrk_SWORD 0 P34 -3276.8 3276.7 SYMBOL_LINK "CalPrmBrkTqCtrlrBrk01.S16_WPE_TC_Dump_Gain_Press_r_1st" 0 /end CHARACTERISTIC
/begin CHARACTERISTIC S16_WPE_TC_Dump_Gain_Press_r_2nd "Temp" VALUE 0x80021604 CalPrmBrkTqCtrlrBrk_SWORD 0 P34 -3276.8 3276.7 SYMBOL_LINK "CalPrmBrkTqCtrlrBrk01.S16_WPE_TC_Dump_Gain_Press_r_2nd" 0 /end CHARACTERISTIC
/begin CHARACTERISTIC S16_WPE_TC_Dump_Gain_Press_r_3rd "Temp" VALUE 0x80021606 CalPrmBrkTqCtrlrBrk_SWORD 0 P34 -3276.8 3276.7 SYMBOL_LINK "CalPrmBrkTqCtrlrBrk01.S16_WPE_TC_Dump_Gain_Press_r_3rd" 0 /end CHARACTERISTIC
/begin CHARACTERISTIC S16_WPE_TC_Dump_Gain_Press_r_4th "Temp" VALUE 0x80021608 CalPrmBrkTqCtrlrBrk_SWORD 0 P34 -3276.8 3276.7 SYMBOL_LINK "CalPrmBrkTqCtrlrBrk01.S16_WPE_TC_Dump_Gain_Press_r_4th" 0 /end CHARACTERISTIC
/begin CHARACTERISTIC S16_WPE_TC_Dump_Gain_Press_r_5th "Temp" VALUE 0x8002160A CalPrmBrkTqCtrlrBrk_SWORD 0 P34 -3276.8 3276.7 SYMBOL_LINK "CalPrmBrkTqCtrlrBrk01.S16_WPE_TC_Dump_Gain_Press_r_5th" 0 /end CHARACTERISTIC
/begin CHARACTERISTIC S16_WPE_TC_Dump_Gain_Press_r_6th "Temp" VALUE 0x8002160C CalPrmBrkTqCtrlrBrk_SWORD 0 P34 -3276.8 3276.7 SYMBOL_LINK "CalPrmBrkTqCtrlrBrk01.S16_WPE_TC_Dump_Gain_Press_r_6th" 0 /end CHARACTERISTIC
/begin CHARACTERISTIC S16_WPE_TC_Dump_Gain_r_1st "Temp" VALUE 0x8002160E CalPrmBrkTqCtrlrBrk_SWORD 0 Perc6 -32768 32767 SYMBOL_LINK "CalPrmBrkTqCtrlrBrk01.S16_WPE_TC_Dump_Gain_r_1st" 0 /end CHARACTERISTIC
/begin CHARACTERISTIC S16_WPE_TC_Dump_Gain_r_2nd "Temp" VALUE 0x80021610 CalPrmBrkTqCtrlrBrk_SWORD 0 Perc6 -32768 32767 SYMBOL_LINK "CalPrmBrkTqCtrlrBrk01.S16_WPE_TC_Dump_Gain_r_2nd" 0 /end CHARACTERISTIC
/begin CHARACTERISTIC S16_WPE_TC_Dump_Gain_r_3rd "Temp" VALUE 0x80021612 CalPrmBrkTqCtrlrBrk_SWORD 0 Perc6 -32768 32767 SYMBOL_LINK "CalPrmBrkTqCtrlrBrk01.S16_WPE_TC_Dump_Gain_r_3rd" 0 /end CHARACTERISTIC
/begin CHARACTERISTIC S16_WPE_TC_Dump_Gain_r_4th "Temp" VALUE 0x80021614 CalPrmBrkTqCtrlrBrk_SWORD 0 Perc6 -32768 32767 SYMBOL_LINK "CalPrmBrkTqCtrlrBrk01.S16_WPE_TC_Dump_Gain_r_4th" 0 /end CHARACTERISTIC
/begin CHARACTERISTIC S16_WPE_TC_Dump_Gain_r_5th "Temp" VALUE 0x80021616 CalPrmBrkTqCtrlrBrk_SWORD 0 Perc6 -32768 32767 SYMBOL_LINK "CalPrmBrkTqCtrlrBrk01.S16_WPE_TC_Dump_Gain_r_5th" 0 /end CHARACTERISTIC
/begin CHARACTERISTIC S16_WPE_TC_Dump_Gain_r_6th "Temp" VALUE 0x80021618 CalPrmBrkTqCtrlrBrk_SWORD 0 Perc6 -32768 32767 SYMBOL_LINK "CalPrmBrkTqCtrlrBrk01.S16_WPE_TC_Dump_Gain_r_6th" 0 /end CHARACTERISTIC
/begin CHARACTERISTIC SSM_S16_AVH_DEFAULT_IDLE_TORQ "" VALUE 0x8003A7B2 CalPrmSsmEng_SWORD 0 Tq51 -3276.8 3276.7 SYMBOL_LINK "CalPrmSsmEng01.SSM_S16_AVH_DEFAULT_IDLE_TORQ" 0 /end CHARACTERISTIC
/begin CHARACTERISTIC SSM_S16_AVH_F_END_E_TQ_LOW_MID_SLOP "" VALUE 0x8003A7A4 CalPrmSsmEng_SWORD 0 Tq51 -3276.8 3276.7 SYMBOL_LINK "CalPrmSsmEng01.SSM_S16_AVH_F_END_E_TQ_LOW_MID_SLOP" 0 /end CHARACTERISTIC
/begin CHARACTERISTIC SSM_S16_AVH_F_END_E_TQ_MAX_SLOP "" VALUE 0x8003A7A6 CalPrmSsmEng_SWORD 0 Tq51 -3276.8 3276.7 SYMBOL_LINK "CalPrmSsmEng01.SSM_S16_AVH_F_END_E_TQ_MAX_SLOP" 0 /end CHARACTERISTIC
/begin CHARACTERISTIC SSM_S16_AVH_F_END_E_TQ_MID_SLOP "" VALUE 0x8003A7A8 CalPrmSsmEng_SWORD 0 Tq51 -3276.8 3276.7 SYMBOL_LINK "CalPrmSsmEng01.SSM_S16_AVH_F_END_E_TQ_MID_SLOP" 0 /end CHARACTERISTIC
/begin CHARACTERISTIC SSM_S16_AVH_F_END_E_TQ_MIN_SLOP "" VALUE 0x8003A7AA CalPrmSsmEng_SWORD 0 Tq51 -3276.8 3276.7 SYMBOL_LINK "CalPrmSsmEng01.SSM_S16_AVH_F_END_E_TQ_MIN_SLOP" 0 /end CHARACTERISTIC
/begin CHARACTERISTIC SSM_S16_AVH_T_P_TEMP_1 "" VALUE 0x8003A7B4 CalPrmSsmEng_SWORD 0 Fac31 -32768 32767 SYMBOL_LINK "CalPrmSsmEng01.SSM_S16_AVH_T_P_TEMP_1" 0 /end CHARACTERISTIC
/begin CHARACTERISTIC SSM_S16_AVH_T_P_TEMP_10 "" VALUE 0x8003A7B6 CalPrmSsmEng_SWORD 0 Fac31 -32768 32767 SYMBOL_LINK "CalPrmSsmEng01.SSM_S16_AVH_T_P_TEMP_10" 0 /end CHARACTERISTIC
/begin CHARACTERISTIC SSM_S16_AVH_T_P_TEMP_2 "" VALUE 0x8003A7B8 CalPrmSsmEng_SWORD 0 Fac31 -32768 32767 SYMBOL_LINK "CalPrmSsmEng01.SSM_S16_AVH_T_P_TEMP_2" 0 /end CHARACTERISTIC
/begin CHARACTERISTIC SSM_S16_AVH_T_P_TEMP_3 "" VALUE 0x8003A7BA CalPrmSsmEng_SWORD 0 Fac31 -32768 32767 SYMBOL_LINK "CalPrmSsmEng01.SSM_S16_AVH_T_P_TEMP_3" 0 /end CHARACTERISTIC
/begin CHARACTERISTIC SSM_S16_AVH_T_P_TEMP_4 "" VALUE 0x8003A7BC CalPrmSsmEng_SWORD 0 Fac31 -32768 32767 SYMBOL_LINK "CalPrmSsmEng01.SSM_S16_AVH_T_P_TEMP_4" 0 /end CHARACTERISTIC
/begin CHARACTERISTIC SSM_S16_AVH_T_P_TEMP_5 "" VALUE 0x8003A7BE CalPrmSsmEng_SWORD 0 Fac31 -32768 32767 SYMBOL_LINK "CalPrmSsmEng01.SSM_S16_AVH_T_P_TEMP_5" 0 /end CHARACTERISTIC
/begin CHARACTERISTIC SSM_S16_AVH_T_P_TEMP_6 "" VALUE 0x8003A7C0 CalPrmSsmEng_SWORD 0 Fac31 -32768 32767 SYMBOL_LINK "CalPrmSsmEng01.SSM_S16_AVH_T_P_TEMP_6" 0 /end CHARACTERISTIC
/begin CHARACTERISTIC SSM_S16_AVH_T_P_TEMP_7 "" VALUE 0x8003A7C2 CalPrmSsmEng_SWORD 0 Fac31 -32768 32767 SYMBOL_LINK "CalPrmSsmEng01.SSM_S16_AVH_T_P_TEMP_7" 0 /end CHARACTERISTIC
/begin CHARACTERISTIC SSM_S16_AVH_T_P_TEMP_8 "" VALUE 0x8003A7C4 CalPrmSsmEng_SWORD 0 Fac31 -32768 32767 SYMBOL_LINK "CalPrmSsmEng01.SSM_S16_AVH_T_P_TEMP_8" 0 /end CHARACTERISTIC
/begin CHARACTERISTIC SSM_S16_AVH_T_P_TEMP_9 "" VALUE 0x8003A7C6 CalPrmSsmEng_SWORD 0 Fac31 -32768 32767 SYMBOL_LINK "CalPrmSsmEng01.SSM_S16_AVH_T_P_TEMP_9" 0 /end CHARACTERISTIC
/begin CHARACTERISTIC SSM_U8_AVH_SENSITIVE_ENTER_DELAY "" VALUE 0x8003A7AC CalPrmSsmEng_UBYTE 0 Ti21 0 2.55 SYMBOL_LINK "CalPrmSsmEng01.SSM_U8_AVH_SENSITIVE_ENTER_DELAY" 0 /end CHARACTERISTIC
/begin CHARACTERISTIC SSM_U8_AVH_SENSITIVE_ENTER_THRES "" VALUE 0x8003A7AD CalPrmSsmEng_UBYTE 0 P34 0 25.5 SYMBOL_LINK "CalPrmSsmEng01.SSM_U8_AVH_SENSITIVE_ENTER_THRES" 0 /end CHARACTERISTIC
/begin CHARACTERISTIC SSM_U8_AVH_SENSITIVE_ENT_HM_THRES "" VALUE 0x8003A7AE CalPrmSsmEng_UBYTE 0 P34 0 25.5 SYMBOL_LINK "CalPrmSsmEng01.SSM_U8_AVH_SENSITIVE_ENT_HM_THRES" 0 /end CHARACTERISTIC
/begin CHARACTERISTIC SSM_U8_AVH_SENSITIVE_ENT_LM_THRES "" VALUE 0x8003A7AF CalPrmSsmEng_UBYTE 0 P34 0 25.5 SYMBOL_LINK "CalPrmSsmEng01.SSM_U8_AVH_SENSITIVE_ENT_LM_THRES" 0 /end CHARACTERISTIC
/begin CHARACTERISTIC SSM_U8_AVH_SENSITIVE_ENT_MAX_THRES "" VALUE 0x8003A7B0 CalPrmSsmEng_UBYTE 0 P34 0 25.5 SYMBOL_LINK "CalPrmSsmEng01.SSM_U8_AVH_SENSITIVE_ENT_MAX_THRES" 0 /end CHARACTERISTIC
/begin CHARACTERISTIC TP_S16TCSCpBrkCtlTrqOfStuck "" VALUE 0x8003A186 CalPrmWspcEng_SWORD 0 Tq2 -32768 32767 SYMBOL_LINK "CalPrmWspcEng01.TP_S16TCSCpBrkCtlTrqOfStuck" 0 /end CHARACTERISTIC
/begin CHARACTERISTIC TP_S16TCSCpBrkCtlTrqOfVCA "" VALUE 0x8003A188 CalPrmWspcEng_SWORD 0 Tq2 -32768 32767 SYMBOL_LINK "CalPrmWspcEng01.TP_S16TCSCpBrkCtlTrqOfVCA" 0 /end CHARACTERISTIC
/begin CHARACTERISTIC TP_S16TCSCpCtlMotorV_Stuck "" VALUE 0x8003A1B8 CalPrmWspcEng_SWORD 0 U13 -3276.8 3276.7 SYMBOL_LINK "CalPrmWspcEng01.TP_S16TCSCpCtlMotorV_Stuck" 0 /end CHARACTERISTIC
/begin CHARACTERISTIC TP_S16TCSCpCtlMotorV_VCA "" VALUE 0x8003A1BA CalPrmWspcEng_SWORD 0 U13 -3276.8 3276.7 SYMBOL_LINK "CalPrmWspcEng01.TP_S16TCSCpCtlMotorV_VCA" 0 /end CHARACTERISTIC
/begin CHARACTERISTIC TP_S16TCSCpFadeOutCtrlHghPreTunTh_FA "" VALUE 0x8003A1D6 CalPrmWspcEng_SWORD 0 P34 -3276.8 3276.7 SYMBOL_LINK "CalPrmWspcEng01.TP_S16TCSCpFadeOutCtrlHghPreTunTh_FA" 0 /end CHARACTERISTIC
/begin CHARACTERISTIC TP_S16TCSCpFadeOutCtrlLowPreTunTh_FA "" VALUE 0x8003A1DE CalPrmWspcEng_SWORD 0 P34 -3276.8 3276.7 SYMBOL_LINK "CalPrmWspcEng01.TP_S16TCSCpFadeOutCtrlLowPreTunTh_FA" 0 /end CHARACTERISTIC
/begin CHARACTERISTIC TP_S16TCSCpFadeOutDecTQ4HghPreTurn_FA "" VALUE 0x8003A1E6 CalPrmWspcEng_SWORD 0 TqGrdt10 -32768 32767 SYMBOL_LINK "CalPrmWspcEng01.TP_S16TCSCpFadeOutDecTQ4HghPreTurn_FA" 0 /end CHARACTERISTIC
/begin CHARACTERISTIC TP_S16TCSCpFadeOutDecTQ4LowPreTurn_FA "" VALUE 0x8003A1EE CalPrmWspcEng_SWORD 0 TqGrdt10 -32768 32767 SYMBOL_LINK "CalPrmWspcEng01.TP_S16TCSCpFadeOutDecTQ4LowPreTurn_FA" 0 /end CHARACTERISTIC
/begin CHARACTERISTIC TP_S16TCSCpInitMaxMotorV_VCA "" VALUE 0x8003A200 CalPrmWspcEng_SWORD 0 U13 -3276.8 3276.7 SYMBOL_LINK "CalPrmWspcEng01.TP_S16TCSCpInitMaxMotorV_VCA" 0 /end CHARACTERISTIC
/begin CHARACTERISTIC TP_S16TCSCpInitMaxVCATCCurnt "" VALUE 0x8003A202 CalPrmWspcEng_SWORD 0 Amp2 -32.768 32.767 SYMBOL_LINK "CalPrmWspcEng01.TP_S16TCSCpInitMaxVCATCCurnt" 0 /end CHARACTERISTIC
/begin CHARACTERISTIC TP_S16TCSCpThOfAsymSpCtlInTurn[0] "" VALUE 0x8003A20C CalPrmWspcEng_SWORD 0 Spd12 -4096 4095.875 SYMBOL_LINK "CalPrmWspcEng01.TP_S16TCSCpThOfAsymSpCtlInTurn[0]" 0 /end CHARACTERISTIC
/begin CHARACTERISTIC TP_S16TCSCpThOfAsymSpCtlInTurn[1] "" VALUE 0x8003A20E CalPrmWspcEng_SWORD 0 Spd12 -4096 4095.875 SYMBOL_LINK "CalPrmWspcEng01.TP_S16TCSCpThOfAsymSpCtlInTurn[1]" 0 /end CHARACTERISTIC
/begin CHARACTERISTIC TP_S16TCSCpThOfAsymSpCtlInTurn[2] "" VALUE 0x8003A210 CalPrmWspcEng_SWORD 0 Spd12 -4096 4095.875 SYMBOL_LINK "CalPrmWspcEng01.TP_S16TCSCpThOfAsymSpCtlInTurn[2]" 0 /end CHARACTERISTIC
/begin CHARACTERISTIC TP_S16TCSCpThOfAsymSpCtlInTurn[3] "" VALUE 0x8003A212 CalPrmWspcEng_SWORD 0 Spd12 -4096 4095.875 SYMBOL_LINK "CalPrmWspcEng01.TP_S16TCSCpThOfAsymSpCtlInTurn[3]" 0 /end CHARACTERISTIC
/begin CHARACTERISTIC TP_S16TCSCpThOfAsymSpCtlInTurn[4] "" VALUE 0x8003A214 CalPrmWspcEng_SWORD 0 Spd12 -4096 4095.875 SYMBOL_LINK "CalPrmWspcEng01.TP_S16TCSCpThOfAsymSpCtlInTurn[4]" 0 /end CHARACTERISTIC
/begin CHARACTERISTIC TP_S16TCSCpVcaBrkCtlTrqAxisAxMax "" VALUE 0x8003A22A CalPrmWspcEng_SWORD 0 A42 -327.68 327.67 SYMBOL_LINK "CalPrmWspcEng01.TP_S16TCSCpVcaBrkCtlTrqAxisAxMax" 0 /end CHARACTERISTIC
/begin CHARACTERISTIC TP_S16TCSCpVcaBrkCtlTrqAxisAxMin "" VALUE 0x8003A22C CalPrmWspcEng_SWORD 0 A42 -327.68 327.67 SYMBOL_LINK "CalPrmWspcEng01.TP_S16TCSCpVcaBrkCtlTrqAxisAxMin" 0 /end CHARACTERISTIC
/begin CHARACTERISTIC TP_S16TCSCpVcaBrkCtlTrqMax "" VALUE 0x8003A22E CalPrmWspcEng_SWORD 0 Tq51 -3276.8 3276.7 SYMBOL_LINK "CalPrmWspcEng01.TP_S16TCSCpVcaBrkCtlTrqMax" 0 /end CHARACTERISTIC
/begin CHARACTERISTIC TP_S16TCSCpVcaBrkCtlTrqMin "" VALUE 0x8003A230 CalPrmWspcEng_SWORD 0 Tq51 -3276.8 3276.7 SYMBOL_LINK "CalPrmWspcEng01.TP_S16TCSCpVcaBrkCtlTrqMin" 0 /end CHARACTERISTIC
/begin CHARACTERISTIC TP_S16TCSCpYawLim4VcaWhlSeln "" VALUE 0x8003A23E CalPrmWspcEng_SWORD 0 A42 -327.68 327.67 SYMBOL_LINK "CalPrmWspcEng01.TP_S16TCSCpYawLim4VcaWhlSeln" 0 /end CHARACTERISTIC
/begin CHARACTERISTIC TP_S16_CBC_DECEL_THRES_COMP_H "CBC start decel condition compensation at high vehicle speed" VALUE 0x80020752 CalPrmWslcBrk_SWORD 0 Spd12 -4096 4095.875 SYMBOL_LINK "CalPrmWslcBrk01.TP_S16_CBC_DECEL_THRES_COMP_H" 0 /end CHARACTERISTIC
/begin CHARACTERISTIC TP_S16_CBC_DECEL_THRES_COMP_M "CBC start decel condition compensation at med vehicle speed" VALUE 0x80020754 CalPrmWslcBrk_SWORD 0 Spd12 -4096 4095.875 SYMBOL_LINK "CalPrmWslcBrk01.TP_S16_CBC_DECEL_THRES_COMP_M" 0 /end CHARACTERISTIC
/begin CHARACTERISTIC TP_S16_CBC_DECEL_THRES_H "CBC start decel(verf-vrad) threshold at high Ay level" VALUE 0x80020756 CalPrmWslcBrk_SWORD 0 Spd12 -4096 4095.875 SYMBOL_LINK "CalPrmWslcBrk01.TP_S16_CBC_DECEL_THRES_H" 0 /end CHARACTERISTIC
/begin CHARACTERISTIC TP_S16_CBC_DECEL_THRES_L "CBC start decel(verf-vrad) threshold at low Ay level" VALUE 0x80020758 CalPrmWslcBrk_SWORD 0 Spd12 -4096 4095.875 SYMBOL_LINK "CalPrmWslcBrk01.TP_S16_CBC_DECEL_THRES_L" 0 /end CHARACTERISTIC
/begin CHARACTERISTIC TP_S16_CBC_DECEL_THRES_M "CBC start decel(verf-vrad) threshold at med Ay level" VALUE 0x8002075A CalPrmWslcBrk_SWORD 0 Spd12 -4096 4095.875 SYMBOL_LINK "CalPrmWslcBrk01.TP_S16_CBC_DECEL_THRES_M" 0 /end CHARACTERISTIC
/begin CHARACTERISTIC TP_S16_CBC_DELTA_PRESS_ABS_SPD_H "Rear target delta pressure at high speed" VALUE 0x800206F6 CalPrmWslcBrk_SWORD 0 P34 -3276.8 3276.7 SYMBOL_LINK "CalPrmWslcBrk01.TP_S16_CBC_DELTA_PRESS_ABS_SPD_H" 0 /end CHARACTERISTIC
/begin CHARACTERISTIC TP_S16_CBC_DELTA_PRESS_ABS_SPD_M "Rear target delta pressure at middle speed" VALUE 0x800206F8 CalPrmWslcBrk_SWORD 0 P34 -3276.8 3276.7 SYMBOL_LINK "CalPrmWslcBrk01.TP_S16_CBC_DELTA_PRESS_ABS_SPD_M" 0 /end CHARACTERISTIC
/begin CHARACTERISTIC TP_S16_CBC_DELTA_PRESS_ABS_SPD_S "Rear target delta pressure at low speed" VALUE 0x800206FA CalPrmWslcBrk_SWORD 0 P34 -3276.8 3276.7 SYMBOL_LINK "CalPrmWslcBrk01.TP_S16_CBC_DELTA_PRESS_ABS_SPD_S" 0 /end CHARACTERISTIC
/begin CHARACTERISTIC TP_S16_CBC_DELTA_PRESS_ALAT_LEVEL_H "Reference high Ay level for Rear delta pressure control" VALUE 0x80020768 CalPrmWslcBrk_SWORD 0 A41 -32.768 32.767 SYMBOL_LINK "CalPrmWslcBrk01.TP_S16_CBC_DELTA_PRESS_ALAT_LEVEL_H" 0 /end CHARACTERISTIC
/begin CHARACTERISTIC TP_S16_CBC_DELTA_PRESS_ALAT_LEVEL_L "Reference low Ay level for Rear delta pressure control" VALUE 0x80020766 CalPrmWslcBrk_SWORD 0 A41 -32.768 32.767 SYMBOL_LINK "CalPrmWslcBrk01.TP_S16_CBC_DELTA_PRESS_ALAT_LEVEL_L" 0 /end CHARACTERISTIC
/begin CHARACTERISTIC TP_S16_CBC_DELTA_PRESS_ALAT_LEVEL_M "Reference middle Ay level for Rear delta pressure control" VALUE 0x8002076A CalPrmWslcBrk_SWORD 0 A41 -32.768 32.767 SYMBOL_LINK "CalPrmWslcBrk01.TP_S16_CBC_DELTA_PRESS_ALAT_LEVEL_M" 0 /end CHARACTERISTIC
/begin CHARACTERISTIC TP_S16_DEFAULT_TARGET_dYAW2_SPEED_H "Target Delta-Yaw2 at High Speed in Normal Mu Condition for stable hold time(flasg:111), default 1 deg/sec" VALUE 0x800204E6 CalPrmWslcBrk_SWORD 0 AgSpd31 -327.68 327.67 SYMBOL_LINK "CalPrmWslcBrk01.TP_S16_DEFAULT_TARGET_dYAW2_SPEED_H" 0 /end CHARACTERISTIC
/begin CHARACTERISTIC TP_S16_DEFAULT_TARGET_dYAW2_SPEED_L "Target Delta-Yaw2 at Low Speed in Normal Mu Condition for stable hold time(flasg:111), default 1 deg/sec" VALUE 0x800204E8 CalPrmWslcBrk_SWORD 0 AgSpd31 -327.68 327.67 SYMBOL_LINK "CalPrmWslcBrk01.TP_S16_DEFAULT_TARGET_dYAW2_SPEED_L" 0 /end CHARACTERISTIC
/begin CHARACTERISTIC TP_S16_DEFAULT_TARGET_dYAW2_SPEED_M "Target Delta-Yaw2 at Med Speed in Normal Mu Condition for stable hold time(flasg:111), default 1 deg/sec" VALUE 0x800204EA CalPrmWslcBrk_SWORD 0 AgSpd31 -327.68 327.67 SYMBOL_LINK "CalPrmWslcBrk01.TP_S16_DEFAULT_TARGET_dYAW2_SPEED_M" 0 /end CHARACTERISTIC
/begin CHARACTERISTIC TP_S16_Decel_Gain_HMu_100_150kph_F "Decel Gain, High Mu Detect, 100-150kph, Decel State, Front Wheels" VALUE 0x8002031C CalPrmWslcBrk_SWORD 0 Gain -32768 32767 SYMBOL_LINK "CalPrmWslcBrk01.TP_S16_Decel_Gain_HMu_100_150kph_F" 0 /end CHARACTERISTIC
/begin CHARACTERISTIC TP_S16_Decel_Gain_HMu_10_20kph_F "Decel Gain, High Mu Detect, 10-20kph, Decel State, Front Wheels" VALUE 0x8002031E CalPrmWslcBrk_SWORD 0 Gain -32768 32767 SYMBOL_LINK "CalPrmWslcBrk01.TP_S16_Decel_Gain_HMu_10_20kph_F" 0 /end CHARACTERISTIC
/begin CHARACTERISTIC TP_S16_Decel_Gain_HMu_20_40kph_F "Decel Gain, High Mu Detect, 20-40kph, Decel State, Front wheels" VALUE 0x80020320 CalPrmWslcBrk_SWORD 0 Gain -32768 32767 SYMBOL_LINK "CalPrmWslcBrk01.TP_S16_Decel_Gain_HMu_20_40kph_F" 0 /end CHARACTERISTIC
/begin CHARACTERISTIC TP_S16_Decel_Gain_HMu_40_60kph_F "Decel Gain, High Mu Detect, 40-60kph, Decel State, Front wheels" VALUE 0x80020322 CalPrmWslcBrk_SWORD 0 Gain -32768 32767 SYMBOL_LINK "CalPrmWslcBrk01.TP_S16_Decel_Gain_HMu_40_60kph_F" 0 /end CHARACTERISTIC
/begin CHARACTERISTIC TP_S16_Decel_Gain_HMu_60_100kph_F "Decel Gain, High Mu Detect, 60-100kph, Decel State, Front wheels" VALUE 0x80020324 CalPrmWslcBrk_SWORD 0 Gain -32768 32767 SYMBOL_LINK "CalPrmWslcBrk01.TP_S16_Decel_Gain_HMu_60_100kph_F" 0 /end CHARACTERISTIC
/begin CHARACTERISTIC TP_S16_Decel_Gain_HMu_Ab_150kph_F "Decel Gain, High Mu Detect, Above 150kph, Decel State, Front wheels" VALUE 0x80020326 CalPrmWslcBrk_SWORD 0 Gain -32768 32767 SYMBOL_LINK "CalPrmWslcBrk01.TP_S16_Decel_Gain_HMu_Ab_150kph_F" 0 /end CHARACTERISTIC
/begin CHARACTERISTIC TP_S16_Decel_Gain_HMu_B_10kph_F "Decel Gain, High Mu Detect, Below 10kph, Decel State, Front Wheels" VALUE 0x80020328 CalPrmWslcBrk_SWORD 0 Gain -32768 32767 SYMBOL_LINK "CalPrmWslcBrk01.TP_S16_Decel_Gain_HMu_B_10kph_F" 0 /end CHARACTERISTIC
/begin CHARACTERISTIC TP_S16_HDF_REF_MMu_40_60kph_F "HDF reference, condition for special 1st cycle dump" VALUE 0x800205C2 CalPrmWslcBrk_SWORD 0 Gain -32768 32767 SYMBOL_LINK "CalPrmWslcBrk01.TP_S16_HDF_REF_MMu_40_60kph_F" 0 /end CHARACTERISTIC
/begin CHARACTERISTIC TP_S16_HDF_REF_MMu_Ab_60kph_F "HDF reference, condition for special 1st cycle dump" VALUE 0x800205C4 CalPrmWslcBrk_SWORD 0 Gain -32768 32767 SYMBOL_LINK "CalPrmWslcBrk01.TP_S16_HDF_REF_MMu_Ab_60kph_F" 0 /end CHARACTERISTIC
/begin CHARACTERISTIC TP_S16_HDF_REF_MMu_B_40kph_F "HDF reference, condition for special 1st cycle dump" VALUE 0x800205C6 CalPrmWslcBrk_SWORD 0 Gain -32768 32767 SYMBOL_LINK "CalPrmWslcBrk01.TP_S16_HDF_REF_MMu_B_40kph_F" 0 /end CHARACTERISTIC
/begin CHARACTERISTIC TP_S16_LCB_ENTER_MAX_LATERAL_G "Max. Lateral G for Limit Cornering Brake Detection (default 0.5g)" VALUE 0x8002054C CalPrmWslcBrk_SWORD 0 A41 -32.768 32.767 SYMBOL_LINK "CalPrmWslcBrk01.TP_S16_LCB_ENTER_MAX_LATERAL_G" 0 /end CHARACTERISTIC
/begin CHARACTERISTIC TP_S16_LCB_EXIT_MIN_LATERAL_G "Min. Lateral G for Limit Cornering Brake Reset (default 0.6g)" VALUE 0x8002054E CalPrmWslcBrk_SWORD 0 A41 -32.768 32.767 SYMBOL_LINK "CalPrmWslcBrk01.TP_S16_LCB_EXIT_MIN_LATERAL_G" 0 /end CHARACTERISTIC
/begin CHARACTERISTIC TP_S16_LMu_TARGET_dYAW2_SPEED_H "Target Delta-Yaw2 at High Speed in Low Mu for stable hold time(flasg:111), default 1 deg/sec" VALUE 0x800204EC CalPrmWslcBrk_SWORD 0 AgSpd31 -327.68 327.67 SYMBOL_LINK "CalPrmWslcBrk01.TP_S16_LMu_TARGET_dYAW2_SPEED_H" 0 /end CHARACTERISTIC
/begin CHARACTERISTIC TP_S16_LMu_TARGET_dYAW2_SPEED_L "Target Delta-Yaw2 at Low Speed in Low Mu for stable hold time(flasg:111), default 1 deg/sec" VALUE 0x800204EE CalPrmWslcBrk_SWORD 0 AgSpd31 -327.68 327.67 SYMBOL_LINK "CalPrmWslcBrk01.TP_S16_LMu_TARGET_dYAW2_SPEED_L" 0 /end CHARACTERISTIC
/begin CHARACTERISTIC TP_S16_LMu_TARGET_dYAW2_SPEED_M "Target Delta-Yaw2 at Med Speed in Low Mu for stable hold time(flasg:111), default 1 deg/sec" VALUE 0x800204F0 CalPrmWslcBrk_SWORD 0 AgSpd31 -327.68 327.67 SYMBOL_LINK "CalPrmWslcBrk01.TP_S16_LMu_TARGET_dYAW2_SPEED_M" 0 /end CHARACTERISTIC
/begin CHARACTERISTIC TP_S16_MINIMUM_EFFECTIVE_LFC_DUTY "minimum LFC duty for ABS end" VALUE 0x80020210 CalPrmWslcBrk_SWORD 0 Gain -32768 32767 SYMBOL_LINK "CalPrmWslcBrk01.TP_S16_MINIMUM_EFFECTIVE_LFC_DUTY" 0 /end CHARACTERISTIC
/begin CHARACTERISTIC TP_S16_SPLIT_TARGET_dYAW2_SPEED_H "Target Delta-Yaw2 at High Speed in Split Mu for stable hold time(flasg:111), default 1 deg/sec" VALUE 0x800204F2 CalPrmWslcBrk_SWORD 0 AgSpd31 -327.68 327.67 SYMBOL_LINK "CalPrmWslcBrk01.TP_S16_SPLIT_TARGET_dYAW2_SPEED_H" 0 /end CHARACTERISTIC
/begin CHARACTERISTIC TP_S16_SPLIT_TARGET_dYAW2_SPEED_L "Target Delta-Yaw2 at Low Speed in Split Mu for stable hold time(flasg:111), default 3 deg/sec" VALUE 0x800204F4 CalPrmWslcBrk_SWORD 0 AgSpd31 -327.68 327.67 SYMBOL_LINK "CalPrmWslcBrk01.TP_S16_SPLIT_TARGET_dYAW2_SPEED_L" 0 /end CHARACTERISTIC
/begin CHARACTERISTIC TP_S16_SPLIT_TARGET_dYAW2_SPEED_M "Target Delta-Yaw2 at Med Speed in Split Mu for stable hold time(flasg:111), default 2 deg/sec" VALUE 0x800204F6 CalPrmWslcBrk_SWORD 0 AgSpd31 -327.68 327.67 SYMBOL_LINK "CalPrmWslcBrk01.TP_S16_SPLIT_TARGET_dYAW2_SPEED_M" 0 /end CHARACTERISTIC
/begin CHARACTERISTIC TP_S16_Slip_Gain_HMu_100_150kph_F "Slip Gain, High Mu Detect, 100-150kph, Decel State, Front Wheels" VALUE 0x8002032A CalPrmWslcBrk_SWORD 0 Gain -32768 32767 SYMBOL_LINK "CalPrmWslcBrk01.TP_S16_Slip_Gain_HMu_100_150kph_F" 0 /end CHARACTERISTIC
/begin CHARACTERISTIC TP_S16_Slip_Gain_HMu_10_20kph_F "Slip Gain, High Mu Detect, 10-20kph, Decel State, Front Wheels" VALUE 0x8002032C CalPrmWslcBrk_SWORD 0 Gain -32768 32767 SYMBOL_LINK "CalPrmWslcBrk01.TP_S16_Slip_Gain_HMu_10_20kph_F" 0 /end CHARACTERISTIC
/begin CHARACTERISTIC TP_S16_Slip_Gain_HMu_20_40kph_F "Slip Gain, High Mu Detect, 20-40kph, Decel State, Front Wheels" VALUE 0x8002032E CalPrmWslcBrk_SWORD 0 Gain -32768 32767 SYMBOL_LINK "CalPrmWslcBrk01.TP_S16_Slip_Gain_HMu_20_40kph_F" 0 /end CHARACTERISTIC
/begin CHARACTERISTIC TP_S16_Slip_Gain_HMu_40_60kph_F "Slip Gain, High Mu Detect, 40-60kph, Decel State, Front Wheels" VALUE 0x80020330 CalPrmWslcBrk_SWORD 0 Gain -32768 32767 SYMBOL_LINK "CalPrmWslcBrk01.TP_S16_Slip_Gain_HMu_40_60kph_F" 0 /end CHARACTERISTIC
/begin CHARACTERISTIC TP_S16_Slip_Gain_HMu_60_100kph_F "Slip Gain, High Mu Detect, 60-100kph, Decel State, Front Wheels" VALUE 0x80020332 CalPrmWslcBrk_SWORD 0 Gain -32768 32767 SYMBOL_LINK "CalPrmWslcBrk01.TP_S16_Slip_Gain_HMu_60_100kph_F" 0 /end CHARACTERISTIC
/begin CHARACTERISTIC TP_S16_Slip_Gain_HMu_Ab_150kph_F "Slip Gain, High Mu Detect, Above 150kph, Decel State, Front Wheels" VALUE 0x80020334 CalPrmWslcBrk_SWORD 0 Gain -32768 32767 SYMBOL_LINK "CalPrmWslcBrk01.TP_S16_Slip_Gain_HMu_Ab_150kph_F" 0 /end CHARACTERISTIC
/begin CHARACTERISTIC TP_S16_Slip_Gain_HMu_B_10kph_F "Slip Gain, High Mu Detect, Below 10kph, Decel State, Front Wheels" VALUE 0x80020336 CalPrmWslcBrk_SWORD 0 Gain -32768 32767 SYMBOL_LINK "CalPrmWslcBrk01.TP_S16_Slip_Gain_HMu_B_10kph_F" 0 /end CHARACTERISTIC
/begin CHARACTERISTIC TP_S8_Arad_1stPoint_40_60KPH "1st reference point to set the reference EBD cut slip depending on wheel acceleration, 40-60KPH" VALUE 0x80020697 CalPrmWslcBrk_SBYTE 0 A20 -32 31.75 SYMBOL_LINK "CalPrmWslcBrk01.TP_S8_Arad_1stPoint_40_60KPH" 0 /end CHARACTERISTIC
/begin CHARACTERISTIC TP_S8_Arad_2ndPoint_40_60KPH "2nd reference point to set the reference EBD cut slip depending on wheel acceleration, 40-60KPH" VALUE 0x80020698 CalPrmWslcBrk_SBYTE 0 A20 -32 31.75 SYMBOL_LINK "CalPrmWslcBrk01.TP_S8_Arad_2ndPoint_40_60KPH" 0 /end CHARACTERISTIC
/begin CHARACTERISTIC TP_S8_Arad_3rdPoint_40_60KPH "3rd reference point to set the reference EBD cut slip depending on wheel acceleration, 40-60KPH" VALUE 0x80020699 CalPrmWslcBrk_SBYTE 0 A20 -32 31.75 SYMBOL_LINK "CalPrmWslcBrk01.TP_S8_Arad_3rdPoint_40_60KPH" 0 /end CHARACTERISTIC
/begin CHARACTERISTIC TP_S8_Arad_Fact_1_2P_40_60KPH "subtracting value from initial cut slip at wheel acceleration between Arad_1stPoint ~ Arad_2ndPoint, 40-60KPH" VALUE 0x8002069A CalPrmWslcBrk_SBYTE 0 Perc6 -128 127 SYMBOL_LINK "CalPrmWslcBrk01.TP_S8_Arad_Fact_1_2P_40_60KPH" 0 /end CHARACTERISTIC
/begin CHARACTERISTIC TP_S8_Arad_Fact_2_3P_40_60KPH "subtracting value from initial cut slip at wheel acceleration between Arad_2ndPoint ~ Arad_3rdPoint, 40-60KPH" VALUE 0x8002069B CalPrmWslcBrk_SBYTE 0 Perc6 -128 127 SYMBOL_LINK "CalPrmWslcBrk01.TP_S8_Arad_Fact_2_3P_40_60KPH" 0 /end CHARACTERISTIC
/begin CHARACTERISTIC TP_S8_Arad_Fact_Ab_3P_40_60KPH "subtracting value from initial cut slip at wheel acceleration above Arad_3rdPoint, 40-60KPH" VALUE 0x8002069C CalPrmWslcBrk_SBYTE 0 Perc6 -128 127 SYMBOL_LINK "CalPrmWslcBrk01.TP_S8_Arad_Fact_Ab_3P_40_60KPH" 0 /end CHARACTERISTIC
/begin CHARACTERISTIC TP_S8_Arad_Fact_B_1P_40_60KPH "subtracting value from initial cut slip at wheel acceleration below Arad_1stPoint, 40-60KPH" VALUE 0x8002069D CalPrmWslcBrk_SBYTE 0 Perc6 -128 127 SYMBOL_LINK "CalPrmWslcBrk01.TP_S8_Arad_Fact_B_1P_40_60KPH" 0 /end CHARACTERISTIC
/begin CHARACTERISTIC TP_S8_Decel_Gain_LMu_10_20k_R_HDC "Decel Gain during HDC, Low Mu, 10-20kph, Rear Wheels, Default Low Mu gain" VALUE 0x80020564 CalPrmWslcBrk_SBYTE 0 Gain -128 127 SYMBOL_LINK "CalPrmWslcBrk01.TP_S8_Decel_Gain_LMu_10_20k_R_HDC" 0 /end CHARACTERISTIC
/begin CHARACTERISTIC TP_S8_Decel_Gain_LMu_B_10k_R_HDC "Decel Gain during HDC, Low Mu, Below 10kph, Rear Wheels, Default Low Mu gain" VALUE 0x80020565 CalPrmWslcBrk_SBYTE 0 Gain -128 127 SYMBOL_LINK "CalPrmWslcBrk01.TP_S8_Decel_Gain_LMu_B_10k_R_HDC" 0 /end CHARACTERISTIC
/begin CHARACTERISTIC TP_S8_F_WL_Fact_ASum1G_Slip2_5P "Cut slip compensation value if : -2%>avg.Front wheel slip >-5%, AND Front arad sum > -1g" VALUE 0x800206B9 CalPrmWslcBrk_SBYTE 0 Perc6 -128 127 SYMBOL_LINK "CalPrmWslcBrk01.TP_S8_F_WL_Fact_ASum1G_Slip2_5P" 0 /end CHARACTERISTIC
/begin CHARACTERISTIC TP_S8_F_WL_Fact_ASum3G_Slip2_5P "Cut slip compensation value if : -2%>avg.Front wheel slip >-5%, AND -1g > Front arad sum > -3g" VALUE 0x800206BA CalPrmWslcBrk_SBYTE 0 Perc6 -128 127 SYMBOL_LINK "CalPrmWslcBrk01.TP_S8_F_WL_Fact_ASum3G_Slip2_5P" 0 /end CHARACTERISTIC
/begin CHARACTERISTIC TP_S8_F_WL_Fact_ASumAb3G_Slip2_5P "Cut slip compensation value if : -2%>avg.Front wheel slip >-5%, AND Front arad sum < -3g" VALUE 0x800206BB CalPrmWslcBrk_SBYTE 0 Perc6 -128 127 SYMBOL_LINK "CalPrmWslcBrk01.TP_S8_F_WL_Fact_ASumAb3G_Slip2_5P" 0 /end CHARACTERISTIC
/begin CHARACTERISTIC TP_S8_LCB_ENTER_DEL_YAW_THRES "Min. Del-Yaw (Oversteer) Thres. for Limit Cornering Brake Detection (default 2deg/s)" VALUE 0x80020550 CalPrmWslcBrk_SBYTE 0 Gain -128 127 SYMBOL_LINK "CalPrmWslcBrk01.TP_S8_LCB_ENTER_DEL_YAW_THRES" 0 /end CHARACTERISTIC
/begin CHARACTERISTIC TP_S8_LCB_EXIT_DEL_YAW_THRES "Max. Del-Yaw (Nuetralsteer) Thres. for Limit Cornering Brake Reset (default 0deg/s)" VALUE 0x80020551 CalPrmWslcBrk_SBYTE 0 Gain -128 127 SYMBOL_LINK "CalPrmWslcBrk01.TP_S8_LCB_EXIT_DEL_YAW_THRES" 0 /end CHARACTERISTIC
/begin CHARACTERISTIC TP_S8_L_to_Split_Duty_Diff1 "Difference between current-duty and end-duty ( Default = 10 )" VALUE 0x800205AC CalPrmWslcBrk_SBYTE 0 Gain -128 127 SYMBOL_LINK "CalPrmWslcBrk01.TP_S8_L_to_Split_Duty_Diff1" 0 /end CHARACTERISTIC
/begin CHARACTERISTIC TP_S8_L_to_Split_Duty_Diff2 "Current-duty difference of front wheels at 1st cycle ( Default = 10 )" VALUE 0x800205AD CalPrmWslcBrk_SBYTE 0 Gain -128 127 SYMBOL_LINK "CalPrmWslcBrk01.TP_S8_L_to_Split_Duty_Diff2" 0 /end CHARACTERISTIC
/begin CHARACTERISTIC TP_S8_Slip_Gain_LMu_10_20k_R_HDC "Slip  Gain during HDC, Low Mu, 10-20kph, Rear Wheels, Default Low Mu gain" VALUE 0x80020566 CalPrmWslcBrk_SBYTE 0 Gain -128 127 SYMBOL_LINK "CalPrmWslcBrk01.TP_S8_Slip_Gain_LMu_10_20k_R_HDC" 0 /end CHARACTERISTIC
/begin CHARACTERISTIC TP_S8_Slip_Gain_LMu_B_10k_R_HDC "Slip  Gain during HDC, Low Mu, Below 10kph, Rear Wheels, Default Low Mu gain" VALUE 0x80020567 CalPrmWslcBrk_SBYTE 0 Gain -128 127 SYMBOL_LINK "CalPrmWslcBrk01.TP_S8_Slip_Gain_LMu_B_10k_R_HDC" 0 /end CHARACTERISTIC
/begin CHARACTERISTIC TP_S8_dP_Arad_Ref_Ab_HMu_R "Arad Ref. for starting Unstable Rise, above High-mu, Rear Wheels" VALUE 0x8002041E CalPrmWslcBrk_SBYTE 0 A20 -32 31.75 SYMBOL_LINK "CalPrmWslcBrk01.TP_S8_dP_Arad_Ref_Ab_HMu_R" 0 /end CHARACTERISTIC
/begin CHARACTERISTIC TP_S8_dP_Arad_Ref_Bw_LMu_R "Arad Ref. for starting Unstable Rise, Below Low mu, Rear Wheels" VALUE 0x80020432 CalPrmWslcBrk_SBYTE 0 A20 -32 31.75 SYMBOL_LINK "CalPrmWslcBrk01.TP_S8_dP_Arad_Ref_Bw_LMu_R" 0 /end CHARACTERISTIC
/begin CHARACTERISTIC TP_S8_dP_Arad_Ref_LMMu_MMu_R "Arad Ref. for starting Unstable Rise, From Low-Medium to Medium mu, Rear Wheels" VALUE 0x8002042A CalPrmWslcBrk_SBYTE 0 A20 -32 31.75 SYMBOL_LINK "CalPrmWslcBrk01.TP_S8_dP_Arad_Ref_LMMu_MMu_R" 0 /end CHARACTERISTIC
/begin CHARACTERISTIC TP_S8_dP_Arad_Ref_LMu_LMMu_R "Arad Ref. for starting Unstable Rise, From Low to Low-Medium mu, Rear Wheels" VALUE 0x8002042E CalPrmWslcBrk_SBYTE 0 A20 -32 31.75 SYMBOL_LINK "CalPrmWslcBrk01.TP_S8_dP_Arad_Ref_LMu_LMMu_R" 0 /end CHARACTERISTIC
/begin CHARACTERISTIC TP_S8_dP_Arad_Ref_MHMu_HMu_R "Arad Ref. for starting Unstable Rise, From Med-High to High-mu, Rear Wheels" VALUE 0x80020422 CalPrmWslcBrk_SBYTE 0 A20 -32 31.75 SYMBOL_LINK "CalPrmWslcBrk01.TP_S8_dP_Arad_Ref_MHMu_HMu_R" 0 /end CHARACTERISTIC
/begin CHARACTERISTIC TP_S8_dP_Arad_Ref_MMu_MHMu_R "Arad Ref. for starting Unstable Rise, From Medium to Med-High mu, Rear Wheels" VALUE 0x80020426 CalPrmWslcBrk_SBYTE 0 A20 -32 31.75 SYMBOL_LINK "CalPrmWslcBrk01.TP_S8_dP_Arad_Ref_MMu_MHMu_R" 0 /end CHARACTERISTIC
/begin CHARACTERISTIC TP_U16_AX_RANGE_MAX "" VALUE 0x8003A242 CalPrmWspcEng_UWORD 0 A47 0 327.675 SYMBOL_LINK "CalPrmWspcEng01.TP_U16_AX_RANGE_MAX" 0 /end CHARACTERISTIC
/begin CHARACTERISTIC TP_U8TCSCpBsAsmdMuDiffTurn_F[0] "" VALUE 0x8003A293 CalPrmWspcEng_UBYTE 0 A42 0 2.55 SYMBOL_LINK "CalPrmWspcEng01.TP_U8TCSCpBsAsmdMuDiffTurn_F[0]" 0 /end CHARACTERISTIC
/begin CHARACTERISTIC TP_U8TCSCpBsAsmdMuDiffTurn_F[1] "" VALUE 0x8003A294 CalPrmWspcEng_UBYTE 0 A42 0 2.55 SYMBOL_LINK "CalPrmWspcEng01.TP_U8TCSCpBsAsmdMuDiffTurn_F[1]" 0 /end CHARACTERISTIC
/begin CHARACTERISTIC TP_U8TCSCpBsAsmdMuDiffTurn_F[2] "" VALUE 0x8003A295 CalPrmWspcEng_UBYTE 0 A42 0 2.55 SYMBOL_LINK "CalPrmWspcEng01.TP_U8TCSCpBsAsmdMuDiffTurn_F[2]" 0 /end CHARACTERISTIC
/begin CHARACTERISTIC TP_U8TCSCpBsAsmdMuDiffTurn_F[3] "" VALUE 0x8003A296 CalPrmWspcEng_UBYTE 0 A42 0 2.55 SYMBOL_LINK "CalPrmWspcEng01.TP_U8TCSCpBsAsmdMuDiffTurn_F[3]" 0 /end CHARACTERISTIC
/begin CHARACTERISTIC TP_U8TCSCpBsAsmdMuDiffTurn_F[4] "" VALUE 0x8003A297 CalPrmWspcEng_UBYTE 0 A42 0 2.55 SYMBOL_LINK "CalPrmWspcEng01.TP_U8TCSCpBsAsmdMuDiffTurn_F[4]" 0 /end CHARACTERISTIC
/begin CHARACTERISTIC TP_U8TCSCpBsAsmdMuDiffTurn_R[0] "" VALUE 0x8003A298 CalPrmWspcEng_UBYTE 0 A42 0 2.55 SYMBOL_LINK "CalPrmWspcEng01.TP_U8TCSCpBsAsmdMuDiffTurn_R[0]" 0 /end CHARACTERISTIC
/begin CHARACTERISTIC TP_U8TCSCpBsAsmdMuDiffTurn_R[1] "" VALUE 0x8003A299 CalPrmWspcEng_UBYTE 0 A42 0 2.55 SYMBOL_LINK "CalPrmWspcEng01.TP_U8TCSCpBsAsmdMuDiffTurn_R[1]" 0 /end CHARACTERISTIC
/begin CHARACTERISTIC TP_U8TCSCpBsAsmdMuDiffTurn_R[2] "" VALUE 0x8003A29A CalPrmWspcEng_UBYTE 0 A42 0 2.55 SYMBOL_LINK "CalPrmWspcEng01.TP_U8TCSCpBsAsmdMuDiffTurn_R[2]" 0 /end CHARACTERISTIC
/begin CHARACTERISTIC TP_U8TCSCpBsAsmdMuDiffTurn_R[3] "" VALUE 0x8003A29B CalPrmWspcEng_UBYTE 0 A42 0 2.55 SYMBOL_LINK "CalPrmWspcEng01.TP_U8TCSCpBsAsmdMuDiffTurn_R[3]" 0 /end CHARACTERISTIC
/begin CHARACTERISTIC TP_U8TCSCpBsAsmdMuDiffTurn_R[4] "" VALUE 0x8003A29C CalPrmWspcEng_UBYTE 0 A42 0 2.55 SYMBOL_LINK "CalPrmWspcEng01.TP_U8TCSCpBsAsmdMuDiffTurn_R[4]" 0 /end CHARACTERISTIC
/begin CHARACTERISTIC TP_U8TCSCpBsHillPG4ASFBCtlN_F[0] "" VALUE 0x8003A2A7 CalPrmWspcEng_UBYTE 0 Gain 0 255 SYMBOL_LINK "CalPrmWspcEng01.TP_U8TCSCpBsHillPG4ASFBCtlN_F[0]" 0 /end CHARACTERISTIC
/begin CHARACTERISTIC TP_U8TCSCpBsHillPG4ASFBCtlN_F[1] "" VALUE 0x8003A2A8 CalPrmWspcEng_UBYTE 0 Gain 0 255 SYMBOL_LINK "CalPrmWspcEng01.TP_U8TCSCpBsHillPG4ASFBCtlN_F[1]" 0 /end CHARACTERISTIC
/begin CHARACTERISTIC TP_U8TCSCpBsHillPG4ASFBCtlN_F[2] "" VALUE 0x8003A2A9 CalPrmWspcEng_UBYTE 0 Gain 0 255 SYMBOL_LINK "CalPrmWspcEng01.TP_U8TCSCpBsHillPG4ASFBCtlN_F[2]" 0 /end CHARACTERISTIC
/begin CHARACTERISTIC TP_U8TCSCpBsHillPG4ASFBCtlN_F[3] "" VALUE 0x8003A2AA CalPrmWspcEng_UBYTE 0 Gain 0 255 SYMBOL_LINK "CalPrmWspcEng01.TP_U8TCSCpBsHillPG4ASFBCtlN_F[3]" 0 /end CHARACTERISTIC
/begin CHARACTERISTIC TP_U8TCSCpBsHillPG4ASFBCtlN_F[4] "" VALUE 0x8003A2AB CalPrmWspcEng_UBYTE 0 Gain 0 255 SYMBOL_LINK "CalPrmWspcEng01.TP_U8TCSCpBsHillPG4ASFBCtlN_F[4]" 0 /end CHARACTERISTIC
/begin CHARACTERISTIC TP_U8TCSCpBsHillPG4ASFBCtlN_R[0] "" VALUE 0x8003A2AC CalPrmWspcEng_UBYTE 0 Gain 0 255 SYMBOL_LINK "CalPrmWspcEng01.TP_U8TCSCpBsHillPG4ASFBCtlN_R[0]" 0 /end CHARACTERISTIC
/begin CHARACTERISTIC TP_U8TCSCpBsHillPG4ASFBCtlN_R[1] "" VALUE 0x8003A2AD CalPrmWspcEng_UBYTE 0 Gain 0 255 SYMBOL_LINK "CalPrmWspcEng01.TP_U8TCSCpBsHillPG4ASFBCtlN_R[1]" 0 /end CHARACTERISTIC
/begin CHARACTERISTIC TP_U8TCSCpBsHillPG4ASFBCtlN_R[2] "" VALUE 0x8003A2AE CalPrmWspcEng_UBYTE 0 Gain 0 255 SYMBOL_LINK "CalPrmWspcEng01.TP_U8TCSCpBsHillPG4ASFBCtlN_R[2]" 0 /end CHARACTERISTIC
/begin CHARACTERISTIC TP_U8TCSCpBsHillPG4ASFBCtlN_R[3] "" VALUE 0x8003A2AF CalPrmWspcEng_UBYTE 0 Gain 0 255 SYMBOL_LINK "CalPrmWspcEng01.TP_U8TCSCpBsHillPG4ASFBCtlN_R[3]" 0 /end CHARACTERISTIC
/begin CHARACTERISTIC TP_U8TCSCpBsHillPG4ASFBCtlN_R[4] "" VALUE 0x8003A2B0 CalPrmWspcEng_UBYTE 0 Gain 0 255 SYMBOL_LINK "CalPrmWspcEng01.TP_U8TCSCpBsHillPG4ASFBCtlN_R[4]" 0 /end CHARACTERISTIC
/begin CHARACTERISTIC TP_U8TCSCpBsHillPG4ASFBCtlP_F[0] "" VALUE 0x8003A2B1 CalPrmWspcEng_UBYTE 0 Gain 0 255 SYMBOL_LINK "CalPrmWspcEng01.TP_U8TCSCpBsHillPG4ASFBCtlP_F[0]" 0 /end CHARACTERISTIC
/begin CHARACTERISTIC TP_U8TCSCpBsHillPG4ASFBCtlP_F[1] "" VALUE 0x8003A2B2 CalPrmWspcEng_UBYTE 0 Gain 0 255 SYMBOL_LINK "CalPrmWspcEng01.TP_U8TCSCpBsHillPG4ASFBCtlP_F[1]" 0 /end CHARACTERISTIC
/begin CHARACTERISTIC TP_U8TCSCpBsHillPG4ASFBCtlP_F[2] "" VALUE 0x8003A2B3 CalPrmWspcEng_UBYTE 0 Gain 0 255 SYMBOL_LINK "CalPrmWspcEng01.TP_U8TCSCpBsHillPG4ASFBCtlP_F[2]" 0 /end CHARACTERISTIC
/begin CHARACTERISTIC TP_U8TCSCpBsHillPG4ASFBCtlP_F[3] "" VALUE 0x8003A2B4 CalPrmWspcEng_UBYTE 0 Gain 0 255 SYMBOL_LINK "CalPrmWspcEng01.TP_U8TCSCpBsHillPG4ASFBCtlP_F[3]" 0 /end CHARACTERISTIC
/begin CHARACTERISTIC TP_U8TCSCpBsHillPG4ASFBCtlP_F[4] "" VALUE 0x8003A2B5 CalPrmWspcEng_UBYTE 0 Gain 0 255 SYMBOL_LINK "CalPrmWspcEng01.TP_U8TCSCpBsHillPG4ASFBCtlP_F[4]" 0 /end CHARACTERISTIC
/begin CHARACTERISTIC TP_U8TCSCpBsHillPG4ASFBCtlP_R[0] "" VALUE 0x8003A2B6 CalPrmWspcEng_UBYTE 0 Gain 0 255 SYMBOL_LINK "CalPrmWspcEng01.TP_U8TCSCpBsHillPG4ASFBCtlP_R[0]" 0 /end CHARACTERISTIC
/begin CHARACTERISTIC TP_U8TCSCpBsHillPG4ASFBCtlP_R[1] "" VALUE 0x8003A2B7 CalPrmWspcEng_UBYTE 0 Gain 0 255 SYMBOL_LINK "CalPrmWspcEng01.TP_U8TCSCpBsHillPG4ASFBCtlP_R[1]" 0 /end CHARACTERISTIC
/begin CHARACTERISTIC TP_U8TCSCpBsHillPG4ASFBCtlP_R[2] "" VALUE 0x8003A2B8 CalPrmWspcEng_UBYTE 0 Gain 0 255 SYMBOL_LINK "CalPrmWspcEng01.TP_U8TCSCpBsHillPG4ASFBCtlP_R[2]" 0 /end CHARACTERISTIC
/begin CHARACTERISTIC TP_U8TCSCpBsHillPG4ASFBCtlP_R[3] "" VALUE 0x8003A2B9 CalPrmWspcEng_UBYTE 0 Gain 0 255 SYMBOL_LINK "CalPrmWspcEng01.TP_U8TCSCpBsHillPG4ASFBCtlP_R[3]" 0 /end CHARACTERISTIC
/begin CHARACTERISTIC TP_U8TCSCpBsHillPG4ASFBCtlP_R[4] "" VALUE 0x8003A2BA CalPrmWspcEng_UBYTE 0 Gain 0 255 SYMBOL_LINK "CalPrmWspcEng01.TP_U8TCSCpBsHillPG4ASFBCtlP_R[4]" 0 /end CHARACTERISTIC
/begin CHARACTERISTIC TP_U8TCSCpBsTurnIG4ASFBCtl_F[0] "" VALUE 0x8003A2D9 CalPrmWspcEng_UBYTE 0 Gain 0 255 SYMBOL_LINK "CalPrmWspcEng01.TP_U8TCSCpBsTurnIG4ASFBCtl_F[0]" 0 /end CHARACTERISTIC
/begin CHARACTERISTIC TP_U8TCSCpBsTurnIG4ASFBCtl_F[1] "" VALUE 0x8003A2DA CalPrmWspcEng_UBYTE 0 Gain 0 255 SYMBOL_LINK "CalPrmWspcEng01.TP_U8TCSCpBsTurnIG4ASFBCtl_F[1]" 0 /end CHARACTERISTIC
/begin CHARACTERISTIC TP_U8TCSCpBsTurnIG4ASFBCtl_F[2] "" VALUE 0x8003A2DB CalPrmWspcEng_UBYTE 0 Gain 0 255 SYMBOL_LINK "CalPrmWspcEng01.TP_U8TCSCpBsTurnIG4ASFBCtl_F[2]" 0 /end CHARACTERISTIC
/begin CHARACTERISTIC TP_U8TCSCpBsTurnIG4ASFBCtl_F[3] "" VALUE 0x8003A2DC CalPrmWspcEng_UBYTE 0 Gain 0 255 SYMBOL_LINK "CalPrmWspcEng01.TP_U8TCSCpBsTurnIG4ASFBCtl_F[3]" 0 /end CHARACTERISTIC
/begin CHARACTERISTIC TP_U8TCSCpBsTurnIG4ASFBCtl_F[4] "" VALUE 0x8003A2DD CalPrmWspcEng_UBYTE 0 Gain 0 255 SYMBOL_LINK "CalPrmWspcEng01.TP_U8TCSCpBsTurnIG4ASFBCtl_F[4]" 0 /end CHARACTERISTIC
/begin CHARACTERISTIC TP_U8TCSCpBsTurnIG4ASFBCtl_R[0] "" VALUE 0x8003A2DE CalPrmWspcEng_UBYTE 0 Gain 0 255 SYMBOL_LINK "CalPrmWspcEng01.TP_U8TCSCpBsTurnIG4ASFBCtl_R[0]" 0 /end CHARACTERISTIC
/begin CHARACTERISTIC TP_U8TCSCpBsTurnIG4ASFBCtl_R[1] "" VALUE 0x8003A2DF CalPrmWspcEng_UBYTE 0 Gain 0 255 SYMBOL_LINK "CalPrmWspcEng01.TP_U8TCSCpBsTurnIG4ASFBCtl_R[1]" 0 /end CHARACTERISTIC
/begin CHARACTERISTIC TP_U8TCSCpBsTurnIG4ASFBCtl_R[2] "" VALUE 0x8003A2E0 CalPrmWspcEng_UBYTE 0 Gain 0 255 SYMBOL_LINK "CalPrmWspcEng01.TP_U8TCSCpBsTurnIG4ASFBCtl_R[2]" 0 /end CHARACTERISTIC
/begin CHARACTERISTIC TP_U8TCSCpBsTurnIG4ASFBCtl_R[3] "" VALUE 0x8003A2E1 CalPrmWspcEng_UBYTE 0 Gain 0 255 SYMBOL_LINK "CalPrmWspcEng01.TP_U8TCSCpBsTurnIG4ASFBCtl_R[3]" 0 /end CHARACTERISTIC
/begin CHARACTERISTIC TP_U8TCSCpBsTurnIG4ASFBCtl_R[4] "" VALUE 0x8003A2E2 CalPrmWspcEng_UBYTE 0 Gain 0 255 SYMBOL_LINK "CalPrmWspcEng01.TP_U8TCSCpBsTurnIG4ASFBCtl_R[4]" 0 /end CHARACTERISTIC
/begin CHARACTERISTIC TP_U8TCSCpBsTurnPG4ASFBCtlN_F[0] "" VALUE 0x8003A2E3 CalPrmWspcEng_UBYTE 0 Gain 0 255 SYMBOL_LINK "CalPrmWspcEng01.TP_U8TCSCpBsTurnPG4ASFBCtlN_F[0]" 0 /end CHARACTERISTIC
/begin CHARACTERISTIC TP_U8TCSCpBsTurnPG4ASFBCtlN_F[1] "" VALUE 0x8003A2E4 CalPrmWspcEng_UBYTE 0 Gain 0 255 SYMBOL_LINK "CalPrmWspcEng01.TP_U8TCSCpBsTurnPG4ASFBCtlN_F[1]" 0 /end CHARACTERISTIC
/begin CHARACTERISTIC TP_U8TCSCpBsTurnPG4ASFBCtlN_F[2] "" VALUE 0x8003A2E5 CalPrmWspcEng_UBYTE 0 Gain 0 255 SYMBOL_LINK "CalPrmWspcEng01.TP_U8TCSCpBsTurnPG4ASFBCtlN_F[2]" 0 /end CHARACTERISTIC
/begin CHARACTERISTIC TP_U8TCSCpBsTurnPG4ASFBCtlN_F[3] "" VALUE 0x8003A2E6 CalPrmWspcEng_UBYTE 0 Gain 0 255 SYMBOL_LINK "CalPrmWspcEng01.TP_U8TCSCpBsTurnPG4ASFBCtlN_F[3]" 0 /end CHARACTERISTIC
/begin CHARACTERISTIC TP_U8TCSCpBsTurnPG4ASFBCtlN_F[4] "" VALUE 0x8003A2E7 CalPrmWspcEng_UBYTE 0 Gain 0 255 SYMBOL_LINK "CalPrmWspcEng01.TP_U8TCSCpBsTurnPG4ASFBCtlN_F[4]" 0 /end CHARACTERISTIC
/begin CHARACTERISTIC TP_U8TCSCpBsTurnPG4ASFBCtlN_R[0] "" VALUE 0x8003A2E8 CalPrmWspcEng_UBYTE 0 Gain 0 255 SYMBOL_LINK "CalPrmWspcEng01.TP_U8TCSCpBsTurnPG4ASFBCtlN_R[0]" 0 /end CHARACTERISTIC
/begin CHARACTERISTIC TP_U8TCSCpBsTurnPG4ASFBCtlN_R[1] "" VALUE 0x8003A2E9 CalPrmWspcEng_UBYTE 0 Gain 0 255 SYMBOL_LINK "CalPrmWspcEng01.TP_U8TCSCpBsTurnPG4ASFBCtlN_R[1]" 0 /end CHARACTERISTIC
/begin CHARACTERISTIC TP_U8TCSCpBsTurnPG4ASFBCtlN_R[2] "" VALUE 0x8003A2EA CalPrmWspcEng_UBYTE 0 Gain 0 255 SYMBOL_LINK "CalPrmWspcEng01.TP_U8TCSCpBsTurnPG4ASFBCtlN_R[2]" 0 /end CHARACTERISTIC
/begin CHARACTERISTIC TP_U8TCSCpBsTurnPG4ASFBCtlN_R[3] "" VALUE 0x8003A2EB CalPrmWspcEng_UBYTE 0 Gain 0 255 SYMBOL_LINK "CalPrmWspcEng01.TP_U8TCSCpBsTurnPG4ASFBCtlN_R[3]" 0 /end CHARACTERISTIC
/begin CHARACTERISTIC TP_U8TCSCpBsTurnPG4ASFBCtlN_R[4] "" VALUE 0x8003A2EC CalPrmWspcEng_UBYTE 0 Gain 0 255 SYMBOL_LINK "CalPrmWspcEng01.TP_U8TCSCpBsTurnPG4ASFBCtlN_R[4]" 0 /end CHARACTERISTIC
/begin CHARACTERISTIC TP_U8TCSCpBsTurnPG4ASFBCtlP_F[0] "" VALUE 0x8003A2ED CalPrmWspcEng_UBYTE 0 Gain 0 255 SYMBOL_LINK "CalPrmWspcEng01.TP_U8TCSCpBsTurnPG4ASFBCtlP_F[0]" 0 /end CHARACTERISTIC
/begin CHARACTERISTIC TP_U8TCSCpBsTurnPG4ASFBCtlP_F[1] "" VALUE 0x8003A2EE CalPrmWspcEng_UBYTE 0 Gain 0 255 SYMBOL_LINK "CalPrmWspcEng01.TP_U8TCSCpBsTurnPG4ASFBCtlP_F[1]" 0 /end CHARACTERISTIC
/begin CHARACTERISTIC TP_U8TCSCpBsTurnPG4ASFBCtlP_F[2] "" VALUE 0x8003A2EF CalPrmWspcEng_UBYTE 0 Gain 0 255 SYMBOL_LINK "CalPrmWspcEng01.TP_U8TCSCpBsTurnPG4ASFBCtlP_F[2]" 0 /end CHARACTERISTIC
/begin CHARACTERISTIC TP_U8TCSCpBsTurnPG4ASFBCtlP_F[3] "" VALUE 0x8003A2F0 CalPrmWspcEng_UBYTE 0 Gain 0 255 SYMBOL_LINK "CalPrmWspcEng01.TP_U8TCSCpBsTurnPG4ASFBCtlP_F[3]" 0 /end CHARACTERISTIC
/begin CHARACTERISTIC TP_U8TCSCpBsTurnPG4ASFBCtlP_F[4] "" VALUE 0x8003A2F1 CalPrmWspcEng_UBYTE 0 Gain 0 255 SYMBOL_LINK "CalPrmWspcEng01.TP_U8TCSCpBsTurnPG4ASFBCtlP_F[4]" 0 /end CHARACTERISTIC
/begin CHARACTERISTIC TP_U8TCSCpBsTurnPG4ASFBCtlP_R[0] "" VALUE 0x8003A2F2 CalPrmWspcEng_UBYTE 0 Gain 0 255 SYMBOL_LINK "CalPrmWspcEng01.TP_U8TCSCpBsTurnPG4ASFBCtlP_R[0]" 0 /end CHARACTERISTIC
/begin CHARACTERISTIC TP_U8TCSCpBsTurnPG4ASFBCtlP_R[1] "" VALUE 0x8003A2F3 CalPrmWspcEng_UBYTE 0 Gain 0 255 SYMBOL_LINK "CalPrmWspcEng01.TP_U8TCSCpBsTurnPG4ASFBCtlP_R[1]" 0 /end CHARACTERISTIC
/begin CHARACTERISTIC TP_U8TCSCpBsTurnPG4ASFBCtlP_R[2] "" VALUE 0x8003A2F4 CalPrmWspcEng_UBYTE 0 Gain 0 255 SYMBOL_LINK "CalPrmWspcEng01.TP_U8TCSCpBsTurnPG4ASFBCtlP_R[2]" 0 /end CHARACTERISTIC
/begin CHARACTERISTIC TP_U8TCSCpBsTurnPG4ASFBCtlP_R[3] "" VALUE 0x8003A2F5 CalPrmWspcEng_UBYTE 0 Gain 0 255 SYMBOL_LINK "CalPrmWspcEng01.TP_U8TCSCpBsTurnPG4ASFBCtlP_R[3]" 0 /end CHARACTERISTIC
/begin CHARACTERISTIC TP_U8TCSCpBsTurnPG4ASFBCtlP_R[4] "" VALUE 0x8003A2F6 CalPrmWspcEng_UBYTE 0 Gain 0 255 SYMBOL_LINK "CalPrmWspcEng01.TP_U8TCSCpBsTurnPG4ASFBCtlP_R[4]" 0 /end CHARACTERISTIC
/begin CHARACTERISTIC TP_U8TCSCpIniVCACtlModeMtorTime "" VALUE 0x8003A318 CalPrmWspcEng_UBYTE 0 Ti21 0 2.55 SYMBOL_LINK "CalPrmWspcEng01.TP_U8TCSCpIniVCACtlModeMtorTime" 0 /end CHARACTERISTIC
/begin CHARACTERISTIC TP_U8TCSCpIniVCACtlModeTime "" VALUE 0x8003A319 CalPrmWspcEng_UBYTE 0 Ti21 0 2.55 SYMBOL_LINK "CalPrmWspcEng01.TP_U8TCSCpIniVCACtlModeTime" 0 /end CHARACTERISTIC
/begin CHARACTERISTIC TP_U8TCSCpPgFac4ASFBCtlTurn_F[0] "" VALUE 0x8003A32B CalPrmWspcEng_UBYTE 0 Fac31 0 255 SYMBOL_LINK "CalPrmWspcEng01.TP_U8TCSCpPgFac4ASFBCtlTurn_F[0]" 0 /end CHARACTERISTIC
/begin CHARACTERISTIC TP_U8TCSCpPgFac4ASFBCtlTurn_F[1] "" VALUE 0x8003A32C CalPrmWspcEng_UBYTE 0 Fac31 0 255 SYMBOL_LINK "CalPrmWspcEng01.TP_U8TCSCpPgFac4ASFBCtlTurn_F[1]" 0 /end CHARACTERISTIC
/begin CHARACTERISTIC TP_U8TCSCpPgFac4ASFBCtlTurn_F[2] "" VALUE 0x8003A32D CalPrmWspcEng_UBYTE 0 Fac31 0 255 SYMBOL_LINK "CalPrmWspcEng01.TP_U8TCSCpPgFac4ASFBCtlTurn_F[2]" 0 /end CHARACTERISTIC
/begin CHARACTERISTIC TP_U8TCSCpPgFac4ASFBCtlTurn_F[3] "" VALUE 0x8003A32E CalPrmWspcEng_UBYTE 0 Fac31 0 255 SYMBOL_LINK "CalPrmWspcEng01.TP_U8TCSCpPgFac4ASFBCtlTurn_F[3]" 0 /end CHARACTERISTIC
/begin CHARACTERISTIC TP_U8TCSCpPgFac4ASFBCtlTurn_F[4] "" VALUE 0x8003A32F CalPrmWspcEng_UBYTE 0 Fac31 0 255 SYMBOL_LINK "CalPrmWspcEng01.TP_U8TCSCpPgFac4ASFBCtlTurn_F[4]" 0 /end CHARACTERISTIC
/begin CHARACTERISTIC TP_U8TCSCpPgFac4ASFBCtlTurn_R[0] "" VALUE 0x8003A330 CalPrmWspcEng_UBYTE 0 Fac31 0 255 SYMBOL_LINK "CalPrmWspcEng01.TP_U8TCSCpPgFac4ASFBCtlTurn_R[0]" 0 /end CHARACTERISTIC
/begin CHARACTERISTIC TP_U8TCSCpPgFac4ASFBCtlTurn_R[1] "" VALUE 0x8003A331 CalPrmWspcEng_UBYTE 0 Fac31 0 255 SYMBOL_LINK "CalPrmWspcEng01.TP_U8TCSCpPgFac4ASFBCtlTurn_R[1]" 0 /end CHARACTERISTIC
/begin CHARACTERISTIC TP_U8TCSCpPgFac4ASFBCtlTurn_R[2] "" VALUE 0x8003A332 CalPrmWspcEng_UBYTE 0 Fac31 0 255 SYMBOL_LINK "CalPrmWspcEng01.TP_U8TCSCpPgFac4ASFBCtlTurn_R[2]" 0 /end CHARACTERISTIC
/begin CHARACTERISTIC TP_U8TCSCpPgFac4ASFBCtlTurn_R[3] "" VALUE 0x8003A333 CalPrmWspcEng_UBYTE 0 Fac31 0 255 SYMBOL_LINK "CalPrmWspcEng01.TP_U8TCSCpPgFac4ASFBCtlTurn_R[3]" 0 /end CHARACTERISTIC
/begin CHARACTERISTIC TP_U8TCSCpPgFac4ASFBCtlTurn_R[4] "" VALUE 0x8003A334 CalPrmWspcEng_UBYTE 0 Fac31 0 255 SYMBOL_LINK "CalPrmWspcEng01.TP_U8TCSCpPgFac4ASFBCtlTurn_R[4]" 0 /end CHARACTERISTIC
/begin CHARACTERISTIC TP_U8TCSCpPresDifLR4SymSp "" VALUE 0x8003A335 CalPrmWspcEng_UBYTE 0 P34 0 25.5 SYMBOL_LINK "CalPrmWspcEng01.TP_U8TCSCpPresDifLR4SymSp" 0 /end CHARACTERISTIC
/begin CHARACTERISTIC TP_U8TCSCpRearCtlOfVCA "" VALUE 0x8003A336 CalPrmWspcEng_UBYTE 0 OnOff1 0 255 SYMBOL_LINK "CalPrmWspcEng01.TP_U8TCSCpRearCtlOfVCA" 0 /end CHARACTERISTIC
/begin CHARACTERISTIC TP_U8TCSCpStuckPressureRiseTime "" VALUE 0x8003A341 CalPrmWspcEng_UBYTE 0 Ti21 0 2.55 SYMBOL_LINK "CalPrmWspcEng01.TP_U8TCSCpStuckPressureRiseTime" 0 /end CHARACTERISTIC
/begin CHARACTERISTIC TP_U8TCSCpSymBoth2WlSpdDifTh "" VALUE 0x8003A342 CalPrmWspcEng_UBYTE 0 Spd12 0 31.875 SYMBOL_LINK "CalPrmWspcEng01.TP_U8TCSCpSymBoth2WlSpdDifTh" 0 /end CHARACTERISTIC
/begin CHARACTERISTIC TP_U8TCSCpSymBoth2WlSpinTh "" VALUE 0x8003A343 CalPrmWspcEng_UBYTE 0 Spd12 0 31.875 SYMBOL_LINK "CalPrmWspcEng01.TP_U8TCSCpSymBoth2WlSpinTh" 0 /end CHARACTERISTIC
/begin CHARACTERISTIC TP_U8TCSCpSymExtHysOfMovDiffLnR "" VALUE 0x8003A345 CalPrmWspcEng_UBYTE 0 Spd12 0 31.875 SYMBOL_LINK "CalPrmWspcEng01.TP_U8TCSCpSymExtHysOfMovDiffLnR" 0 /end CHARACTERISTIC
/begin CHARACTERISTIC TP_U8TCSCpTBrkTorqDec4Sym "" VALUE 0x8003A358 CalPrmWspcEng_UBYTE 0 A42 0 2.55 SYMBOL_LINK "CalPrmWspcEng01.TP_U8TCSCpTBrkTorqDec4Sym" 0 /end CHARACTERISTIC
/begin CHARACTERISTIC TP_U8TCSCpTarWhlSpinDiffHill[0] "" VALUE 0x8003A34E CalPrmWspcEng_UBYTE 0 Spd12 0 31.875 SYMBOL_LINK "CalPrmWspcEng01.TP_U8TCSCpTarWhlSpinDiffHill[0]" 0 /end CHARACTERISTIC
/begin CHARACTERISTIC TP_U8TCSCpTarWhlSpinDiffHill[1] "" VALUE 0x8003A34F CalPrmWspcEng_UBYTE 0 Spd12 0 31.875 SYMBOL_LINK "CalPrmWspcEng01.TP_U8TCSCpTarWhlSpinDiffHill[1]" 0 /end CHARACTERISTIC
/begin CHARACTERISTIC TP_U8TCSCpTarWhlSpinDiffHill[2] "" VALUE 0x8003A350 CalPrmWspcEng_UBYTE 0 Spd12 0 31.875 SYMBOL_LINK "CalPrmWspcEng01.TP_U8TCSCpTarWhlSpinDiffHill[2]" 0 /end CHARACTERISTIC
/begin CHARACTERISTIC TP_U8TCSCpTarWhlSpinDiffHill[3] "" VALUE 0x8003A351 CalPrmWspcEng_UBYTE 0 Spd12 0 31.875 SYMBOL_LINK "CalPrmWspcEng01.TP_U8TCSCpTarWhlSpinDiffHill[3]" 0 /end CHARACTERISTIC
/begin CHARACTERISTIC TP_U8TCSCpTarWhlSpinDiffHill[4] "" VALUE 0x8003A352 CalPrmWspcEng_UBYTE 0 Spd12 0 31.875 SYMBOL_LINK "CalPrmWspcEng01.TP_U8TCSCpTarWhlSpinDiffHill[4]" 0 /end CHARACTERISTIC
/begin CHARACTERISTIC TP_U8TCSCpTarWhlSpinDiffTurn[0] "" VALUE 0x8003A353 CalPrmWspcEng_UBYTE 0 Spd12 0 31.875 SYMBOL_LINK "CalPrmWspcEng01.TP_U8TCSCpTarWhlSpinDiffTurn[0]" 0 /end CHARACTERISTIC
/begin CHARACTERISTIC TP_U8TCSCpTarWhlSpinDiffTurn[1] "" VALUE 0x8003A354 CalPrmWspcEng_UBYTE 0 Spd12 0 31.875 SYMBOL_LINK "CalPrmWspcEng01.TP_U8TCSCpTarWhlSpinDiffTurn[1]" 0 /end CHARACTERISTIC
/begin CHARACTERISTIC TP_U8TCSCpTarWhlSpinDiffTurn[2] "" VALUE 0x8003A355 CalPrmWspcEng_UBYTE 0 Spd12 0 31.875 SYMBOL_LINK "CalPrmWspcEng01.TP_U8TCSCpTarWhlSpinDiffTurn[2]" 0 /end CHARACTERISTIC
/begin CHARACTERISTIC TP_U8TCSCpTarWhlSpinDiffTurn[3] "" VALUE 0x8003A356 CalPrmWspcEng_UBYTE 0 Spd12 0 31.875 SYMBOL_LINK "CalPrmWspcEng01.TP_U8TCSCpTarWhlSpinDiffTurn[3]" 0 /end CHARACTERISTIC
/begin CHARACTERISTIC TP_U8TCSCpTarWhlSpinDiffTurn[4] "" VALUE 0x8003A357 CalPrmWspcEng_UBYTE 0 Spd12 0 31.875 SYMBOL_LINK "CalPrmWspcEng01.TP_U8TCSCpTarWhlSpinDiffTurn[4]" 0 /end CHARACTERISTIC
/begin CHARACTERISTIC TP_U8TCSCpVcaActvOnlyAtBigSpinDtcd "" VALUE 0x8003A35B CalPrmWspcEng_UBYTE 0 Gain 0 255 SYMBOL_LINK "CalPrmWspcEng01.TP_U8TCSCpVcaActvOnlyAtBigSpinDtcd" 0 /end CHARACTERISTIC
/begin CHARACTERISTIC TP_U8_1st_Dumpscantime_EBD_R "EBD Dump time in ms of 1st dump-scan, default 7, min 5, max 20" VALUE 0x800206DC CalPrmWslcBrk_UBYTE 0 Gain 0 255 SYMBOL_LINK "CalPrmWslcBrk01.TP_U8_1st_Dumpscantime_EBD_R" 0 /end CHARACTERISTIC
/begin CHARACTERISTIC TP_U8_1st_Dumpscantime_MMu_F "Time of 1st dump-scan in Low-med~medium mu, Front Wheels" VALUE 0x800204A4 CalPrmWslcBrk_UBYTE 0 Gain 0 255 SYMBOL_LINK "CalPrmWslcBrk01.TP_U8_1st_Dumpscantime_MMu_F" 0 /end CHARACTERISTIC
/begin CHARACTERISTIC TP_U8_ACC_TH_VCA "" VALUE 0x8003A256 CalPrmWspcEng_UBYTE 0 A47 0 1.275 SYMBOL_LINK "CalPrmWspcEng01.TP_U8_ACC_TH_VCA" 0 /end CHARACTERISTIC
/begin CHARACTERISTIC TP_U8_DEFAULT_DUMPSCANTIME "Default Dump scantime" VALUE 0x800205E8 CalPrmWslcBrk_UBYTE 0 Gain 0 255 SYMBOL_LINK "CalPrmWslcBrk01.TP_U8_DEFAULT_DUMPSCANTIME" 0 /end CHARACTERISTIC
/begin CHARACTERISTIC TP_U8_DV_BASE_HIGH_FOR_F_OUT_ABS "Higher Limit of d_V(Outside ABS, Front Wheels)" VALUE 0x8002056A CalPrmWslcBrk_UBYTE 0 Spd12 0 31.875 SYMBOL_LINK "CalPrmWslcBrk01.TP_U8_DV_BASE_HIGH_FOR_F_OUT_ABS" 0 /end CHARACTERISTIC
/begin CHARACTERISTIC TP_U8_DV_BASE_HIGH_FOR_R_OUT_ABS "Higher Limit of d_V(Outside ABS, Rear Wheels)" VALUE 0x8002056B CalPrmWslcBrk_UBYTE 0 Spd12 0 31.875 SYMBOL_LINK "CalPrmWslcBrk01.TP_U8_DV_BASE_HIGH_FOR_R_OUT_ABS" 0 /end CHARACTERISTIC
/begin CHARACTERISTIC TP_U8_DV_BASE_LOW_FOR_F_OUT_ABS "Higher Limit of d_V(Outside ABS, Front Wheels)" VALUE 0x8002056C CalPrmWslcBrk_UBYTE 0 Spd12 0 31.875 SYMBOL_LINK "CalPrmWslcBrk01.TP_U8_DV_BASE_LOW_FOR_F_OUT_ABS" 0 /end CHARACTERISTIC
/begin CHARACTERISTIC TP_U8_DV_BASE_LOW_FOR_GMA "Lower Limit of d_V(Split_Mu, Front Wheels)" VALUE 0x8002056D CalPrmWslcBrk_UBYTE 0 Spd12 0 31.875 SYMBOL_LINK "CalPrmWslcBrk01.TP_U8_DV_BASE_LOW_FOR_GMA" 0 /end CHARACTERISTIC
/begin CHARACTERISTIC TP_U8_DV_BASE_LOW_FOR_R_OUT_ABS "Higher Limit of d_V(Outside ABS, Rear Wheels)" VALUE 0x8002056E CalPrmWslcBrk_UBYTE 0 Spd12 0 31.875 SYMBOL_LINK "CalPrmWslcBrk01.TP_U8_DV_BASE_LOW_FOR_R_OUT_ABS" 0 /end CHARACTERISTIC
/begin CHARACTERISTIC TP_U8_DV_BASE_LOW_F_OUT_ABS_B40KPH "Higher Limit of d_V @ lower speed than 40kph(Outside ABS, Front Wheels), Default 2KPH, Min 2KPH," VALUE 0x8002056F CalPrmWslcBrk_UBYTE 0 Spd12 0 31.875 SYMBOL_LINK "CalPrmWslcBrk01.TP_U8_DV_BASE_LOW_F_OUT_ABS_B40KPH" 0 /end CHARACTERISTIC
/begin CHARACTERISTIC TP_U8_GMA_HOLD_TIME_MAX "Maximum GMA hold time, default 70, min 70, max 140" VALUE 0x80020604 CalPrmWslcBrk_UBYTE 0 Gain 0 255 SYMBOL_LINK "CalPrmWslcBrk01.TP_U8_GMA_HOLD_TIME_MAX" 0 /end CHARACTERISTIC
/begin CHARACTERISTIC TP_U8_Hold_Timer_ABS_Limit_Speed "Hold Timer Ref. for LFC rising below ABS Limit Speed" VALUE 0x800202B5 CalPrmWslcBrk_UBYTE 0 Gain 0 255 SYMBOL_LINK "CalPrmWslcBrk01.TP_U8_Hold_Timer_ABS_Limit_Speed" 0 /end CHARACTERISTIC
/begin CHARACTERISTIC TP_U8_Hold_Timer_New_Ref_High "Reference Hold Time, High mu, Front Wheels" VALUE 0x800202B6 CalPrmWslcBrk_UBYTE 0 Gain 0 255 SYMBOL_LINK "CalPrmWslcBrk01.TP_U8_Hold_Timer_New_Ref_High" 0 /end CHARACTERISTIC
/begin CHARACTERISTIC TP_U8_Hold_Timer_New_Ref_High_R "Reference Hold Time, High mu, Rear Wheels" VALUE 0x800202B7 CalPrmWslcBrk_UBYTE 0 Gain 0 255 SYMBOL_LINK "CalPrmWslcBrk01.TP_U8_Hold_Timer_New_Ref_High_R" 0 /end CHARACTERISTIC
/begin CHARACTERISTIC TP_U8_Hold_Timer_New_Ref_Initial "Reference Hold Time, 1st cycle, All wheels" VALUE 0x800202B8 CalPrmWslcBrk_UBYTE 0 Gain 0 255 SYMBOL_LINK "CalPrmWslcBrk01.TP_U8_Hold_Timer_New_Ref_Initial" 0 /end CHARACTERISTIC
/begin CHARACTERISTIC TP_U8_Hold_Timer_New_Ref_Low "Reference Hold Time, Low mu, Front wheels" VALUE 0x800202B9 CalPrmWslcBrk_UBYTE 0 Gain 0 255 SYMBOL_LINK "CalPrmWslcBrk01.TP_U8_Hold_Timer_New_Ref_Low" 0 /end CHARACTERISTIC
/begin CHARACTERISTIC TP_U8_Hold_Timer_New_Ref_Low_R "Reference Hold Time, Low mu, Rear wheels" VALUE 0x800202BA CalPrmWslcBrk_UBYTE 0 Gain 0 255 SYMBOL_LINK "CalPrmWslcBrk01.TP_U8_Hold_Timer_New_Ref_Low_R" 0 /end CHARACTERISTIC
/begin CHARACTERISTIC TP_U8_Hold_Timer_New_Ref_Med "Reference Hold Time, Medium mu, Front wheels" VALUE 0x800202BB CalPrmWslcBrk_UBYTE 0 Gain 0 255 SYMBOL_LINK "CalPrmWslcBrk01.TP_U8_Hold_Timer_New_Ref_Med" 0 /end CHARACTERISTIC
/begin CHARACTERISTIC TP_U8_Hold_Timer_New_Ref_Med_R "Reference Hold Time, Medium mu, Rear wheels" VALUE 0x800202BC CalPrmWslcBrk_UBYTE 0 Gain 0 255 SYMBOL_LINK "CalPrmWslcBrk01.TP_U8_Hold_Timer_New_Ref_Med_R" 0 /end CHARACTERISTIC
/begin CHARACTERISTIC TP_U8_Hold_Timer_New_Ref_SpHigh_F "Reference Hold Time, Split mu, Front high side wheel" VALUE 0x800202BD CalPrmWslcBrk_UBYTE 0 Gain 0 255 SYMBOL_LINK "CalPrmWslcBrk01.TP_U8_Hold_Timer_New_Ref_SpHigh_F" 0 /end CHARACTERISTIC
/begin CHARACTERISTIC TP_U8_Init_Duty_Rough_Sus_Comp_F "Initial duty compensation to rough road suspect, Front Wheels" VALUE 0x800204D0 CalPrmWslcBrk_UBYTE 0 Gain 0 255 SYMBOL_LINK "CalPrmWslcBrk01.TP_U8_Init_Duty_Rough_Sus_Comp_F" 0 /end CHARACTERISTIC
/begin CHARACTERISTIC TP_U8_Init_Duty_Rough_Sus_Comp_R "Initial duty compensation to rough road suspect, Rear Wheels" VALUE 0x800204D1 CalPrmWslcBrk_UBYTE 0 Gain 0 255 SYMBOL_LINK "CalPrmWslcBrk01.TP_U8_Init_Duty_Rough_Sus_Comp_R" 0 /end CHARACTERISTIC
/begin CHARACTERISTIC TP_U8_Initial_Duty_Rough_Comp_F "Initial duty compensation to rough road, Front Wheels" VALUE 0x800204CE CalPrmWslcBrk_UBYTE 0 Gain 0 255 SYMBOL_LINK "CalPrmWslcBrk01.TP_U8_Initial_Duty_Rough_Comp_F" 0 /end CHARACTERISTIC
/begin CHARACTERISTIC TP_U8_Initial_Duty_Rough_Comp_R "Initial duty compensation to rough road, Rear Wheels" VALUE 0x800204CF CalPrmWslcBrk_UBYTE 0 Gain 0 255 SYMBOL_LINK "CalPrmWslcBrk01.TP_U8_Initial_Duty_Rough_Comp_R" 0 /end CHARACTERISTIC
/begin CHARACTERISTIC TP_U8_L2H_DCT_DECEL_CNT_L "L2H detect reference time by arad(default : 300ms)" VALUE 0x80020651 CalPrmWslcBrk_UBYTE 0 Ti41 0 1.275 SYMBOL_LINK "CalPrmWslcBrk01.TP_U8_L2H_DCT_DECEL_CNT_L" 0 /end CHARACTERISTIC
/begin CHARACTERISTIC TP_U8_L2H_DCT_DECEL_CNT_S "L2H detect reference time by arad(default : 250ms)" VALUE 0x80020652 CalPrmWslcBrk_UBYTE 0 Ti41 0 1.275 SYMBOL_LINK "CalPrmWslcBrk01.TP_U8_L2H_DCT_DECEL_CNT_S" 0 /end CHARACTERISTIC
/begin CHARACTERISTIC TP_U8_L2H_STB_TIM_L_DECEL_F "L2H stable time front wheel at U8_L2H_DCT_DECEL_CNT_L(default : 350ms)" VALUE 0x80020653 CalPrmWslcBrk_UBYTE 0 Ti41 0 1.275 SYMBOL_LINK "CalPrmWslcBrk01.TP_U8_L2H_STB_TIM_L_DECEL_F" 0 /end CHARACTERISTIC
/begin CHARACTERISTIC TP_U8_L2H_STB_TIM_L_DECEL_R "L2H stable time rear wheel at U8_L2H_DCT_DECEL_CNT_L(default : 200ms)" VALUE 0x80020654 CalPrmWslcBrk_UBYTE 0 Ti41 0 1.275 SYMBOL_LINK "CalPrmWslcBrk01.TP_U8_L2H_STB_TIM_L_DECEL_R" 0 /end CHARACTERISTIC
/begin CHARACTERISTIC TP_U8_L2H_STB_TIM_S_DECEL_F "L2H stable time front wheel at U8_L2H_DCT_DECEL_CNT_S(default : 400ms)" VALUE 0x80020655 CalPrmWslcBrk_UBYTE 0 Ti41 0 1.275 SYMBOL_LINK "CalPrmWslcBrk01.TP_U8_L2H_STB_TIM_S_DECEL_F" 0 /end CHARACTERISTIC
/begin CHARACTERISTIC TP_U8_L2H_STB_TIM_S_DECEL_R "L2H stable time rear wheel at U8_L2H_DCT_DECEL_CNT_S(default : 200ms)" VALUE 0x80020656 CalPrmWslcBrk_UBYTE 0 Ti41 0 1.275 SYMBOL_LINK "CalPrmWslcBrk01.TP_U8_L2H_STB_TIM_S_DECEL_R" 0 /end CHARACTERISTIC
/begin CHARACTERISTIC TP_U8_L2Hsus_SP_STB_TIM_L_DEC_SUM "reference stable time decel sum, split at U8_L2H_DCT_DECEL_CNT_L(default : 450ms)" VALUE 0x80020643 CalPrmWslcBrk_UBYTE 0 Ti41 0 1.275 SYMBOL_LINK "CalPrmWslcBrk01.TP_U8_L2Hsus_SP_STB_TIM_L_DEC_SUM" 0 /end CHARACTERISTIC
/begin CHARACTERISTIC TP_U8_L2Hsus_SP_STB_TIM_S_DEC_SUM1 "reference stable time decel sum, split at S16_L2H_DCT_DIFF_DECEL_H(default : 500ms)" VALUE 0x80020644 CalPrmWslcBrk_UBYTE 0 Ti41 0 1.275 SYMBOL_LINK "CalPrmWslcBrk01.TP_U8_L2Hsus_SP_STB_TIM_S_DEC_SUM1" 0 /end CHARACTERISTIC
/begin CHARACTERISTIC TP_U8_L2Hsus_SP_STB_TIM_S_DEC_SUM2 "reference stable time decel sum, split at S16_L2H_DCT_DIFF_DECEL(default : 550ms)" VALUE 0x80020645 CalPrmWslcBrk_UBYTE 0 Ti41 0 1.275 SYMBOL_LINK "CalPrmWslcBrk01.TP_U8_L2Hsus_SP_STB_TIM_S_DEC_SUM2" 0 /end CHARACTERISTIC
/begin CHARACTERISTIC TP_U8_L2Hsus_STB_TIM_L_DECEL_F1 "L2H suspect stable timeat U8_L2H_DCT_DECEL_CNT_L, front wheel(default : 300ms)" VALUE 0x80020646 CalPrmWslcBrk_UBYTE 0 Ti41 0 1.275 SYMBOL_LINK "CalPrmWslcBrk01.TP_U8_L2Hsus_STB_TIM_L_DECEL_F1" 0 /end CHARACTERISTIC
/begin CHARACTERISTIC TP_U8_L2Hsus_STB_TIM_L_DECEL_MIN "L2H detect reference time for all wheel(default : 170ms)" VALUE 0x80020647 CalPrmWslcBrk_UBYTE 0 Ti41 0 1.275 SYMBOL_LINK "CalPrmWslcBrk01.TP_U8_L2Hsus_STB_TIM_L_DECEL_MIN" 0 /end CHARACTERISTIC
/begin CHARACTERISTIC TP_U8_L2Hsus_STB_TIM_L_DECEL_R1 "L2H suspect stable timeat U8_L2H_DCT_DECEL_CNT_L, rear wheel(default : 150ms)" VALUE 0x80020648 CalPrmWslcBrk_UBYTE 0 Ti41 0 1.275 SYMBOL_LINK "CalPrmWslcBrk01.TP_U8_L2Hsus_STB_TIM_L_DECEL_R1" 0 /end CHARACTERISTIC
/begin CHARACTERISTIC TP_U8_L2Hsus_STB_TIM_L_DECEL_SUM "reference stable time decel sum, homo at U8_L2H_DCT_DECEL_CNT_L(default : 650ms)" VALUE 0x80020649 CalPrmWslcBrk_UBYTE 0 Ti41 0 1.275 SYMBOL_LINK "CalPrmWslcBrk01.TP_U8_L2Hsus_STB_TIM_L_DECEL_SUM" 0 /end CHARACTERISTIC
/begin CHARACTERISTIC TP_U8_L2Hsus_STB_TIM_S_DECEL_F1 "L2H suspect stable timeat S16_L2H_DCT_DIFF_DECEL_H, front wheel(default : 300ms)" VALUE 0x8002064A CalPrmWslcBrk_UBYTE 0 Ti41 0 1.275 SYMBOL_LINK "CalPrmWslcBrk01.TP_U8_L2Hsus_STB_TIM_S_DECEL_F1" 0 /end CHARACTERISTIC
/begin CHARACTERISTIC TP_U8_L2Hsus_STB_TIM_S_DECEL_F2 "L2H suspect stable timeat S16_L2H_DCT_DIFF_DECEL, front wheel(default : 400ms)" VALUE 0x8002064B CalPrmWslcBrk_UBYTE 0 Ti41 0 1.275 SYMBOL_LINK "CalPrmWslcBrk01.TP_U8_L2Hsus_STB_TIM_S_DECEL_F2" 0 /end CHARACTERISTIC
/begin CHARACTERISTIC TP_U8_L2Hsus_STB_TIM_S_DECEL_MIN "L2H detect reference time for all wheel(default : 180ms)" VALUE 0x8002064C CalPrmWslcBrk_UBYTE 0 Ti41 0 1.275 SYMBOL_LINK "CalPrmWslcBrk01.TP_U8_L2Hsus_STB_TIM_S_DECEL_MIN" 0 /end CHARACTERISTIC
/begin CHARACTERISTIC TP_U8_L2Hsus_STB_TIM_S_DECEL_R1 "L2H suspect stable timeat S16_L2H_DCT_DIFF_DECEL_H, rear wheel(default : 200ms)" VALUE 0x8002064D CalPrmWslcBrk_UBYTE 0 Ti41 0 1.275 SYMBOL_LINK "CalPrmWslcBrk01.TP_U8_L2Hsus_STB_TIM_S_DECEL_R1" 0 /end CHARACTERISTIC
/begin CHARACTERISTIC TP_U8_L2Hsus_STB_TIM_S_DECEL_R2 "L2H suspect stable timeat S16_L2H_DCT_DIFF_DECEL, rear wheel(default : 250ms)" VALUE 0x8002064E CalPrmWslcBrk_UBYTE 0 Ti41 0 1.275 SYMBOL_LINK "CalPrmWslcBrk01.TP_U8_L2Hsus_STB_TIM_S_DECEL_R2" 0 /end CHARACTERISTIC
/begin CHARACTERISTIC TP_U8_L2Hsus_STB_TIM_S_DECEL_SUM1 "reference stable time decel sum, homo at S16_L2H_DCT_DIFF_DECEL_H(default : 500ms)" VALUE 0x8002064F CalPrmWslcBrk_UBYTE 0 Ti41 0 1.275 SYMBOL_LINK "CalPrmWslcBrk01.TP_U8_L2Hsus_STB_TIM_S_DECEL_SUM1" 0 /end CHARACTERISTIC
/begin CHARACTERISTIC TP_U8_L2Hsus_STB_TIM_S_DECEL_SUM2 "reference stable time decel sum, homo at S16_L2H_DCT_DIFF_DECEL(default : 800ms)" VALUE 0x80020650 CalPrmWslcBrk_UBYTE 0 Ti41 0 1.275 SYMBOL_LINK "CalPrmWslcBrk01.TP_U8_L2Hsus_STB_TIM_S_DECEL_SUM2" 0 /end CHARACTERISTIC
/begin CHARACTERISTIC TP_U8_LCB_MED_MU_DET_F_INS_SKID "Min. Skid Pressure of Front Inside Wheel for Detecting Limit Cornering Brake (default 40bar)" VALUE 0x80020552 CalPrmWslcBrk_UBYTE 0 P35 0 255 SYMBOL_LINK "CalPrmWslcBrk01.TP_U8_LCB_MED_MU_DET_F_INS_SKID" 0 /end CHARACTERISTIC
/begin CHARACTERISTIC TP_U8_LCB_MED_MU_DET_F_OUT_SKID "Min. Skid Pressure of Front Outside Wheel for Detecting Limit Cornering Brake (default 50bar)" VALUE 0x80020553 CalPrmWslcBrk_UBYTE 0 P35 0 255 SYMBOL_LINK "CalPrmWslcBrk01.TP_U8_LCB_MED_MU_DET_F_OUT_SKID" 0 /end CHARACTERISTIC
/begin CHARACTERISTIC TP_U8_LFC_Long_Hold_Comp_Duty_F "Compensation Duty for Temporary Hold, Front wheels" VALUE 0x800202C8 CalPrmWslcBrk_UBYTE 0 Gain 0 255 SYMBOL_LINK "CalPrmWslcBrk01.TP_U8_LFC_Long_Hold_Comp_Duty_F" 0 /end CHARACTERISTIC
/begin CHARACTERISTIC TP_U8_LFC_Long_Hold_Comp_Duty_R "Compensation Duty for Temporary Hold, Rear wheels" VALUE 0x800202C9 CalPrmWslcBrk_UBYTE 0 Gain 0 255 SYMBOL_LINK "CalPrmWslcBrk01.TP_U8_LFC_Long_Hold_Comp_Duty_R" 0 /end CHARACTERISTIC
/begin CHARACTERISTIC TP_U8_LFC_built_cnt_F_High_Ref "Reference Built Reapply Scans, High_Mu, Front Wheels" VALUE 0x800202BE CalPrmWslcBrk_UBYTE 0 Gain 0 255 SYMBOL_LINK "CalPrmWslcBrk01.TP_U8_LFC_built_cnt_F_High_Ref" 0 /end CHARACTERISTIC
/begin CHARACTERISTIC TP_U8_LFC_built_cnt_F_Low_B_15_Ref "Reference Built Reapply Scans below 15kph, Low_Mu, Front Wheels" VALUE 0x800202BF CalPrmWslcBrk_UBYTE 0 Gain 0 255 SYMBOL_LINK "CalPrmWslcBrk01.TP_U8_LFC_built_cnt_F_Low_B_15_Ref" 0 /end CHARACTERISTIC
/begin CHARACTERISTIC TP_U8_LFC_built_cnt_F_Low_Ref "Reference Built Reapply Scans, Low_Mu, Front Wheels" VALUE 0x800202C0 CalPrmWslcBrk_UBYTE 0 Gain 0 255 SYMBOL_LINK "CalPrmWslcBrk01.TP_U8_LFC_built_cnt_F_Low_Ref" 0 /end CHARACTERISTIC
/begin CHARACTERISTIC TP_U8_LFC_built_cnt_F_Med_Ref "Reference Built Reapply Scans, Medium_Mu, Front Wheels" VALUE 0x800202C1 CalPrmWslcBrk_UBYTE 0 Gain 0 255 SYMBOL_LINK "CalPrmWslcBrk01.TP_U8_LFC_built_cnt_F_Med_Ref" 0 /end CHARACTERISTIC
/begin CHARACTERISTIC TP_U8_LFC_built_cnt_F_Rough_Ref "Reference Built Reapply Scans, Rough road, Front Wheels" VALUE 0x800202C2 CalPrmWslcBrk_UBYTE 0 Gain 0 255 SYMBOL_LINK "CalPrmWslcBrk01.TP_U8_LFC_built_cnt_F_Rough_Ref" 0 /end CHARACTERISTIC
/begin CHARACTERISTIC TP_U8_LFC_built_cnt_F_SpHigh_Ref "Reference Built Reapply Scans, Split mu, Front high side Wheel" VALUE 0x800202C3 CalPrmWslcBrk_UBYTE 0 Gain 0 255 SYMBOL_LINK "CalPrmWslcBrk01.TP_U8_LFC_built_cnt_F_SpHigh_Ref" 0 /end CHARACTERISTIC
/begin CHARACTERISTIC TP_U8_LFC_built_cnt_R_High_Ref "Reference Built Reapply Scans, High_Mu, Rear Wheels" VALUE 0x800202C4 CalPrmWslcBrk_UBYTE 0 Gain 0 255 SYMBOL_LINK "CalPrmWslcBrk01.TP_U8_LFC_built_cnt_R_High_Ref" 0 /end CHARACTERISTIC
/begin CHARACTERISTIC TP_U8_LFC_built_cnt_R_Low_Ref "Reference Built Reapply Scans, Low_Mu, Rear Wheels" VALUE 0x800202C5 CalPrmWslcBrk_UBYTE 0 Gain 0 255 SYMBOL_LINK "CalPrmWslcBrk01.TP_U8_LFC_built_cnt_R_Low_Ref" 0 /end CHARACTERISTIC
/begin CHARACTERISTIC TP_U8_LFC_built_cnt_R_Med_Ref "Reference Built Reapply Scans, Medium_Mu, Rear Wheels" VALUE 0x800202C6 CalPrmWslcBrk_UBYTE 0 Gain 0 255 SYMBOL_LINK "CalPrmWslcBrk01.TP_U8_LFC_built_cnt_R_Med_Ref" 0 /end CHARACTERISTIC
/begin CHARACTERISTIC TP_U8_LFC_built_cnt_R_Rough_Ref "Reference Built Reapply Scans, Rough road, Rear Wheels" VALUE 0x800202C7 CalPrmWslcBrk_UBYTE 0 Gain 0 255 SYMBOL_LINK "CalPrmWslcBrk01.TP_U8_LFC_built_cnt_R_Rough_Ref" 0 /end CHARACTERISTIC
/begin CHARACTERISTIC TP_U8_MAX_VCA_SUSTAIN_SCAN "" VALUE 0x8003A257 CalPrmWspcEng_UBYTE 0 Ti21 0 2.55 SYMBOL_LINK "CalPrmWspcEng01.TP_U8_MAX_VCA_SUSTAIN_SCAN" 0 /end CHARACTERISTIC
/begin CHARACTERISTIC TP_U8_SPEED_TH_VCA "" VALUE 0x8003A258 CalPrmWspcEng_UBYTE 0 Spd12 0 31.875 SYMBOL_LINK "CalPrmWspcEng01.TP_U8_SPEED_TH_VCA" 0 /end CHARACTERISTIC
/begin CHARACTERISTIC TP_U8_SPIN_TH_VCA "" VALUE 0x8003A259 CalPrmWspcEng_UBYTE 0 Spd12 0 31.875 SYMBOL_LINK "CalPrmWspcEng01.TP_U8_SPIN_TH_VCA" 0 /end CHARACTERISTIC
/begin CHARACTERISTIC TP_U8_STABDUMP_SCANTIME_F "Dump scantime for stable dump by Yaw stability control (ESC only)" VALUE 0x800205E9 CalPrmWslcBrk_UBYTE 0 Gain 0 255 SYMBOL_LINK "CalPrmWslcBrk01.TP_U8_STABDUMP_SCANTIME_F" 0 /end CHARACTERISTIC
/begin CHARACTERISTIC TP_U8_STB_DMP_MAX_HIGH_OverInR "Stable Dump limitation level for Over Inside Rear Wheel, High-mu (default : 4)" VALUE 0x80020522 CalPrmWslcBrk_UBYTE 0 Gain 0 255 SYMBOL_LINK "CalPrmWslcBrk01.TP_U8_STB_DMP_MAX_HIGH_OverInR" 0 /end CHARACTERISTIC
/begin CHARACTERISTIC TP_U8_STB_DMP_MAX_LOW_OverInR "Stable Dump limitation level for Over Inside Rear Wheel, low-mu (default : 8)" VALUE 0x80020523 CalPrmWslcBrk_UBYTE 0 Gain 0 255 SYMBOL_LINK "CalPrmWslcBrk01.TP_U8_STB_DMP_MAX_LOW_OverInR" 0 /end CHARACTERISTIC
/begin CHARACTERISTIC TP_U8_STB_DMP_MAX_MED_OverInR "Stable Dump limitation level for Over Inside Rear Wheel, med-mu (default : 6)" VALUE 0x80020524 CalPrmWslcBrk_UBYTE 0 Gain 0 255 SYMBOL_LINK "CalPrmWslcBrk01.TP_U8_STB_DMP_MAX_MED_OverInR" 0 /end CHARACTERISTIC
/begin CHARACTERISTIC TP_U8_STB_DMP_MAX_SP_OverInR "Stable Dump limitation level for Over Inside Rear Wheel, Split-mu (default : 4)" VALUE 0x80020525 CalPrmWslcBrk_UBYTE 0 Gain 0 255 SYMBOL_LINK "CalPrmWslcBrk01.TP_U8_STB_DMP_MAX_SP_OverInR" 0 /end CHARACTERISTIC
/begin CHARACTERISTIC TP_U8_TCS_VCA_REENGAGE_ALLOW_TIME "" VALUE 0x8003A25B CalPrmWspcEng_UBYTE 0 Ti21 0 2.55 SYMBOL_LINK "CalPrmWspcEng01.TP_U8_TCS_VCA_REENGAGE_ALLOW_TIME" 0 /end CHARACTERISTIC
/begin CHARACTERISTIC TP_U8_VREF_DECREASE_LIMIT_OF_VCA "" VALUE 0x8003A269 CalPrmWspcEng_UBYTE 0 Spd12 0 31.875 SYMBOL_LINK "CalPrmWspcEng01.TP_U8_VREF_DECREASE_LIMIT_OF_VCA" 0 /end CHARACTERISTIC
/begin CHARACTERISTIC TP_U8_YDF_RISEHOLD_T_AT_INC_L1 "Rise hold scans at Pressure Increase level 1 (default : 20)" VALUE 0x80020516 CalPrmWslcBrk_UBYTE 0 Gain 0 255 SYMBOL_LINK "CalPrmWslcBrk01.TP_U8_YDF_RISEHOLD_T_AT_INC_L1" 0 /end CHARACTERISTIC
/begin CHARACTERISTIC TP_U8_YDF_RISEHOLD_T_AT_INC_L2 "Rise hold scans at Pressure Increase level 2 (default : 14)" VALUE 0x80020517 CalPrmWslcBrk_UBYTE 0 Gain 0 255 SYMBOL_LINK "CalPrmWslcBrk01.TP_U8_YDF_RISEHOLD_T_AT_INC_L2" 0 /end CHARACTERISTIC
/begin CHARACTERISTIC TP_U8_YDF_RISEHOLD_T_AT_TARGETDYAW "Rise hold scans at Target del-yaw, level 0 (default : 56)" VALUE 0x80020518 CalPrmWslcBrk_UBYTE 0 Gain 0 255 SYMBOL_LINK "CalPrmWslcBrk01.TP_U8_YDF_RISEHOLD_T_AT_TARGETDYAW" 0 /end CHARACTERISTIC
/begin CHARACTERISTIC TP_U8_YDF_RISEHOLD_T_MAX "Maximum rise-hold scans at Pressure Increase at Max YDF, level max. (default : 140)" VALUE 0x80020519 CalPrmWslcBrk_UBYTE 0 Gain 0 255 SYMBOL_LINK "CalPrmWslcBrk01.TP_U8_YDF_RISEHOLD_T_MAX" 0 /end CHARACTERISTIC
/begin CHARACTERISTIC TP_U8_dPTim_Dump_Ref_Ab_HMu_1_R "1st reference point to set the dP rise time depending on the number of dump scans, above High-mu, Rear Wheels" VALUE 0x80020441 CalPrmWslcBrk_UBYTE 0 Gain 0 255 SYMBOL_LINK "CalPrmWslcBrk01.TP_U8_dPTim_Dump_Ref_Ab_HMu_1_R" 0 /end CHARACTERISTIC
/begin CHARACTERISTIC TP_U8_dPTim_Dump_Ref_Ab_HMu_2_R "2nd reference point to set the dP rise time depending on the number of dump scans, above High-mu, Rear Wheels" VALUE 0x80020442 CalPrmWslcBrk_UBYTE 0 Gain 0 255 SYMBOL_LINK "CalPrmWslcBrk01.TP_U8_dPTim_Dump_Ref_Ab_HMu_2_R" 0 /end CHARACTERISTIC
/begin CHARACTERISTIC TP_U8_dPTim_Dump_Ref_Ab_HMu_3_R "3rd reference point to set the dP rise time depending on the number of dump scans, above High-mu, Rear Wheels" VALUE 0x80020443 CalPrmWslcBrk_UBYTE 0 Gain 0 255 SYMBOL_LINK "CalPrmWslcBrk01.TP_U8_dPTim_Dump_Ref_Ab_HMu_3_R" 0 /end CHARACTERISTIC
/begin CHARACTERISTIC TP_U8_dPTim_Dump_Ref_Bw_LMu_1_R "1st reference point to set the dP rise time depending on the number of dump scans, Below Low mu, Rear Wheels" VALUE 0x80020487 CalPrmWslcBrk_UBYTE 0 Gain 0 255 SYMBOL_LINK "CalPrmWslcBrk01.TP_U8_dPTim_Dump_Ref_Bw_LMu_1_R" 0 /end CHARACTERISTIC
/begin CHARACTERISTIC TP_U8_dPTim_Dump_Ref_Bw_LMu_2_R "2nd reference point to set the dP rise time depending on the number of dump scans, Below Low mu, Rear Wheels" VALUE 0x80020488 CalPrmWslcBrk_UBYTE 0 Gain 0 255 SYMBOL_LINK "CalPrmWslcBrk01.TP_U8_dPTim_Dump_Ref_Bw_LMu_2_R" 0 /end CHARACTERISTIC
/begin CHARACTERISTIC TP_U8_dPTim_Dump_Ref_Bw_LMu_3_R "3rd reference point to set the dP rise time depending on the number of dump scans, Below Low mu, Rear Wheels" VALUE 0x80020489 CalPrmWslcBrk_UBYTE 0 Gain 0 255 SYMBOL_LINK "CalPrmWslcBrk01.TP_U8_dPTim_Dump_Ref_Bw_LMu_3_R" 0 /end CHARACTERISTIC
/begin CHARACTERISTIC TP_U8_dPTim_Dump_Ref_LMMu_MMu_1_R "1st reference point to set the dP rise time depending on the number of dump scans, Low-Med to Medium mu, Rear Wheels" VALUE 0x8002046B CalPrmWslcBrk_UBYTE 0 Gain 0 255 SYMBOL_LINK "CalPrmWslcBrk01.TP_U8_dPTim_Dump_Ref_LMMu_MMu_1_R" 0 /end CHARACTERISTIC
/begin CHARACTERISTIC TP_U8_dPTim_Dump_Ref_LMMu_MMu_2_R "2nd reference point to set the dP rise time depending on the number of dump scans, Low-Med to Medium mu, Rear Wheels" VALUE 0x8002046C CalPrmWslcBrk_UBYTE 0 Gain 0 255 SYMBOL_LINK "CalPrmWslcBrk01.TP_U8_dPTim_Dump_Ref_LMMu_MMu_2_R" 0 /end CHARACTERISTIC
/begin CHARACTERISTIC TP_U8_dPTim_Dump_Ref_LMMu_MMu_3_R "3rd reference point to set the dP rise time depending on the number of dump scans, Low-Med to Medium mu, Rear Wheels" VALUE 0x8002046D CalPrmWslcBrk_UBYTE 0 Gain 0 255 SYMBOL_LINK "CalPrmWslcBrk01.TP_U8_dPTim_Dump_Ref_LMMu_MMu_3_R" 0 /end CHARACTERISTIC
/begin CHARACTERISTIC TP_U8_dPTim_Dump_Ref_LMu_LMMu_1_R "1st reference point to set the dP rise time depending on the number of dump scans, Low to Low-Med mu, Rear Wheels" VALUE 0x80020479 CalPrmWslcBrk_UBYTE 0 Gain 0 255 SYMBOL_LINK "CalPrmWslcBrk01.TP_U8_dPTim_Dump_Ref_LMu_LMMu_1_R" 0 /end CHARACTERISTIC
/begin CHARACTERISTIC TP_U8_dPTim_Dump_Ref_LMu_LMMu_2_R "2nd reference point to set the dP rise time depending on the number of dump scans, Low to Low-Med mu, Rear Wheels" VALUE 0x8002047A CalPrmWslcBrk_UBYTE 0 Gain 0 255 SYMBOL_LINK "CalPrmWslcBrk01.TP_U8_dPTim_Dump_Ref_LMu_LMMu_2_R" 0 /end CHARACTERISTIC
/begin CHARACTERISTIC TP_U8_dPTim_Dump_Ref_LMu_LMMu_3_R "3rd reference point to set the dP rise time depending on the number of dump scans, Low to Low-Med mu, Rear Wheels" VALUE 0x8002047B CalPrmWslcBrk_UBYTE 0 Gain 0 255 SYMBOL_LINK "CalPrmWslcBrk01.TP_U8_dPTim_Dump_Ref_LMu_LMMu_3_R" 0 /end CHARACTERISTIC
/begin CHARACTERISTIC TP_U8_dPTim_Dump_Ref_MHMu_HMu_1_R "1st reference point to set the dP rise time depending on the number of dump scans, Med-High to High mu, Rear Wheels" VALUE 0x8002044F CalPrmWslcBrk_UBYTE 0 Gain 0 255 SYMBOL_LINK "CalPrmWslcBrk01.TP_U8_dPTim_Dump_Ref_MHMu_HMu_1_R" 0 /end CHARACTERISTIC
/begin CHARACTERISTIC TP_U8_dPTim_Dump_Ref_MHMu_HMu_2_R "2nd reference point to set the dP rise time depending on the number of dump scans, Med-High to High mu, Rear Wheels" VALUE 0x80020450 CalPrmWslcBrk_UBYTE 0 Gain 0 255 SYMBOL_LINK "CalPrmWslcBrk01.TP_U8_dPTim_Dump_Ref_MHMu_HMu_2_R" 0 /end CHARACTERISTIC
/begin CHARACTERISTIC TP_U8_dPTim_Dump_Ref_MHMu_HMu_3_R "3rd reference point to set the dP rise time depending on the number of dump scans, Med-High to High mu, Rear Wheels" VALUE 0x80020451 CalPrmWslcBrk_UBYTE 0 Gain 0 255 SYMBOL_LINK "CalPrmWslcBrk01.TP_U8_dPTim_Dump_Ref_MHMu_HMu_3_R" 0 /end CHARACTERISTIC
/begin CHARACTERISTIC TP_U8_dPTim_Dump_Ref_MMu_MHMu_1_R "1st reference point to set the dP rise time depending on the number of dump scans, Medium to Med-High mu, Rear Wheels" VALUE 0x8002045D CalPrmWslcBrk_UBYTE 0 Gain 0 255 SYMBOL_LINK "CalPrmWslcBrk01.TP_U8_dPTim_Dump_Ref_MMu_MHMu_1_R" 0 /end CHARACTERISTIC
/begin CHARACTERISTIC TP_U8_dPTim_Dump_Ref_MMu_MHMu_2_R "2nd reference point to set the dP rise time depending on the number of dump scans, Medium to Med-High mu, Rear Wheels" VALUE 0x8002045E CalPrmWslcBrk_UBYTE 0 Gain 0 255 SYMBOL_LINK "CalPrmWslcBrk01.TP_U8_dPTim_Dump_Ref_MMu_MHMu_2_R" 0 /end CHARACTERISTIC
/begin CHARACTERISTIC TP_U8_dPTim_Dump_Ref_MMu_MHMu_3_R "3rd reference point to set the dP rise time depending on the number of dump scans, Medium to Med-High mu, Rear Wheels" VALUE 0x8002045F CalPrmWslcBrk_UBYTE 0 Gain 0 255 SYMBOL_LINK "CalPrmWslcBrk01.TP_U8_dPTim_Dump_Ref_MMu_MHMu_3_R" 0 /end CHARACTERISTIC
/begin CHARACTERISTIC TP_U8_dPTim_by_Dump_Ab_HMu_1_R "dP rise time if num. of dump scans is smaller than 1st reference point, above High-mu, Rear Wheels" VALUE 0x8002043D CalPrmWslcBrk_UBYTE 0 Gain 0 255 SYMBOL_LINK "CalPrmWslcBrk01.TP_U8_dPTim_by_Dump_Ab_HMu_1_R" 0 /end CHARACTERISTIC
/begin CHARACTERISTIC TP_U8_dPTim_by_Dump_Ab_HMu_2_R "dP rise time if num. of dump scans is between 1st and 2nd reference point, above High-mu, Rear Wheels" VALUE 0x8002043E CalPrmWslcBrk_UBYTE 0 Gain 0 255 SYMBOL_LINK "CalPrmWslcBrk01.TP_U8_dPTim_by_Dump_Ab_HMu_2_R" 0 /end CHARACTERISTIC
/begin CHARACTERISTIC TP_U8_dPTim_by_Dump_Ab_HMu_3_R "dP rise time if num. of dump scans is between 2nd and 3rd reference point, above High-mu, Rear Wheels" VALUE 0x8002043F CalPrmWslcBrk_UBYTE 0 Gain 0 255 SYMBOL_LINK "CalPrmWslcBrk01.TP_U8_dPTim_by_Dump_Ab_HMu_3_R" 0 /end CHARACTERISTIC
/begin CHARACTERISTIC TP_U8_dPTim_by_Dump_Ab_HMu_Max_R "dP rise time if num. of dump scans is larger than 3rd reference point, above High-mu, Rear Wheels" VALUE 0x80020440 CalPrmWslcBrk_UBYTE 0 Gain 0 255 SYMBOL_LINK "CalPrmWslcBrk01.TP_U8_dPTim_by_Dump_Ab_HMu_Max_R" 0 /end CHARACTERISTIC
/begin CHARACTERISTIC TP_U8_dPTim_by_Dump_Bw_LMu_1_R "dP rise time if num. of dump scans is smaller than 1st reference point, Below Low mu, Rear Wheels" VALUE 0x80020483 CalPrmWslcBrk_UBYTE 0 Gain 0 255 SYMBOL_LINK "CalPrmWslcBrk01.TP_U8_dPTim_by_Dump_Bw_LMu_1_R" 0 /end CHARACTERISTIC
/begin CHARACTERISTIC TP_U8_dPTim_by_Dump_Bw_LMu_2_R "dP rise time if num. of dump scans is between 1st and 2nd reference point, Below Low mu, Rear Wheels" VALUE 0x80020484 CalPrmWslcBrk_UBYTE 0 Gain 0 255 SYMBOL_LINK "CalPrmWslcBrk01.TP_U8_dPTim_by_Dump_Bw_LMu_2_R" 0 /end CHARACTERISTIC
/begin CHARACTERISTIC TP_U8_dPTim_by_Dump_Bw_LMu_3_R "dP rise time if num. of dump scans is between 2nd and 3rd reference point, Below Low mu, Rear Wheels" VALUE 0x80020485 CalPrmWslcBrk_UBYTE 0 Gain 0 255 SYMBOL_LINK "CalPrmWslcBrk01.TP_U8_dPTim_by_Dump_Bw_LMu_3_R" 0 /end CHARACTERISTIC
/begin CHARACTERISTIC TP_U8_dPTim_by_Dump_Bw_LMu_Max_R "dP rise time if num. of dump scans is larger than 3rd reference point, Below Low mu, Rear Wheels" VALUE 0x80020486 CalPrmWslcBrk_UBYTE 0 Gain 0 255 SYMBOL_LINK "CalPrmWslcBrk01.TP_U8_dPTim_by_Dump_Bw_LMu_Max_R" 0 /end CHARACTERISTIC
/begin CHARACTERISTIC TP_U8_dPTim_by_Dump_LMMu_MMu_1_R "dP rise time if num. of dump scans is smaller than 1st reference point, Low-Med to Medium mu, Rear Wheels" VALUE 0x80020467 CalPrmWslcBrk_UBYTE 0 Gain 0 255 SYMBOL_LINK "CalPrmWslcBrk01.TP_U8_dPTim_by_Dump_LMMu_MMu_1_R" 0 /end CHARACTERISTIC
/begin CHARACTERISTIC TP_U8_dPTim_by_Dump_LMMu_MMu_2_R "dP rise time if num. of dump scans is between 1st and 2nd reference point, Low-Med to Medium mu, Rear Wheels" VALUE 0x80020468 CalPrmWslcBrk_UBYTE 0 Gain 0 255 SYMBOL_LINK "CalPrmWslcBrk01.TP_U8_dPTim_by_Dump_LMMu_MMu_2_R" 0 /end CHARACTERISTIC
/begin CHARACTERISTIC TP_U8_dPTim_by_Dump_LMMu_MMu_3_R "dP rise time if num. of dump scans is between 2nd and 3rd reference point, Low-Med to Medium mu, Rear Wheels" VALUE 0x80020469 CalPrmWslcBrk_UBYTE 0 Gain 0 255 SYMBOL_LINK "CalPrmWslcBrk01.TP_U8_dPTim_by_Dump_LMMu_MMu_3_R" 0 /end CHARACTERISTIC
/begin CHARACTERISTIC TP_U8_dPTim_by_Dump_LMMu_MMu_Max_R "dP rise time if num. of dump scans is larger than 3rd reference point, Low-Med to Medium mu, Rear Wheels" VALUE 0x8002046A CalPrmWslcBrk_UBYTE 0 Gain 0 255 SYMBOL_LINK "CalPrmWslcBrk01.TP_U8_dPTim_by_Dump_LMMu_MMu_Max_R" 0 /end CHARACTERISTIC
/begin CHARACTERISTIC TP_U8_dPTim_by_Dump_LMu_LMMu_1_R "dP rise time if num. of dump scans is smaller than 1st reference point, Low to Low-Med mu, Rear Wheels" VALUE 0x80020475 CalPrmWslcBrk_UBYTE 0 Gain 0 255 SYMBOL_LINK "CalPrmWslcBrk01.TP_U8_dPTim_by_Dump_LMu_LMMu_1_R" 0 /end CHARACTERISTIC
/begin CHARACTERISTIC TP_U8_dPTim_by_Dump_LMu_LMMu_2_R "dP rise time if num. of dump scans is between 1st and 2nd reference point, Low to Low-Med mu, Rear Wheels" VALUE 0x80020476 CalPrmWslcBrk_UBYTE 0 Gain 0 255 SYMBOL_LINK "CalPrmWslcBrk01.TP_U8_dPTim_by_Dump_LMu_LMMu_2_R" 0 /end CHARACTERISTIC
/begin CHARACTERISTIC TP_U8_dPTim_by_Dump_LMu_LMMu_3_R "dP rise time if num. of dump scans is between 2nd and 3rd reference point, Low to Low-Med mu, Rear Wheels" VALUE 0x80020477 CalPrmWslcBrk_UBYTE 0 Gain 0 255 SYMBOL_LINK "CalPrmWslcBrk01.TP_U8_dPTim_by_Dump_LMu_LMMu_3_R" 0 /end CHARACTERISTIC
/begin CHARACTERISTIC TP_U8_dPTim_by_Dump_LMu_LMMu_Max_R "dP rise time if num. of dump scans is larger than 3rd reference point, Low to Low-Med mu, Rear Wheels" VALUE 0x80020478 CalPrmWslcBrk_UBYTE 0 Gain 0 255 SYMBOL_LINK "CalPrmWslcBrk01.TP_U8_dPTim_by_Dump_LMu_LMMu_Max_R" 0 /end CHARACTERISTIC
/begin CHARACTERISTIC TP_U8_dPTim_by_Dump_MHMu_HMu_1_R "dP rise time if num. of dump scans is smaller than 1st reference point, Med-High to High mu, Rear Wheels" VALUE 0x8002044B CalPrmWslcBrk_UBYTE 0 Gain 0 255 SYMBOL_LINK "CalPrmWslcBrk01.TP_U8_dPTim_by_Dump_MHMu_HMu_1_R" 0 /end CHARACTERISTIC
/begin CHARACTERISTIC TP_U8_dPTim_by_Dump_MHMu_HMu_2_R "dP rise time if num. of dump scans is between 1st and 2nd reference point, Med-High to High mu, Rear Wheels" VALUE 0x8002044C CalPrmWslcBrk_UBYTE 0 Gain 0 255 SYMBOL_LINK "CalPrmWslcBrk01.TP_U8_dPTim_by_Dump_MHMu_HMu_2_R" 0 /end CHARACTERISTIC
/begin CHARACTERISTIC TP_U8_dPTim_by_Dump_MHMu_HMu_3_R "dP rise time if num. of dump scans is between 2nd and 3rd reference point, Med-High to High mu, Rear Wheels" VALUE 0x8002044D CalPrmWslcBrk_UBYTE 0 Gain 0 255 SYMBOL_LINK "CalPrmWslcBrk01.TP_U8_dPTim_by_Dump_MHMu_HMu_3_R" 0 /end CHARACTERISTIC
/begin CHARACTERISTIC TP_U8_dPTim_by_Dump_MHMu_HMu_Max_R "dP rise time if num. of dump scans is larger than 3rd reference point, Med-High to High mu, Rear Wheels" VALUE 0x8002044E CalPrmWslcBrk_UBYTE 0 Gain 0 255 SYMBOL_LINK "CalPrmWslcBrk01.TP_U8_dPTim_by_Dump_MHMu_HMu_Max_R" 0 /end CHARACTERISTIC
/begin CHARACTERISTIC TP_U8_dPTim_by_Dump_MMu_MHMu_1_R "dP rise time if num. of dump scans is smaller than 1st reference point, Medium to Med-High mu, Rear Wheels" VALUE 0x80020459 CalPrmWslcBrk_UBYTE 0 Gain 0 255 SYMBOL_LINK "CalPrmWslcBrk01.TP_U8_dPTim_by_Dump_MMu_MHMu_1_R" 0 /end CHARACTERISTIC
/begin CHARACTERISTIC TP_U8_dPTim_by_Dump_MMu_MHMu_2_R "dP rise time if num. of dump scans is between 1st and 2nd reference point, Medium to Med-High mu, Rear Wheels" VALUE 0x8002045A CalPrmWslcBrk_UBYTE 0 Gain 0 255 SYMBOL_LINK "CalPrmWslcBrk01.TP_U8_dPTim_by_Dump_MMu_MHMu_2_R" 0 /end CHARACTERISTIC
/begin CHARACTERISTIC TP_U8_dPTim_by_Dump_MMu_MHMu_3_R "dP rise time if num. of dump scans is between 2nd and 3rd reference point, Medium to Med-High mu, Rear Wheels" VALUE 0x8002045B CalPrmWslcBrk_UBYTE 0 Gain 0 255 SYMBOL_LINK "CalPrmWslcBrk01.TP_U8_dPTim_by_Dump_MMu_MHMu_3_R" 0 /end CHARACTERISTIC
/begin CHARACTERISTIC TP_U8_dPTim_by_Dump_MMu_MHMu_Max_R "dP rise time if num. of dump scans is larger than 3rd reference point, Medium to Med-High mu, Rear Wheels" VALUE 0x8002045C CalPrmWslcBrk_UBYTE 0 Gain 0 255 SYMBOL_LINK "CalPrmWslcBrk01.TP_U8_dPTim_by_Dump_MMu_MHMu_Max_R" 0 /end CHARACTERISTIC
/begin CHARACTERISTIC TP_U8_dP_Dump_cnt_Ref_Ab_HMu_R "Number of Dump scans Ref. for starting Unstable Rise, above High-mu, Rear Wheels" VALUE 0x8002041F CalPrmWslcBrk_UBYTE 0 Gain 0 255 SYMBOL_LINK "CalPrmWslcBrk01.TP_U8_dP_Dump_cnt_Ref_Ab_HMu_R" 0 /end CHARACTERISTIC
/begin CHARACTERISTIC TP_U8_dP_Dump_cnt_Ref_Bw_LMu_R "Number of Dump scans Ref. for starting Unstable Rise, Below Low mu, Rear Wheels" VALUE 0x80020433 CalPrmWslcBrk_UBYTE 0 Gain 0 255 SYMBOL_LINK "CalPrmWslcBrk01.TP_U8_dP_Dump_cnt_Ref_Bw_LMu_R" 0 /end CHARACTERISTIC
/begin CHARACTERISTIC TP_U8_dP_Dump_cnt_Ref_LMMu_MMu_R "Number of Dump scans Ref. for starting Unstable Rise, From Low-Medium to Medium mu, Rear Wheels" VALUE 0x8002042B CalPrmWslcBrk_UBYTE 0 Gain 0 255 SYMBOL_LINK "CalPrmWslcBrk01.TP_U8_dP_Dump_cnt_Ref_LMMu_MMu_R" 0 /end CHARACTERISTIC
/begin CHARACTERISTIC TP_U8_dP_Dump_cnt_Ref_LMu_LMMu_R "Number of Dump scans Ref. for starting Unstable Rise, From Low to Low-Medium mu, Rear Wheels" VALUE 0x8002042F CalPrmWslcBrk_UBYTE 0 Gain 0 255 SYMBOL_LINK "CalPrmWslcBrk01.TP_U8_dP_Dump_cnt_Ref_LMu_LMMu_R" 0 /end CHARACTERISTIC
/begin CHARACTERISTIC TP_U8_dP_Dump_cnt_Ref_MHMu_HMu_R "Number of Dump scans Ref. for starting Unstable Rise, From Med-High to High-mu, Rear Wheels" VALUE 0x80020423 CalPrmWslcBrk_UBYTE 0 Gain 0 255 SYMBOL_LINK "CalPrmWslcBrk01.TP_U8_dP_Dump_cnt_Ref_MHMu_HMu_R" 0 /end CHARACTERISTIC
/begin CHARACTERISTIC TP_U8_dP_Dump_cnt_Ref_MMu_MHMu_R "Number of Dump scans Ref. for starting Unstable Rise, From Medium to Med-High mu, Rear Wheels" VALUE 0x80020427 CalPrmWslcBrk_UBYTE 0 Gain 0 255 SYMBOL_LINK "CalPrmWslcBrk01.TP_U8_dP_Dump_cnt_Ref_MMu_MHMu_R" 0 /end CHARACTERISTIC
/begin CHARACTERISTIC TP_U8_dP_HMu_Dct_AradRef_1st_R "Arad Reference to detect High Mu for Unstable-rise compensation at 1st cycle, Rear Wheels" VALUE 0x800205E4 CalPrmWslcBrk_UBYTE 0 A20 0 63.75 SYMBOL_LINK "CalPrmWslcBrk01.TP_U8_dP_HMu_Dct_AradRef_1st_R" 0 /end CHARACTERISTIC
/begin CHARACTERISTIC TP_U8_dP_HMu_Dct_DumpRef_1st_R "Dump Reference to detect High Mu for Unstable-rise compensation at 1st cycle, Rear Wheels" VALUE 0x800205E5 CalPrmWslcBrk_UBYTE 0 Gain 0 255 SYMBOL_LINK "CalPrmWslcBrk01.TP_U8_dP_HMu_Dct_DumpRef_1st_R" 0 /end CHARACTERISTIC
/begin CHARACTERISTIC TP_U8_dP_LMu_Dct_AradRef_1st_R "Arad Reference to detect Low Mu for Unstable-rise compensation at 1st cycle, Rear Wheels" VALUE 0x800205E6 CalPrmWslcBrk_UBYTE 0 A20 0 63.75 SYMBOL_LINK "CalPrmWslcBrk01.TP_U8_dP_LMu_Dct_AradRef_1st_R" 0 /end CHARACTERISTIC
/begin CHARACTERISTIC TP_U8_dP_LMu_Dct_DumpRef_1st_R "Dump Reference to detect Low Mu for Unstable-rise compensation at 1st cycle, Rear Wheels" VALUE 0x800205E7 CalPrmWslcBrk_UBYTE 0 Gain 0 255 SYMBOL_LINK "CalPrmWslcBrk01.TP_U8_dP_LMu_Dct_DumpRef_1st_R" 0 /end CHARACTERISTIC
/begin CHARACTERISTIC TP_U8_nth_Dumpscantime_EBD_R "EBD Dump time in ms of nth dump-scans, default 7, min 5, max 20" VALUE 0x800206DD CalPrmWslcBrk_UBYTE 0 Gain 0 255 SYMBOL_LINK "CalPrmWslcBrk01.TP_U8_nth_Dumpscantime_EBD_R" 0 /end CHARACTERISTIC
/begin CHARACTERISTIC TP_U8_nth_Dumpscantime_MMu_F "Time of nth dump-scan in Low-med~medium mu, Front Wheels" VALUE 0x800204A5 CalPrmWslcBrk_UBYTE 0 Gain 0 255 SYMBOL_LINK "CalPrmWslcBrk01.TP_U8_nth_Dumpscantime_MMu_F" 0 /end CHARACTERISTIC
/begin CHARACTERISTIC TQEHC_Select_Yawrate "" VALUE 0x80020EA0 CalPrmLatDynsCoorrBrk_UBYTE 0 Gain 0 255 SYMBOL_LINK "CalPrmLatDynsCoorrBrk01.TQEHC_Select_Yawrate" 0 /end CHARACTERISTIC
/begin CHARACTERISTIC TQS16_DELYAW_OFFSET_TH_HMU "" VALUE 0x80020CBE CalPrmLatDynsCoorrBrk_SWORD 0 Gain -32768 32767 SYMBOL_LINK "CalPrmLatDynsCoorrBrk01.TQS16_DELYAW_OFFSET_TH_HMU" 0 /end CHARACTERISTIC
/begin CHARACTERISTIC TQS16_DELYAW_OFFSET_TH_LMU "" VALUE 0x80020CBA CalPrmLatDynsCoorrBrk_SWORD 0 Gain -32768 32767 SYMBOL_LINK "CalPrmLatDynsCoorrBrk01.TQS16_DELYAW_OFFSET_TH_LMU" 0 /end CHARACTERISTIC
/begin CHARACTERISTIC TQS16_DELYAW_OFFSET_TH_MMU "" VALUE 0x80020CBC CalPrmLatDynsCoorrBrk_SWORD 0 Gain -32768 32767 SYMBOL_LINK "CalPrmLatDynsCoorrBrk01.TQS16_DELYAW_OFFSET_TH_MMU" 0 /end CHARACTERISTIC
/begin CHARACTERISTIC TQS16_DELYAW_TH_ADD_ABS "" VALUE 0x80020CDA CalPrmLatDynsCoorrBrk_SWORD 0 Gain -32768 32767 SYMBOL_LINK "CalPrmLatDynsCoorrBrk01.TQS16_DELYAW_TH_ADD_ABS" 0 /end CHARACTERISTIC
/begin CHARACTERISTIC TQS16_DELYAW_TH_ADD_BY_SPLIT "" VALUE 0x80020CC0 CalPrmLatDynsCoorrBrk_SWORD 0 Gain -32768 32767 SYMBOL_LINK "CalPrmLatDynsCoorrBrk01.TQS16_DELYAW_TH_ADD_BY_SPLIT" 0 /end CHARACTERISTIC
/begin CHARACTERISTIC TQS16_DYN_PHI_DOT_TH_1st "" VALUE 0x80020B38 CalPrmLatDynsCoorrBrk_SWORD 0 Gain -32768 32767 SYMBOL_LINK "CalPrmLatDynsCoorrBrk01.TQS16_DYN_PHI_DOT_TH_1st" 0 /end CHARACTERISTIC
/begin CHARACTERISTIC TQS16_DYN_PHI_DOT_TH_2nd "" VALUE 0x80020B3A CalPrmLatDynsCoorrBrk_SWORD 0 Gain -32768 32767 SYMBOL_LINK "CalPrmLatDynsCoorrBrk01.TQS16_DYN_PHI_DOT_TH_2nd" 0 /end CHARACTERISTIC
/begin CHARACTERISTIC TQS16_DYN_PHI_DOT_TH_3rd "" VALUE 0x80020B3C CalPrmLatDynsCoorrBrk_SWORD 0 Gain -32768 32767 SYMBOL_LINK "CalPrmLatDynsCoorrBrk01.TQS16_DYN_PHI_DOT_TH_3rd" 0 /end CHARACTERISTIC
/begin CHARACTERISTIC TQS16_DYN_PHI_DOT_TH_4th "" VALUE 0x80020B3E CalPrmLatDynsCoorrBrk_SWORD 0 Gain -32768 32767 SYMBOL_LINK "CalPrmLatDynsCoorrBrk01.TQS16_DYN_PHI_DOT_TH_4th" 0 /end CHARACTERISTIC
/begin CHARACTERISTIC TQS16_DYN_PHI_TH_1st "" VALUE 0x80020B40 CalPrmLatDynsCoorrBrk_SWORD 0 Gain -32768 32767 SYMBOL_LINK "CalPrmLatDynsCoorrBrk01.TQS16_DYN_PHI_TH_1st" 0 /end CHARACTERISTIC
/begin CHARACTERISTIC TQS16_DYN_PHI_TH_2nd "" VALUE 0x80020B42 CalPrmLatDynsCoorrBrk_SWORD 0 Gain -32768 32767 SYMBOL_LINK "CalPrmLatDynsCoorrBrk01.TQS16_DYN_PHI_TH_2nd" 0 /end CHARACTERISTIC
/begin CHARACTERISTIC TQS16_DYN_PHI_TH_3rd "" VALUE 0x80020B44 CalPrmLatDynsCoorrBrk_SWORD 0 Gain -32768 32767 SYMBOL_LINK "CalPrmLatDynsCoorrBrk01.TQS16_DYN_PHI_TH_3rd" 0 /end CHARACTERISTIC
/begin CHARACTERISTIC TQS16_DYN_PHI_TH_4th "" VALUE 0x80020B46 CalPrmLatDynsCoorrBrk_SWORD 0 Gain -32768 32767 SYMBOL_LINK "CalPrmLatDynsCoorrBrk01.TQS16_DYN_PHI_TH_4th" 0 /end CHARACTERISTIC
/begin CHARACTERISTIC TQS16_OS2W_CTRL_NEG_OFFSET "" VALUE 0x80020D22 CalPrmLatDynsCoorrBrk_SWORD 0 Gain -32768 32767 SYMBOL_LINK "CalPrmLatDynsCoorrBrk01.TQS16_OS2W_CTRL_NEG_OFFSET" 0 /end CHARACTERISTIC
/begin CHARACTERISTIC TQS16_ROP_ENTER_ALAT_TH_1st "" VALUE 0x80020B48 CalPrmLatDynsCoorrBrk_SWORD 0 Gain -32768 32767 SYMBOL_LINK "CalPrmLatDynsCoorrBrk01.TQS16_ROP_ENTER_ALAT_TH_1st" 0 /end CHARACTERISTIC
/begin CHARACTERISTIC TQS16_ROP_ENTER_ALAT_TH_2nd "" VALUE 0x80020B4A CalPrmLatDynsCoorrBrk_SWORD 0 Gain -32768 32767 SYMBOL_LINK "CalPrmLatDynsCoorrBrk01.TQS16_ROP_ENTER_ALAT_TH_2nd" 0 /end CHARACTERISTIC
/begin CHARACTERISTIC TQS16_ROP_ENTER_ALAT_TH_3rd "" VALUE 0x80020B4C CalPrmLatDynsCoorrBrk_SWORD 0 Gain -32768 32767 SYMBOL_LINK "CalPrmLatDynsCoorrBrk01.TQS16_ROP_ENTER_ALAT_TH_3rd" 0 /end CHARACTERISTIC
/begin CHARACTERISTIC TQS16_ROP_ENTER_ALAT_TH_4th "" VALUE 0x80020B4E CalPrmLatDynsCoorrBrk_SWORD 0 Gain -32768 32767 SYMBOL_LINK "CalPrmLatDynsCoorrBrk01.TQS16_ROP_ENTER_ALAT_TH_4th" 0 /end CHARACTERISTIC
/begin CHARACTERISTIC TQS16_ROP_ENTER_ALAT_TH_5th "" VALUE 0x80020B50 CalPrmLatDynsCoorrBrk_SWORD 0 Gain -32768 32767 SYMBOL_LINK "CalPrmLatDynsCoorrBrk01.TQS16_ROP_ENTER_ALAT_TH_5th" 0 /end CHARACTERISTIC
/begin CHARACTERISTIC TQS16_ROP_ENTER_ALAT_WEG_1st "" VALUE 0x80020B52 CalPrmLatDynsCoorrBrk_SWORD 0 Gain -32768 32767 SYMBOL_LINK "CalPrmLatDynsCoorrBrk01.TQS16_ROP_ENTER_ALAT_WEG_1st" 0 /end CHARACTERISTIC
/begin CHARACTERISTIC TQS16_ROP_ENTER_ALAT_WEG_2nd "" VALUE 0x80020B54 CalPrmLatDynsCoorrBrk_SWORD 0 Gain -32768 32767 SYMBOL_LINK "CalPrmLatDynsCoorrBrk01.TQS16_ROP_ENTER_ALAT_WEG_2nd" 0 /end CHARACTERISTIC
/begin CHARACTERISTIC TQS16_ROP_ENTER_ALAT_WEG_3rd "" VALUE 0x80020B56 CalPrmLatDynsCoorrBrk_SWORD 0 Gain -32768 32767 SYMBOL_LINK "CalPrmLatDynsCoorrBrk01.TQS16_ROP_ENTER_ALAT_WEG_3rd" 0 /end CHARACTERISTIC
/begin CHARACTERISTIC TQS16_ROP_ENTER_ALAT_WEG_4th "" VALUE 0x80020B58 CalPrmLatDynsCoorrBrk_SWORD 0 Gain -32768 32767 SYMBOL_LINK "CalPrmLatDynsCoorrBrk01.TQS16_ROP_ENTER_ALAT_WEG_4th" 0 /end CHARACTERISTIC
/begin CHARACTERISTIC TQS16_ROP_ENTER_ALAT_WEG_5th "" VALUE 0x80020B5A CalPrmLatDynsCoorrBrk_SWORD 0 Gain -32768 32767 SYMBOL_LINK "CalPrmLatDynsCoorrBrk01.TQS16_ROP_ENTER_ALAT_WEG_5th" 0 /end CHARACTERISTIC
/begin CHARACTERISTIC TQS16_ROP_MODEL_MU_LEVEL "" VALUE 0x80020B6E CalPrmLatDynsCoorrBrk_SWORD 0 Gain -32768 32767 SYMBOL_LINK "CalPrmLatDynsCoorrBrk01.TQS16_ROP_MODEL_MU_LEVEL" 0 /end CHARACTERISTIC
/begin CHARACTERISTIC TQS16_ROP_MU_LEVEL_AY "" VALUE 0x80020B70 CalPrmLatDynsCoorrBrk_SWORD 0 Gain -32768 32767 SYMBOL_LINK "CalPrmLatDynsCoorrBrk01.TQS16_ROP_MU_LEVEL_AY" 0 /end CHARACTERISTIC
/begin CHARACTERISTIC TQS16_ROP_RI_THRES_VEL_100K "" VALUE 0x80020B60 CalPrmLatDynsCoorrBrk_SWORD 0 Gain -32768 32767 SYMBOL_LINK "CalPrmLatDynsCoorrBrk01.TQS16_ROP_RI_THRES_VEL_100K" 0 /end CHARACTERISTIC
/begin CHARACTERISTIC TQS16_ROP_RI_THRES_VEL_20K "" VALUE 0x80020B62 CalPrmLatDynsCoorrBrk_SWORD 0 Gain -32768 32767 SYMBOL_LINK "CalPrmLatDynsCoorrBrk01.TQS16_ROP_RI_THRES_VEL_20K" 0 /end CHARACTERISTIC
/begin CHARACTERISTIC TQS16_ROP_RI_THRES_VEL_40K "" VALUE 0x80020B64 CalPrmLatDynsCoorrBrk_SWORD 0 Gain -32768 32767 SYMBOL_LINK "CalPrmLatDynsCoorrBrk01.TQS16_ROP_RI_THRES_VEL_40K" 0 /end CHARACTERISTIC
/begin CHARACTERISTIC TQS16_ROP_RI_THRES_VEL_60K "" VALUE 0x80020B66 CalPrmLatDynsCoorrBrk_SWORD 0 Gain -32768 32767 SYMBOL_LINK "CalPrmLatDynsCoorrBrk01.TQS16_ROP_RI_THRES_VEL_60K" 0 /end CHARACTERISTIC
/begin CHARACTERISTIC TQS16_ROP_RI_THRES_VEL_80K "" VALUE 0x80020B68 CalPrmLatDynsCoorrBrk_SWORD 0 Gain -32768 32767 SYMBOL_LINK "CalPrmLatDynsCoorrBrk01.TQS16_ROP_RI_THRES_VEL_80K" 0 /end CHARACTERISTIC
/begin CHARACTERISTIC TQS16_ROP_TTP_FAST_VEL_DELAY "" VALUE 0x80020C20 CalPrmLatDynsCoorrBrk_SWORD 0 Gain -32768 32767 SYMBOL_LINK "CalPrmLatDynsCoorrBrk01.TQS16_ROP_TTP_FAST_VEL_DELAY" 0 /end CHARACTERISTIC
/begin CHARACTERISTIC TQS16_ROP_TTP_FAST_WSTR_DOT_DELAY "" VALUE 0x80020C22 CalPrmLatDynsCoorrBrk_SWORD 0 Gain -32768 32767 SYMBOL_LINK "CalPrmLatDynsCoorrBrk01.TQS16_ROP_TTP_FAST_WSTR_DOT_DELAY" 0 /end CHARACTERISTIC
/begin CHARACTERISTIC TQS16_ROP_TTP_SLOW_VEL_DELAY "" VALUE 0x80020C24 CalPrmLatDynsCoorrBrk_SWORD 0 Gain -32768 32767 SYMBOL_LINK "CalPrmLatDynsCoorrBrk01.TQS16_ROP_TTP_SLOW_VEL_DELAY" 0 /end CHARACTERISTIC
/begin CHARACTERISTIC TQS16_ROP_TTP_SLOW_WSTR_DOT_DELAY "" VALUE 0x80020C26 CalPrmLatDynsCoorrBrk_SWORD 0 Gain -32768 32767 SYMBOL_LINK "CalPrmLatDynsCoorrBrk01.TQS16_ROP_TTP_SLOW_WSTR_DOT_DELAY" 0 /end CHARACTERISTIC
/begin CHARACTERISTIC TQS16_ROP_TTP_VEL_FAST "" VALUE 0x80020C28 CalPrmLatDynsCoorrBrk_SWORD 0 Gain -32768 32767 SYMBOL_LINK "CalPrmLatDynsCoorrBrk01.TQS16_ROP_TTP_VEL_FAST" 0 /end CHARACTERISTIC
/begin CHARACTERISTIC TQS16_ROP_TTP_VEL_SLOW "" VALUE 0x80020C2A CalPrmLatDynsCoorrBrk_SWORD 0 Gain -32768 32767 SYMBOL_LINK "CalPrmLatDynsCoorrBrk01.TQS16_ROP_TTP_VEL_SLOW" 0 /end CHARACTERISTIC
/begin CHARACTERISTIC TQS16_ROP_TTP_WSTR_DOT_FAST "" VALUE 0x80020C2C CalPrmLatDynsCoorrBrk_SWORD 0 Gain -32768 32767 SYMBOL_LINK "CalPrmLatDynsCoorrBrk01.TQS16_ROP_TTP_WSTR_DOT_FAST" 0 /end CHARACTERISTIC
/begin CHARACTERISTIC TQS16_ROP_TTP_WSTR_DOT_SLOW "" VALUE 0x80020C2E CalPrmLatDynsCoorrBrk_SWORD 0 Gain -32768 32767 SYMBOL_LINK "CalPrmLatDynsCoorrBrk01.TQS16_ROP_TTP_WSTR_DOT_SLOW" 0 /end CHARACTERISTIC
/begin CHARACTERISTIC TQS16_SS_PHI_DOT_TH_1st "" VALUE 0x80020B28 CalPrmLatDynsCoorrBrk_SWORD 0 Gain -32768 32767 SYMBOL_LINK "CalPrmLatDynsCoorrBrk01.TQS16_SS_PHI_DOT_TH_1st" 0 /end CHARACTERISTIC
/begin CHARACTERISTIC TQS16_SS_PHI_DOT_TH_2nd "" VALUE 0x80020B2A CalPrmLatDynsCoorrBrk_SWORD 0 Gain -32768 32767 SYMBOL_LINK "CalPrmLatDynsCoorrBrk01.TQS16_SS_PHI_DOT_TH_2nd" 0 /end CHARACTERISTIC
/begin CHARACTERISTIC TQS16_SS_PHI_DOT_TH_3rd "" VALUE 0x80020B2C CalPrmLatDynsCoorrBrk_SWORD 0 Gain -32768 32767 SYMBOL_LINK "CalPrmLatDynsCoorrBrk01.TQS16_SS_PHI_DOT_TH_3rd" 0 /end CHARACTERISTIC
/begin CHARACTERISTIC TQS16_SS_PHI_DOT_TH_4th "" VALUE 0x80020B2E CalPrmLatDynsCoorrBrk_SWORD 0 Gain -32768 32767 SYMBOL_LINK "CalPrmLatDynsCoorrBrk01.TQS16_SS_PHI_DOT_TH_4th" 0 /end CHARACTERISTIC
/begin CHARACTERISTIC TQS16_SS_PHI_TH_1st "" VALUE 0x80020B30 CalPrmLatDynsCoorrBrk_SWORD 0 Gain -32768 32767 SYMBOL_LINK "CalPrmLatDynsCoorrBrk01.TQS16_SS_PHI_TH_1st" 0 /end CHARACTERISTIC
/begin CHARACTERISTIC TQS16_SS_PHI_TH_2nd "" VALUE 0x80020B32 CalPrmLatDynsCoorrBrk_SWORD 0 Gain -32768 32767 SYMBOL_LINK "CalPrmLatDynsCoorrBrk01.TQS16_SS_PHI_TH_2nd" 0 /end CHARACTERISTIC
/begin CHARACTERISTIC TQS16_SS_PHI_TH_3rd "" VALUE 0x80020B34 CalPrmLatDynsCoorrBrk_SWORD 0 Gain -32768 32767 SYMBOL_LINK "CalPrmLatDynsCoorrBrk01.TQS16_SS_PHI_TH_3rd" 0 /end CHARACTERISTIC
/begin CHARACTERISTIC TQS16_SS_PHI_TH_4th "" VALUE 0x80020B36 CalPrmLatDynsCoorrBrk_SWORD 0 Gain -32768 32767 SYMBOL_LINK "CalPrmLatDynsCoorrBrk01.TQS16_SS_PHI_TH_4th" 0 /end CHARACTERISTIC
/begin CHARACTERISTIC TQS16_TC_OFFSET_ADD_Y1 "" VALUE 0x800207CE CalPrmLatDynsCoorrBrk_SWORD 0 Gain -32768 32767 SYMBOL_LINK "CalPrmLatDynsCoorrBrk01.TQS16_TC_OFFSET_ADD_Y1" 0 /end CHARACTERISTIC
/begin CHARACTERISTIC TQS16_TC_OFFSET_ADD_Y2 "" VALUE 0x800207D0 CalPrmLatDynsCoorrBrk_SWORD 0 Gain -32768 32767 SYMBOL_LINK "CalPrmLatDynsCoorrBrk01.TQS16_TC_OFFSET_ADD_Y2" 0 /end CHARACTERISTIC
/begin CHARACTERISTIC TQS16_TC_OFFSET_ADD_Y3 "" VALUE 0x800207D2 CalPrmLatDynsCoorrBrk_SWORD 0 Gain -32768 32767 SYMBOL_LINK "CalPrmLatDynsCoorrBrk01.TQS16_TC_OFFSET_ADD_Y3" 0 /end CHARACTERISTIC
/begin CHARACTERISTIC TQS16_TC_OFFSET_ADD_Y4 "" VALUE 0x800207D4 CalPrmLatDynsCoorrBrk_SWORD 0 Gain -32768 32767 SYMBOL_LINK "CalPrmLatDynsCoorrBrk01.TQS16_TC_OFFSET_ADD_Y4" 0 /end CHARACTERISTIC
/begin CHARACTERISTIC TQS16_TC_OFFSET_ADD_Y5 "" VALUE 0x800207D6 CalPrmLatDynsCoorrBrk_SWORD 0 Gain -32768 32767 SYMBOL_LINK "CalPrmLatDynsCoorrBrk01.TQS16_TC_OFFSET_ADD_Y5" 0 /end CHARACTERISTIC
/begin CHARACTERISTIC TQS16_TORQ_GRAD_MOTOR_V_Y1 "" VALUE 0x800207DE CalPrmLatDynsCoorrBrk_SWORD 0 Gain -32768 32767 SYMBOL_LINK "CalPrmLatDynsCoorrBrk01.TQS16_TORQ_GRAD_MOTOR_V_Y1" 0 /end CHARACTERISTIC
/begin CHARACTERISTIC TQS16_TORQ_GRAD_MOTOR_V_Y1_HMU "" VALUE 0x80020F34 CalPrmLatDynsCoorrBrk_SWORD 0 Gain -32768 32767 SYMBOL_LINK "CalPrmLatDynsCoorrBrk01.TQS16_TORQ_GRAD_MOTOR_V_Y1_HMU" 0 /end CHARACTERISTIC
/begin CHARACTERISTIC TQS16_TORQ_GRAD_MOTOR_V_Y1_LMU "" VALUE 0x80020F20 CalPrmLatDynsCoorrBrk_SWORD 0 Gain -32768 32767 SYMBOL_LINK "CalPrmLatDynsCoorrBrk01.TQS16_TORQ_GRAD_MOTOR_V_Y1_LMU" 0 /end CHARACTERISTIC
/begin CHARACTERISTIC TQS16_TORQ_GRAD_MOTOR_V_Y1_MMU "" VALUE 0x80020F2A CalPrmLatDynsCoorrBrk_SWORD 0 Gain -32768 32767 SYMBOL_LINK "CalPrmLatDynsCoorrBrk01.TQS16_TORQ_GRAD_MOTOR_V_Y1_MMU" 0 /end CHARACTERISTIC
/begin CHARACTERISTIC TQS16_TORQ_GRAD_MOTOR_V_Y1_US "" VALUE 0x80020F3E CalPrmLatDynsCoorrBrk_SWORD 0 Gain -32768 32767 SYMBOL_LINK "CalPrmLatDynsCoorrBrk01.TQS16_TORQ_GRAD_MOTOR_V_Y1_US" 0 /end CHARACTERISTIC
/begin CHARACTERISTIC TQS16_TORQ_GRAD_MOTOR_V_Y2 "" VALUE 0x800207E0 CalPrmLatDynsCoorrBrk_SWORD 0 Gain -32768 32767 SYMBOL_LINK "CalPrmLatDynsCoorrBrk01.TQS16_TORQ_GRAD_MOTOR_V_Y2" 0 /end CHARACTERISTIC
/begin CHARACTERISTIC TQS16_TORQ_GRAD_MOTOR_V_Y2_HMU "" VALUE 0x80020F36 CalPrmLatDynsCoorrBrk_SWORD 0 Gain -32768 32767 SYMBOL_LINK "CalPrmLatDynsCoorrBrk01.TQS16_TORQ_GRAD_MOTOR_V_Y2_HMU" 0 /end CHARACTERISTIC
/begin CHARACTERISTIC TQS16_TORQ_GRAD_MOTOR_V_Y2_LMU "" VALUE 0x80020F22 CalPrmLatDynsCoorrBrk_SWORD 0 Gain -32768 32767 SYMBOL_LINK "CalPrmLatDynsCoorrBrk01.TQS16_TORQ_GRAD_MOTOR_V_Y2_LMU" 0 /end CHARACTERISTIC
/begin CHARACTERISTIC TQS16_TORQ_GRAD_MOTOR_V_Y2_MMU "" VALUE 0x80020F2C CalPrmLatDynsCoorrBrk_SWORD 0 Gain -32768 32767 SYMBOL_LINK "CalPrmLatDynsCoorrBrk01.TQS16_TORQ_GRAD_MOTOR_V_Y2_MMU" 0 /end CHARACTERISTIC
/begin CHARACTERISTIC TQS16_TORQ_GRAD_MOTOR_V_Y2_US "" VALUE 0x80020F40 CalPrmLatDynsCoorrBrk_SWORD 0 Gain -32768 32767 SYMBOL_LINK "CalPrmLatDynsCoorrBrk01.TQS16_TORQ_GRAD_MOTOR_V_Y2_US" 0 /end CHARACTERISTIC
/begin CHARACTERISTIC TQS16_TORQ_GRAD_MOTOR_V_Y3 "" VALUE 0x800207E2 CalPrmLatDynsCoorrBrk_SWORD 0 Gain -32768 32767 SYMBOL_LINK "CalPrmLatDynsCoorrBrk01.TQS16_TORQ_GRAD_MOTOR_V_Y3" 0 /end CHARACTERISTIC
/begin CHARACTERISTIC TQS16_TORQ_GRAD_MOTOR_V_Y3_HMU "" VALUE 0x80020F38 CalPrmLatDynsCoorrBrk_SWORD 0 Gain -32768 32767 SYMBOL_LINK "CalPrmLatDynsCoorrBrk01.TQS16_TORQ_GRAD_MOTOR_V_Y3_HMU" 0 /end CHARACTERISTIC
/begin CHARACTERISTIC TQS16_TORQ_GRAD_MOTOR_V_Y3_LMU "" VALUE 0x80020F24 CalPrmLatDynsCoorrBrk_SWORD 0 Gain -32768 32767 SYMBOL_LINK "CalPrmLatDynsCoorrBrk01.TQS16_TORQ_GRAD_MOTOR_V_Y3_LMU" 0 /end CHARACTERISTIC
/begin CHARACTERISTIC TQS16_TORQ_GRAD_MOTOR_V_Y3_MMU "" VALUE 0x80020F2E CalPrmLatDynsCoorrBrk_SWORD 0 Gain -32768 32767 SYMBOL_LINK "CalPrmLatDynsCoorrBrk01.TQS16_TORQ_GRAD_MOTOR_V_Y3_MMU" 0 /end CHARACTERISTIC
/begin CHARACTERISTIC TQS16_TORQ_GRAD_MOTOR_V_Y3_US "" VALUE 0x80020F42 CalPrmLatDynsCoorrBrk_SWORD 0 Gain -32768 32767 SYMBOL_LINK "CalPrmLatDynsCoorrBrk01.TQS16_TORQ_GRAD_MOTOR_V_Y3_US" 0 /end CHARACTERISTIC
/begin CHARACTERISTIC TQS16_TORQ_GRAD_MOTOR_V_Y4 "" VALUE 0x800207E4 CalPrmLatDynsCoorrBrk_SWORD 0 Gain -32768 32767 SYMBOL_LINK "CalPrmLatDynsCoorrBrk01.TQS16_TORQ_GRAD_MOTOR_V_Y4" 0 /end CHARACTERISTIC
/begin CHARACTERISTIC TQS16_TORQ_GRAD_MOTOR_V_Y4_HMU "" VALUE 0x80020F3A CalPrmLatDynsCoorrBrk_SWORD 0 Gain -32768 32767 SYMBOL_LINK "CalPrmLatDynsCoorrBrk01.TQS16_TORQ_GRAD_MOTOR_V_Y4_HMU" 0 /end CHARACTERISTIC
/begin CHARACTERISTIC TQS16_TORQ_GRAD_MOTOR_V_Y4_LMU "" VALUE 0x80020F26 CalPrmLatDynsCoorrBrk_SWORD 0 Gain -32768 32767 SYMBOL_LINK "CalPrmLatDynsCoorrBrk01.TQS16_TORQ_GRAD_MOTOR_V_Y4_LMU" 0 /end CHARACTERISTIC
/begin CHARACTERISTIC TQS16_TORQ_GRAD_MOTOR_V_Y4_MMU "" VALUE 0x80020F30 CalPrmLatDynsCoorrBrk_SWORD 0 Gain -32768 32767 SYMBOL_LINK "CalPrmLatDynsCoorrBrk01.TQS16_TORQ_GRAD_MOTOR_V_Y4_MMU" 0 /end CHARACTERISTIC
/begin CHARACTERISTIC TQS16_TORQ_GRAD_MOTOR_V_Y4_US "" VALUE 0x80020F44 CalPrmLatDynsCoorrBrk_SWORD 0 Gain -32768 32767 SYMBOL_LINK "CalPrmLatDynsCoorrBrk01.TQS16_TORQ_GRAD_MOTOR_V_Y4_US" 0 /end CHARACTERISTIC
/begin CHARACTERISTIC TQS16_TORQ_GRAD_MOTOR_V_Y5 "" VALUE 0x800207E6 CalPrmLatDynsCoorrBrk_SWORD 0 Gain -32768 32767 SYMBOL_LINK "CalPrmLatDynsCoorrBrk01.TQS16_TORQ_GRAD_MOTOR_V_Y5" 0 /end CHARACTERISTIC
/begin CHARACTERISTIC TQS16_TORQ_GRAD_MOTOR_V_Y5_HMU "" VALUE 0x80020F3C CalPrmLatDynsCoorrBrk_SWORD 0 Gain -32768 32767 SYMBOL_LINK "CalPrmLatDynsCoorrBrk01.TQS16_TORQ_GRAD_MOTOR_V_Y5_HMU" 0 /end CHARACTERISTIC
/begin CHARACTERISTIC TQS16_TORQ_GRAD_MOTOR_V_Y5_LMU "" VALUE 0x80020F28 CalPrmLatDynsCoorrBrk_SWORD 0 Gain -32768 32767 SYMBOL_LINK "CalPrmLatDynsCoorrBrk01.TQS16_TORQ_GRAD_MOTOR_V_Y5_LMU" 0 /end CHARACTERISTIC
/begin CHARACTERISTIC TQS16_TORQ_GRAD_MOTOR_V_Y5_MMU "" VALUE 0x80020F32 CalPrmLatDynsCoorrBrk_SWORD 0 Gain -32768 32767 SYMBOL_LINK "CalPrmLatDynsCoorrBrk01.TQS16_TORQ_GRAD_MOTOR_V_Y5_MMU" 0 /end CHARACTERISTIC
/begin CHARACTERISTIC TQS16_TORQ_GRAD_MOTOR_V_Y5_US "" VALUE 0x80020F46 CalPrmLatDynsCoorrBrk_SWORD 0 Gain -32768 32767 SYMBOL_LINK "CalPrmLatDynsCoorrBrk01.TQS16_TORQ_GRAD_MOTOR_V_Y5_US" 0 /end CHARACTERISTIC
/begin CHARACTERISTIC TQS16_TORQ_GRDT_DEC_LMT_HMU "" VALUE 0x80020C60 CalPrmLatDynsCoorrBrk_SWORD 0 Gain -32768 32767 SYMBOL_LINK "CalPrmLatDynsCoorrBrk01.TQS16_TORQ_GRDT_DEC_LMT_HMU" 0 /end CHARACTERISTIC
/begin CHARACTERISTIC TQS16_TORQ_GRDT_DEC_LMT_LMU "" VALUE 0x80020C5C CalPrmLatDynsCoorrBrk_SWORD 0 Gain -32768 32767 SYMBOL_LINK "CalPrmLatDynsCoorrBrk01.TQS16_TORQ_GRDT_DEC_LMT_LMU" 0 /end CHARACTERISTIC
/begin CHARACTERISTIC TQS16_TORQ_GRDT_DEC_LMT_MMU "" VALUE 0x80020C5E CalPrmLatDynsCoorrBrk_SWORD 0 Gain -32768 32767 SYMBOL_LINK "CalPrmLatDynsCoorrBrk01.TQS16_TORQ_GRDT_DEC_LMT_MMU" 0 /end CHARACTERISTIC
/begin CHARACTERISTIC TQS16_TORQ_GRDT_F_BRK_LIMT_HMU "" VALUE 0x8002080A CalPrmLatDynsCoorrBrk_SWORD 0 Gain -32768 32767 SYMBOL_LINK "CalPrmLatDynsCoorrBrk01.TQS16_TORQ_GRDT_F_BRK_LIMT_HMU" 0 /end CHARACTERISTIC
/begin CHARACTERISTIC TQS16_TORQ_GRDT_F_BRK_LIMT_LMU "" VALUE 0x80020806 CalPrmLatDynsCoorrBrk_SWORD 0 Gain -32768 32767 SYMBOL_LINK "CalPrmLatDynsCoorrBrk01.TQS16_TORQ_GRDT_F_BRK_LIMT_LMU" 0 /end CHARACTERISTIC
/begin CHARACTERISTIC TQS16_TORQ_GRDT_F_BRK_LIMT_MMU "" VALUE 0x80020808 CalPrmLatDynsCoorrBrk_SWORD 0 Gain -32768 32767 SYMBOL_LINK "CalPrmLatDynsCoorrBrk01.TQS16_TORQ_GRDT_F_BRK_LIMT_MMU" 0 /end CHARACTERISTIC
/begin CHARACTERISTIC TQS16_TORQ_GRDT_F_BRK_LIMT_SPLIT "" VALUE 0x80020812 CalPrmLatDynsCoorrBrk_SWORD 0 Gain -32768 32767 SYMBOL_LINK "CalPrmLatDynsCoorrBrk01.TQS16_TORQ_GRDT_F_BRK_LIMT_SPLIT" 0 /end CHARACTERISTIC
/begin CHARACTERISTIC TQS16_TORQ_GRDT_F_LIMT_HMU "" VALUE 0x800207FE CalPrmLatDynsCoorrBrk_SWORD 0 Gain -32768 32767 SYMBOL_LINK "CalPrmLatDynsCoorrBrk01.TQS16_TORQ_GRDT_F_LIMT_HMU" 0 /end CHARACTERISTIC
/begin CHARACTERISTIC TQS16_TORQ_GRDT_F_LIMT_LMU "" VALUE 0x800207FA CalPrmLatDynsCoorrBrk_SWORD 0 Gain -32768 32767 SYMBOL_LINK "CalPrmLatDynsCoorrBrk01.TQS16_TORQ_GRDT_F_LIMT_LMU" 0 /end CHARACTERISTIC
/begin CHARACTERISTIC TQS16_TORQ_GRDT_F_LIMT_MMU "" VALUE 0x800207FC CalPrmLatDynsCoorrBrk_SWORD 0 Gain -32768 32767 SYMBOL_LINK "CalPrmLatDynsCoorrBrk01.TQS16_TORQ_GRDT_F_LIMT_MMU" 0 /end CHARACTERISTIC
/begin CHARACTERISTIC TQS16_TORQ_GRDT_F_MAX_HMU_HSP "" VALUE 0x80020D42 CalPrmLatDynsCoorrBrk_SWORD 0 Gain -32768 32767 SYMBOL_LINK "CalPrmLatDynsCoorrBrk01.TQS16_TORQ_GRDT_F_MAX_HMU_HSP" 0 /end CHARACTERISTIC
/begin CHARACTERISTIC TQS16_TORQ_GRDT_F_MAX_HMU_LSP "" VALUE 0x80020D3E CalPrmLatDynsCoorrBrk_SWORD 0 Gain -32768 32767 SYMBOL_LINK "CalPrmLatDynsCoorrBrk01.TQS16_TORQ_GRDT_F_MAX_HMU_LSP" 0 /end CHARACTERISTIC
/begin CHARACTERISTIC TQS16_TORQ_GRDT_F_MAX_HMU_MSP "" VALUE 0x80020D40 CalPrmLatDynsCoorrBrk_SWORD 0 Gain -32768 32767 SYMBOL_LINK "CalPrmLatDynsCoorrBrk01.TQS16_TORQ_GRDT_F_MAX_HMU_MSP" 0 /end CHARACTERISTIC
/begin CHARACTERISTIC TQS16_TORQ_GRDT_F_MAX_LMU_HSP "" VALUE 0x80020D36 CalPrmLatDynsCoorrBrk_SWORD 0 Gain -32768 32767 SYMBOL_LINK "CalPrmLatDynsCoorrBrk01.TQS16_TORQ_GRDT_F_MAX_LMU_HSP" 0 /end CHARACTERISTIC
/begin CHARACTERISTIC TQS16_TORQ_GRDT_F_MAX_LMU_LSP "" VALUE 0x80020D32 CalPrmLatDynsCoorrBrk_SWORD 0 Gain -32768 32767 SYMBOL_LINK "CalPrmLatDynsCoorrBrk01.TQS16_TORQ_GRDT_F_MAX_LMU_LSP" 0 /end CHARACTERISTIC
/begin CHARACTERISTIC TQS16_TORQ_GRDT_F_MAX_LMU_MSP "" VALUE 0x80020D34 CalPrmLatDynsCoorrBrk_SWORD 0 Gain -32768 32767 SYMBOL_LINK "CalPrmLatDynsCoorrBrk01.TQS16_TORQ_GRDT_F_MAX_LMU_MSP" 0 /end CHARACTERISTIC
/begin CHARACTERISTIC TQS16_TORQ_GRDT_F_MAX_MMU_HSP "" VALUE 0x80020D3C CalPrmLatDynsCoorrBrk_SWORD 0 Gain -32768 32767 SYMBOL_LINK "CalPrmLatDynsCoorrBrk01.TQS16_TORQ_GRDT_F_MAX_MMU_HSP" 0 /end CHARACTERISTIC
/begin CHARACTERISTIC TQS16_TORQ_GRDT_F_MAX_MMU_LSP "" VALUE 0x80020D38 CalPrmLatDynsCoorrBrk_SWORD 0 Gain -32768 32767 SYMBOL_LINK "CalPrmLatDynsCoorrBrk01.TQS16_TORQ_GRDT_F_MAX_MMU_LSP" 0 /end CHARACTERISTIC
/begin CHARACTERISTIC TQS16_TORQ_GRDT_F_MAX_MMU_MSP "" VALUE 0x80020D3A CalPrmLatDynsCoorrBrk_SWORD 0 Gain -32768 32767 SYMBOL_LINK "CalPrmLatDynsCoorrBrk01.TQS16_TORQ_GRDT_F_MAX_MMU_MSP" 0 /end CHARACTERISTIC
/begin CHARACTERISTIC TQS16_TORQ_GRDT_P_GAIN "" VALUE 0x800207F6 CalPrmLatDynsCoorrBrk_SWORD 0 Gain -32768 32767 SYMBOL_LINK "CalPrmLatDynsCoorrBrk01.TQS16_TORQ_GRDT_P_GAIN" 0 /end CHARACTERISTIC
/begin CHARACTERISTIC TQS16_TORQ_GRDT_P_GAIN_BRK "" VALUE 0x800207F8 CalPrmLatDynsCoorrBrk_SWORD 0 Gain -32768 32767 SYMBOL_LINK "CalPrmLatDynsCoorrBrk01.TQS16_TORQ_GRDT_P_GAIN_BRK" 0 /end CHARACTERISTIC
/begin CHARACTERISTIC TQS16_TORQ_GRDT_R_BRK_LIMT_HMU "" VALUE 0x80020810 CalPrmLatDynsCoorrBrk_SWORD 0 Gain -32768 32767 SYMBOL_LINK "CalPrmLatDynsCoorrBrk01.TQS16_TORQ_GRDT_R_BRK_LIMT_HMU" 0 /end CHARACTERISTIC
/begin CHARACTERISTIC TQS16_TORQ_GRDT_R_BRK_LIMT_LMU "" VALUE 0x8002080C CalPrmLatDynsCoorrBrk_SWORD 0 Gain -32768 32767 SYMBOL_LINK "CalPrmLatDynsCoorrBrk01.TQS16_TORQ_GRDT_R_BRK_LIMT_LMU" 0 /end CHARACTERISTIC
/begin CHARACTERISTIC TQS16_TORQ_GRDT_R_BRK_LIMT_MMU "" VALUE 0x8002080E CalPrmLatDynsCoorrBrk_SWORD 0 Gain -32768 32767 SYMBOL_LINK "CalPrmLatDynsCoorrBrk01.TQS16_TORQ_GRDT_R_BRK_LIMT_MMU" 0 /end CHARACTERISTIC
/begin CHARACTERISTIC TQS16_TORQ_GRDT_R_BRK_LIMT_SPLIT "" VALUE 0x80020814 CalPrmLatDynsCoorrBrk_SWORD 0 Gain -32768 32767 SYMBOL_LINK "CalPrmLatDynsCoorrBrk01.TQS16_TORQ_GRDT_R_BRK_LIMT_SPLIT" 0 /end CHARACTERISTIC
/begin CHARACTERISTIC TQS16_TORQ_GRDT_R_LIMT_HMU "" VALUE 0x80020804 CalPrmLatDynsCoorrBrk_SWORD 0 Gain -32768 32767 SYMBOL_LINK "CalPrmLatDynsCoorrBrk01.TQS16_TORQ_GRDT_R_LIMT_HMU" 0 /end CHARACTERISTIC
/begin CHARACTERISTIC TQS16_TORQ_GRDT_R_LIMT_HMU_OS "" VALUE 0x80020D24 CalPrmLatDynsCoorrBrk_SWORD 0 Gain -32768 32767 SYMBOL_LINK "CalPrmLatDynsCoorrBrk01.TQS16_TORQ_GRDT_R_LIMT_HMU_OS" 0 /end CHARACTERISTIC
/begin CHARACTERISTIC TQS16_TORQ_GRDT_R_LIMT_LMU "" VALUE 0x80020800 CalPrmLatDynsCoorrBrk_SWORD 0 Gain -32768 32767 SYMBOL_LINK "CalPrmLatDynsCoorrBrk01.TQS16_TORQ_GRDT_R_LIMT_LMU" 0 /end CHARACTERISTIC
/begin CHARACTERISTIC TQS16_TORQ_GRDT_R_LIMT_LMU_OS "" VALUE 0x80020D28 CalPrmLatDynsCoorrBrk_SWORD 0 Gain -32768 32767 SYMBOL_LINK "CalPrmLatDynsCoorrBrk01.TQS16_TORQ_GRDT_R_LIMT_LMU_OS" 0 /end CHARACTERISTIC
/begin CHARACTERISTIC TQS16_TORQ_GRDT_R_LIMT_MMU "" VALUE 0x80020802 CalPrmLatDynsCoorrBrk_SWORD 0 Gain -32768 32767 SYMBOL_LINK "CalPrmLatDynsCoorrBrk01.TQS16_TORQ_GRDT_R_LIMT_MMU" 0 /end CHARACTERISTIC
/begin CHARACTERISTIC TQS16_TORQ_GRDT_R_LIMT_MMU_OS "" VALUE 0x80020D26 CalPrmLatDynsCoorrBrk_SWORD 0 Gain -32768 32767 SYMBOL_LINK "CalPrmLatDynsCoorrBrk01.TQS16_TORQ_GRDT_R_LIMT_MMU_OS" 0 /end CHARACTERISTIC
/begin CHARACTERISTIC TQS16_TVBB_DELTA_YAW_TH_HSP "" VALUE 0x80020DDC CalPrmLatDynsCoorrBrk_SWORD 0 Gain -32768 32767 SYMBOL_LINK "CalPrmLatDynsCoorrBrk01.TQS16_TVBB_DELTA_YAW_TH_HSP" 0 /end CHARACTERISTIC
/begin CHARACTERISTIC TQS16_TVBB_DELTA_YAW_TH_LSP "" VALUE 0x80020DD8 CalPrmLatDynsCoorrBrk_SWORD 0 Gain -32768 32767 SYMBOL_LINK "CalPrmLatDynsCoorrBrk01.TQS16_TVBB_DELTA_YAW_TH_LSP" 0 /end CHARACTERISTIC
/begin CHARACTERISTIC TQS16_TVBB_DELTA_YAW_TH_MSP "" VALUE 0x80020DDA CalPrmLatDynsCoorrBrk_SWORD 0 Gain -32768 32767 SYMBOL_LINK "CalPrmLatDynsCoorrBrk01.TQS16_TVBB_DELTA_YAW_TH_MSP" 0 /end CHARACTERISTIC
/begin CHARACTERISTIC TQS16_TVBB_ENTER_HSPD_LIMIT_HMU "" VALUE 0x80020DD2 CalPrmLatDynsCoorrBrk_SWORD 0 Gain -32768 32767 SYMBOL_LINK "CalPrmLatDynsCoorrBrk01.TQS16_TVBB_ENTER_HSPD_LIMIT_HMU" 0 /end CHARACTERISTIC
/begin CHARACTERISTIC TQS16_TVBB_ENTER_HSPD_LIMIT_LMU "" VALUE 0x80020DD6 CalPrmLatDynsCoorrBrk_SWORD 0 Gain -32768 32767 SYMBOL_LINK "CalPrmLatDynsCoorrBrk01.TQS16_TVBB_ENTER_HSPD_LIMIT_LMU" 0 /end CHARACTERISTIC
/begin CHARACTERISTIC TQS16_TVBB_ENTER_HSPD_LIMIT_MMU "" VALUE 0x80020DD4 CalPrmLatDynsCoorrBrk_SWORD 0 Gain -32768 32767 SYMBOL_LINK "CalPrmLatDynsCoorrBrk01.TQS16_TVBB_ENTER_HSPD_LIMIT_MMU" 0 /end CHARACTERISTIC
/begin CHARACTERISTIC TQS16_TVBB_TQ_GRDT_LIMT "" VALUE 0x80020D5C CalPrmLatDynsCoorrBrk_SWORD 0 Gain -32768 32767 SYMBOL_LINK "CalPrmLatDynsCoorrBrk01.TQS16_TVBB_TQ_GRDT_LIMT" 0 /end CHARACTERISTIC
/begin CHARACTERISTIC TQS16_TorqDec_ABS_Slip_2 "" VALUE 0x80020D2A CalPrmLatDynsCoorrBrk_SWORD 0 Gain -32768 32767 SYMBOL_LINK "CalPrmLatDynsCoorrBrk01.TQS16_TorqDec_ABS_Slip_2" 0 /end CHARACTERISTIC
/begin CHARACTERISTIC TQS16_TorqDec_ABS_Slip_3 "" VALUE 0x80020D2C CalPrmLatDynsCoorrBrk_SWORD 0 Gain -32768 32767 SYMBOL_LINK "CalPrmLatDynsCoorrBrk01.TQS16_TorqDec_ABS_Slip_3" 0 /end CHARACTERISTIC
/begin CHARACTERISTIC TQS16_TorqDec_ABS_Slip_4 "" VALUE 0x80020D2E CalPrmLatDynsCoorrBrk_SWORD 0 Gain -32768 32767 SYMBOL_LINK "CalPrmLatDynsCoorrBrk01.TQS16_TorqDec_ABS_Slip_4" 0 /end CHARACTERISTIC
/begin CHARACTERISTIC TQS16_TorqDec_ABS_Slip_5 "" VALUE 0x80020D30 CalPrmLatDynsCoorrBrk_SWORD 0 Gain -32768 32767 SYMBOL_LINK "CalPrmLatDynsCoorrBrk01.TQS16_TorqDec_ABS_Slip_5" 0 /end CHARACTERISTIC
/begin CHARACTERISTIC TQS16_TorqDec_Add_Slip_2 "" VALUE 0x80020CC2 CalPrmLatDynsCoorrBrk_SWORD 0 Gain -32768 32767 SYMBOL_LINK "CalPrmLatDynsCoorrBrk01.TQS16_TorqDec_Add_Slip_2" 0 /end CHARACTERISTIC
/begin CHARACTERISTIC TQS16_TorqDec_Add_Slip_3 "" VALUE 0x80020CC4 CalPrmLatDynsCoorrBrk_SWORD 0 Gain -32768 32767 SYMBOL_LINK "CalPrmLatDynsCoorrBrk01.TQS16_TorqDec_Add_Slip_3" 0 /end CHARACTERISTIC
/begin CHARACTERISTIC TQS16_TorqDec_Add_Slip_4 "" VALUE 0x80020CC6 CalPrmLatDynsCoorrBrk_SWORD 0 Gain -32768 32767 SYMBOL_LINK "CalPrmLatDynsCoorrBrk01.TQS16_TorqDec_Add_Slip_4" 0 /end CHARACTERISTIC
/begin CHARACTERISTIC TQS16_TorqDec_Add_Slip_5 "" VALUE 0x80020CC8 CalPrmLatDynsCoorrBrk_SWORD 0 Gain -32768 32767 SYMBOL_LINK "CalPrmLatDynsCoorrBrk01.TQS16_TorqDec_Add_Slip_5" 0 /end CHARACTERISTIC
/begin CHARACTERISTIC TQS8_TVBB_ENTER_WHEEL_SPIN_H "" VALUE 0x80020DE3 CalPrmLatDynsCoorrBrk_SBYTE 0 Gain -128 127 SYMBOL_LINK "CalPrmLatDynsCoorrBrk01.TQS8_TVBB_ENTER_WHEEL_SPIN_H" 0 /end CHARACTERISTIC
/begin CHARACTERISTIC TQS8_TVBB_ENTER_WHEEL_SPIN_L "" VALUE 0x80020DE1 CalPrmLatDynsCoorrBrk_SBYTE 0 Gain -128 127 SYMBOL_LINK "CalPrmLatDynsCoorrBrk01.TQS8_TVBB_ENTER_WHEEL_SPIN_L" 0 /end CHARACTERISTIC
/begin CHARACTERISTIC TQS8_TVBB_ENTER_WHEEL_SPIN_M "" VALUE 0x80020DE2 CalPrmLatDynsCoorrBrk_SBYTE 0 Gain -128 127 SYMBOL_LINK "CalPrmLatDynsCoorrBrk01.TQS8_TVBB_ENTER_WHEEL_SPIN_M" 0 /end CHARACTERISTIC
/begin CHARACTERISTIC TQU8_MOT_V_TORQ_GRAD_X1 "" VALUE 0x800207D8 CalPrmLatDynsCoorrBrk_UBYTE 0 Gain 0 255 SYMBOL_LINK "CalPrmLatDynsCoorrBrk01.TQU8_MOT_V_TORQ_GRAD_X1" 0 /end CHARACTERISTIC
/begin CHARACTERISTIC TQU8_MOT_V_TORQ_GRAD_X2 "" VALUE 0x800207D9 CalPrmLatDynsCoorrBrk_UBYTE 0 Gain 0 255 SYMBOL_LINK "CalPrmLatDynsCoorrBrk01.TQU8_MOT_V_TORQ_GRAD_X2" 0 /end CHARACTERISTIC
/begin CHARACTERISTIC TQU8_MOT_V_TORQ_GRAD_X3 "" VALUE 0x800207DA CalPrmLatDynsCoorrBrk_UBYTE 0 Gain 0 255 SYMBOL_LINK "CalPrmLatDynsCoorrBrk01.TQU8_MOT_V_TORQ_GRAD_X3" 0 /end CHARACTERISTIC
/begin CHARACTERISTIC TQU8_MOT_V_TORQ_GRAD_X4 "" VALUE 0x800207DB CalPrmLatDynsCoorrBrk_UBYTE 0 Gain 0 255 SYMBOL_LINK "CalPrmLatDynsCoorrBrk01.TQU8_MOT_V_TORQ_GRAD_X4" 0 /end CHARACTERISTIC
/begin CHARACTERISTIC TQU8_MOT_V_TORQ_GRAD_X5 "" VALUE 0x800207DC CalPrmLatDynsCoorrBrk_UBYTE 0 Gain 0 255 SYMBOL_LINK "CalPrmLatDynsCoorrBrk01.TQU8_MOT_V_TORQ_GRAD_X5" 0 /end CHARACTERISTIC
/begin CHARACTERISTIC TQU8_RISE_SCAN_HIG_HMU "" VALUE 0x800207F0 CalPrmLatDynsCoorrBrk_UBYTE 0 Gain 0 255 SYMBOL_LINK "CalPrmLatDynsCoorrBrk01.TQU8_RISE_SCAN_HIG_HMU" 0 /end CHARACTERISTIC
/begin CHARACTERISTIC TQU8_RISE_SCAN_HIG_LMU "" VALUE 0x800207EA CalPrmLatDynsCoorrBrk_UBYTE 0 Gain 0 255 SYMBOL_LINK "CalPrmLatDynsCoorrBrk01.TQU8_RISE_SCAN_HIG_LMU" 0 /end CHARACTERISTIC
/begin CHARACTERISTIC TQU8_RISE_SCAN_HIG_MMU "" VALUE 0x800207ED CalPrmLatDynsCoorrBrk_UBYTE 0 Gain 0 255 SYMBOL_LINK "CalPrmLatDynsCoorrBrk01.TQU8_RISE_SCAN_HIG_MMU" 0 /end CHARACTERISTIC
/begin CHARACTERISTIC TQU8_RISE_SCAN_LOW_HMU "" VALUE 0x800207EE CalPrmLatDynsCoorrBrk_UBYTE 0 Gain 0 255 SYMBOL_LINK "CalPrmLatDynsCoorrBrk01.TQU8_RISE_SCAN_LOW_HMU" 0 /end CHARACTERISTIC
/begin CHARACTERISTIC TQU8_RISE_SCAN_LOW_LMU "" VALUE 0x800207E8 CalPrmLatDynsCoorrBrk_UBYTE 0 Gain 0 255 SYMBOL_LINK "CalPrmLatDynsCoorrBrk01.TQU8_RISE_SCAN_LOW_LMU" 0 /end CHARACTERISTIC
/begin CHARACTERISTIC TQU8_RISE_SCAN_LOW_MMU "" VALUE 0x800207EB CalPrmLatDynsCoorrBrk_UBYTE 0 Gain 0 255 SYMBOL_LINK "CalPrmLatDynsCoorrBrk01.TQU8_RISE_SCAN_LOW_MMU" 0 /end CHARACTERISTIC
/begin CHARACTERISTIC TQU8_RISE_SCAN_MED_HMU "" VALUE 0x800207EF CalPrmLatDynsCoorrBrk_UBYTE 0 Gain 0 255 SYMBOL_LINK "CalPrmLatDynsCoorrBrk01.TQU8_RISE_SCAN_MED_HMU" 0 /end CHARACTERISTIC
/begin CHARACTERISTIC TQU8_RISE_SCAN_MED_LMU "" VALUE 0x800207E9 CalPrmLatDynsCoorrBrk_UBYTE 0 Gain 0 255 SYMBOL_LINK "CalPrmLatDynsCoorrBrk01.TQU8_RISE_SCAN_MED_LMU" 0 /end CHARACTERISTIC
/begin CHARACTERISTIC TQU8_RISE_SCAN_MED_MMU "" VALUE 0x800207EC CalPrmLatDynsCoorrBrk_UBYTE 0 Gain 0 255 SYMBOL_LINK "CalPrmLatDynsCoorrBrk01.TQU8_RISE_SCAN_MED_MMU" 0 /end CHARACTERISTIC
/begin CHARACTERISTIC TQU8_TC_OFFSET_GRAD_X1 "" VALUE 0x800207C9 CalPrmLatDynsCoorrBrk_UBYTE 0 Gain 0 255 SYMBOL_LINK "CalPrmLatDynsCoorrBrk01.TQU8_TC_OFFSET_GRAD_X1" 0 /end CHARACTERISTIC
/begin CHARACTERISTIC TQU8_TC_OFFSET_GRAD_X2 "" VALUE 0x800207CA CalPrmLatDynsCoorrBrk_UBYTE 0 Gain 0 255 SYMBOL_LINK "CalPrmLatDynsCoorrBrk01.TQU8_TC_OFFSET_GRAD_X2" 0 /end CHARACTERISTIC
/begin CHARACTERISTIC TQU8_TC_OFFSET_GRAD_X3 "" VALUE 0x800207CB CalPrmLatDynsCoorrBrk_UBYTE 0 Gain 0 255 SYMBOL_LINK "CalPrmLatDynsCoorrBrk01.TQU8_TC_OFFSET_GRAD_X3" 0 /end CHARACTERISTIC
/begin CHARACTERISTIC TQU8_TC_OFFSET_GRAD_X4 "" VALUE 0x800207CC CalPrmLatDynsCoorrBrk_UBYTE 0 Gain 0 255 SYMBOL_LINK "CalPrmLatDynsCoorrBrk01.TQU8_TC_OFFSET_GRAD_X4" 0 /end CHARACTERISTIC
/begin CHARACTERISTIC TQU8_TC_OFFSET_GRAD_X5 "" VALUE 0x800207CD CalPrmLatDynsCoorrBrk_UBYTE 0 Gain 0 255 SYMBOL_LINK "CalPrmLatDynsCoorrBrk01.TQU8_TC_OFFSET_GRAD_X5" 0 /end CHARACTERISTIC
/begin CHARACTERISTIC TQU8_TC_RISE_SCAN_HIG_HMU "" VALUE 0x800207C8 CalPrmLatDynsCoorrBrk_UBYTE 0 Gain 0 255 SYMBOL_LINK "CalPrmLatDynsCoorrBrk01.TQU8_TC_RISE_SCAN_HIG_HMU" 0 /end CHARACTERISTIC
/begin CHARACTERISTIC TQU8_TC_RISE_SCAN_HIG_LMU "" VALUE 0x800207C2 CalPrmLatDynsCoorrBrk_UBYTE 0 Gain 0 255 SYMBOL_LINK "CalPrmLatDynsCoorrBrk01.TQU8_TC_RISE_SCAN_HIG_LMU" 0 /end CHARACTERISTIC
/begin CHARACTERISTIC TQU8_TC_RISE_SCAN_HIG_MMU "" VALUE 0x800207C5 CalPrmLatDynsCoorrBrk_UBYTE 0 Gain 0 255 SYMBOL_LINK "CalPrmLatDynsCoorrBrk01.TQU8_TC_RISE_SCAN_HIG_MMU" 0 /end CHARACTERISTIC
/begin CHARACTERISTIC TQU8_TC_RISE_SCAN_LOW_HMU "" VALUE 0x800207C6 CalPrmLatDynsCoorrBrk_UBYTE 0 Gain 0 255 SYMBOL_LINK "CalPrmLatDynsCoorrBrk01.TQU8_TC_RISE_SCAN_LOW_HMU" 0 /end CHARACTERISTIC
/begin CHARACTERISTIC TQU8_TC_RISE_SCAN_LOW_LMU "" VALUE 0x800207C0 CalPrmLatDynsCoorrBrk_UBYTE 0 Gain 0 255 SYMBOL_LINK "CalPrmLatDynsCoorrBrk01.TQU8_TC_RISE_SCAN_LOW_LMU" 0 /end CHARACTERISTIC
/begin CHARACTERISTIC TQU8_TC_RISE_SCAN_LOW_MMU "" VALUE 0x800207C3 CalPrmLatDynsCoorrBrk_UBYTE 0 Gain 0 255 SYMBOL_LINK "CalPrmLatDynsCoorrBrk01.TQU8_TC_RISE_SCAN_LOW_MMU" 0 /end CHARACTERISTIC
/begin CHARACTERISTIC TQU8_TC_RISE_SCAN_MED_HMU "" VALUE 0x800207C7 CalPrmLatDynsCoorrBrk_UBYTE 0 Gain 0 255 SYMBOL_LINK "CalPrmLatDynsCoorrBrk01.TQU8_TC_RISE_SCAN_MED_HMU" 0 /end CHARACTERISTIC
/begin CHARACTERISTIC TQU8_TC_RISE_SCAN_MED_LMU "" VALUE 0x800207C1 CalPrmLatDynsCoorrBrk_UBYTE 0 Gain 0 255 SYMBOL_LINK "CalPrmLatDynsCoorrBrk01.TQU8_TC_RISE_SCAN_MED_LMU" 0 /end CHARACTERISTIC
/begin CHARACTERISTIC TQU8_TC_RISE_SCAN_MED_MMU "" VALUE 0x800207C4 CalPrmLatDynsCoorrBrk_UBYTE 0 Gain 0 255 SYMBOL_LINK "CalPrmLatDynsCoorrBrk01.TQU8_TC_RISE_SCAN_MED_MMU" 0 /end CHARACTERISTIC
/begin CHARACTERISTIC TQU8_TVBB_ENTER_SPIN_REF_ALATM_H "" VALUE 0x80020DE0 CalPrmLatDynsCoorrBrk_UBYTE 0 Gain 0 255 SYMBOL_LINK "CalPrmLatDynsCoorrBrk01.TQU8_TVBB_ENTER_SPIN_REF_ALATM_H" 0 /end CHARACTERISTIC
/begin CHARACTERISTIC TQU8_TVBB_ENTER_SPIN_REF_ALATM_L "" VALUE 0x80020DDE CalPrmLatDynsCoorrBrk_UBYTE 0 Gain 0 255 SYMBOL_LINK "CalPrmLatDynsCoorrBrk01.TQU8_TVBB_ENTER_SPIN_REF_ALATM_L" 0 /end CHARACTERISTIC
/begin CHARACTERISTIC TQU8_TVBB_ENTER_SPIN_REF_ALATM_M "" VALUE 0x80020DDF CalPrmLatDynsCoorrBrk_UBYTE 0 Gain 0 255 SYMBOL_LINK "CalPrmLatDynsCoorrBrk01.TQU8_TVBB_ENTER_SPIN_REF_ALATM_M" 0 /end CHARACTERISTIC
/begin CHARACTERISTIC U8_WPE_LFC_ESC_Rise_Duty_f_1st "Temp" VALUE 0x800216F6 CalPrmBrkTqCtrlrBrk_UBYTE 0 Gain 0 255 SYMBOL_LINK "CalPrmBrkTqCtrlrBrk01.U8_WPE_LFC_ESC_Rise_Duty_f_1st" 0 /end CHARACTERISTIC
/begin CHARACTERISTIC U8_WPE_LFC_ESC_Rise_Duty_f_2nd "Temp" VALUE 0x800216F7 CalPrmBrkTqCtrlrBrk_UBYTE 0 Gain 0 255 SYMBOL_LINK "CalPrmBrkTqCtrlrBrk01.U8_WPE_LFC_ESC_Rise_Duty_f_2nd" 0 /end CHARACTERISTIC
/begin CHARACTERISTIC U8_WPE_LFC_ESC_Rise_Duty_f_3rd "Temp" VALUE 0x800216F8 CalPrmBrkTqCtrlrBrk_UBYTE 0 Gain 0 255 SYMBOL_LINK "CalPrmBrkTqCtrlrBrk01.U8_WPE_LFC_ESC_Rise_Duty_f_3rd" 0 /end CHARACTERISTIC
/begin CHARACTERISTIC U8_WPE_LFC_ESC_Rise_Duty_f_4th "Temp" VALUE 0x800216F9 CalPrmBrkTqCtrlrBrk_UBYTE 0 Gain 0 255 SYMBOL_LINK "CalPrmBrkTqCtrlrBrk01.U8_WPE_LFC_ESC_Rise_Duty_f_4th" 0 /end CHARACTERISTIC
/begin CHARACTERISTIC U8_WPE_LFC_ESC_Rise_Duty_f_5th "Temp" VALUE 0x800216FA CalPrmBrkTqCtrlrBrk_UBYTE 0 Gain 0 255 SYMBOL_LINK "CalPrmBrkTqCtrlrBrk01.U8_WPE_LFC_ESC_Rise_Duty_f_5th" 0 /end CHARACTERISTIC
/begin CHARACTERISTIC U8_WPE_LFC_ESC_Rise_Duty_f_6th "Temp" VALUE 0x800216FB CalPrmBrkTqCtrlrBrk_UBYTE 0 Gain 0 255 SYMBOL_LINK "CalPrmBrkTqCtrlrBrk01.U8_WPE_LFC_ESC_Rise_Duty_f_6th" 0 /end CHARACTERISTIC
/begin CHARACTERISTIC U8_WPE_LFC_ESC_Rise_Duty_r_1st "Temp" VALUE 0x80021708 CalPrmBrkTqCtrlrBrk_UBYTE 0 Gain 0 255 SYMBOL_LINK "CalPrmBrkTqCtrlrBrk01.U8_WPE_LFC_ESC_Rise_Duty_r_1st" 0 /end CHARACTERISTIC
/begin CHARACTERISTIC U8_WPE_LFC_ESC_Rise_Duty_r_2nd "Temp" VALUE 0x80021709 CalPrmBrkTqCtrlrBrk_UBYTE 0 Gain 0 255 SYMBOL_LINK "CalPrmBrkTqCtrlrBrk01.U8_WPE_LFC_ESC_Rise_Duty_r_2nd" 0 /end CHARACTERISTIC
/begin CHARACTERISTIC U8_WPE_LFC_ESC_Rise_Duty_r_3rd "Temp" VALUE 0x8002170A CalPrmBrkTqCtrlrBrk_UBYTE 0 Gain 0 255 SYMBOL_LINK "CalPrmBrkTqCtrlrBrk01.U8_WPE_LFC_ESC_Rise_Duty_r_3rd" 0 /end CHARACTERISTIC
/begin CHARACTERISTIC U8_WPE_LFC_ESC_Rise_Duty_r_4th "Temp" VALUE 0x8002170B CalPrmBrkTqCtrlrBrk_UBYTE 0 Gain 0 255 SYMBOL_LINK "CalPrmBrkTqCtrlrBrk01.U8_WPE_LFC_ESC_Rise_Duty_r_4th" 0 /end CHARACTERISTIC
/begin CHARACTERISTIC U8_WPE_LFC_ESC_Rise_Duty_r_5th "Temp" VALUE 0x8002170C CalPrmBrkTqCtrlrBrk_UBYTE 0 Gain 0 255 SYMBOL_LINK "CalPrmBrkTqCtrlrBrk01.U8_WPE_LFC_ESC_Rise_Duty_r_5th" 0 /end CHARACTERISTIC
/begin CHARACTERISTIC U8_WPE_LFC_ESC_Rise_Duty_r_6th "Temp" VALUE 0x8002170D CalPrmBrkTqCtrlrBrk_UBYTE 0 Gain 0 255 SYMBOL_LINK "CalPrmBrkTqCtrlrBrk01.U8_WPE_LFC_ESC_Rise_Duty_r_6th" 0 /end CHARACTERISTIC
/begin CHARACTERISTIC U8_WPE_LFC_Hold_Duty_f_10th "Temp" VALUE 0x8002165B CalPrmBrkTqCtrlrBrk_UBYTE 0 Gain 0 255 SYMBOL_LINK "CalPrmBrkTqCtrlrBrk01.U8_WPE_LFC_Hold_Duty_f_10th" 0 /end CHARACTERISTIC
/begin CHARACTERISTIC U8_WPE_LFC_Hold_Duty_f_11th "Temp" VALUE 0x8002165C CalPrmBrkTqCtrlrBrk_UBYTE 0 Gain 0 255 SYMBOL_LINK "CalPrmBrkTqCtrlrBrk01.U8_WPE_LFC_Hold_Duty_f_11th" 0 /end CHARACTERISTIC
/begin CHARACTERISTIC U8_WPE_LFC_Hold_Duty_f_12th "Temp" VALUE 0x8002165D CalPrmBrkTqCtrlrBrk_UBYTE 0 Gain 0 255 SYMBOL_LINK "CalPrmBrkTqCtrlrBrk01.U8_WPE_LFC_Hold_Duty_f_12th" 0 /end CHARACTERISTIC
/begin CHARACTERISTIC U8_WPE_LFC_Hold_Duty_f_13th "Temp" VALUE 0x8002165E CalPrmBrkTqCtrlrBrk_UBYTE 0 Gain 0 255 SYMBOL_LINK "CalPrmBrkTqCtrlrBrk01.U8_WPE_LFC_Hold_Duty_f_13th" 0 /end CHARACTERISTIC
/begin CHARACTERISTIC U8_WPE_LFC_Hold_Duty_f_14th "Temp" VALUE 0x8002165F CalPrmBrkTqCtrlrBrk_UBYTE 0 Gain 0 255 SYMBOL_LINK "CalPrmBrkTqCtrlrBrk01.U8_WPE_LFC_Hold_Duty_f_14th" 0 /end CHARACTERISTIC
/begin CHARACTERISTIC U8_WPE_LFC_Hold_Duty_f_15th "Temp" VALUE 0x80021660 CalPrmBrkTqCtrlrBrk_UBYTE 0 Gain 0 255 SYMBOL_LINK "CalPrmBrkTqCtrlrBrk01.U8_WPE_LFC_Hold_Duty_f_15th" 0 /end CHARACTERISTIC
/begin CHARACTERISTIC U8_WPE_LFC_Hold_Duty_f_16th "Temp" VALUE 0x80021661 CalPrmBrkTqCtrlrBrk_UBYTE 0 Gain 0 255 SYMBOL_LINK "CalPrmBrkTqCtrlrBrk01.U8_WPE_LFC_Hold_Duty_f_16th" 0 /end CHARACTERISTIC
/begin CHARACTERISTIC U8_WPE_LFC_Hold_Duty_f_1st "Temp" VALUE 0x80021652 CalPrmBrkTqCtrlrBrk_UBYTE 0 Gain 0 255 SYMBOL_LINK "CalPrmBrkTqCtrlrBrk01.U8_WPE_LFC_Hold_Duty_f_1st" 0 /end CHARACTERISTIC
/begin CHARACTERISTIC U8_WPE_LFC_Hold_Duty_f_2nd "Temp" VALUE 0x80021653 CalPrmBrkTqCtrlrBrk_UBYTE 0 Gain 0 255 SYMBOL_LINK "CalPrmBrkTqCtrlrBrk01.U8_WPE_LFC_Hold_Duty_f_2nd" 0 /end CHARACTERISTIC
/begin CHARACTERISTIC U8_WPE_LFC_Hold_Duty_f_3rd "Temp" VALUE 0x80021654 CalPrmBrkTqCtrlrBrk_UBYTE 0 Gain 0 255 SYMBOL_LINK "CalPrmBrkTqCtrlrBrk01.U8_WPE_LFC_Hold_Duty_f_3rd" 0 /end CHARACTERISTIC
/begin CHARACTERISTIC U8_WPE_LFC_Hold_Duty_f_4th "Temp" VALUE 0x80021655 CalPrmBrkTqCtrlrBrk_UBYTE 0 Gain 0 255 SYMBOL_LINK "CalPrmBrkTqCtrlrBrk01.U8_WPE_LFC_Hold_Duty_f_4th" 0 /end CHARACTERISTIC
/begin CHARACTERISTIC U8_WPE_LFC_Hold_Duty_f_5th "Temp" VALUE 0x80021656 CalPrmBrkTqCtrlrBrk_UBYTE 0 Gain 0 255 SYMBOL_LINK "CalPrmBrkTqCtrlrBrk01.U8_WPE_LFC_Hold_Duty_f_5th" 0 /end CHARACTERISTIC
/begin CHARACTERISTIC U8_WPE_LFC_Hold_Duty_f_6th "Temp" VALUE 0x80021657 CalPrmBrkTqCtrlrBrk_UBYTE 0 Gain 0 255 SYMBOL_LINK "CalPrmBrkTqCtrlrBrk01.U8_WPE_LFC_Hold_Duty_f_6th" 0 /end CHARACTERISTIC
/begin CHARACTERISTIC U8_WPE_LFC_Hold_Duty_f_7th "Temp" VALUE 0x80021658 CalPrmBrkTqCtrlrBrk_UBYTE 0 Gain 0 255 SYMBOL_LINK "CalPrmBrkTqCtrlrBrk01.U8_WPE_LFC_Hold_Duty_f_7th" 0 /end CHARACTERISTIC
/begin CHARACTERISTIC U8_WPE_LFC_Hold_Duty_f_8th "Temp" VALUE 0x80021659 CalPrmBrkTqCtrlrBrk_UBYTE 0 Gain 0 255 SYMBOL_LINK "CalPrmBrkTqCtrlrBrk01.U8_WPE_LFC_Hold_Duty_f_8th" 0 /end CHARACTERISTIC
/begin CHARACTERISTIC U8_WPE_LFC_Hold_Duty_f_9th "Temp" VALUE 0x8002165A CalPrmBrkTqCtrlrBrk_UBYTE 0 Gain 0 255 SYMBOL_LINK "CalPrmBrkTqCtrlrBrk01.U8_WPE_LFC_Hold_Duty_f_9th" 0 /end CHARACTERISTIC
/begin COMPU_METHOD A20 "" LINEAR "%.15" "g" COEFFS_LINEAR 0.25 0 /end COMPU_METHOD
/begin COMPU_METHOD A41 "" LINEAR "%.15" "g" COEFFS_LINEAR 0.001 0 /end COMPU_METHOD
/begin COMPU_METHOD A42 "" LINEAR "%.15" "g" COEFFS_LINEAR 0.01 0 /end COMPU_METHOD
/begin COMPU_METHOD A47 "" LINEAR "%.15" "g" COEFFS_LINEAR 0.005 0 /end COMPU_METHOD
/begin COMPU_METHOD AgSpd31 "" LINEAR "%.15" "DegPerSec" COEFFS_LINEAR 0.01 0 /end COMPU_METHOD
/begin COMPU_METHOD Amp2 "" LINEAR "%.15" "A" COEFFS_LINEAR 0.001 0 /end COMPU_METHOD
/begin COMPU_METHOD Fac31 "" LINEAR "%.15" "NA" COEFFS_LINEAR 1 0 /end COMPU_METHOD
/begin COMPU_METHOD Gain "" LINEAR "%.15" "NA" COEFFS_LINEAR 1 0 /end COMPU_METHOD
/begin COMPU_METHOD OnOff1 "" LINEAR "%.15" "NA" COEFFS_LINEAR 1 0 STATUS_STRING_REF OnOffTable /end COMPU_METHOD
/begin COMPU_METHOD P32 "" LINEAR "%.15" "bar" COEFFS_LINEAR 0.01 0 /end COMPU_METHOD
/begin COMPU_METHOD P34 "" LINEAR "%.15" "bar" COEFFS_LINEAR 0.1 0 /end COMPU_METHOD
/begin COMPU_METHOD P35 "" LINEAR "%.15" "bar" COEFFS_LINEAR 1 0 /end COMPU_METHOD
/begin COMPU_METHOD PGrdt13 "" LINEAR "%.15" "bar/30ms" COEFFS_LINEAR 0.1 0 /end COMPU_METHOD
/begin COMPU_METHOD Perc6 "" LINEAR "%.15" "Percentage" COEFFS_LINEAR 1 0 /end COMPU_METHOD
/begin COMPU_METHOD Spd12 "" LINEAR "%.15" "kph" COEFFS_LINEAR 0.125 0 /end COMPU_METHOD
/begin COMPU_METHOD T32 "" LINEAR "%.15" "degC" COEFFS_LINEAR 0.031225 0 /end COMPU_METHOD
/begin COMPU_METHOD Ti11 "" LINEAR "%.15" "sec" COEFFS_LINEAR 1 0 /end COMPU_METHOD
/begin COMPU_METHOD Ti21 "" LINEAR "%.15" "sec" COEFFS_LINEAR 0.01 0 /end COMPU_METHOD
/begin COMPU_METHOD Ti41 "" LINEAR "%.15" "sec" COEFFS_LINEAR 0.005 0 /end COMPU_METHOD
/begin COMPU_METHOD Tq2 "" LINEAR "%.15" "Nm" COEFFS_LINEAR 1 0 /end COMPU_METHOD
/begin COMPU_METHOD Tq51 "" LINEAR "%.15" "Nm" COEFFS_LINEAR 0.1 0 /end COMPU_METHOD
/begin COMPU_METHOD TqGrdt10 "" LINEAR "%.15" "Nm/10ms" COEFFS_LINEAR 1 0 /end COMPU_METHOD
/begin COMPU_METHOD U13 "" LINEAR "%.15" "V" COEFFS_LINEAR 0.1 0 /end COMPU_METHOD
/begin COMPU_VTAB OnOff1 "" TAB_VERB 2 0 "off" 1 "on" DEFAULT_VALUE "" /end COMPU_VTAB
/begin COMPU_VTAB OnOffTable "" TAB_VERB 2 0 "Off" 1 "On" DEFAULT_VALUE "" /end COMPU_VTAB
/begin RECORD_LAYOUT CalPrmBrkAssisCoorrBrk_SWORD FNC_VALUES 1 SWORD COLUMN_DIR DIRECT ALIGNMENT_BYTE 1 ALIGNMENT_WORD 1 ALIGNMENT_LONG 1 ALIGNMENT_FLOAT32_IEEE 1 ALIGNMENT_FLOAT64_IEEE 1 ALIGNMENT_INT64 1 /end RECORD_LAYOUT
/begin RECORD_LAYOUT CalPrmBrkAssisCoorrBrk_UBYTE FNC_VALUES 1 UBYTE COLUMN_DIR DIRECT ALIGNMENT_BYTE 1 ALIGNMENT_WORD 1 ALIGNMENT_LONG 1 ALIGNMENT_FLOAT32_IEEE 1 ALIGNMENT_FLOAT64_IEEE 1 ALIGNMENT_INT64 1 /end RECORD_LAYOUT
/begin RECORD_LAYOUT CalPrmBrkAssisCoorrBrk_UWORD FNC_VALUES 1 UWORD COLUMN_DIR DIRECT ALIGNMENT_BYTE 1 ALIGNMENT_WORD 1 ALIGNMENT_LONG 1 ALIGNMENT_FLOAT32_IEEE 1 ALIGNMENT_FLOAT64_IEEE 1 ALIGNMENT_INT64 1 /end RECORD_LAYOUT
/begin RECORD_LAYOUT CalPrmBrkTqCtrlrBrk_SWORD FNC_VALUES 1 SWORD COLUMN_DIR DIRECT ALIGNMENT_BYTE 1 ALIGNMENT_WORD 1 ALIGNMENT_LONG 1 ALIGNMENT_FLOAT32_IEEE 1 ALIGNMENT_FLOAT64_IEEE 1 ALIGNMENT_INT64 1 /end RECORD_LAYOUT
/begin RECORD_LAYOUT CalPrmBrkTqCtrlrBrk_UBYTE FNC_VALUES 1 UBYTE COLUMN_DIR DIRECT ALIGNMENT_BYTE 1 ALIGNMENT_WORD 1 ALIGNMENT_LONG 1 ALIGNMENT_FLOAT32_IEEE 1 ALIGNMENT_FLOAT64_IEEE 1 ALIGNMENT_INT64 1 /end RECORD_LAYOUT
/begin RECORD_LAYOUT CalPrmCmnEng_UWORD FNC_VALUES 1 UWORD COLUMN_DIR DIRECT ALIGNMENT_BYTE 1 ALIGNMENT_WORD 1 ALIGNMENT_LONG 1 ALIGNMENT_FLOAT32_IEEE 1 ALIGNMENT_FLOAT64_IEEE 1 ALIGNMENT_INT64 1 /end RECORD_LAYOUT
/begin RECORD_LAYOUT CalPrmEstmrEng_SBYTE FNC_VALUES 1 SBYTE COLUMN_DIR DIRECT ALIGNMENT_BYTE 1 ALIGNMENT_WORD 1 ALIGNMENT_LONG 1 ALIGNMENT_FLOAT32_IEEE 1 ALIGNMENT_FLOAT64_IEEE 1 ALIGNMENT_INT64 1 /end RECORD_LAYOUT
/begin RECORD_LAYOUT CalPrmEstmrEng_UBYTE FNC_VALUES 1 UBYTE COLUMN_DIR DIRECT ALIGNMENT_BYTE 1 ALIGNMENT_WORD 1 ALIGNMENT_LONG 1 ALIGNMENT_FLOAT32_IEEE 1 ALIGNMENT_FLOAT64_IEEE 1 ALIGNMENT_INT64 1 /end RECORD_LAYOUT
/begin RECORD_LAYOUT CalPrmEstmrEng_UWORD FNC_VALUES 1 UWORD COLUMN_DIR DIRECT ALIGNMENT_BYTE 1 ALIGNMENT_WORD 1 ALIGNMENT_LONG 1 ALIGNMENT_FLOAT32_IEEE 1 ALIGNMENT_FLOAT64_IEEE 1 ALIGNMENT_INT64 1 /end RECORD_LAYOUT
/begin RECORD_LAYOUT CalPrmLatDynsCoorrBrk_SBYTE FNC_VALUES 1 SBYTE COLUMN_DIR DIRECT ALIGNMENT_BYTE 1 ALIGNMENT_WORD 1 ALIGNMENT_LONG 1 ALIGNMENT_FLOAT32_IEEE 1 ALIGNMENT_FLOAT64_IEEE 1 ALIGNMENT_INT64 1 /end RECORD_LAYOUT
/begin RECORD_LAYOUT CalPrmLatDynsCoorrBrk_SWORD FNC_VALUES 1 SWORD COLUMN_DIR DIRECT ALIGNMENT_BYTE 1 ALIGNMENT_WORD 1 ALIGNMENT_LONG 1 ALIGNMENT_FLOAT32_IEEE 1 ALIGNMENT_FLOAT64_IEEE 1 ALIGNMENT_INT64 1 /end RECORD_LAYOUT
/begin RECORD_LAYOUT CalPrmLatDynsCoorrBrk_UBYTE FNC_VALUES 1 UBYTE COLUMN_DIR DIRECT ALIGNMENT_BYTE 1 ALIGNMENT_WORD 1 ALIGNMENT_LONG 1 ALIGNMENT_FLOAT32_IEEE 1 ALIGNMENT_FLOAT64_IEEE 1 ALIGNMENT_INT64 1 /end RECORD_LAYOUT
/begin RECORD_LAYOUT CalPrmLoPCoorrBrk_SBYTE FNC_VALUES 1 SBYTE COLUMN_DIR DIRECT ALIGNMENT_BYTE 1 ALIGNMENT_WORD 1 ALIGNMENT_LONG 1 ALIGNMENT_FLOAT32_IEEE 1 ALIGNMENT_FLOAT64_IEEE 1 ALIGNMENT_INT64 1 /end RECORD_LAYOUT
/begin RECORD_LAYOUT CalPrmLoPCoorrBrk_SWORD FNC_VALUES 1 SWORD COLUMN_DIR DIRECT ALIGNMENT_BYTE 1 ALIGNMENT_WORD 1 ALIGNMENT_LONG 1 ALIGNMENT_FLOAT32_IEEE 1 ALIGNMENT_FLOAT64_IEEE 1 ALIGNMENT_INT64 1 /end RECORD_LAYOUT
/begin RECORD_LAYOUT CalPrmLoPCoorrBrk_UBYTE FNC_VALUES 1 UBYTE COLUMN_DIR DIRECT ALIGNMENT_BYTE 1 ALIGNMENT_WORD 1 ALIGNMENT_LONG 1 ALIGNMENT_FLOAT32_IEEE 1 ALIGNMENT_FLOAT64_IEEE 1 ALIGNMENT_INT64 1 /end RECORD_LAYOUT
/begin RECORD_LAYOUT CalPrmLoPCoorrBrk_UWORD FNC_VALUES 1 UWORD COLUMN_DIR DIRECT ALIGNMENT_BYTE 1 ALIGNMENT_WORD 1 ALIGNMENT_LONG 1 ALIGNMENT_FLOAT32_IEEE 1 ALIGNMENT_FLOAT64_IEEE 1 ALIGNMENT_INT64 1 /end RECORD_LAYOUT
/begin RECORD_LAYOUT CalPrmSigProcrBrk_SBYTE FNC_VALUES 1 SBYTE COLUMN_DIR DIRECT ALIGNMENT_BYTE 1 ALIGNMENT_WORD 1 ALIGNMENT_LONG 1 ALIGNMENT_FLOAT32_IEEE 1 ALIGNMENT_FLOAT64_IEEE 1 ALIGNMENT_INT64 1 /end RECORD_LAYOUT
/begin RECORD_LAYOUT CalPrmSigProcrBrk_SWORD FNC_VALUES 1 SWORD COLUMN_DIR DIRECT ALIGNMENT_BYTE 1 ALIGNMENT_WORD 1 ALIGNMENT_LONG 1 ALIGNMENT_FLOAT32_IEEE 1 ALIGNMENT_FLOAT64_IEEE 1 ALIGNMENT_INT64 1 /end RECORD_LAYOUT
/begin RECORD_LAYOUT CalPrmSigProcrBrk_UWORD FNC_VALUES 1 UWORD COLUMN_DIR DIRECT ALIGNMENT_BYTE 1 ALIGNMENT_WORD 1 ALIGNMENT_LONG 1 ALIGNMENT_FLOAT32_IEEE 1 ALIGNMENT_FLOAT64_IEEE 1 ALIGNMENT_INT64 1 /end RECORD_LAYOUT
/begin RECORD_LAYOUT CalPrmSigProcrEng_SBYTE FNC_VALUES 1 SBYTE COLUMN_DIR DIRECT ALIGNMENT_BYTE 1 ALIGNMENT_WORD 1 ALIGNMENT_LONG 1 ALIGNMENT_FLOAT32_IEEE 1 ALIGNMENT_FLOAT64_IEEE 1 ALIGNMENT_INT64 1 /end RECORD_LAYOUT
/begin RECORD_LAYOUT CalPrmSigProcrEng_SWORD FNC_VALUES 1 SWORD COLUMN_DIR DIRECT ALIGNMENT_BYTE 1 ALIGNMENT_WORD 1 ALIGNMENT_LONG 1 ALIGNMENT_FLOAT32_IEEE 1 ALIGNMENT_FLOAT64_IEEE 1 ALIGNMENT_INT64 1 /end RECORD_LAYOUT
/begin RECORD_LAYOUT CalPrmSsmEng_SWORD FNC_VALUES 1 SWORD COLUMN_DIR DIRECT ALIGNMENT_BYTE 1 ALIGNMENT_WORD 1 ALIGNMENT_LONG 1 ALIGNMENT_FLOAT32_IEEE 1 ALIGNMENT_FLOAT64_IEEE 1 ALIGNMENT_INT64 1 /end RECORD_LAYOUT
/begin RECORD_LAYOUT CalPrmSsmEng_UBYTE FNC_VALUES 1 UBYTE COLUMN_DIR DIRECT ALIGNMENT_BYTE 1 ALIGNMENT_WORD 1 ALIGNMENT_LONG 1 ALIGNMENT_FLOAT32_IEEE 1 ALIGNMENT_FLOAT64_IEEE 1 ALIGNMENT_INT64 1 /end RECORD_LAYOUT
/begin RECORD_LAYOUT CalPrmSsmEng_UWORD FNC_VALUES 1 UWORD COLUMN_DIR DIRECT ALIGNMENT_BYTE 1 ALIGNMENT_WORD 1 ALIGNMENT_LONG 1 ALIGNMENT_FLOAT32_IEEE 1 ALIGNMENT_FLOAT64_IEEE 1 ALIGNMENT_INT64 1 /end RECORD_LAYOUT
/begin RECORD_LAYOUT CalPrmStrStabyCtrlBrk_SBYTE FNC_VALUES 1 SBYTE COLUMN_DIR DIRECT ALIGNMENT_BYTE 1 ALIGNMENT_WORD 1 ALIGNMENT_LONG 1 ALIGNMENT_FLOAT32_IEEE 1 ALIGNMENT_FLOAT64_IEEE 1 ALIGNMENT_INT64 1 /end RECORD_LAYOUT
/begin RECORD_LAYOUT CalPrmVehLgtCoorrBrk_SBYTE FNC_VALUES 1 SBYTE COLUMN_DIR DIRECT ALIGNMENT_BYTE 1 ALIGNMENT_WORD 1 ALIGNMENT_LONG 1 ALIGNMENT_FLOAT32_IEEE 1 ALIGNMENT_FLOAT64_IEEE 1 ALIGNMENT_INT64 1 /end RECORD_LAYOUT
/begin RECORD_LAYOUT CalPrmVehLgtCoorrBrk_ULONG FNC_VALUES 1 ULONG COLUMN_DIR DIRECT ALIGNMENT_BYTE 1 ALIGNMENT_WORD 1 ALIGNMENT_LONG 1 ALIGNMENT_FLOAT32_IEEE 1 ALIGNMENT_FLOAT64_IEEE 1 ALIGNMENT_INT64 1 /end RECORD_LAYOUT
/begin RECORD_LAYOUT CalPrmVehLgtCoorrEng_ULONG FNC_VALUES 1 ULONG COLUMN_DIR DIRECT ALIGNMENT_BYTE 1 ALIGNMENT_WORD 1 ALIGNMENT_LONG 1 ALIGNMENT_FLOAT32_IEEE 1 ALIGNMENT_FLOAT64_IEEE 1 ALIGNMENT_INT64 1 /end RECORD_LAYOUT
/begin RECORD_LAYOUT CalPrmWslcBrk_SBYTE FNC_VALUES 1 SBYTE COLUMN_DIR DIRECT ALIGNMENT_BYTE 1 ALIGNMENT_WORD 1 ALIGNMENT_LONG 1 ALIGNMENT_FLOAT32_IEEE 1 ALIGNMENT_FLOAT64_IEEE 1 ALIGNMENT_INT64 1 /end RECORD_LAYOUT
/begin RECORD_LAYOUT CalPrmWslcBrk_SWORD FNC_VALUES 1 SWORD COLUMN_DIR DIRECT ALIGNMENT_BYTE 1 ALIGNMENT_WORD 1 ALIGNMENT_LONG 1 ALIGNMENT_FLOAT32_IEEE 1 ALIGNMENT_FLOAT64_IEEE 1 ALIGNMENT_INT64 1 /end RECORD_LAYOUT
/begin RECORD_LAYOUT CalPrmWslcBrk_UBYTE FNC_VALUES 1 UBYTE COLUMN_DIR DIRECT ALIGNMENT_BYTE 1 ALIGNMENT_WORD 1 ALIGNMENT_LONG 1 ALIGNMENT_FLOAT32_IEEE 1 ALIGNMENT_FLOAT64_IEEE 1 ALIGNMENT_INT64 1 /end RECORD_LAYOUT
/begin RECORD_LAYOUT CalPrmWspcEng_SWORD FNC_VALUES 1 SWORD COLUMN_DIR DIRECT ALIGNMENT_BYTE 1 ALIGNMENT_WORD 1 ALIGNMENT_LONG 1 ALIGNMENT_FLOAT32_IEEE 1 ALIGNMENT_FLOAT64_IEEE 1 ALIGNMENT_INT64 1 /end RECORD_LAYOUT
/begin RECORD_LAYOUT CalPrmWspcEng_UBYTE FNC_VALUES 1 UBYTE COLUMN_DIR DIRECT ALIGNMENT_BYTE 1 ALIGNMENT_WORD 1 ALIGNMENT_LONG 1 ALIGNMENT_FLOAT32_IEEE 1 ALIGNMENT_FLOAT64_IEEE 1 ALIGNMENT_INT64 1 /end RECORD_LAYOUT
/begin RECORD_LAYOUT CalPrmWspcEng_UWORD FNC_VALUES 1 UWORD COLUMN_DIR DIRECT ALIGNMENT_BYTE 1 ALIGNMENT_WORD 1 ALIGNMENT_LONG 1 ALIGNMENT_FLOAT32_IEEE 1 ALIGNMENT_FLOAT64_IEEE 1 ALIGNMENT_INT64 1 /end RECORD_LAYOUT
/begin RECORD_LAYOUT SSV__A_INT64_S AXIS_PTS_X 1 A_INT64 INDEX_INCR DIRECT /end RECORD_LAYOUT
/begin RECORD_LAYOUT SSV__A_UINT64_S AXIS_PTS_X 1 A_UINT64 INDEX_INCR DIRECT /end RECORD_LAYOUT
/begin RECORD_LAYOUT SSV__FLOAT32_IEEE_S AXIS_PTS_X 1 FLOAT32_IEEE INDEX_INCR DIRECT /end RECORD_LAYOUT
/begin GROUP b_Over_Inside_Rear_Ctrl ""
 /begin REF_CHARACTERISTIC TP_U8_STB_DMP_MAX_HIGH_OverInR TP_U8_STB_DMP_MAX_LOW_OverInR TP_U8_STB_DMP_MAX_MED_OverInR TP_U8_STB_DMP_MAX_SP_OverInR /end REF_CHARACTERISTIC
/end GROUP
/begin GROUP b_PBA ""
 /begin SUB_GROUP ba_PBA_Enter_Threshold bb_PBA_Exit_Threshold bc_PBA_Control /end SUB_GROUP
/end GROUP
/begin GROUP b_P_Effect "" /begin SUB_GROUP a_P_gain b_P_gain_Factor /end SUB_GROUP /end GROUP
/begin GROUP b_P_gain_Factor "" /begin SUB_GROUP a_PgainFactor_Straight b_PgainFactor_Turn /end SUB_GROUP /end GROUP
/begin GROUP b_PgainFactor_Turn ""
 /begin REF_CHARACTERISTIC TP_U8TCSCpPgFac4ASFBCtlTurn_F[0] TP_U8TCSCpPgFac4ASFBCtlTurn_F[1] TP_U8TCSCpPgFac4ASFBCtlTurn_F[2] TP_U8TCSCpPgFac4ASFBCtlTurn_F[3] TP_U8TCSCpPgFac4ASFBCtlTurn_F[4] TP_U8TCSCpPgFac4ASFBCtlTurn_R[0] TP_U8TCSCpPgFac4ASFBCtlTurn_R[1] TP_U8TCSCpPgFac4ASFBCtlTurn_R[2] TP_U8TCSCpPgFac4ASFBCtlTurn_R[3] TP_U8TCSCpPgFac4ASFBCtlTurn_R[4] /end REF_CHARACTERISTIC
/end GROUP
/begin GROUP b_Pgain_Hill ""
 /begin REF_CHARACTERISTIC TP_U8TCSCpBsHillPG4ASFBCtlN_F[0] TP_U8TCSCpBsHillPG4ASFBCtlN_F[1] TP_U8TCSCpBsHillPG4ASFBCtlN_F[2] TP_U8TCSCpBsHillPG4ASFBCtlN_F[3] TP_U8TCSCpBsHillPG4ASFBCtlN_F[4] TP_U8TCSCpBsHillPG4ASFBCtlN_R[0] TP_U8TCSCpBsHillPG4ASFBCtlN_R[1] TP_U8TCSCpBsHillPG4ASFBCtlN_R[2] TP_U8TCSCpBsHillPG4ASFBCtlN_R[3] TP_U8TCSCpBsHillPG4ASFBCtlN_R[4] TP_U8TCSCpBsHillPG4ASFBCtlP_F[0] TP_U8TCSCpBsHillPG4ASFBCtlP_F[1] TP_U8TCSCpBsHillPG4ASFBCtlP_F[2] TP_U8TCSCpBsHillPG4ASFBCtlP_F[3] TP_U8TCSCpBsHillPG4ASFBCtlP_F[4] TP_U8TCSCpBsHillPG4ASFBCtlP_R[0] TP_U8TCSCpBsHillPG4ASFBCtlP_R[1] TP_U8TCSCpBsHillPG4ASFBCtlP_R[2] TP_U8TCSCpBsHillPG4ASFBCtlP_R[3] TP_U8TCSCpBsHillPG4ASFBCtlP_R[4] /end REF_CHARACTERISTIC
/end GROUP
/begin GROUP b_Rear_H "" /begin REF_CHARACTERISTIC TP_S8_dP_Arad_Ref_Ab_HMu_R TP_U8_dP_Dump_cnt_Ref_Ab_HMu_R /end REF_CHARACTERISTIC /end GROUP
/begin GROUP b_Rear_H_T ""
 /begin REF_CHARACTERISTIC TP_U8_dPTim_Dump_Ref_Ab_HMu_1_R TP_U8_dPTim_Dump_Ref_Ab_HMu_2_R TP_U8_dPTim_Dump_Ref_Ab_HMu_3_R TP_U8_dPTim_by_Dump_Ab_HMu_1_R TP_U8_dPTim_by_Dump_Ab_HMu_2_R TP_U8_dPTim_by_Dump_Ab_HMu_3_R TP_U8_dPTim_by_Dump_Ab_HMu_Max_R /end REF_CHARACTERISTIC
/end GROUP
/begin GROUP b_Rear_Initial ""
 /begin REF_CHARACTERISTIC TP_U8_dP_HMu_Dct_AradRef_1st_R TP_U8_dP_HMu_Dct_DumpRef_1st_R TP_U8_dP_LMu_Dct_AradRef_1st_R TP_U8_dP_LMu_Dct_DumpRef_1st_R /end REF_CHARACTERISTIC
/end GROUP
/begin GROUP b_Rear_L "" /begin REF_CHARACTERISTIC TP_S8_dP_Arad_Ref_Bw_LMu_R TP_U8_dP_Dump_cnt_Ref_Bw_LMu_R /end REF_CHARACTERISTIC /end GROUP
/begin GROUP b_Rear_LM ""
 /begin REF_CHARACTERISTIC TP_S8_dP_Arad_Ref_LMMu_MMu_R TP_U8_dP_Dump_cnt_Ref_LMMu_MMu_R /end REF_CHARACTERISTIC
/end GROUP
/begin GROUP b_Rear_LM_T ""
 /begin REF_CHARACTERISTIC TP_U8_dPTim_Dump_Ref_LMMu_MMu_1_R TP_U8_dPTim_Dump_Ref_LMMu_MMu_2_R TP_U8_dPTim_Dump_Ref_LMMu_MMu_3_R TP_U8_dPTim_by_Dump_LMMu_MMu_1_R TP_U8_dPTim_by_Dump_LMMu_MMu_2_R TP_U8_dPTim_by_Dump_LMMu_MMu_3_R TP_U8_dPTim_by_Dump_LMMu_MMu_Max_R /end REF_CHARACTERISTIC
/end GROUP
/begin GROUP b_Rear_L_T ""
 /begin REF_CHARACTERISTIC TP_U8_dPTim_Dump_Ref_Bw_LMu_1_R TP_U8_dPTim_Dump_Ref_Bw_LMu_2_R TP_U8_dPTim_Dump_Ref_Bw_LMu_3_R TP_U8_dPTim_by_Dump_Bw_LMu_1_R TP_U8_dPTim_by_Dump_Bw_LMu_2_R TP_U8_dPTim_by_Dump_Bw_LMu_3_R TP_U8_dPTim_by_Dump_Bw_LMu_Max_R /end REF_CHARACTERISTIC
/end GROUP
/begin GROUP b_Rear_M ""
 /begin REF_CHARACTERISTIC TP_S8_dP_Arad_Ref_MMu_MHMu_R TP_U8_dP_Dump_cnt_Ref_MMu_MHMu_R /end REF_CHARACTERISTIC
/end GROUP
/begin GROUP b_Rear_MH ""
 /begin REF_CHARACTERISTIC TP_S8_dP_Arad_Ref_MHMu_HMu_R TP_U8_dP_Dump_cnt_Ref_MHMu_HMu_R /end REF_CHARACTERISTIC
/end GROUP
/begin GROUP b_Rear_MH_T ""
 /begin REF_CHARACTERISTIC TP_U8_dPTim_Dump_Ref_MHMu_HMu_1_R TP_U8_dPTim_Dump_Ref_MHMu_HMu_2_R TP_U8_dPTim_Dump_Ref_MHMu_HMu_3_R TP_U8_dPTim_by_Dump_MHMu_HMu_1_R TP_U8_dPTim_by_Dump_MHMu_HMu_2_R TP_U8_dPTim_by_Dump_MHMu_HMu_3_R TP_U8_dPTim_by_Dump_MHMu_HMu_Max_R /end REF_CHARACTERISTIC
/end GROUP
/begin GROUP b_Rear_M_T ""
 /begin REF_CHARACTERISTIC TP_U8_dPTim_Dump_Ref_MMu_MHMu_1_R TP_U8_dPTim_Dump_Ref_MMu_MHMu_2_R TP_U8_dPTim_Dump_Ref_MMu_MHMu_3_R TP_U8_dPTim_by_Dump_MMu_MHMu_1_R TP_U8_dPTim_by_Dump_MMu_MHMu_2_R TP_U8_dPTim_by_Dump_MMu_MHMu_3_R TP_U8_dPTim_by_Dump_MMu_MHMu_Max_R /end REF_CHARACTERISTIC
/end GROUP
/begin GROUP b_Rear_Pulse_down_LMu_AB ""
 /begin REF_CHARACTERISTIC TP_S8_Decel_Gain_LMu_10_20k_R_HDC TP_S8_Decel_Gain_LMu_B_10k_R_HDC TP_S8_Slip_Gain_LMu_10_20k_R_HDC TP_S8_Slip_Gain_LMu_B_10k_R_HDC /end REF_CHARACTERISTIC
/end GROUP
/begin GROUP b_Rear_UL ""
 /begin REF_CHARACTERISTIC TP_S8_dP_Arad_Ref_LMu_LMMu_R TP_U8_dP_Dump_cnt_Ref_LMu_LMMu_R /end REF_CHARACTERISTIC
/end GROUP
/begin GROUP b_Rear_UL_T ""
 /begin REF_CHARACTERISTIC TP_U8_dPTim_Dump_Ref_LMu_LMMu_1_R TP_U8_dPTim_Dump_Ref_LMu_LMMu_2_R TP_U8_dPTim_Dump_Ref_LMu_LMMu_3_R TP_U8_dPTim_by_Dump_LMu_LMMu_1_R TP_U8_dPTim_by_Dump_LMu_LMMu_2_R TP_U8_dPTim_by_Dump_LMu_LMMu_3_R TP_U8_dPTim_by_Dump_LMu_LMMu_Max_R /end REF_CHARACTERISTIC
/end GROUP
/begin GROUP b_RiseHold_Rate ""
 /begin REF_CHARACTERISTIC TP_U8_YDF_RISEHOLD_T_AT_INC_L1 TP_U8_YDF_RISEHOLD_T_AT_INC_L2 TP_U8_YDF_RISEHOLD_T_AT_TARGETDYAW TP_U8_YDF_RISEHOLD_T_MAX /end REF_CHARACTERISTIC
/end GROUP
/begin GROUP b_Rough_Road_Comp ""
 /begin REF_CHARACTERISTIC TP_U8_Init_Duty_Rough_Sus_Comp_F TP_U8_Init_Duty_Rough_Sus_Comp_R TP_U8_Initial_Duty_Rough_Comp_F TP_U8_Initial_Duty_Rough_Comp_R /end REF_CHARACTERISTIC
/end GROUP
/begin GROUP b_Set_Target_Del_Yaw_2 ""
 /begin REF_CHARACTERISTIC TP_S16_DEFAULT_TARGET_dYAW2_SPEED_H TP_S16_DEFAULT_TARGET_dYAW2_SPEED_L TP_S16_DEFAULT_TARGET_dYAW2_SPEED_M TP_S16_LMu_TARGET_dYAW2_SPEED_H TP_S16_LMu_TARGET_dYAW2_SPEED_L TP_S16_LMu_TARGET_dYAW2_SPEED_M TP_S16_SPLIT_TARGET_dYAW2_SPEED_H TP_S16_SPLIT_TARGET_dYAW2_SPEED_L TP_S16_SPLIT_TARGET_dYAW2_SPEED_M /end REF_CHARACTERISTIC
/end GROUP
/begin GROUP b_Stuck ""
 /begin REF_CHARACTERISTIC TP_S16TCSCpBrkCtlTrqOfStuck TP_S16TCSCpCtlMotorV_Stuck TP_U8TCSCpStuckPressureRiseTime /end REF_CHARACTERISTIC
/end GROUP
/begin GROUP b_Symmetric_Torque "" /begin SUB_GROUP b_Symmetric_control /end SUB_GROUP /end GROUP
/begin GROUP b_Symmetric_control ""
 /begin REF_CHARACTERISTIC TP_U8TCSCpPresDifLR4SymSp TP_U8TCSCpSymBoth2WlSpdDifTh TP_U8TCSCpSymBoth2WlSpinTh TP_U8TCSCpSymExtHysOfMovDiffLnR TP_U8TCSCpTBrkTorqDec4Sym /end REF_CHARACTERISTIC
/end GROUP
/begin GROUP b_TargetSpin_Hill ""
 /begin REF_CHARACTERISTIC TP_U8TCSCpTarWhlSpinDiffHill[0] TP_U8TCSCpTarWhlSpinDiffHill[1] TP_U8TCSCpTarWhlSpinDiffHill[2] TP_U8TCSCpTarWhlSpinDiffHill[3] TP_U8TCSCpTarWhlSpinDiffHill[4] /end REF_CHARACTERISTIC
/end GROUP
/begin GROUP b_Unstable_Rise "" /begin SUB_GROUP a_Unstable_Rise_Thresholds b_Unstable_Rise_Time /end SUB_GROUP /end GROUP
/begin GROUP b_Unstable_Rise_Logic "" /begin SUB_GROUP a_1stCycle_UR_MinMax_Time b_1stCycle_UR_Time c_Detection /end SUB_GROUP /end GROUP
/begin GROUP b_Unstable_Rise_Time ""
 /begin SUB_GROUP a_High_Mu_UR_Time b_Med_High_Mu_UR_Time c_Medium_Mu_UR_Time d_Low_Med_Mu_UR_Time e_Under_Low_Med_Mu_UR_Time f_Low_Mu_UR_Time g_Split_Mu_UR_Time h_UR_Time_MIN_MAX /end SUB_GROUP
/end GROUP
/begin GROUP b_WpeBrkVolumeRear ""
 /begin REF_CHARACTERISTIC S16_WPE_Caliper_Model_Volume_No_r S16_WPE_Caliper_Model_Volume_r_1 S16_WPE_Caliper_Model_Volume_r_10 S16_WPE_Caliper_Model_Volume_r_11 S16_WPE_Caliper_Model_Volume_r_12 S16_WPE_Caliper_Model_Volume_r_13 S16_WPE_Caliper_Model_Volume_r_14 S16_WPE_Caliper_Model_Volume_r_15 S16_WPE_Caliper_Model_Volume_r_16 S16_WPE_Caliper_Model_Volume_r_2 S16_WPE_Caliper_Model_Volume_r_3 S16_WPE_Caliper_Model_Volume_r_4 S16_WPE_Caliper_Model_Volume_r_5 S16_WPE_Caliper_Model_Volume_r_6 S16_WPE_Caliper_Model_Volume_r_7 S16_WPE_Caliper_Model_Volume_r_8 S16_WPE_Caliper_Model_Volume_r_9 /end REF_CHARACTERISTIC
/end GROUP
/begin GROUP b_WpeLfcEscRise ""
 /begin REF_CHARACTERISTIC S16_WPE_LFC_ESC_Rise_Gain_2_f_1st S16_WPE_LFC_ESC_Rise_Gain_2_f_2nd S16_WPE_LFC_ESC_Rise_Gain_2_f_3rd S16_WPE_LFC_ESC_Rise_Gain_2_f_4th S16_WPE_LFC_ESC_Rise_Gain_2_f_5th S16_WPE_LFC_ESC_Rise_Gain_2_f_6th S16_WPE_LFC_ESC_Rise_Gain_2_r_1st S16_WPE_LFC_ESC_Rise_Gain_2_r_2nd S16_WPE_LFC_ESC_Rise_Gain_2_r_3rd S16_WPE_LFC_ESC_Rise_Gain_2_r_4th S16_WPE_LFC_ESC_Rise_Gain_2_r_5th S16_WPE_LFC_ESC_Rise_Gain_2_r_6th S16_WPE_LFC_ESC_Rise_Gain_f_1st S16_WPE_LFC_ESC_Rise_Gain_f_2nd S16_WPE_LFC_ESC_Rise_Gain_f_3rd S16_WPE_LFC_ESC_Rise_Gain_f_4th S16_WPE_LFC_ESC_Rise_Gain_f_5th S16_WPE_LFC_ESC_Rise_Gain_f_6th S16_WPE_LFC_ESC_Rise_Gain_r_1st S16_WPE_LFC_ESC_Rise_Gain_r_2nd S16_WPE_LFC_ESC_Rise_Gain_r_3rd S16_WPE_LFC_ESC_Rise_Gain_r_4th S16_WPE_LFC_ESC_Rise_Gain_r_5th S16_WPE_LFC_ESC_Rise_Gain_r_6th S16_WPE_LFC_ESC_Rise_Press_f_1st S16_WPE_LFC_ESC_Rise_Press_f_2nd S16_WPE_LFC_ESC_Rise_Press_f_3rd S16_WPE_LFC_ESC_Rise_Press_f_4th S16_WPE_LFC_ESC_Rise_Press_f_5th S16_WPE_LFC_ESC_Rise_Press_f_6th S16_WPE_LFC_ESC_Rise_Press_r_1st S16_WPE_LFC_ESC_Rise_Press_r_2nd S16_WPE_LFC_ESC_Rise_Press_r_3rd S16_WPE_LFC_ESC_Rise_Press_r_4th S16_WPE_LFC_ESC_Rise_Press_r_5th S16_WPE_LFC_ESC_Rise_Press_r_6th U8_WPE_LFC_ESC_Rise_Duty_f_1st U8_WPE_LFC_ESC_Rise_Duty_f_2nd U8_WPE_LFC_ESC_Rise_Duty_f_3rd U8_WPE_LFC_ESC_Rise_Duty_f_4th U8_WPE_LFC_ESC_Rise_Duty_f_5th U8_WPE_LFC_ESC_Rise_Duty_f_6th U8_WPE_LFC_ESC_Rise_Duty_r_1st U8_WPE_LFC_ESC_Rise_Duty_r_2nd U8_WPE_LFC_ESC_Rise_Duty_r_3rd U8_WPE_LFC_ESC_Rise_Duty_r_4th U8_WPE_LFC_ESC_Rise_Duty_r_5th U8_WPE_LFC_ESC_Rise_Duty_r_6th /end REF_CHARACTERISTIC
/end GROUP
/begin GROUP b_WpeNcDumpRear ""
 /begin REF_CHARACTERISTIC S16_WPE_NC_Dump_Gain_Press_r_1st S16_WPE_NC_Dump_Gain_Press_r_2nd S16_WPE_NC_Dump_Gain_Press_r_3rd S16_WPE_NC_Dump_Gain_Press_r_4th S16_WPE_NC_Dump_Gain_Press_r_5th S16_WPE_NC_Dump_Gain_Press_r_6th S16_WPE_NC_Dump_Gain_r_1st S16_WPE_NC_Dump_Gain_r_2nd S16_WPE_NC_Dump_Gain_r_3rd S16_WPE_NC_Dump_Gain_r_4th S16_WPE_NC_Dump_Gain_r_5th S16_WPE_NC_Dump_Gain_r_6th /end REF_CHARACTERISTIC
/end GROUP
/begin GROUP b_WpeTcDumpRear ""
 /begin REF_CHARACTERISTIC S16_WPE_TC_Dump_Gain_Press_r_1st S16_WPE_TC_Dump_Gain_Press_r_2nd S16_WPE_TC_Dump_Gain_Press_r_3rd S16_WPE_TC_Dump_Gain_Press_r_4th S16_WPE_TC_Dump_Gain_Press_r_5th S16_WPE_TC_Dump_Gain_Press_r_6th S16_WPE_TC_Dump_Gain_r_1st S16_WPE_TC_Dump_Gain_r_2nd S16_WPE_TC_Dump_Gain_r_3rd S16_WPE_TC_Dump_Gain_r_4th S16_WPE_TC_Dump_Gain_r_5th S16_WPE_TC_Dump_Gain_r_6th /end REF_CHARACTERISTIC
/end GROUP
/begin GROUP b_Yaw_Stability_Improve ""
 /begin SUB_GROUP a_Set_Del_Yaw_Offset b_Del_Yaw_Gain c_Yaw_Stability_Improve_Ctrl d_Stable_Dump_Rate e_Front_YDF_at_GMA_pulse_up f_MIRC_Improve /end SUB_GROUP
/end GROUP
/begin GROUP b_dP_Control_AB "" /begin SUB_GROUP a_Pulse_down_AB /end SUB_GROUP /end GROUP
/begin GROUP b_dV_Limit_Outside_ABS ""
 /begin REF_CHARACTERISTIC TP_U8_DV_BASE_HIGH_FOR_F_OUT_ABS TP_U8_DV_BASE_HIGH_FOR_R_OUT_ABS TP_U8_DV_BASE_LOW_FOR_F_OUT_ABS TP_U8_DV_BASE_LOW_FOR_GMA TP_U8_DV_BASE_LOW_FOR_R_OUT_ABS TP_U8_DV_BASE_LOW_F_OUT_ABS_B40KPH /end REF_CHARACTERISTIC
 /begin SUB_GROUP a_ABS_enter_limit_by_slip /end SUB_GROUP
/end GROUP
/begin GROUP b_dV_Per_RoadMu ""
 /begin SUB_GROUP a_Before_AFZ_OK b_High_Mu c_Medium_Mu d_LowMed_Mu e_Low_Mu f_Split_Mu /end SUB_GROUP
/end GROUP
/begin GROUP b_dV_setting "" /begin SUB_GROUP a_dV_Common b_dV_Per_RoadMu /end SUB_GROUP /end GROUP
/begin GROUP ba.EHC_Wstr_Dot "" /begin SUB_GROUP EHC_Wstr_Dot_HM EHC_Wstr_Dot_MM /end SUB_GROUP /end GROUP
/begin GROUP ba.Rop_SS_Th ""
 /begin REF_CHARACTERISTIC TQS16_SS_PHI_DOT_TH_1st TQS16_SS_PHI_DOT_TH_2nd TQS16_SS_PHI_DOT_TH_3rd TQS16_SS_PHI_DOT_TH_4th TQS16_SS_PHI_TH_1st TQS16_SS_PHI_TH_2nd TQS16_SS_PHI_TH_3rd TQS16_SS_PHI_TH_4th /end REF_CHARACTERISTIC
/end GROUP
/begin GROUP ba.TC_Override ""
 /begin REF_CHARACTERISTIC TQS16_TC_OFFSET_ADD_Y1 TQS16_TC_OFFSET_ADD_Y2 TQS16_TC_OFFSET_ADD_Y3 TQS16_TC_OFFSET_ADD_Y4 TQS16_TC_OFFSET_ADD_Y5 TQU8_TC_OFFSET_GRAD_X1 TQU8_TC_OFFSET_GRAD_X2 TQU8_TC_OFFSET_GRAD_X3 TQU8_TC_OFFSET_GRAD_X4 TQU8_TC_OFFSET_GRAD_X5 TQU8_TC_RISE_SCAN_HIG_HMU TQU8_TC_RISE_SCAN_HIG_LMU TQU8_TC_RISE_SCAN_HIG_MMU TQU8_TC_RISE_SCAN_LOW_HMU TQU8_TC_RISE_SCAN_LOW_LMU TQU8_TC_RISE_SCAN_LOW_MMU TQU8_TC_RISE_SCAN_MED_HMU TQU8_TC_RISE_SCAN_MED_LMU TQU8_TC_RISE_SCAN_MED_MMU /end REF_CHARACTERISTIC
/end GROUP
/begin GROUP ba.TVBB_Enter_Speed ""
 /begin REF_CHARACTERISTIC TQS16_TVBB_ENTER_HSPD_LIMIT_HMU TQS16_TVBB_ENTER_HSPD_LIMIT_LMU TQS16_TVBB_ENTER_HSPD_LIMIT_MMU /end REF_CHARACTERISTIC
/end GROUP
/begin GROUP ba_AVH_Fast_Exit ""
 /begin REF_CHARACTERISTIC SSM_S16_AVH_F_END_E_TQ_LOW_MID_SLOP SSM_S16_AVH_F_END_E_TQ_MAX_SLOP SSM_S16_AVH_F_END_E_TQ_MID_SLOP SSM_S16_AVH_F_END_E_TQ_MIN_SLOP /end REF_CHARACTERISTIC
/end GROUP
/begin GROUP ba_BDW_Enter ""
 /begin REF_CHARACTERISTIC LPC_S16_BDW_ENABLE_DISK_TEMP LPC_S16_BDW_ENT_ALATM LPC_S16_BDW_ENT_MPRESS LPC_S16_BDW_ENT_MTP LPC_S16_BDW_ENT_SPEED LPC_S16_BDW_RAIN_DETECT_TIME LPC_U8_BDW_Initial_Clean_Enable /end REF_CHARACTERISTIC
/end GROUP
/begin GROUP ba_PBA_Enter_Threshold ""
 /begin REF_CHARACTERISTIC BAC_U16_PBA_ESP_MU_HIGH BAC_U16_PBA_ESP_MU_LOW BAC_U16_PBA_ESP_MU_MEDIUM BAC_U16_PBA_PRESS_ENTER_THR BAC_U16_PBA_PRESS_RISE_RATE_THR1 BAC_U16_PBA_PRESS_RISE_RATE_THR2 BAC_U16_PBA_SPEED_ENTER_THR /end REF_CHARACTERISTIC
/end GROUP
/begin GROUP bb.EHC_Yaw_Dot "" /begin REF_CHARACTERISTIC TQEHC_Select_Yawrate /end REF_CHARACTERISTIC /begin SUB_GROUP EHC_Yaw_Dot_HM EHC_Yaw_Dot_MM /end SUB_GROUP /end GROUP
/begin GROUP bb.Motor_Override ""
 /begin REF_CHARACTERISTIC TQS16_TORQ_GRAD_MOTOR_V_Y1 TQS16_TORQ_GRAD_MOTOR_V_Y2 TQS16_TORQ_GRAD_MOTOR_V_Y3 TQS16_TORQ_GRAD_MOTOR_V_Y4 TQS16_TORQ_GRAD_MOTOR_V_Y5 TQU8_MOT_V_TORQ_GRAD_X1 TQU8_MOT_V_TORQ_GRAD_X2 TQU8_MOT_V_TORQ_GRAD_X3 TQU8_MOT_V_TORQ_GRAD_X4 TQU8_MOT_V_TORQ_GRAD_X5 TQU8_RISE_SCAN_HIG_HMU TQU8_RISE_SCAN_HIG_LMU TQU8_RISE_SCAN_HIG_MMU TQU8_RISE_SCAN_LOW_HMU TQU8_RISE_SCAN_LOW_LMU TQU8_RISE_SCAN_LOW_MMU TQU8_RISE_SCAN_MED_HMU TQU8_RISE_SCAN_MED_LMU TQU8_RISE_SCAN_MED_MMU /end REF_CHARACTERISTIC
/end GROUP
/begin GROUP bb.Rop_DYN_Th ""
 /begin REF_CHARACTERISTIC TQS16_DYN_PHI_DOT_TH_1st TQS16_DYN_PHI_DOT_TH_2nd TQS16_DYN_PHI_DOT_TH_3rd TQS16_DYN_PHI_DOT_TH_4th TQS16_DYN_PHI_TH_1st TQS16_DYN_PHI_TH_2nd TQS16_DYN_PHI_TH_3rd TQS16_DYN_PHI_TH_4th /end REF_CHARACTERISTIC
/end GROUP
/begin GROUP bb.TVBB_Enter_DelYaw "" /begin SUB_GROUP TVBB_Enter_DelYaw_Weg /end SUB_GROUP /end GROUP
/begin GROUP bb_AVH_Sensitive_Enter ""
 /begin REF_CHARACTERISTIC SSM_U8_AVH_SENSITIVE_ENTER_DELAY SSM_U8_AVH_SENSITIVE_ENTER_THRES SSM_U8_AVH_SENSITIVE_ENT_HM_THRES SSM_U8_AVH_SENSITIVE_ENT_LM_THRES SSM_U8_AVH_SENSITIVE_ENT_MAX_THRES /end REF_CHARACTERISTIC
/end GROUP
/begin GROUP bb_BDW_Activation "" /begin REF_CHARACTERISTIC LPC_S16_BDW_ACTIVE_TIME LPC_S16_BDW_INTERVAL_TIME /end REF_CHARACTERISTIC /end GROUP
/begin GROUP bb_PBA_Exit_Threshold ""
 /begin REF_CHARACTERISTIC BAC_U16_PBA_BIG_SLOPE_EXIT_TIME1 BAC_U16_PBA_BIG_SLOPE_EXIT_TIME2 BAC_U16_PBA_PRESS_EXIT_THR1 BAC_U16_PBA_PRESS_EXIT_THR2 BAC_U16_PBA_SPEED_EXIT_THR /end REF_CHARACTERISTIC
/end GROUP
/begin GROUP bbb.TVBB_Enter_DelYaw ""
 /begin REF_CHARACTERISTIC TQS16_TVBB_DELTA_YAW_TH_HSP TQS16_TVBB_DELTA_YAW_TH_LSP TQS16_TVBB_DELTA_YAW_TH_MSP /end REF_CHARACTERISTIC
/end GROUP
/begin GROUP bc.EHC_Wstr_Peak "" /begin SUB_GROUP EHC_Wstr_Peak_HM EHC_Wstr_Peak_MM /end SUB_GROUP /end GROUP
/begin GROUP bc.EHC_Yaw_Peak "" /begin SUB_GROUP EHC_Yaw_Peak_HM EHC_Yaw_Peak_MM /end SUB_GROUP /end GROUP
/begin GROUP bc.Rop_Alat_Th ""
 /begin REF_CHARACTERISTIC TQS16_ROP_ENTER_ALAT_TH_1st TQS16_ROP_ENTER_ALAT_TH_2nd TQS16_ROP_ENTER_ALAT_TH_3rd TQS16_ROP_ENTER_ALAT_TH_4th TQS16_ROP_ENTER_ALAT_TH_5th TQS16_ROP_ENTER_ALAT_WEG_1st TQS16_ROP_ENTER_ALAT_WEG_2nd TQS16_ROP_ENTER_ALAT_WEG_3rd TQS16_ROP_ENTER_ALAT_WEG_4th TQS16_ROP_ENTER_ALAT_WEG_5th /end REF_CHARACTERISTIC
/end GROUP
/begin GROUP bc.TVBB_Enter_Slip ""
 /begin REF_CHARACTERISTIC TQS8_TVBB_ENTER_WHEEL_SPIN_H TQS8_TVBB_ENTER_WHEEL_SPIN_L TQS8_TVBB_ENTER_WHEEL_SPIN_M TQU8_TVBB_ENTER_SPIN_REF_ALATM_H TQU8_TVBB_ENTER_SPIN_REF_ALATM_L TQU8_TVBB_ENTER_SPIN_REF_ALATM_M /end REF_CHARACTERISTIC
/end GROUP
/begin GROUP bc_AVH_Cal_Idle_Torq "" /begin REF_CHARACTERISTIC SSM_S16_AVH_DEFAULT_IDLE_TORQ /end REF_CHARACTERISTIC /end GROUP
/begin GROUP bc_BDW_Exit ""
 /begin REF_CHARACTERISTIC LPC_S16_BDW_DISABLE_DISK_TEMP LPC_S16_BDW_EXT_ALATM LPC_S16_BDW_EXT_MPRESS LPC_S16_BDW_EXT_MTP LPC_S16_BDW_EXT_SPEED /end REF_CHARACTERISTIC
/end GROUP
/begin GROUP bc_PBA_Control ""
 /begin REF_CHARACTERISTIC BAC_PBA_EXIT_CONTROL_TIME BAC_S16_PBA_MAX_TARGET_PRESS BAC_U8_PBA_APPLY_TIME /end REF_CHARACTERISTIC
/end GROUP
/begin GROUP bd.EHC_Steer_Enter "" /begin SUB_GROUP EHC_Steer_Enter_HM EHC_Steer_Enter_MM /end SUB_GROUP /end GROUP
/begin GROUP bd.Rop_RI_Thres ""
 /begin REF_CHARACTERISTIC TQS16_ROP_RI_THRES_VEL_100K TQS16_ROP_RI_THRES_VEL_20K TQS16_ROP_RI_THRES_VEL_40K TQS16_ROP_RI_THRES_VEL_60K TQS16_ROP_RI_THRES_VEL_80K /end REF_CHARACTERISTIC
/end GROUP
/begin GROUP bd_AVH_Reserved ""
 /begin REF_CHARACTERISTIC SSM_S16_AVH_T_P_TEMP_1 SSM_S16_AVH_T_P_TEMP_10 SSM_S16_AVH_T_P_TEMP_2 SSM_S16_AVH_T_P_TEMP_3 SSM_S16_AVH_T_P_TEMP_4 SSM_S16_AVH_T_P_TEMP_5 SSM_S16_AVH_T_P_TEMP_6 SSM_S16_AVH_T_P_TEMP_7 SSM_S16_AVH_T_P_TEMP_8 SSM_S16_AVH_T_P_TEMP_9 /end REF_CHARACTERISTIC
/end GROUP
/begin GROUP bd_BDW_Reserved ""
 /begin REF_CHARACTERISTIC LPC_S16_BDW_Temp1 LPC_S16_BDW_Temp2 LPC_S16_BDW_Temp3 LPC_S16_BDW_Temp4 LPC_S16_BDW_Temp5 /end REF_CHARACTERISTIC
/end GROUP
/begin GROUP c.EHC_Tar_Torque ""
 /begin SUB_GROUP ca.EHC_Tq_Max ca.EHC_Tq_Weg cb.EHC_Tq_Inc cc.EHC_Tq_Dec cca.EHC_Tq_Weg ccb.EHC_Tq_Inc /end SUB_GROUP
/end GROUP
/begin GROUP c.Rop_Moment ""
 /begin REF_CHARACTERISTIC TQS16_ROP_MODEL_MU_LEVEL TQS16_ROP_MU_LEVEL_AY TQS16_ROP_TTP_FAST_VEL_DELAY TQS16_ROP_TTP_FAST_WSTR_DOT_DELAY TQS16_ROP_TTP_SLOW_VEL_DELAY TQS16_ROP_TTP_SLOW_WSTR_DOT_DELAY TQS16_ROP_TTP_VEL_FAST TQS16_ROP_TTP_VEL_SLOW TQS16_ROP_TTP_WSTR_DOT_FAST TQS16_ROP_TTP_WSTR_DOT_SLOW /end REF_CHARACTERISTIC
 /begin SUB_GROUP ca.Rop_Ay_Vx_Dot cb.Rop_Ay_Gain cc.Rop_Dump cc.Rop_Prefill cd.Rop_Press ce.Rop_Esc_Off_Mode /end SUB_GROUP
/end GROUP
/begin GROUP c.TVBB_Tar_Tq "" /begin REF_CHARACTERISTIC TQS16_TVBB_TQ_GRDT_LIMT /end REF_CHARACTERISTIC
 /begin SUB_GROUP ca.TVBB_Tar_Moment cb.TVBB_Tar_Mmt_Spd_Weg cc.TVBB_Tar_Mmt_Slip_Weg cd.TVBB_Fade_Out cd.TVBB_Tar_Tq_Cal /end SUB_GROUP
/end GROUP
/begin GROUP c.Tq_Gradient ""
 /begin REF_CHARACTERISTIC TQS16_DELYAW_OFFSET_TH_HMU TQS16_DELYAW_OFFSET_TH_LMU TQS16_DELYAW_OFFSET_TH_MMU TQS16_DELYAW_TH_ADD_ABS TQS16_DELYAW_TH_ADD_BY_SPLIT TQS16_OS2W_CTRL_NEG_OFFSET TQS16_TORQ_GRAD_MOTOR_V_Y1_HMU TQS16_TORQ_GRAD_MOTOR_V_Y1_LMU TQS16_TORQ_GRAD_MOTOR_V_Y1_MMU TQS16_TORQ_GRAD_MOTOR_V_Y1_US TQS16_TORQ_GRAD_MOTOR_V_Y2_HMU TQS16_TORQ_GRAD_MOTOR_V_Y2_LMU TQS16_TORQ_GRAD_MOTOR_V_Y2_MMU TQS16_TORQ_GRAD_MOTOR_V_Y2_US TQS16_TORQ_GRAD_MOTOR_V_Y3_HMU TQS16_TORQ_GRAD_MOTOR_V_Y3_LMU TQS16_TORQ_GRAD_MOTOR_V_Y3_MMU TQS16_TORQ_GRAD_MOTOR_V_Y3_US TQS16_TORQ_GRAD_MOTOR_V_Y4_HMU TQS16_TORQ_GRAD_MOTOR_V_Y4_LMU TQS16_TORQ_GRAD_MOTOR_V_Y4_MMU TQS16_TORQ_GRAD_MOTOR_V_Y4_US TQS16_TORQ_GRAD_MOTOR_V_Y5_HMU TQS16_TORQ_GRAD_MOTOR_V_Y5_LMU TQS16_TORQ_GRAD_MOTOR_V_Y5_MMU TQS16_TORQ_GRAD_MOTOR_V_Y5_US TQS16_TORQ_GRDT_DEC_LMT_HMU TQS16_TORQ_GRDT_DEC_LMT_LMU TQS16_TORQ_GRDT_DEC_LMT_MMU TQS16_TORQ_GRDT_F_BRK_LIMT_HMU TQS16_TORQ_GRDT_F_BRK_LIMT_LMU TQS16_TORQ_GRDT_F_BRK_LIMT_MMU TQS16_TORQ_GRDT_F_BRK_LIMT_SPLIT TQS16_TORQ_GRDT_F_LIMT_HMU TQS16_TORQ_GRDT_F_LIMT_LMU TQS16_TORQ_GRDT_F_LIMT_MMU TQS16_TORQ_GRDT_F_MAX_HMU_HSP TQS16_TORQ_GRDT_F_MAX_HMU_LSP TQS16_TORQ_GRDT_F_MAX_HMU_MSP TQS16_TORQ_GRDT_F_MAX_LMU_HSP TQS16_TORQ_GRDT_F_MAX_LMU_LSP TQS16_TORQ_GRDT_F_MAX_LMU_MSP TQS16_TORQ_GRDT_F_MAX_MMU_HSP TQS16_TORQ_GRDT_F_MAX_MMU_LSP TQS16_TORQ_GRDT_F_MAX_MMU_MSP TQS16_TORQ_GRDT_P_GAIN TQS16_TORQ_GRDT_P_GAIN_BRK TQS16_TORQ_GRDT_R_BRK_LIMT_HMU TQS16_TORQ_GRDT_R_BRK_LIMT_LMU TQS16_TORQ_GRDT_R_BRK_LIMT_MMU TQS16_TORQ_GRDT_R_BRK_LIMT_SPLIT TQS16_TORQ_GRDT_R_LIMT_HMU TQS16_TORQ_GRDT_R_LIMT_HMU_OS TQS16_TORQ_GRDT_R_LIMT_LMU TQS16_TORQ_GRDT_R_LIMT_LMU_OS TQS16_TORQ_GRDT_R_LIMT_MMU TQS16_TORQ_GRDT_R_LIMT_MMU_OS TQS16_TorqDec_ABS_Slip_2 TQS16_TorqDec_ABS_Slip_3 TQS16_TorqDec_ABS_Slip_4 TQS16_TorqDec_ABS_Slip_5 TQS16_TorqDec_Add_Slip_2 TQS16_TorqDec_Add_Slip_3 TQS16_TorqDec_Add_Slip_4 TQS16_TorqDec_Add_Slip_5 /end REF_CHARACTERISTIC
 /begin SUB_GROUP ca.Grad_Base cb.Grad_Add_YawAccel cc.Grad_Add_DelM cd.Grad_Max /end SUB_GROUP
/end GROUP
/begin GROUP c_40_60KPH ""
 /begin REF_CHARACTERISTIC TP_S8_Arad_1stPoint_40_60KPH TP_S8_Arad_2ndPoint_40_60KPH TP_S8_Arad_3rdPoint_40_60KPH TP_S8_Arad_Fact_1_2P_40_60KPH TP_S8_Arad_Fact_2_3P_40_60KPH TP_S8_Arad_Fact_Ab_3P_40_60KPH TP_S8_Arad_Fact_B_1P_40_60KPH /end REF_CHARACTERISTIC
/end GROUP
/begin GROUP c_BaseTorque_Turn ""
 /begin REF_CHARACTERISTIC TP_U8TCSCpBsAsmdMuDiffTurn_F[0] TP_U8TCSCpBsAsmdMuDiffTurn_F[1] TP_U8TCSCpBsAsmdMuDiffTurn_F[2] TP_U8TCSCpBsAsmdMuDiffTurn_F[3] TP_U8TCSCpBsAsmdMuDiffTurn_F[4] TP_U8TCSCpBsAsmdMuDiffTurn_R[0] TP_U8TCSCpBsAsmdMuDiffTurn_R[1] TP_U8TCSCpBsAsmdMuDiffTurn_R[2] TP_U8TCSCpBsAsmdMuDiffTurn_R[3] TP_U8TCSCpBsAsmdMuDiffTurn_R[4] /end REF_CHARACTERISTIC
/end GROUP
/begin GROUP c_Both_Over_Ctrl "" /begin SUB_GROUP a_Both_Over_F b_Both_Over_R /end SUB_GROUP /end GROUP
/begin GROUP c_CBC_Control_Ay_Level ""
 /begin REF_CHARACTERISTIC TP_S16_CBC_DELTA_PRESS_ALAT_LEVEL_H TP_S16_CBC_DELTA_PRESS_ALAT_LEVEL_L TP_S16_CBC_DELTA_PRESS_ALAT_LEVEL_M /end REF_CHARACTERISTIC
/end GROUP
/begin GROUP c_CBC_Enter_Decel_Thres ""
 /begin REF_CHARACTERISTIC TP_S16_CBC_DECEL_THRES_COMP_H TP_S16_CBC_DECEL_THRES_COMP_M TP_S16_CBC_DECEL_THRES_H TP_S16_CBC_DECEL_THRES_L TP_S16_CBC_DECEL_THRES_M /end REF_CHARACTERISTIC
/end GROUP
/begin GROUP c_CBC_abs_Control_Delta_P ""
 /begin REF_CHARACTERISTIC TP_S16_CBC_DELTA_PRESS_ABS_SPD_H TP_S16_CBC_DELTA_PRESS_ABS_SPD_M TP_S16_CBC_DELTA_PRESS_ABS_SPD_S /end REF_CHARACTERISTIC
/end GROUP
/begin GROUP c_Detection "" /begin SUB_GROUP a_Initial_cycle_Mu /end SUB_GROUP /end GROUP
/begin GROUP c_Dump_Scantime ""
 /begin SUB_GROUP a_HighMu_F_Dumptime b_HighMu_R_Dumptime c_MedMu_F_Dumptime d_MedMu_R_Dumptime e_LowMedMu_F_Dumptime f_LowMedMu_R_Dumptime g_LowMu_F_Dumptime h_LowMu_R_Dumptime i_1st_cycle /end SUB_GROUP
/end GROUP
/begin GROUP c_Dump_Scantime_Logic "" /begin REF_CHARACTERISTIC TP_U8_DEFAULT_DUMPSCANTIME TP_U8_STABDUMP_SCANTIME_F /end REF_CHARACTERISTIC /begin SUB_GROUP a_Split_Lowside_DumpScantime /end SUB_GROUP /end GROUP
/begin GROUP c_Duty_Pattern ""
 /begin REF_CHARACTERISTIC TP_S16_MINIMUM_EFFECTIVE_LFC_DUTY TP_U8_Hold_Timer_ABS_Limit_Speed TP_U8_Hold_Timer_New_Ref_High TP_U8_Hold_Timer_New_Ref_High_R TP_U8_Hold_Timer_New_Ref_Initial TP_U8_Hold_Timer_New_Ref_Low TP_U8_Hold_Timer_New_Ref_Low_R TP_U8_Hold_Timer_New_Ref_Med TP_U8_Hold_Timer_New_Ref_Med_R TP_U8_Hold_Timer_New_Ref_SpHigh_F TP_U8_LFC_Long_Hold_Comp_Duty_F TP_U8_LFC_Long_Hold_Comp_Duty_R TP_U8_LFC_built_cnt_F_High_Ref TP_U8_LFC_built_cnt_F_Low_B_15_Ref TP_U8_LFC_built_cnt_F_Low_Ref TP_U8_LFC_built_cnt_F_Med_Ref TP_U8_LFC_built_cnt_F_Rough_Ref TP_U8_LFC_built_cnt_F_SpHigh_Ref TP_U8_LFC_built_cnt_R_High_Ref TP_U8_LFC_built_cnt_R_Low_Ref TP_U8_LFC_built_cnt_R_Med_Ref TP_U8_LFC_built_cnt_R_Rough_Ref /end REF_CHARACTERISTIC
/end GROUP
/begin GROUP c_EBD_Cut_in_slip_Thres ""
 /begin SUB_GROUP a_EBD_slip_Thres_Initial b_Factor_for_arad c_Factor_for_Front_wheel /end SUB_GROUP
/end GROUP
/begin GROUP c_EBD_Dump "" /begin SUB_GROUP a_EBD_Dump_Gain b_EBD_Dump_Threshold c_EBD_Dump_Scantime /end SUB_GROUP /end GROUP
/begin GROUP c_EBD_Dump_Scantime "" /begin REF_CHARACTERISTIC TP_U8_1st_Dumpscantime_EBD_R TP_U8_nth_Dumpscantime_EBD_R /end REF_CHARACTERISTIC /end GROUP
/begin GROUP c_FBC ""
 /begin SUB_GROUP ca_FBC_Fade_Detection cb_FBC_Enter cc_FBC_Exit cd_FBC_Exit_Low_Mpress ce_FBC_Control cf_FBC_Reserved /end SUB_GROUP
/end GROUP
/begin GROUP c_Factor_for_Front_wheel ""
 /begin SUB_GROUP a_Front_positive_slip b_Front_slip_0_2_percent c_Front_slip_2_5_percent d_Front_slip_Above_5percent /end SUB_GROUP
/end GROUP
/begin GROUP c_Fadeout_turn_FA ""
 /begin REF_CHARACTERISTIC TP_S16TCSCpFadeOutCtrlHghPreTunTh_FA TP_S16TCSCpFadeOutCtrlLowPreTunTh_FA TP_S16TCSCpFadeOutDecTQ4HghPreTurn_FA TP_S16TCSCpFadeOutDecTQ4LowPreTurn_FA /end REF_CHARACTERISTIC
/end GROUP
/begin GROUP c_First_Cycle_LowMed_Ref_Front ""
 /begin REF_CHARACTERISTIC TP_S16_HDF_REF_MMu_40_60kph_F TP_S16_HDF_REF_MMu_Ab_60kph_F TP_S16_HDF_REF_MMu_B_40kph_F /end REF_CHARACTERISTIC
/end GROUP
/begin GROUP c_Front_slip_2_5_percent ""
 /begin REF_CHARACTERISTIC TP_S8_F_WL_Fact_ASum1G_Slip2_5P TP_S8_F_WL_Fact_ASum3G_Slip2_5P TP_S8_F_WL_Fact_ASumAb3G_Slip2_5P /end REF_CHARACTERISTIC
/end GROUP
/begin GROUP c_GMA ""
 /begin SUB_GROUP a_GMA_Speed_Reference b_GMA_Dump_time c_GMA_Pulse_up_Hold_scans d_GMA_Pulse_up_Reapply_time e_GMA_Clear f_GMA_LFC /end SUB_GROUP
/end GROUP
/begin GROUP c_GMA_PulseUp_HoldTim_Max "" /begin REF_CHARACTERISTIC TP_U8_GMA_HOLD_TIME_MAX /end REF_CHARACTERISTIC /end GROUP
/begin GROUP c_GMA_Pulse_up_Hold_scans "" /begin SUB_GROUP a_High_Speed b_Med_Speed /end SUB_GROUP /end GROUP
/begin GROUP c_HSA ""
 /begin SUB_GROUP ca_HSA_Enter_thres cb_HSA_Exit_thres cc_HSA_Press_Release cd_HSA_Logic_Tuning ce_HSA_Rise_thres cf_HSA_Status_Indication cg_HSA_Reserved /end SUB_GROUP
/end GROUP
/begin GROUP c_High_Mu_Gain_Front ""
 /begin REF_CHARACTERISTIC TP_S16_Decel_Gain_HMu_100_150kph_F TP_S16_Decel_Gain_HMu_10_20kph_F TP_S16_Decel_Gain_HMu_20_40kph_F TP_S16_Decel_Gain_HMu_40_60kph_F TP_S16_Decel_Gain_HMu_60_100kph_F TP_S16_Decel_Gain_HMu_Ab_150kph_F TP_S16_Decel_Gain_HMu_B_10kph_F TP_S16_Slip_Gain_HMu_100_150kph_F TP_S16_Slip_Gain_HMu_10_20kph_F TP_S16_Slip_Gain_HMu_20_40kph_F TP_S16_Slip_Gain_HMu_40_60kph_F TP_S16_Slip_Gain_HMu_60_100kph_F TP_S16_Slip_Gain_HMu_Ab_150kph_F TP_S16_Slip_Gain_HMu_B_10kph_F /end REF_CHARACTERISTIC
/end GROUP
/begin GROUP c_I_Effect "" /begin SUB_GROUP a_I_gain b_I_gain_Factor /end SUB_GROUP /end GROUP
/begin GROUP c_Igain_Turn ""
 /begin REF_CHARACTERISTIC TP_U8TCSCpBsTurnIG4ASFBCtl_F[0] TP_U8TCSCpBsTurnIG4ASFBCtl_F[1] TP_U8TCSCpBsTurnIG4ASFBCtl_F[2] TP_U8TCSCpBsTurnIG4ASFBCtl_F[3] TP_U8TCSCpBsTurnIG4ASFBCtl_F[4] TP_U8TCSCpBsTurnIG4ASFBCtl_R[0] TP_U8TCSCpBsTurnIG4ASFBCtl_R[1] TP_U8TCSCpBsTurnIG4ASFBCtl_R[2] TP_U8TCSCpBsTurnIG4ASFBCtl_R[3] TP_U8TCSCpBsTurnIG4ASFBCtl_R[4] /end REF_CHARACTERISTIC
/end GROUP
/begin GROUP c_L2H_Detection_Time ""
 /begin REF_CHARACTERISTIC TP_U8_L2H_DCT_DECEL_CNT_L TP_U8_L2H_DCT_DECEL_CNT_S TP_U8_L2H_STB_TIM_L_DECEL_F TP_U8_L2H_STB_TIM_L_DECEL_R TP_U8_L2H_STB_TIM_S_DECEL_F TP_U8_L2H_STB_TIM_S_DECEL_R TP_U8_L2Hsus_SP_STB_TIM_L_DEC_SUM TP_U8_L2Hsus_SP_STB_TIM_S_DEC_SUM1 TP_U8_L2Hsus_SP_STB_TIM_S_DEC_SUM2 TP_U8_L2Hsus_STB_TIM_L_DECEL_F1 TP_U8_L2Hsus_STB_TIM_L_DECEL_MIN TP_U8_L2Hsus_STB_TIM_L_DECEL_R1 TP_U8_L2Hsus_STB_TIM_L_DECEL_SUM TP_U8_L2Hsus_STB_TIM_S_DECEL_F1 TP_U8_L2Hsus_STB_TIM_S_DECEL_F2 TP_U8_L2Hsus_STB_TIM_S_DECEL_MIN TP_U8_L2Hsus_STB_TIM_S_DECEL_R1 TP_U8_L2Hsus_STB_TIM_S_DECEL_R2 TP_U8_L2Hsus_STB_TIM_S_DECEL_SUM1 TP_U8_L2Hsus_STB_TIM_S_DECEL_SUM2 /end REF_CHARACTERISTIC
/end GROUP
/begin GROUP c_L2SP_Detect "" /begin REF_CHARACTERISTIC TP_S8_L_to_Split_Duty_Diff1 TP_S8_L_to_Split_Duty_Diff2 /end REF_CHARACTERISTIC /end GROUP
/begin GROUP c_LFC_Logic ""
 /begin SUB_GROUP a_Cyclic_comp_disable b_Mu_Jump_Detect d_Big_Rise_Dump_Detect e_Mu_Change /end SUB_GROUP
/end GROUP
/begin GROUP c_Limit_Cornering_Brake ""
 /begin REF_CHARACTERISTIC TP_S16_LCB_ENTER_MAX_LATERAL_G TP_S16_LCB_EXIT_MIN_LATERAL_G TP_S8_LCB_ENTER_DEL_YAW_THRES TP_S8_LCB_EXIT_DEL_YAW_THRES TP_U8_LCB_MED_MU_DET_F_INS_SKID TP_U8_LCB_MED_MU_DET_F_OUT_SKID /end REF_CHARACTERISTIC
/end GROUP
/begin GROUP c_MedMu_F_Dumptime "" /begin REF_CHARACTERISTIC TP_U8_1st_Dumpscantime_MMu_F TP_U8_nth_Dumpscantime_MMu_F /end REF_CHARACTERISTIC /begin SUB_GROUP a_Low_Speed_MMu_F /end SUB_GROUP /end GROUP
/begin GROUP c_Med_High_Mu_UR_Thres "" /begin SUB_GROUP a_Front_MH b_Rear_MH /end SUB_GROUP /end GROUP
/begin GROUP c_Medium_Mu "" /begin SUB_GROUP a_Medium_Mu_Front b_Medium_Mu_Rear /end SUB_GROUP /end GROUP
/begin GROUP c_Medium_Mu_UR_Time "" /begin SUB_GROUP a_Front_M_T b_Rear_M_T /end SUB_GROUP /end GROUP
/begin GROUP c_Pgain_Turn ""
 /begin REF_CHARACTERISTIC TP_U8TCSCpBsTurnPG4ASFBCtlN_F[0] TP_U8TCSCpBsTurnPG4ASFBCtlN_F[1] TP_U8TCSCpBsTurnPG4ASFBCtlN_F[2] TP_U8TCSCpBsTurnPG4ASFBCtlN_F[3] TP_U8TCSCpBsTurnPG4ASFBCtlN_F[4] TP_U8TCSCpBsTurnPG4ASFBCtlN_R[0] TP_U8TCSCpBsTurnPG4ASFBCtlN_R[1] TP_U8TCSCpBsTurnPG4ASFBCtlN_R[2] TP_U8TCSCpBsTurnPG4ASFBCtlN_R[3] TP_U8TCSCpBsTurnPG4ASFBCtlN_R[4] TP_U8TCSCpBsTurnPG4ASFBCtlP_F[0] TP_U8TCSCpBsTurnPG4ASFBCtlP_F[1] TP_U8TCSCpBsTurnPG4ASFBCtlP_F[2] TP_U8TCSCpBsTurnPG4ASFBCtlP_F[3] TP_U8TCSCpBsTurnPG4ASFBCtlP_F[4] TP_U8TCSCpBsTurnPG4ASFBCtlP_R[0] TP_U8TCSCpBsTurnPG4ASFBCtlP_R[1] TP_U8TCSCpBsTurnPG4ASFBCtlP_R[2] TP_U8TCSCpBsTurnPG4ASFBCtlP_R[3] TP_U8TCSCpBsTurnPG4ASFBCtlP_R[4] /end REF_CHARACTERISTIC
/end GROUP
/begin GROUP c_Rise_Rate_Per_YDF "" /begin SUB_GROUP a_RiseHold_YDF_Ref b_RiseHold_Rate /end SUB_GROUP /end GROUP
/begin GROUP c_TargetSpin_Turn ""
 /begin REF_CHARACTERISTIC TP_U8TCSCpTarWhlSpinDiffTurn[0] TP_U8TCSCpTarWhlSpinDiffTurn[1] TP_U8TCSCpTarWhlSpinDiffTurn[2] TP_U8TCSCpTarWhlSpinDiffTurn[3] TP_U8TCSCpTarWhlSpinDiffTurn[4] /end REF_CHARACTERISTIC
/end GROUP
/begin GROUP c_Turnning_Asymmetric ""
 /begin REF_CHARACTERISTIC TP_S16TCSCpThOfAsymSpCtlInTurn[0] TP_S16TCSCpThOfAsymSpCtlInTurn[1] TP_S16TCSCpThOfAsymSpCtlInTurn[2] TP_S16TCSCpThOfAsymSpCtlInTurn[3] TP_S16TCSCpThOfAsymSpCtlInTurn[4] /end REF_CHARACTERISTIC
/end GROUP
/begin GROUP c_VCA ""
 /begin REF_CHARACTERISTIC TP_S16TCSCpBrkCtlTrqOfVCA TP_S16TCSCpCtlMotorV_VCA TP_S16TCSCpInitMaxMotorV_VCA TP_S16TCSCpInitMaxVCATCCurnt TP_S16TCSCpVcaBrkCtlTrqAxisAxMax TP_S16TCSCpVcaBrkCtlTrqAxisAxMin TP_S16TCSCpVcaBrkCtlTrqMax TP_S16TCSCpVcaBrkCtlTrqMin TP_S16TCSCpYawLim4VcaWhlSeln TP_U16_AX_RANGE_MAX TP_U8TCSCpIniVCACtlModeMtorTime TP_U8TCSCpIniVCACtlModeTime TP_U8TCSCpRearCtlOfVCA TP_U8TCSCpVcaActvOnlyAtBigSpinDtcd TP_U8_ACC_TH_VCA TP_U8_MAX_VCA_SUSTAIN_SCAN TP_U8_SPEED_TH_VCA TP_U8_SPIN_TH_VCA TP_U8_TCS_VCA_REENGAGE_ALLOW_TIME TP_U8_VREF_DECREASE_LIMIT_OF_VCA /end REF_CHARACTERISTIC
/end GROUP
/begin GROUP c_WpeBrkVolumPres ""
 /begin REF_CHARACTERISTIC S16_WPE_Caliper_Model_Press_1 S16_WPE_Caliper_Model_Press_10 S16_WPE_Caliper_Model_Press_11 S16_WPE_Caliper_Model_Press_12 S16_WPE_Caliper_Model_Press_13 S16_WPE_Caliper_Model_Press_14 S16_WPE_Caliper_Model_Press_15 S16_WPE_Caliper_Model_Press_16 S16_WPE_Caliper_Model_Press_2 S16_WPE_Caliper_Model_Press_3 S16_WPE_Caliper_Model_Press_4 S16_WPE_Caliper_Model_Press_5 S16_WPE_Caliper_Model_Press_6 S16_WPE_Caliper_Model_Press_7 S16_WPE_Caliper_Model_Press_8 S16_WPE_Caliper_Model_Press_9 /end REF_CHARACTERISTIC
/end GROUP
/begin GROUP c_WpeLfcHoldFront ""
 /begin REF_CHARACTERISTIC S16_WPE_LFC_Hold_press_f_10th S16_WPE_LFC_Hold_press_f_11th S16_WPE_LFC_Hold_press_f_12th S16_WPE_LFC_Hold_press_f_13th S16_WPE_LFC_Hold_press_f_14th S16_WPE_LFC_Hold_press_f_15th S16_WPE_LFC_Hold_press_f_16th S16_WPE_LFC_Hold_press_f_1st S16_WPE_LFC_Hold_press_f_2nd S16_WPE_LFC_Hold_press_f_3rd S16_WPE_LFC_Hold_press_f_4th S16_WPE_LFC_Hold_press_f_5th S16_WPE_LFC_Hold_press_f_6th S16_WPE_LFC_Hold_press_f_7th S16_WPE_LFC_Hold_press_f_8th S16_WPE_LFC_Hold_press_f_9th U8_WPE_LFC_Hold_Duty_f_10th U8_WPE_LFC_Hold_Duty_f_11th U8_WPE_LFC_Hold_Duty_f_12th U8_WPE_LFC_Hold_Duty_f_13th U8_WPE_LFC_Hold_Duty_f_14th U8_WPE_LFC_Hold_Duty_f_15th U8_WPE_LFC_Hold_Duty_f_16th U8_WPE_LFC_Hold_Duty_f_1st U8_WPE_LFC_Hold_Duty_f_2nd U8_WPE_LFC_Hold_Duty_f_3rd U8_WPE_LFC_Hold_Duty_f_4th U8_WPE_LFC_Hold_Duty_f_5th U8_WPE_LFC_Hold_Duty_f_6th U8_WPE_LFC_Hold_Duty_f_7th U8_WPE_LFC_Hold_Duty_f_8th U8_WPE_LFC_Hold_Duty_f_9th /end REF_CHARACTERISTIC
/end GROUP
/end MODULE
/end PROJECT
