ASAP2_VERSION 1 60
/begin PROJECT Master ""
/begin MODULE CPP ""
/begin MOD_COMMON "" BYTE_ORDER MSB_LAST ALIGNMENT_BYTE 1 ALIGNMENT_WORD 1 ALIGNMENT_LONG 1 ALIGNMENT_FLOAT32_IEEE 1 ALIGNMENT_FLOAT64_IEEE 1 ALIGNMENT_INT64 1 /end MOD_COMMON
/begin VARIANT_CODING
 /begin VAR_CHARACTERISTIC TQS16_ROP_WSTR_DOT_ENT_60K BrkCalVariantCriterion
  /begin VAR_ADDRESS 0x80020BF8 0x80023FF8 0x800273F8 0x8002A7F8 0x8002DBF8 0x80030FF8 0x800343F8 0x800377F8 /end VAR_ADDRESS
 /end VAR_CHARACTERISTIC
 /begin VAR_CHARACTERISTIC TQS16_ROP_WSTR_DOT_ENT_70K BrkCalVariantCriterion
  /begin VAR_ADDRESS 0x80020BFA 0x80023FFA 0x800273FA 0x8002A7FA 0x8002DBFA 0x80030FFA 0x800343FA 0x800377FA /end VAR_ADDRESS
 /end VAR_CHARACTERISTIC
 /begin VAR_CHARACTERISTIC TQS16_ROP_WSTR_DOT_ENT_80K BrkCalVariantCriterion
  /begin VAR_ADDRESS 0x80020BFC 0x80023FFC 0x800273FC 0x8002A7FC 0x8002DBFC 0x80030FFC 0x800343FC 0x800377FC /end VAR_ADDRESS
 /end VAR_CHARACTERISTIC
 /begin VAR_CHARACTERISTIC TQS16_ROP_WSTR_DOT_EXT_100K BrkCalVariantCriterion
  /begin VAR_ADDRESS 0x80020BFE 0x80023FFE 0x800273FE 0x8002A7FE 0x8002DBFE 0x80030FFE 0x800343FE 0x800377FE /end VAR_ADDRESS
 /end VAR_CHARACTERISTIC
 /begin VAR_CHARACTERISTIC TQS16_ROP_WSTR_DOT_EXT_120K BrkCalVariantCriterion
  /begin VAR_ADDRESS 0x80020C00 0x80024000 0x80027400 0x8002A800 0x8002DC00 0x80031000 0x80034400 0x80037800 /end VAR_ADDRESS
 /end VAR_CHARACTERISTIC
 /begin VAR_CHARACTERISTIC TQS16_ROP_WSTR_DOT_EXT_40K BrkCalVariantCriterion
  /begin VAR_ADDRESS 0x80020C02 0x80024002 0x80027402 0x8002A802 0x8002DC02 0x80031002 0x80034402 0x80037802 /end VAR_ADDRESS
 /end VAR_CHARACTERISTIC
 /begin VAR_CHARACTERISTIC TQS16_ROP_WSTR_DOT_EXT_50K BrkCalVariantCriterion
  /begin VAR_ADDRESS 0x80020C04 0x80024004 0x80027404 0x8002A804 0x8002DC04 0x80031004 0x80034404 0x80037804 /end VAR_ADDRESS
 /end VAR_CHARACTERISTIC
 /begin VAR_CHARACTERISTIC TQS16_ROP_WSTR_DOT_EXT_60K BrkCalVariantCriterion
  /begin VAR_ADDRESS 0x80020C06 0x80024006 0x80027406 0x8002A806 0x8002DC06 0x80031006 0x80034406 0x80037806 /end VAR_ADDRESS
 /end VAR_CHARACTERISTIC
 /begin VAR_CHARACTERISTIC TQS16_ROP_WSTR_DOT_EXT_70K BrkCalVariantCriterion
  /begin VAR_ADDRESS 0x80020C08 0x80024008 0x80027408 0x8002A808 0x8002DC08 0x80031008 0x80034408 0x80037808 /end VAR_ADDRESS
 /end VAR_CHARACTERISTIC
 /begin VAR_CHARACTERISTIC TQS16_ROP_WSTR_DOT_EXT_80K BrkCalVariantCriterion
  /begin VAR_ADDRESS 0x80020C0A 0x8002400A 0x8002740A 0x8002A80A 0x8002DC0A 0x8003100A 0x8003440A 0x8003780A /end VAR_ADDRESS
 /end VAR_CHARACTERISTIC
 /begin VAR_CHARACTERISTIC TQS16_ROP_YAW_DOT_ENT_100K BrkCalVariantCriterion
  /begin VAR_ADDRESS 0x80020BD4 0x80023FD4 0x800273D4 0x8002A7D4 0x8002DBD4 0x80030FD4 0x800343D4 0x800377D4 /end VAR_ADDRESS
 /end VAR_CHARACTERISTIC
 /begin VAR_CHARACTERISTIC TQS16_ROP_YAW_DOT_ENT_120K BrkCalVariantCriterion
  /begin VAR_ADDRESS 0x80020BD6 0x80023FD6 0x800273D6 0x8002A7D6 0x8002DBD6 0x80030FD6 0x800343D6 0x800377D6 /end VAR_ADDRESS
 /end VAR_CHARACTERISTIC
 /begin VAR_CHARACTERISTIC TQS16_ROP_YAW_DOT_ENT_40K BrkCalVariantCriterion
  /begin VAR_ADDRESS 0x80020BD8 0x80023FD8 0x800273D8 0x8002A7D8 0x8002DBD8 0x80030FD8 0x800343D8 0x800377D8 /end VAR_ADDRESS
 /end VAR_CHARACTERISTIC
 /begin VAR_CHARACTERISTIC TQS16_ROP_YAW_DOT_ENT_50K BrkCalVariantCriterion
  /begin VAR_ADDRESS 0x80020BDA 0x80023FDA 0x800273DA 0x8002A7DA 0x8002DBDA 0x80030FDA 0x800343DA 0x800377DA /end VAR_ADDRESS
 /end VAR_CHARACTERISTIC
 /begin VAR_CHARACTERISTIC TQS16_ROP_YAW_DOT_ENT_60K BrkCalVariantCriterion
  /begin VAR_ADDRESS 0x80020BDC 0x80023FDC 0x800273DC 0x8002A7DC 0x8002DBDC 0x80030FDC 0x800343DC 0x800377DC /end VAR_ADDRESS
 /end VAR_CHARACTERISTIC
 /begin VAR_CHARACTERISTIC TQS16_ROP_YAW_DOT_ENT_70K BrkCalVariantCriterion
  /begin VAR_ADDRESS 0x80020BDE 0x80023FDE 0x800273DE 0x8002A7DE 0x8002DBDE 0x80030FDE 0x800343DE 0x800377DE /end VAR_ADDRESS
 /end VAR_CHARACTERISTIC
 /begin VAR_CHARACTERISTIC TQS16_ROP_YAW_DOT_ENT_80K BrkCalVariantCriterion
  /begin VAR_ADDRESS 0x80020BE0 0x80023FE0 0x800273E0 0x8002A7E0 0x8002DBE0 0x80030FE0 0x800343E0 0x800377E0 /end VAR_ADDRESS
 /end VAR_CHARACTERISTIC
 /begin VAR_CHARACTERISTIC TQS16_ROP_YAW_DOT_EXT_100K BrkCalVariantCriterion
  /begin VAR_ADDRESS 0x80020BE2 0x80023FE2 0x800273E2 0x8002A7E2 0x8002DBE2 0x80030FE2 0x800343E2 0x800377E2 /end VAR_ADDRESS
 /end VAR_CHARACTERISTIC
 /begin VAR_CHARACTERISTIC TQS16_ROP_YAW_DOT_EXT_120K BrkCalVariantCriterion
  /begin VAR_ADDRESS 0x80020BE4 0x80023FE4 0x800273E4 0x8002A7E4 0x8002DBE4 0x80030FE4 0x800343E4 0x800377E4 /end VAR_ADDRESS
 /end VAR_CHARACTERISTIC
 /begin VAR_CHARACTERISTIC TQS16_ROP_YAW_DOT_EXT_40K BrkCalVariantCriterion
  /begin VAR_ADDRESS 0x80020BE6 0x80023FE6 0x800273E6 0x8002A7E6 0x8002DBE6 0x80030FE6 0x800343E6 0x800377E6 /end VAR_ADDRESS
 /end VAR_CHARACTERISTIC
 /begin VAR_CHARACTERISTIC TQS16_ROP_YAW_DOT_EXT_50K BrkCalVariantCriterion
  /begin VAR_ADDRESS 0x80020BE8 0x80023FE8 0x800273E8 0x8002A7E8 0x8002DBE8 0x80030FE8 0x800343E8 0x800377E8 /end VAR_ADDRESS
 /end VAR_CHARACTERISTIC
 /begin VAR_CHARACTERISTIC TQS16_ROP_YAW_DOT_EXT_60K BrkCalVariantCriterion
  /begin VAR_ADDRESS 0x80020BEA 0x80023FEA 0x800273EA 0x8002A7EA 0x8002DBEA 0x80030FEA 0x800343EA 0x800377EA /end VAR_ADDRESS
 /end VAR_CHARACTERISTIC
 /begin VAR_CHARACTERISTIC TQS16_ROP_YAW_DOT_EXT_70K BrkCalVariantCriterion
  /begin VAR_ADDRESS 0x80020BEC 0x80023FEC 0x800273EC 0x8002A7EC 0x8002DBEC 0x80030FEC 0x800343EC 0x800377EC /end VAR_ADDRESS
 /end VAR_CHARACTERISTIC
 /begin VAR_CHARACTERISTIC TQS16_ROP_YAW_DOT_EXT_80K BrkCalVariantCriterion
  /begin VAR_ADDRESS 0x80020BEE 0x80023FEE 0x800273EE 0x8002A7EE 0x8002DBEE 0x80030FEE 0x800343EE 0x800377EE /end VAR_ADDRESS
 /end VAR_CHARACTERISTIC
 /begin VAR_CHARACTERISTIC TQS16_SATBLE_FRT_TAR_SLIP_WEG BrkCalVariantCriterion
  /begin VAR_ADDRESS 0x80020D4A 0x8002414A 0x8002754A 0x8002A94A 0x8002DD4A 0x8003114A 0x8003454A 0x8003794A /end VAR_ADDRESS
 /end VAR_CHARACTERISTIC
 /begin VAR_CHARACTERISTIC TQS16_SHAFT_TORQ_WEG BrkCalVariantCriterion
  /begin VAR_ADDRESS 0x8002081E 0x80023C1E 0x8002701E 0x8002A41E 0x8002D81E 0x80030C1E 0x8003401E 0x8003741E /end VAR_ADDRESS
 /end VAR_CHARACTERISTIC
 /begin VAR_CHARACTERISTIC TQS16_SLIP_TAR_X1_HMU BrkCalVariantCriterion
  /begin VAR_ADDRESS 0x80020E52 0x80024252 0x80027652 0x8002AA52 0x8002DE52 0x80031252 0x80034652 0x80037A52 /end VAR_ADDRESS
 /end VAR_CHARACTERISTIC
 /begin VAR_CHARACTERISTIC TQS16_SLIP_TAR_X1_LMU BrkCalVariantCriterion
  /begin VAR_ADDRESS 0x80020E46 0x80024246 0x80027646 0x8002AA46 0x8002DE46 0x80031246 0x80034646 0x80037A46 /end VAR_ADDRESS
 /end VAR_CHARACTERISTIC
 /begin VAR_CHARACTERISTIC TQS16_SLIP_TAR_X1_MMU BrkCalVariantCriterion
  /begin VAR_ADDRESS 0x80020E4C 0x8002424C 0x8002764C 0x8002AA4C 0x8002DE4C 0x8003124C 0x8003464C 0x80037A4C /end VAR_ADDRESS
 /end VAR_CHARACTERISTIC
 /begin VAR_CHARACTERISTIC TQS16_SLIP_TAR_X2_HMU BrkCalVariantCriterion
  /begin VAR_ADDRESS 0x80020E54 0x80024254 0x80027654 0x8002AA54 0x8002DE54 0x80031254 0x80034654 0x80037A54 /end VAR_ADDRESS
 /end VAR_CHARACTERISTIC
 /begin VAR_CHARACTERISTIC TQS16_SLIP_TAR_X2_LMU BrkCalVariantCriterion
  /begin VAR_ADDRESS 0x80020E48 0x80024248 0x80027648 0x8002AA48 0x8002DE48 0x80031248 0x80034648 0x80037A48 /end VAR_ADDRESS
 /end VAR_CHARACTERISTIC
 /begin VAR_CHARACTERISTIC TQS16_SLIP_TAR_X2_MMU BrkCalVariantCriterion
  /begin VAR_ADDRESS 0x80020E4E 0x8002424E 0x8002764E 0x8002AA4E 0x8002DE4E 0x8003124E 0x8003464E 0x80037A4E /end VAR_ADDRESS
 /end VAR_CHARACTERISTIC
 /begin VAR_CHARACTERISTIC TQS16_SLIP_TAR_X3_HMU BrkCalVariantCriterion
  /begin VAR_ADDRESS 0x80020E56 0x80024256 0x80027656 0x8002AA56 0x8002DE56 0x80031256 0x80034656 0x80037A56 /end VAR_ADDRESS
 /end VAR_CHARACTERISTIC
 /begin VAR_CHARACTERISTIC TQS16_SLIP_TAR_X3_LMU BrkCalVariantCriterion
  /begin VAR_ADDRESS 0x80020E4A 0x8002424A 0x8002764A 0x8002AA4A 0x8002DE4A 0x8003124A 0x8003464A 0x80037A4A /end VAR_ADDRESS
 /end VAR_CHARACTERISTIC
 /begin VAR_CHARACTERISTIC TQS16_SLIP_TAR_X3_MMU BrkCalVariantCriterion
  /begin VAR_ADDRESS 0x80020E50 0x80024250 0x80027650 0x8002AA50 0x8002DE50 0x80031250 0x80034650 0x80037A50 /end VAR_ADDRESS
 /end VAR_CHARACTERISTIC
 /begin VAR_CHARACTERISTIC TQS16_SPEED_THR_HIG BrkCalVariantCriterion
  /begin VAR_ADDRESS 0x800209DE 0x80023DDE 0x800271DE 0x8002A5DE 0x8002D9DE 0x80030DDE 0x800341DE 0x800375DE /end VAR_ADDRESS
 /end VAR_CHARACTERISTIC
 /begin VAR_CHARACTERISTIC TQS16_SPEED_THR_LOW BrkCalVariantCriterion
  /begin VAR_ADDRESS 0x800209DA 0x80023DDA 0x800271DA 0x8002A5DA 0x8002D9DA 0x80030DDA 0x800341DA 0x800375DA /end VAR_ADDRESS
 /end VAR_CHARACTERISTIC
 /begin VAR_CHARACTERISTIC TQS16_SPEED_THR_MED BrkCalVariantCriterion
  /begin VAR_ADDRESS 0x800209DC 0x80023DDC 0x800271DC 0x8002A5DC 0x8002D9DC 0x80030DDC 0x800341DC 0x800375DC /end VAR_ADDRESS
 /end VAR_CHARACTERISTIC
 /begin VAR_CHARACTERISTIC TQS16_SPLIT_FRT_TAR_SLIP_MAX BrkCalVariantCriterion
  /begin VAR_ADDRESS 0x80020824 0x80023C24 0x80027024 0x8002A424 0x8002D824 0x80030C24 0x80034024 0x80037424 /end VAR_ADDRESS
 /end VAR_CHARACTERISTIC
 /begin VAR_CHARACTERISTIC TQS16_SPLIT_REAR_TAR_SLIP_MAX BrkCalVariantCriterion
  /begin VAR_ADDRESS 0x80020826 0x80023C26 0x80027026 0x8002A426 0x8002D826 0x80030C26 0x80034026 0x80037426 /end VAR_ADDRESS
 /end VAR_CHARACTERISTIC
 /begin VAR_CHARACTERISTIC TQS16_SS_PHI_DOT_TH_1st BrkCalVariantCriterion
  /begin VAR_ADDRESS 0x80020B28 0x80023F28 0x80027328 0x8002A728 0x8002DB28 0x80030F28 0x80034328 0x80037728 /end VAR_ADDRESS
 /end VAR_CHARACTERISTIC
 /begin VAR_CHARACTERISTIC TQS16_SS_PHI_DOT_TH_2nd BrkCalVariantCriterion
  /begin VAR_ADDRESS 0x80020B2A 0x80023F2A 0x8002732A 0x8002A72A 0x8002DB2A 0x80030F2A 0x8003432A 0x8003772A /end VAR_ADDRESS
 /end VAR_CHARACTERISTIC
 /begin VAR_CHARACTERISTIC TQS16_SS_PHI_DOT_TH_3rd BrkCalVariantCriterion
  /begin VAR_ADDRESS 0x80020B2C 0x80023F2C 0x8002732C 0x8002A72C 0x8002DB2C 0x80030F2C 0x8003432C 0x8003772C /end VAR_ADDRESS
 /end VAR_CHARACTERISTIC
 /begin VAR_CHARACTERISTIC TQS16_SS_PHI_DOT_TH_4th BrkCalVariantCriterion
  /begin VAR_ADDRESS 0x80020B2E 0x80023F2E 0x8002732E 0x8002A72E 0x8002DB2E 0x80030F2E 0x8003432E 0x8003772E /end VAR_ADDRESS
 /end VAR_CHARACTERISTIC
 /begin VAR_CHARACTERISTIC TQS16_SS_PHI_TH_1st BrkCalVariantCriterion
  /begin VAR_ADDRESS 0x80020B30 0x80023F30 0x80027330 0x8002A730 0x8002DB30 0x80030F30 0x80034330 0x80037730 /end VAR_ADDRESS
 /end VAR_CHARACTERISTIC
 /begin VAR_CHARACTERISTIC TQS16_SS_PHI_TH_2nd BrkCalVariantCriterion
  /begin VAR_ADDRESS 0x80020B32 0x80023F32 0x80027332 0x8002A732 0x8002DB32 0x80030F32 0x80034332 0x80037732 /end VAR_ADDRESS
 /end VAR_CHARACTERISTIC
 /begin VAR_CHARACTERISTIC TQS16_SS_PHI_TH_3rd BrkCalVariantCriterion
  /begin VAR_ADDRESS 0x80020B34 0x80023F34 0x80027334 0x8002A734 0x8002DB34 0x80030F34 0x80034334 0x80037734 /end VAR_ADDRESS
 /end VAR_CHARACTERISTIC
 /begin VAR_CHARACTERISTIC TQS16_SS_PHI_TH_4th BrkCalVariantCriterion
  /begin VAR_ADDRESS 0x80020B36 0x80023F36 0x80027336 0x8002A736 0x8002DB36 0x80030F36 0x80034336 0x80037736 /end VAR_ADDRESS
 /end VAR_CHARACTERISTIC
 /begin VAR_CHARACTERISTIC TQS16_SS_WSTR_DOT_MAX BrkCalVariantCriterion
  /begin VAR_ADDRESS 0x80020B5E 0x80023F5E 0x8002735E 0x8002A75E 0x8002DB5E 0x80030F5E 0x8003435E 0x8003775E /end VAR_ADDRESS
 /end VAR_CHARACTERISTIC
 /begin VAR_CHARACTERISTIC TQS16_STABLE_FRT_TAR_SLIP_MAX BrkCalVariantCriterion
  /begin VAR_ADDRESS 0x80020D4C 0x8002414C 0x8002754C 0x8002A94C 0x8002DD4C 0x8003114C 0x8003454C 0x8003794C /end VAR_ADDRESS
 /end VAR_CHARACTERISTIC
 /begin VAR_CHARACTERISTIC TQS16_STABLE_OS2W_REAR_TAR_PRESS_MAX BrkCalVariantCriterion
  /begin VAR_ADDRESS 0x80020C9C 0x8002409C 0x8002749C 0x8002A89C 0x8002DC9C 0x8003109C 0x8003449C 0x8003789C /end VAR_ADDRESS
 /end VAR_CHARACTERISTIC
 /begin VAR_CHARACTERISTIC TQS16_STABLE_REAR_TAR_SLIP_MAX BrkCalVariantCriterion
  /begin VAR_ADDRESS 0x80020C9A 0x8002409A 0x8002749A 0x8002A89A 0x8002DC9A 0x8003109A 0x8003449A 0x8003789A /end VAR_ADDRESS
 /end VAR_CHARACTERISTIC
 /begin VAR_CHARACTERISTIC TQS16_STEERING_MAX_DEG BrkCalVariantCriterion
  /begin VAR_ADDRESS 0x80020078 0x80023478 0x80026878 0x80029C78 0x8002D078 0x80030478 0x80033878 0x80036C78 /end VAR_ADDRESS
 /end VAR_CHARACTERISTIC
 /begin VAR_CHARACTERISTIC TQS16_STEERING_RATIO_10 BrkCalVariantCriterion
  /begin VAR_ADDRESS 0x80020042 0x80023442 0x80026842 0x80029C42 0x8002D042 0x80030442 0x80033842 0x80036C42 /end VAR_ADDRESS
 /end VAR_CHARACTERISTIC
 /begin VAR_CHARACTERISTIC TQS16_STEER_FRT_TAR_PRESS_MAX BrkCalVariantCriterion
  /begin VAR_ADDRESS 0x80020C9E 0x8002409E 0x8002749E 0x8002A89E 0x8002DC9E 0x8003109E 0x8003449E 0x8003789E /end VAR_ADDRESS
 /end VAR_CHARACTERISTIC
 /begin VAR_CHARACTERISTIC TQS16_STEER_FRT_TAR_SLIP_MAX BrkCalVariantCriterion
  /begin VAR_ADDRESS 0x80020820 0x80023C20 0x80027020 0x8002A420 0x8002D820 0x80030C20 0x80034020 0x80037420 /end VAR_ADDRESS
 /end VAR_CHARACTERISTIC
 /begin VAR_CHARACTERISTIC TQS16_STEER_REAR_TAR_PRESS_MAX BrkCalVariantCriterion
  /begin VAR_ADDRESS 0x80020CA0 0x800240A0 0x800274A0 0x8002A8A0 0x8002DCA0 0x800310A0 0x800344A0 0x800378A0 /end VAR_ADDRESS
 /end VAR_CHARACTERISTIC
 /begin VAR_CHARACTERISTIC TQS16_STEER_REAR_TAR_SLIP_MAX BrkCalVariantCriterion
  /begin VAR_ADDRESS 0x80020822 0x80023C22 0x80027022 0x8002A422 0x8002D822 0x80030C22 0x80034022 0x80037422 /end VAR_ADDRESS
 /end VAR_CHARACTERISTIC
 /begin VAR_CHARACTERISTIC TQS16_STR_1st_Point BrkCalVariantCriterion
  /begin VAR_ADDRESS 0x8002006E 0x8002346E 0x8002686E 0x80029C6E 0x8002D06E 0x8003046E 0x8003386E 0x80036C6E /end VAR_ADDRESS
 /end VAR_CHARACTERISTIC
 /begin VAR_CHARACTERISTIC TQS16_STR_2nd_Point BrkCalVariantCriterion
  /begin VAR_ADDRESS 0x80020070 0x80023470 0x80026870 0x80029C70 0x8002D070 0x80030470 0x80033870 0x80036C70 /end VAR_ADDRESS
 /end VAR_CHARACTERISTIC
 /begin VAR_CHARACTERISTIC TQS16_STR_3rd_Point BrkCalVariantCriterion
  /begin VAR_ADDRESS 0x80020072 0x80023472 0x80026872 0x80029C72 0x8002D072 0x80030472 0x80033872 0x80036C72 /end VAR_ADDRESS
 /end VAR_CHARACTERISTIC
 /begin VAR_CHARACTERISTIC TQS16_STR_4th_Point BrkCalVariantCriterion
  /begin VAR_ADDRESS 0x80020074 0x80023474 0x80026874 0x80029C74 0x8002D074 0x80030474 0x80033874 0x80036C74 /end VAR_ADDRESS
 /end VAR_CHARACTERISTIC
 /begin VAR_CHARACTERISTIC TQS16_STR_5th_Point BrkCalVariantCriterion
  /begin VAR_ADDRESS 0x80020076 0x80023476 0x80026876 0x80029C76 0x8002D076 0x80030476 0x80033876 0x80036C76 /end VAR_ADDRESS
 /end VAR_CHARACTERISTIC
 /begin VAR_CHARACTERISTIC TQS16_STR_RATIO_10_1st BrkCalVariantCriterion
  /begin VAR_ADDRESS 0x8002007A 0x8002347A 0x8002687A 0x80029C7A 0x8002D07A 0x8003047A 0x8003387A 0x80036C7A /end VAR_ADDRESS
 /end VAR_CHARACTERISTIC
 /begin VAR_CHARACTERISTIC TQS16_STR_RATIO_10_2nd BrkCalVariantCriterion
  /begin VAR_ADDRESS 0x8002007C 0x8002347C 0x8002687C 0x80029C7C 0x8002D07C 0x8003047C 0x8003387C 0x80036C7C /end VAR_ADDRESS
 /end VAR_CHARACTERISTIC
 /begin VAR_CHARACTERISTIC TQS16_STR_RATIO_10_3rd BrkCalVariantCriterion
  /begin VAR_ADDRESS 0x8002007E 0x8002347E 0x8002687E 0x80029C7E 0x8002D07E 0x8003047E 0x8003387E 0x80036C7E /end VAR_ADDRESS
 /end VAR_CHARACTERISTIC
 /begin VAR_CHARACTERISTIC TQS16_STR_RATIO_10_4th BrkCalVariantCriterion
  /begin VAR_ADDRESS 0x80020080 0x80023480 0x80026880 0x80029C80 0x8002D080 0x80030480 0x80033880 0x80036C80 /end VAR_ADDRESS
 /end VAR_CHARACTERISTIC
 /begin VAR_CHARACTERISTIC TQS16_STR_RATIO_10_5th BrkCalVariantCriterion
  /begin VAR_ADDRESS 0x80020082 0x80023482 0x80026882 0x80029C82 0x8002D082 0x80030482 0x80033882 0x80036C82 /end VAR_ADDRESS
 /end VAR_CHARACTERISTIC
 /begin VAR_CHARACTERISTIC TQS16_STR_RATIO_10_MAX BrkCalVariantCriterion
  /begin VAR_ADDRESS 0x80020084 0x80023484 0x80026884 0x80029C84 0x8002D084 0x80030484 0x80033884 0x80036C84 /end VAR_ADDRESS
 /end VAR_CHARACTERISTIC
 /begin VAR_CHARACTERISTIC TQS16_TC_OFFSET_ADD_Y1 BrkCalVariantCriterion
  /begin VAR_ADDRESS 0x800207CE 0x80023BCE 0x80026FCE 0x8002A3CE 0x8002D7CE 0x80030BCE 0x80033FCE 0x800373CE /end VAR_ADDRESS
 /end VAR_CHARACTERISTIC
 /begin VAR_CHARACTERISTIC TQS16_TC_OFFSET_ADD_Y2 BrkCalVariantCriterion
  /begin VAR_ADDRESS 0x800207D0 0x80023BD0 0x80026FD0 0x8002A3D0 0x8002D7D0 0x80030BD0 0x80033FD0 0x800373D0 /end VAR_ADDRESS
 /end VAR_CHARACTERISTIC
 /begin VAR_CHARACTERISTIC TQS16_TC_OFFSET_ADD_Y3 BrkCalVariantCriterion
  /begin VAR_ADDRESS 0x800207D2 0x80023BD2 0x80026FD2 0x8002A3D2 0x8002D7D2 0x80030BD2 0x80033FD2 0x800373D2 /end VAR_ADDRESS
 /end VAR_CHARACTERISTIC
 /begin VAR_CHARACTERISTIC TQS16_TC_OFFSET_ADD_Y4 BrkCalVariantCriterion
  /begin VAR_ADDRESS 0x800207D4 0x80023BD4 0x80026FD4 0x8002A3D4 0x8002D7D4 0x80030BD4 0x80033FD4 0x800373D4 /end VAR_ADDRESS
 /end VAR_CHARACTERISTIC
 /begin VAR_CHARACTERISTIC TQS16_TC_OFFSET_ADD_Y5 BrkCalVariantCriterion
  /begin VAR_ADDRESS 0x800207D6 0x80023BD6 0x80026FD6 0x8002A3D6 0x8002D7D6 0x80030BD6 0x80033FD6 0x800373D6 /end VAR_ADDRESS
 /end VAR_CHARACTERISTIC
 /begin VAR_CHARACTERISTIC TQS16_TORQ_BASE_ADD_HMU BrkCalVariantCriterion
  /begin VAR_ADDRESS 0x80020CA6 0x800240A6 0x800274A6 0x8002A8A6 0x8002DCA6 0x800310A6 0x800344A6 0x800378A6 /end VAR_ADDRESS
 /end VAR_CHARACTERISTIC
 /begin VAR_CHARACTERISTIC TQS16_TORQ_BASE_ADD_HMU_MP_X1 BrkCalVariantCriterion
  /begin VAR_ADDRESS 0x80020E88 0x80024288 0x80027688 0x8002AA88 0x8002DE88 0x80031288 0x80034688 0x80037A88 /end VAR_ADDRESS
 /end VAR_CHARACTERISTIC
 /begin VAR_CHARACTERISTIC TQS16_TORQ_BASE_ADD_HMU_MP_X2 BrkCalVariantCriterion
  /begin VAR_ADDRESS 0x80020E8A 0x8002428A 0x8002768A 0x8002AA8A 0x8002DE8A 0x8003128A 0x8003468A 0x80037A8A /end VAR_ADDRESS
 /end VAR_CHARACTERISTIC
 /begin VAR_CHARACTERISTIC TQS16_TORQ_BASE_ADD_HMU_MP_X3 BrkCalVariantCriterion
  /begin VAR_ADDRESS 0x80020E8C 0x8002428C 0x8002768C 0x8002AA8C 0x8002DE8C 0x8003128C 0x8003468C 0x80037A8C /end VAR_ADDRESS
 /end VAR_CHARACTERISTIC
 /begin VAR_CHARACTERISTIC TQS16_TORQ_BASE_ADD_HMU_MP_X4 BrkCalVariantCriterion
  /begin VAR_ADDRESS 0x80020E8E 0x8002428E 0x8002768E 0x8002AA8E 0x8002DE8E 0x8003128E 0x8003468E 0x80037A8E /end VAR_ADDRESS
 /end VAR_CHARACTERISTIC
 /begin VAR_CHARACTERISTIC TQS16_TORQ_BASE_ADD_LMU BrkCalVariantCriterion
  /begin VAR_ADDRESS 0x80020CA2 0x800240A2 0x800274A2 0x8002A8A2 0x8002DCA2 0x800310A2 0x800344A2 0x800378A2 /end VAR_ADDRESS
 /end VAR_CHARACTERISTIC
 /begin VAR_CHARACTERISTIC TQS16_TORQ_BASE_ADD_LMU_MP_X1 BrkCalVariantCriterion
  /begin VAR_ADDRESS 0x80020E78 0x80024278 0x80027678 0x8002AA78 0x8002DE78 0x80031278 0x80034678 0x80037A78 /end VAR_ADDRESS
 /end VAR_CHARACTERISTIC
 /begin VAR_CHARACTERISTIC TQS16_TORQ_BASE_ADD_LMU_MP_X2 BrkCalVariantCriterion
  /begin VAR_ADDRESS 0x80020E7A 0x8002427A 0x8002767A 0x8002AA7A 0x8002DE7A 0x8003127A 0x8003467A 0x80037A7A /end VAR_ADDRESS
 /end VAR_CHARACTERISTIC
 /begin VAR_CHARACTERISTIC TQS16_TORQ_BASE_ADD_LMU_MP_X3 BrkCalVariantCriterion
  /begin VAR_ADDRESS 0x80020E7C 0x8002427C 0x8002767C 0x8002AA7C 0x8002DE7C 0x8003127C 0x8003467C 0x80037A7C /end VAR_ADDRESS
 /end VAR_CHARACTERISTIC
 /begin VAR_CHARACTERISTIC TQS16_TORQ_BASE_ADD_LMU_MP_X4 BrkCalVariantCriterion
  /begin VAR_ADDRESS 0x80020E7E 0x8002427E 0x8002767E 0x8002AA7E 0x8002DE7E 0x8003127E 0x8003467E 0x80037A7E /end VAR_ADDRESS
 /end VAR_CHARACTERISTIC
 /begin VAR_CHARACTERISTIC TQS16_TORQ_BASE_ADD_MMU BrkCalVariantCriterion
  /begin VAR_ADDRESS 0x80020CA4 0x800240A4 0x800274A4 0x8002A8A4 0x8002DCA4 0x800310A4 0x800344A4 0x800378A4 /end VAR_ADDRESS
 /end VAR_CHARACTERISTIC
 /begin VAR_CHARACTERISTIC TQS16_TORQ_BASE_ADD_MMU_MP_X1 BrkCalVariantCriterion
  /begin VAR_ADDRESS 0x80020E80 0x80024280 0x80027680 0x8002AA80 0x8002DE80 0x80031280 0x80034680 0x80037A80 /end VAR_ADDRESS
 /end VAR_CHARACTERISTIC
 /begin VAR_CHARACTERISTIC TQS16_TORQ_BASE_ADD_MMU_MP_X2 BrkCalVariantCriterion
  /begin VAR_ADDRESS 0x80020E82 0x80024282 0x80027682 0x8002AA82 0x8002DE82 0x80031282 0x80034682 0x80037A82 /end VAR_ADDRESS
 /end VAR_CHARACTERISTIC
 /begin VAR_CHARACTERISTIC TQS16_TORQ_BASE_ADD_MMU_MP_X3 BrkCalVariantCriterion
  /begin VAR_ADDRESS 0x80020E84 0x80024284 0x80027684 0x8002AA84 0x8002DE84 0x80031284 0x80034684 0x80037A84 /end VAR_ADDRESS
 /end VAR_CHARACTERISTIC
 /begin VAR_CHARACTERISTIC TQS16_TORQ_BASE_ADD_MMU_MP_X4 BrkCalVariantCriterion
  /begin VAR_ADDRESS 0x80020E86 0x80024286 0x80027686 0x8002AA86 0x8002DE86 0x80031286 0x80034686 0x80037A86 /end VAR_ADDRESS
 /end VAR_CHARACTERISTIC
 /begin VAR_CHARACTERISTIC TQS16_TORQ_GRAD_MOTOR_V_Y1 BrkCalVariantCriterion
  /begin VAR_ADDRESS 0x800207DE 0x80023BDE 0x80026FDE 0x8002A3DE 0x8002D7DE 0x80030BDE 0x80033FDE 0x800373DE /end VAR_ADDRESS
 /end VAR_CHARACTERISTIC
 /begin VAR_CHARACTERISTIC TQS16_TORQ_GRAD_MOTOR_V_Y1_HMU BrkCalVariantCriterion
  /begin VAR_ADDRESS 0x80020F34 0x80024334 0x80027734 0x8002AB34 0x8002DF34 0x80031334 0x80034734 0x80037B34 /end VAR_ADDRESS
 /end VAR_CHARACTERISTIC
 /begin VAR_CHARACTERISTIC TQS16_TORQ_GRAD_MOTOR_V_Y1_LMU BrkCalVariantCriterion
  /begin VAR_ADDRESS 0x80020F20 0x80024320 0x80027720 0x8002AB20 0x8002DF20 0x80031320 0x80034720 0x80037B20 /end VAR_ADDRESS
 /end VAR_CHARACTERISTIC
 /begin VAR_CHARACTERISTIC TQS16_TORQ_GRAD_MOTOR_V_Y1_MMU BrkCalVariantCriterion
  /begin VAR_ADDRESS 0x80020F2A 0x8002432A 0x8002772A 0x8002AB2A 0x8002DF2A 0x8003132A 0x8003472A 0x80037B2A /end VAR_ADDRESS
 /end VAR_CHARACTERISTIC
 /begin VAR_CHARACTERISTIC TQS16_TORQ_GRAD_MOTOR_V_Y1_US BrkCalVariantCriterion
  /begin VAR_ADDRESS 0x80020F3E 0x8002433E 0x8002773E 0x8002AB3E 0x8002DF3E 0x8003133E 0x8003473E 0x80037B3E /end VAR_ADDRESS
 /end VAR_CHARACTERISTIC
 /begin VAR_CHARACTERISTIC TQS16_TORQ_GRAD_MOTOR_V_Y2 BrkCalVariantCriterion
  /begin VAR_ADDRESS 0x800207E0 0x80023BE0 0x80026FE0 0x8002A3E0 0x8002D7E0 0x80030BE0 0x80033FE0 0x800373E0 /end VAR_ADDRESS
 /end VAR_CHARACTERISTIC
 /begin VAR_CHARACTERISTIC TQS16_TORQ_GRAD_MOTOR_V_Y2_HMU BrkCalVariantCriterion
  /begin VAR_ADDRESS 0x80020F36 0x80024336 0x80027736 0x8002AB36 0x8002DF36 0x80031336 0x80034736 0x80037B36 /end VAR_ADDRESS
 /end VAR_CHARACTERISTIC
 /begin VAR_CHARACTERISTIC TQS16_TORQ_GRAD_MOTOR_V_Y2_LMU BrkCalVariantCriterion
  /begin VAR_ADDRESS 0x80020F22 0x80024322 0x80027722 0x8002AB22 0x8002DF22 0x80031322 0x80034722 0x80037B22 /end VAR_ADDRESS
 /end VAR_CHARACTERISTIC
 /begin VAR_CHARACTERISTIC TQS16_TORQ_GRAD_MOTOR_V_Y2_MMU BrkCalVariantCriterion
  /begin VAR_ADDRESS 0x80020F2C 0x8002432C 0x8002772C 0x8002AB2C 0x8002DF2C 0x8003132C 0x8003472C 0x80037B2C /end VAR_ADDRESS
 /end VAR_CHARACTERISTIC
 /begin VAR_CHARACTERISTIC TQS16_TORQ_GRAD_MOTOR_V_Y2_US BrkCalVariantCriterion
  /begin VAR_ADDRESS 0x80020F40 0x80024340 0x80027740 0x8002AB40 0x8002DF40 0x80031340 0x80034740 0x80037B40 /end VAR_ADDRESS
 /end VAR_CHARACTERISTIC
 /begin VAR_CHARACTERISTIC TQS16_TORQ_GRAD_MOTOR_V_Y3 BrkCalVariantCriterion
  /begin VAR_ADDRESS 0x800207E2 0x80023BE2 0x80026FE2 0x8002A3E2 0x8002D7E2 0x80030BE2 0x80033FE2 0x800373E2 /end VAR_ADDRESS
 /end VAR_CHARACTERISTIC
 /begin VAR_CHARACTERISTIC TQS16_TORQ_GRAD_MOTOR_V_Y3_HMU BrkCalVariantCriterion
  /begin VAR_ADDRESS 0x80020F38 0x80024338 0x80027738 0x8002AB38 0x8002DF38 0x80031338 0x80034738 0x80037B38 /end VAR_ADDRESS
 /end VAR_CHARACTERISTIC
 /begin VAR_CHARACTERISTIC TQS16_TORQ_GRAD_MOTOR_V_Y3_LMU BrkCalVariantCriterion
  /begin VAR_ADDRESS 0x80020F24 0x80024324 0x80027724 0x8002AB24 0x8002DF24 0x80031324 0x80034724 0x80037B24 /end VAR_ADDRESS
 /end VAR_CHARACTERISTIC
 /begin VAR_CHARACTERISTIC TQS16_TORQ_GRAD_MOTOR_V_Y3_MMU BrkCalVariantCriterion
  /begin VAR_ADDRESS 0x80020F2E 0x8002432E 0x8002772E 0x8002AB2E 0x8002DF2E 0x8003132E 0x8003472E 0x80037B2E /end VAR_ADDRESS
 /end VAR_CHARACTERISTIC
 /begin VAR_CHARACTERISTIC TQS16_TORQ_GRAD_MOTOR_V_Y3_US BrkCalVariantCriterion
  /begin VAR_ADDRESS 0x80020F42 0x80024342 0x80027742 0x8002AB42 0x8002DF42 0x80031342 0x80034742 0x80037B42 /end VAR_ADDRESS
 /end VAR_CHARACTERISTIC
 /begin VAR_CHARACTERISTIC TQS16_TORQ_GRAD_MOTOR_V_Y4 BrkCalVariantCriterion
  /begin VAR_ADDRESS 0x800207E4 0x80023BE4 0x80026FE4 0x8002A3E4 0x8002D7E4 0x80030BE4 0x80033FE4 0x800373E4 /end VAR_ADDRESS
 /end VAR_CHARACTERISTIC
 /begin VAR_CHARACTERISTIC TQS16_TORQ_GRAD_MOTOR_V_Y4_HMU BrkCalVariantCriterion
  /begin VAR_ADDRESS 0x80020F3A 0x8002433A 0x8002773A 0x8002AB3A 0x8002DF3A 0x8003133A 0x8003473A 0x80037B3A /end VAR_ADDRESS
 /end VAR_CHARACTERISTIC
 /begin VAR_CHARACTERISTIC TQS16_TORQ_GRAD_MOTOR_V_Y4_LMU BrkCalVariantCriterion
  /begin VAR_ADDRESS 0x80020F26 0x80024326 0x80027726 0x8002AB26 0x8002DF26 0x80031326 0x80034726 0x80037B26 /end VAR_ADDRESS
 /end VAR_CHARACTERISTIC
 /begin VAR_CHARACTERISTIC TQS16_TORQ_GRAD_MOTOR_V_Y4_MMU BrkCalVariantCriterion
  /begin VAR_ADDRESS 0x80020F30 0x80024330 0x80027730 0x8002AB30 0x8002DF30 0x80031330 0x80034730 0x80037B30 /end VAR_ADDRESS
 /end VAR_CHARACTERISTIC
 /begin VAR_CHARACTERISTIC TQS16_TORQ_GRAD_MOTOR_V_Y4_US BrkCalVariantCriterion
  /begin VAR_ADDRESS 0x80020F44 0x80024344 0x80027744 0x8002AB44 0x8002DF44 0x80031344 0x80034744 0x80037B44 /end VAR_ADDRESS
 /end VAR_CHARACTERISTIC
 /begin VAR_CHARACTERISTIC TQS16_TORQ_GRAD_MOTOR_V_Y5 BrkCalVariantCriterion
  /begin VAR_ADDRESS 0x800207E6 0x80023BE6 0x80026FE6 0x8002A3E6 0x8002D7E6 0x80030BE6 0x80033FE6 0x800373E6 /end VAR_ADDRESS
 /end VAR_CHARACTERISTIC
 /begin VAR_CHARACTERISTIC TQS16_TORQ_GRAD_MOTOR_V_Y5_HMU BrkCalVariantCriterion
  /begin VAR_ADDRESS 0x80020F3C 0x8002433C 0x8002773C 0x8002AB3C 0x8002DF3C 0x8003133C 0x8003473C 0x80037B3C /end VAR_ADDRESS
 /end VAR_CHARACTERISTIC
 /begin VAR_CHARACTERISTIC TQS16_TORQ_GRAD_MOTOR_V_Y5_LMU BrkCalVariantCriterion
  /begin VAR_ADDRESS 0x80020F28 0x80024328 0x80027728 0x8002AB28 0x8002DF28 0x80031328 0x80034728 0x80037B28 /end VAR_ADDRESS
 /end VAR_CHARACTERISTIC
 /begin VAR_CHARACTERISTIC TQS16_TORQ_GRAD_MOTOR_V_Y5_MMU BrkCalVariantCriterion
  /begin VAR_ADDRESS 0x80020F32 0x80024332 0x80027732 0x8002AB32 0x8002DF32 0x80031332 0x80034732 0x80037B32 /end VAR_ADDRESS
 /end VAR_CHARACTERISTIC
 /begin VAR_CHARACTERISTIC TQS16_TORQ_GRAD_MOTOR_V_Y5_US BrkCalVariantCriterion
  /begin VAR_ADDRESS 0x80020F46 0x80024346 0x80027746 0x8002AB46 0x8002DF46 0x80031346 0x80034746 0x80037B46 /end VAR_ADDRESS
 /end VAR_CHARACTERISTIC
 /begin VAR_CHARACTERISTIC TQS16_TORQ_GRDT_ADD_CNT_HMU BrkCalVariantCriterion
  /begin VAR_ADDRESS 0x80020C96 0x80024096 0x80027496 0x8002A896 0x8002DC96 0x80031096 0x80034496 0x80037896 /end VAR_ADDRESS
 /end VAR_CHARACTERISTIC
 /begin VAR_CHARACTERISTIC TQS16_TORQ_GRDT_ADD_CNT_LMU BrkCalVariantCriterion
  /begin VAR_ADDRESS 0x80020C92 0x80024092 0x80027492 0x8002A892 0x8002DC92 0x80031092 0x80034492 0x80037892 /end VAR_ADDRESS
 /end VAR_CHARACTERISTIC
 /begin VAR_CHARACTERISTIC TQS16_TORQ_GRDT_ADD_CNT_MMU BrkCalVariantCriterion
  /begin VAR_ADDRESS 0x80020C94 0x80024094 0x80027494 0x8002A894 0x8002DC94 0x80031094 0x80034494 0x80037894 /end VAR_ADDRESS
 /end VAR_CHARACTERISTIC
 /begin VAR_CHARACTERISTIC TQS16_TORQ_GRDT_ADD_X2_F_HMU BrkCalVariantCriterion
  /begin VAR_ADDRESS 0x80020C8E 0x8002408E 0x8002748E 0x8002A88E 0x8002DC8E 0x8003108E 0x8003448E 0x8003788E /end VAR_ADDRESS
 /end VAR_CHARACTERISTIC
 /begin VAR_CHARACTERISTIC TQS16_TORQ_GRDT_ADD_X2_F_LMU BrkCalVariantCriterion
  /begin VAR_ADDRESS 0x80020C86 0x80024086 0x80027486 0x8002A886 0x8002DC86 0x80031086 0x80034486 0x80037886 /end VAR_ADDRESS
 /end VAR_CHARACTERISTIC
 /begin VAR_CHARACTERISTIC TQS16_TORQ_GRDT_ADD_X2_F_MMU BrkCalVariantCriterion
  /begin VAR_ADDRESS 0x80020C8A 0x8002408A 0x8002748A 0x8002A88A 0x8002DC8A 0x8003108A 0x8003448A 0x8003788A /end VAR_ADDRESS
 /end VAR_CHARACTERISTIC
 /begin VAR_CHARACTERISTIC TQS16_TORQ_GRDT_ADD_X3_F_HMU BrkCalVariantCriterion
  /begin VAR_ADDRESS 0x80020C90 0x80024090 0x80027490 0x8002A890 0x8002DC90 0x80031090 0x80034490 0x80037890 /end VAR_ADDRESS
 /end VAR_CHARACTERISTIC
 /begin VAR_CHARACTERISTIC TQS16_TORQ_GRDT_ADD_X3_F_LMU BrkCalVariantCriterion
  /begin VAR_ADDRESS 0x80020C88 0x80024088 0x80027488 0x8002A888 0x8002DC88 0x80031088 0x80034488 0x80037888 /end VAR_ADDRESS
 /end VAR_CHARACTERISTIC
 /begin VAR_CHARACTERISTIC TQS16_TORQ_GRDT_ADD_X3_F_MMU BrkCalVariantCriterion
  /begin VAR_ADDRESS 0x80020C8C 0x8002408C 0x8002748C 0x8002A88C 0x8002DC8C 0x8003108C 0x8003448C 0x8003788C /end VAR_ADDRESS
 /end VAR_CHARACTERISTIC
 /begin VAR_CHARACTERISTIC TQS16_TORQ_GRDT_DEC_LMT_HMU BrkCalVariantCriterion
  /begin VAR_ADDRESS 0x80020C60 0x80024060 0x80027460 0x8002A860 0x8002DC60 0x80031060 0x80034460 0x80037860 /end VAR_ADDRESS
 /end VAR_CHARACTERISTIC
 /begin VAR_CHARACTERISTIC TQS16_TORQ_GRDT_DEC_LMT_LMU BrkCalVariantCriterion
  /begin VAR_ADDRESS 0x80020C5C 0x8002405C 0x8002745C 0x8002A85C 0x8002DC5C 0x8003105C 0x8003445C 0x8003785C /end VAR_ADDRESS
 /end VAR_CHARACTERISTIC
 /begin VAR_CHARACTERISTIC TQS16_TORQ_GRDT_DEC_LMT_MMU BrkCalVariantCriterion
  /begin VAR_ADDRESS 0x80020C5E 0x8002405E 0x8002745E 0x8002A85E 0x8002DC5E 0x8003105E 0x8003445E 0x8003785E /end VAR_ADDRESS
 /end VAR_CHARACTERISTIC
 /begin VAR_CHARACTERISTIC TQS16_TORQ_GRDT_DELM_ADD_X2 BrkCalVariantCriterion
  /begin VAR_ADDRESS 0x80020CD0 0x800240D0 0x800274D0 0x8002A8D0 0x8002DCD0 0x800310D0 0x800344D0 0x800378D0 /end VAR_ADDRESS
 /end VAR_CHARACTERISTIC
 /begin VAR_CHARACTERISTIC TQS16_TORQ_GRDT_DELM_ADD_X3 BrkCalVariantCriterion
  /begin VAR_ADDRESS 0x80020CD2 0x800240D2 0x800274D2 0x8002A8D2 0x8002DCD2 0x800310D2 0x800344D2 0x800378D2 /end VAR_ADDRESS
 /end VAR_CHARACTERISTIC
 /begin VAR_CHARACTERISTIC TQS16_TORQ_GRDT_F_BRK_LIMT_HMU BrkCalVariantCriterion
  /begin VAR_ADDRESS 0x8002080A 0x80023C0A 0x8002700A 0x8002A40A 0x8002D80A 0x80030C0A 0x8003400A 0x8003740A /end VAR_ADDRESS
 /end VAR_CHARACTERISTIC
 /begin VAR_CHARACTERISTIC TQS16_TORQ_GRDT_F_BRK_LIMT_LMU BrkCalVariantCriterion
  /begin VAR_ADDRESS 0x80020806 0x80023C06 0x80027006 0x8002A406 0x8002D806 0x80030C06 0x80034006 0x80037406 /end VAR_ADDRESS
 /end VAR_CHARACTERISTIC
 /begin VAR_CHARACTERISTIC TQS16_TORQ_GRDT_F_BRK_LIMT_MMU BrkCalVariantCriterion
  /begin VAR_ADDRESS 0x80020808 0x80023C08 0x80027008 0x8002A408 0x8002D808 0x80030C08 0x80034008 0x80037408 /end VAR_ADDRESS
 /end VAR_CHARACTERISTIC
 /begin VAR_CHARACTERISTIC TQS16_TORQ_GRDT_F_BRK_LIMT_SPLIT BrkCalVariantCriterion
  /begin VAR_ADDRESS 0x80020812 0x80023C12 0x80027012 0x8002A412 0x8002D812 0x80030C12 0x80034012 0x80037412 /end VAR_ADDRESS
 /end VAR_CHARACTERISTIC
 /begin VAR_CHARACTERISTIC TQS16_TORQ_GRDT_F_LIMT_HMU BrkCalVariantCriterion
  /begin VAR_ADDRESS 0x800207FE 0x80023BFE 0x80026FFE 0x8002A3FE 0x8002D7FE 0x80030BFE 0x80033FFE 0x800373FE /end VAR_ADDRESS
 /end VAR_CHARACTERISTIC
 /begin VAR_CHARACTERISTIC TQS16_TORQ_GRDT_F_LIMT_HMU_HSP BrkCalVariantCriterion
  /begin VAR_ADDRESS 0x80020CB8 0x800240B8 0x800274B8 0x8002A8B8 0x8002DCB8 0x800310B8 0x800344B8 0x800378B8 /end VAR_ADDRESS
 /end VAR_CHARACTERISTIC
 /begin VAR_CHARACTERISTIC TQS16_TORQ_GRDT_F_LIMT_HMU_LSP BrkCalVariantCriterion
  /begin VAR_ADDRESS 0x80020CB4 0x800240B4 0x800274B4 0x8002A8B4 0x8002DCB4 0x800310B4 0x800344B4 0x800378B4 /end VAR_ADDRESS
 /end VAR_CHARACTERISTIC
 /begin VAR_CHARACTERISTIC TQS16_TORQ_GRDT_F_LIMT_HMU_MSP BrkCalVariantCriterion
  /begin VAR_ADDRESS 0x80020CB6 0x800240B6 0x800274B6 0x8002A8B6 0x8002DCB6 0x800310B6 0x800344B6 0x800378B6 /end VAR_ADDRESS
 /end VAR_CHARACTERISTIC
 /begin VAR_CHARACTERISTIC TQS16_TORQ_GRDT_F_LIMT_LMU BrkCalVariantCriterion
  /begin VAR_ADDRESS 0x800207FA 0x80023BFA 0x80026FFA 0x8002A3FA 0x8002D7FA 0x80030BFA 0x80033FFA 0x800373FA /end VAR_ADDRESS
 /end VAR_CHARACTERISTIC
 /begin VAR_CHARACTERISTIC TQS16_TORQ_GRDT_F_LIMT_LMU_HSP BrkCalVariantCriterion
  /begin VAR_ADDRESS 0x80020CAC 0x800240AC 0x800274AC 0x8002A8AC 0x8002DCAC 0x800310AC 0x800344AC 0x800378AC /end VAR_ADDRESS
 /end VAR_CHARACTERISTIC
 /begin VAR_CHARACTERISTIC TQS16_TORQ_GRDT_F_LIMT_LMU_LSP BrkCalVariantCriterion
  /begin VAR_ADDRESS 0x80020CA8 0x800240A8 0x800274A8 0x8002A8A8 0x8002DCA8 0x800310A8 0x800344A8 0x800378A8 /end VAR_ADDRESS
 /end VAR_CHARACTERISTIC
 /begin VAR_CHARACTERISTIC TQS16_TORQ_GRDT_F_LIMT_LMU_MSP BrkCalVariantCriterion
  /begin VAR_ADDRESS 0x80020CAA 0x800240AA 0x800274AA 0x8002A8AA 0x8002DCAA 0x800310AA 0x800344AA 0x800378AA /end VAR_ADDRESS
 /end VAR_CHARACTERISTIC
 /begin VAR_CHARACTERISTIC TQS16_TORQ_GRDT_F_LIMT_MMU BrkCalVariantCriterion
  /begin VAR_ADDRESS 0x800207FC 0x80023BFC 0x80026FFC 0x8002A3FC 0x8002D7FC 0x80030BFC 0x80033FFC 0x800373FC /end VAR_ADDRESS
 /end VAR_CHARACTERISTIC
 /begin VAR_CHARACTERISTIC TQS16_TORQ_GRDT_F_LIMT_MMU_HSP BrkCalVariantCriterion
  /begin VAR_ADDRESS 0x80020CB2 0x800240B2 0x800274B2 0x8002A8B2 0x8002DCB2 0x800310B2 0x800344B2 0x800378B2 /end VAR_ADDRESS
 /end VAR_CHARACTERISTIC
 /begin VAR_CHARACTERISTIC TQS16_TORQ_GRDT_F_LIMT_MMU_LSP BrkCalVariantCriterion
  /begin VAR_ADDRESS 0x80020CAE 0x800240AE 0x800274AE 0x8002A8AE 0x8002DCAE 0x800310AE 0x800344AE 0x800378AE /end VAR_ADDRESS
 /end VAR_CHARACTERISTIC
 /begin VAR_CHARACTERISTIC TQS16_TORQ_GRDT_F_LIMT_MMU_MSP BrkCalVariantCriterion
  /begin VAR_ADDRESS 0x80020CB0 0x800240B0 0x800274B0 0x8002A8B0 0x8002DCB0 0x800310B0 0x800344B0 0x800378B0 /end VAR_ADDRESS
 /end VAR_CHARACTERISTIC
 /begin VAR_CHARACTERISTIC TQS16_TORQ_GRDT_F_MAX_HMU BrkCalVariantCriterion
  /begin VAR_ADDRESS 0x80020CD4 0x800240D4 0x800274D4 0x8002A8D4 0x8002DCD4 0x800310D4 0x800344D4 0x800378D4 /end VAR_ADDRESS
 /end VAR_CHARACTERISTIC
 /begin VAR_CHARACTERISTIC TQS16_TORQ_GRDT_F_MAX_HMU_HSP BrkCalVariantCriterion
  /begin VAR_ADDRESS 0x80020D42 0x80024142 0x80027542 0x8002A942 0x8002DD42 0x80031142 0x80034542 0x80037942 /end VAR_ADDRESS
 /end VAR_CHARACTERISTIC
 /begin VAR_CHARACTERISTIC TQS16_TORQ_GRDT_F_MAX_HMU_LSP BrkCalVariantCriterion
  /begin VAR_ADDRESS 0x80020D3E 0x8002413E 0x8002753E 0x8002A93E 0x8002DD3E 0x8003113E 0x8003453E 0x8003793E /end VAR_ADDRESS
 /end VAR_CHARACTERISTIC
 /begin VAR_CHARACTERISTIC TQS16_TORQ_GRDT_F_MAX_HMU_MSP BrkCalVariantCriterion
  /begin VAR_ADDRESS 0x80020D40 0x80024140 0x80027540 0x8002A940 0x8002DD40 0x80031140 0x80034540 0x80037940 /end VAR_ADDRESS
 /end VAR_CHARACTERISTIC
 /begin VAR_CHARACTERISTIC TQS16_TORQ_GRDT_F_MAX_LMU BrkCalVariantCriterion
  /begin VAR_ADDRESS 0x80020CD8 0x800240D8 0x800274D8 0x8002A8D8 0x8002DCD8 0x800310D8 0x800344D8 0x800378D8 /end VAR_ADDRESS
 /end VAR_CHARACTERISTIC
 /begin VAR_CHARACTERISTIC TQS16_TORQ_GRDT_F_MAX_LMU_HSP BrkCalVariantCriterion
  /begin VAR_ADDRESS 0x80020D36 0x80024136 0x80027536 0x8002A936 0x8002DD36 0x80031136 0x80034536 0x80037936 /end VAR_ADDRESS
 /end VAR_CHARACTERISTIC
 /begin VAR_CHARACTERISTIC TQS16_TORQ_GRDT_F_MAX_LMU_LSP BrkCalVariantCriterion
  /begin VAR_ADDRESS 0x80020D32 0x80024132 0x80027532 0x8002A932 0x8002DD32 0x80031132 0x80034532 0x80037932 /end VAR_ADDRESS
 /end VAR_CHARACTERISTIC
 /begin VAR_CHARACTERISTIC TQS16_TORQ_GRDT_F_MAX_LMU_MSP BrkCalVariantCriterion
  /begin VAR_ADDRESS 0x80020D34 0x80024134 0x80027534 0x8002A934 0x8002DD34 0x80031134 0x80034534 0x80037934 /end VAR_ADDRESS
 /end VAR_CHARACTERISTIC
 /begin VAR_CHARACTERISTIC TQS16_TORQ_GRDT_F_MAX_MMU BrkCalVariantCriterion
  /begin VAR_ADDRESS 0x80020CD6 0x800240D6 0x800274D6 0x8002A8D6 0x8002DCD6 0x800310D6 0x800344D6 0x800378D6 /end VAR_ADDRESS
 /end VAR_CHARACTERISTIC
 /begin VAR_CHARACTERISTIC TQS16_TORQ_GRDT_F_MAX_MMU_HSP BrkCalVariantCriterion
  /begin VAR_ADDRESS 0x80020D3C 0x8002413C 0x8002753C 0x8002A93C 0x8002DD3C 0x8003113C 0x8003453C 0x8003793C /end VAR_ADDRESS
 /end VAR_CHARACTERISTIC
 /begin VAR_CHARACTERISTIC TQS16_TORQ_GRDT_F_MAX_MMU_LSP BrkCalVariantCriterion
  /begin VAR_ADDRESS 0x80020D38 0x80024138 0x80027538 0x8002A938 0x8002DD38 0x80031138 0x80034538 0x80037938 /end VAR_ADDRESS
 /end VAR_CHARACTERISTIC
 /begin VAR_CHARACTERISTIC TQS16_TORQ_GRDT_F_MAX_MMU_MSP BrkCalVariantCriterion
  /begin VAR_ADDRESS 0x80020D3A 0x8002413A 0x8002753A 0x8002A93A 0x8002DD3A 0x8003113A 0x8003453A 0x8003793A /end VAR_ADDRESS
 /end VAR_CHARACTERISTIC
 /begin VAR_CHARACTERISTIC TQS16_TORQ_GRDT_P_GAIN BrkCalVariantCriterion
  /begin VAR_ADDRESS 0x800207F6 0x80023BF6 0x80026FF6 0x8002A3F6 0x8002D7F6 0x80030BF6 0x80033FF6 0x800373F6 /end VAR_ADDRESS
 /end VAR_CHARACTERISTIC
 /begin VAR_CHARACTERISTIC TQS16_TORQ_GRDT_P_GAIN_BRK BrkCalVariantCriterion
  /begin VAR_ADDRESS 0x800207F8 0x80023BF8 0x80026FF8 0x8002A3F8 0x8002D7F8 0x80030BF8 0x80033FF8 0x800373F8 /end VAR_ADDRESS
 /end VAR_CHARACTERISTIC
 /begin VAR_CHARACTERISTIC TQS16_TORQ_GRDT_R_BRK_LIMT_HMU BrkCalVariantCriterion
  /begin VAR_ADDRESS 0x80020810 0x80023C10 0x80027010 0x8002A410 0x8002D810 0x80030C10 0x80034010 0x80037410 /end VAR_ADDRESS
 /end VAR_CHARACTERISTIC
 /begin VAR_CHARACTERISTIC TQS16_TORQ_GRDT_R_BRK_LIMT_LMU BrkCalVariantCriterion
  /begin VAR_ADDRESS 0x8002080C 0x80023C0C 0x8002700C 0x8002A40C 0x8002D80C 0x80030C0C 0x8003400C 0x8003740C /end VAR_ADDRESS
 /end VAR_CHARACTERISTIC
 /begin VAR_CHARACTERISTIC TQS16_TORQ_GRDT_R_BRK_LIMT_MMU BrkCalVariantCriterion
  /begin VAR_ADDRESS 0x8002080E 0x80023C0E 0x8002700E 0x8002A40E 0x8002D80E 0x80030C0E 0x8003400E 0x8003740E /end VAR_ADDRESS
 /end VAR_CHARACTERISTIC
 /begin VAR_CHARACTERISTIC TQS16_TORQ_GRDT_R_BRK_LIMT_SPLIT BrkCalVariantCriterion
  /begin VAR_ADDRESS 0x80020814 0x80023C14 0x80027014 0x8002A414 0x8002D814 0x80030C14 0x80034014 0x80037414 /end VAR_ADDRESS
 /end VAR_CHARACTERISTIC
 /begin VAR_CHARACTERISTIC TQS16_TORQ_GRDT_R_LIMT_HMU BrkCalVariantCriterion
  /begin VAR_ADDRESS 0x80020804 0x80023C04 0x80027004 0x8002A404 0x8002D804 0x80030C04 0x80034004 0x80037404 /end VAR_ADDRESS
 /end VAR_CHARACTERISTIC
 /begin VAR_CHARACTERISTIC TQS16_TORQ_GRDT_R_LIMT_HMU_OS BrkCalVariantCriterion
  /begin VAR_ADDRESS 0x80020D24 0x80024124 0x80027524 0x8002A924 0x8002DD24 0x80031124 0x80034524 0x80037924 /end VAR_ADDRESS
 /end VAR_CHARACTERISTIC
 /begin VAR_CHARACTERISTIC TQS16_TORQ_GRDT_R_LIMT_LMU BrkCalVariantCriterion
  /begin VAR_ADDRESS 0x80020800 0x80023C00 0x80027000 0x8002A400 0x8002D800 0x80030C00 0x80034000 0x80037400 /end VAR_ADDRESS
 /end VAR_CHARACTERISTIC
 /begin VAR_CHARACTERISTIC TQS16_TORQ_GRDT_R_LIMT_LMU_OS BrkCalVariantCriterion
  /begin VAR_ADDRESS 0x80020D28 0x80024128 0x80027528 0x8002A928 0x8002DD28 0x80031128 0x80034528 0x80037928 /end VAR_ADDRESS
 /end VAR_CHARACTERISTIC
 /begin VAR_CHARACTERISTIC TQS16_TORQ_GRDT_R_LIMT_MMU BrkCalVariantCriterion
  /begin VAR_ADDRESS 0x80020802 0x80023C02 0x80027002 0x8002A402 0x8002D802 0x80030C02 0x80034002 0x80037402 /end VAR_ADDRESS
 /end VAR_CHARACTERISTIC
 /begin VAR_CHARACTERISTIC TQS16_TORQ_GRDT_R_LIMT_MMU_OS BrkCalVariantCriterion
  /begin VAR_ADDRESS 0x80020D26 0x80024126 0x80027526 0x8002A926 0x8002DD26 0x80031126 0x80034526 0x80037926 /end VAR_ADDRESS
 /end VAR_CHARACTERISTIC
 /begin VAR_CHARACTERISTIC TQS16_TORQ_GRDT_US2W_F_HMU BrkCalVariantCriterion
  /begin VAR_ADDRESS 0x80020D48 0x80024148 0x80027548 0x8002A948 0x8002DD48 0x80031148 0x80034548 0x80037948 /end VAR_ADDRESS
 /end VAR_CHARACTERISTIC
 /begin VAR_CHARACTERISTIC TQS16_TORQ_GRDT_US2W_F_LMU BrkCalVariantCriterion
  /begin VAR_ADDRESS 0x80020D44 0x80024144 0x80027544 0x8002A944 0x8002DD44 0x80031144 0x80034544 0x80037944 /end VAR_ADDRESS
 /end VAR_CHARACTERISTIC
 /begin VAR_CHARACTERISTIC TQS16_TORQ_GRDT_US2W_F_MMU BrkCalVariantCriterion
  /begin VAR_ADDRESS 0x80020D46 0x80024146 0x80027546 0x8002A946 0x8002DD46 0x80031146 0x80034546 0x80037946 /end VAR_ADDRESS
 /end VAR_CHARACTERISTIC
 /begin VAR_CHARACTERISTIC TQS16_TTL_max BrkCalVariantCriterion
  /begin VAR_ADDRESS 0x80020B22 0x80023F22 0x80027322 0x8002A722 0x8002DB22 0x80030F22 0x80034322 0x80037722 /end VAR_ADDRESS
 /end VAR_CHARACTERISTIC
 /begin VAR_CHARACTERISTIC TQS16_TTL_min BrkCalVariantCriterion
  /begin VAR_ADDRESS 0x80020B24 0x80023F24 0x80027324 0x8002A724 0x8002DB24 0x80030F24 0x80034324 0x80037724 /end VAR_ADDRESS
 /end VAR_CHARACTERISTIC
 /begin VAR_CHARACTERISTIC TQS16_TTL_thres BrkCalVariantCriterion
  /begin VAR_ADDRESS 0x80020B26 0x80023F26 0x80027326 0x8002A726 0x8002DB26 0x80030F26 0x80034326 0x80037726 /end VAR_ADDRESS
 /end VAR_CHARACTERISTIC
 /begin VAR_CHARACTERISTIC TQS16_TVBB_AYC_TH BrkCalVariantCriterion
  /begin VAR_ADDRESS 0x80020D60 0x80024160 0x80027560 0x8002A960 0x8002DD60 0x80031160 0x80034560 0x80037960 /end VAR_ADDRESS
 /end VAR_CHARACTERISTIC
 /begin VAR_CHARACTERISTIC TQS16_TVBB_CTRL_MOMENT_HIGH BrkCalVariantCriterion
  /begin VAR_ADDRESS 0x80020DEA 0x800241EA 0x800275EA 0x8002A9EA 0x8002DDEA 0x800311EA 0x800345EA 0x800379EA /end VAR_ADDRESS
 /end VAR_CHARACTERISTIC
 /begin VAR_CHARACTERISTIC TQS16_TVBB_CTRL_MOMENT_LOW BrkCalVariantCriterion
  /begin VAR_ADDRESS 0x80020DE4 0x800241E4 0x800275E4 0x8002A9E4 0x8002DDE4 0x800311E4 0x800345E4 0x800379E4 /end VAR_ADDRESS
 /end VAR_CHARACTERISTIC
 /begin VAR_CHARACTERISTIC TQS16_TVBB_CTRL_MOMENT_MEDHIGH BrkCalVariantCriterion
  /begin VAR_ADDRESS 0x80020DE8 0x800241E8 0x800275E8 0x8002A9E8 0x8002DDE8 0x800311E8 0x800345E8 0x800379E8 /end VAR_ADDRESS
 /end VAR_CHARACTERISTIC
 /begin VAR_CHARACTERISTIC TQS16_TVBB_CTRL_MOMENT_MEDLOW BrkCalVariantCriterion
  /begin VAR_ADDRESS 0x80020DE6 0x800241E6 0x800275E6 0x8002A9E6 0x8002DDE6 0x800311E6 0x800345E6 0x800379E6 /end VAR_ADDRESS
 /end VAR_CHARACTERISTIC
 /begin VAR_CHARACTERISTIC TQS16_TVBB_CTRL_PD_WEG_ENGINE_HTQ BrkCalVariantCriterion
  /begin VAR_ADDRESS 0x80020E02 0x80024202 0x80027602 0x8002AA02 0x8002DE02 0x80031202 0x80034602 0x80037A02 /end VAR_ADDRESS
 /end VAR_CHARACTERISTIC
 /begin VAR_CHARACTERISTIC TQS16_TVBB_CTRL_PD_WEG_ENGINE_LTQ BrkCalVariantCriterion
  /begin VAR_ADDRESS 0x80020E04 0x80024204 0x80027604 0x8002AA04 0x8002DE04 0x80031204 0x80034604 0x80037A04 /end VAR_ADDRESS
 /end VAR_CHARACTERISTIC
 /begin VAR_CHARACTERISTIC TQS16_TVBB_CTRL_PD_WEG_ENGINE_MHTQ BrkCalVariantCriterion
  /begin VAR_ADDRESS 0x80020E06 0x80024206 0x80027606 0x8002AA06 0x8002DE06 0x80031206 0x80034606 0x80037A06 /end VAR_ADDRESS
 /end VAR_CHARACTERISTIC
 /begin VAR_CHARACTERISTIC TQS16_TVBB_CTRL_PD_WEG_ENGINE_MLTQ BrkCalVariantCriterion
  /begin VAR_ADDRESS 0x80020E08 0x80024208 0x80027608 0x8002AA08 0x8002DE08 0x80031208 0x80034608 0x80037A08 /end VAR_ADDRESS
 /end VAR_CHARACTERISTIC
 /begin VAR_CHARACTERISTIC TQS16_TVBB_CTRL_PD_WEG_HMU_HSPD BrkCalVariantCriterion
  /begin VAR_ADDRESS 0x80020DA0 0x800241A0 0x800275A0 0x8002A9A0 0x8002DDA0 0x800311A0 0x800345A0 0x800379A0 /end VAR_ADDRESS
 /end VAR_CHARACTERISTIC
 /begin VAR_CHARACTERISTIC TQS16_TVBB_CTRL_PD_WEG_HMU_LSPD BrkCalVariantCriterion
  /begin VAR_ADDRESS 0x80020D9A 0x8002419A 0x8002759A 0x8002A99A 0x8002DD9A 0x8003119A 0x8003459A 0x8003799A /end VAR_ADDRESS
 /end VAR_CHARACTERISTIC
 /begin VAR_CHARACTERISTIC TQS16_TVBB_CTRL_PD_WEG_HMU_MHSPD BrkCalVariantCriterion
  /begin VAR_ADDRESS 0x80020D9E 0x8002419E 0x8002759E 0x8002A99E 0x8002DD9E 0x8003119E 0x8003459E 0x8003799E /end VAR_ADDRESS
 /end VAR_CHARACTERISTIC
 /begin VAR_CHARACTERISTIC TQS16_TVBB_CTRL_PD_WEG_HMU_MLSPD BrkCalVariantCriterion
  /begin VAR_ADDRESS 0x80020D9C 0x8002419C 0x8002759C 0x8002A99C 0x8002DD9C 0x8003119C 0x8003459C 0x8003799C /end VAR_ADDRESS
 /end VAR_CHARACTERISTIC
 /begin VAR_CHARACTERISTIC TQS16_TVBB_CTRL_PD_WEG_LMU_HSPD BrkCalVariantCriterion
  /begin VAR_ADDRESS 0x80020DC0 0x800241C0 0x800275C0 0x8002A9C0 0x8002DDC0 0x800311C0 0x800345C0 0x800379C0 /end VAR_ADDRESS
 /end VAR_CHARACTERISTIC
 /begin VAR_CHARACTERISTIC TQS16_TVBB_CTRL_PD_WEG_LMU_LSPD BrkCalVariantCriterion
  /begin VAR_ADDRESS 0x80020DBA 0x800241BA 0x800275BA 0x8002A9BA 0x8002DDBA 0x800311BA 0x800345BA 0x800379BA /end VAR_ADDRESS
 /end VAR_CHARACTERISTIC
 /begin VAR_CHARACTERISTIC TQS16_TVBB_CTRL_PD_WEG_LMU_MHSPD BrkCalVariantCriterion
  /begin VAR_ADDRESS 0x80020DBE 0x800241BE 0x800275BE 0x8002A9BE 0x8002DDBE 0x800311BE 0x800345BE 0x800379BE /end VAR_ADDRESS
 /end VAR_CHARACTERISTIC
 /begin VAR_CHARACTERISTIC TQS16_TVBB_CTRL_PD_WEG_LMU_MLSPD BrkCalVariantCriterion
  /begin VAR_ADDRESS 0x80020DBC 0x800241BC 0x800275BC 0x8002A9BC 0x8002DDBC 0x800311BC 0x800345BC 0x800379BC /end VAR_ADDRESS
 /end VAR_CHARACTERISTIC
 /begin VAR_CHARACTERISTIC TQS16_TVBB_CTRL_PD_WEG_MMU_HSPD BrkCalVariantCriterion
  /begin VAR_ADDRESS 0x80020DB0 0x800241B0 0x800275B0 0x8002A9B0 0x8002DDB0 0x800311B0 0x800345B0 0x800379B0 /end VAR_ADDRESS
 /end VAR_CHARACTERISTIC
 /begin VAR_CHARACTERISTIC TQS16_TVBB_CTRL_PD_WEG_MMU_LSPD BrkCalVariantCriterion
  /begin VAR_ADDRESS 0x80020DAA 0x800241AA 0x800275AA 0x8002A9AA 0x8002DDAA 0x800311AA 0x800345AA 0x800379AA /end VAR_ADDRESS
 /end VAR_CHARACTERISTIC
 /begin VAR_CHARACTERISTIC TQS16_TVBB_CTRL_PD_WEG_MMU_MHSPD BrkCalVariantCriterion
  /begin VAR_ADDRESS 0x80020DAE 0x800241AE 0x800275AE 0x8002A9AE 0x8002DDAE 0x800311AE 0x800345AE 0x800379AE /end VAR_ADDRESS
 /end VAR_CHARACTERISTIC
 /begin VAR_CHARACTERISTIC TQS16_TVBB_CTRL_PD_WEG_MMU_MLSPD BrkCalVariantCriterion
  /begin VAR_ADDRESS 0x80020DAC 0x800241AC 0x800275AC 0x8002A9AC 0x8002DDAC 0x800311AC 0x800345AC 0x800379AC /end VAR_ADDRESS
 /end VAR_CHARACTERISTIC
 /begin VAR_CHARACTERISTIC TQS16_TVBB_CTRL_REF_WHL_SLIP_HMU_1 BrkCalVariantCriterion
  /begin VAR_ADDRESS 0x80020DC2 0x800241C2 0x800275C2 0x8002A9C2 0x8002DDC2 0x800311C2 0x800345C2 0x800379C2 /end VAR_ADDRESS
 /end VAR_CHARACTERISTIC
 /begin VAR_CHARACTERISTIC TQS16_TVBB_CTRL_REF_WHL_SLIP_HMU_2 BrkCalVariantCriterion
  /begin VAR_ADDRESS 0x80020DC4 0x800241C4 0x800275C4 0x8002A9C4 0x8002DDC4 0x800311C4 0x800345C4 0x800379C4 /end VAR_ADDRESS
 /end VAR_CHARACTERISTIC
 /begin VAR_CHARACTERISTIC TQS16_TVBB_CTRL_REF_WHL_SLIP_HMU_3 BrkCalVariantCriterion
  /begin VAR_ADDRESS 0x80020DC6 0x800241C6 0x800275C6 0x8002A9C6 0x8002DDC6 0x800311C6 0x800345C6 0x800379C6 /end VAR_ADDRESS
 /end VAR_CHARACTERISTIC
 /begin VAR_CHARACTERISTIC TQS16_TVBB_CTRL_REF_WHL_SLIP_HMU_4 BrkCalVariantCriterion
  /begin VAR_ADDRESS 0x80020DC8 0x800241C8 0x800275C8 0x8002A9C8 0x8002DDC8 0x800311C8 0x800345C8 0x800379C8 /end VAR_ADDRESS
 /end VAR_CHARACTERISTIC
 /begin VAR_CHARACTERISTIC TQS16_TVBB_CTRL_REF_WHL_SLIP_HMU_5 BrkCalVariantCriterion
  /begin VAR_ADDRESS 0x80020DCA 0x800241CA 0x800275CA 0x8002A9CA 0x8002DDCA 0x800311CA 0x800345CA 0x800379CA /end VAR_ADDRESS
 /end VAR_CHARACTERISTIC
 /begin VAR_CHARACTERISTIC TQS16_TVBB_CTRL_TAR_TQ_HIGH BrkCalVariantCriterion
  /begin VAR_ADDRESS 0x80020DF2 0x800241F2 0x800275F2 0x8002A9F2 0x8002DDF2 0x800311F2 0x800345F2 0x800379F2 /end VAR_ADDRESS
 /end VAR_CHARACTERISTIC
 /begin VAR_CHARACTERISTIC TQS16_TVBB_CTRL_TAR_TQ_LOW BrkCalVariantCriterion
  /begin VAR_ADDRESS 0x80020DEC 0x800241EC 0x800275EC 0x8002A9EC 0x8002DDEC 0x800311EC 0x800345EC 0x800379EC /end VAR_ADDRESS
 /end VAR_CHARACTERISTIC
 /begin VAR_CHARACTERISTIC TQS16_TVBB_CTRL_TAR_TQ_MEDHIGH BrkCalVariantCriterion
  /begin VAR_ADDRESS 0x80020DF0 0x800241F0 0x800275F0 0x8002A9F0 0x8002DDF0 0x800311F0 0x800345F0 0x800379F0 /end VAR_ADDRESS
 /end VAR_CHARACTERISTIC
 /begin VAR_CHARACTERISTIC TQS16_TVBB_CTRL_TAR_TQ_MEDLOW BrkCalVariantCriterion
  /begin VAR_ADDRESS 0x80020DEE 0x800241EE 0x800275EE 0x8002A9EE 0x8002DDEE 0x800311EE 0x800345EE 0x800379EE /end VAR_ADDRESS
 /end VAR_CHARACTERISTIC
 /begin VAR_CHARACTERISTIC TQS16_TVBB_DELTA_YAW_TH_EXTI BrkCalVariantCriterion
  /begin VAR_ADDRESS 0x80020DF4 0x800241F4 0x800275F4 0x8002A9F4 0x8002DDF4 0x800311F4 0x800345F4 0x800379F4 /end VAR_ADDRESS
 /end VAR_CHARACTERISTIC
 /begin VAR_CHARACTERISTIC TQS16_TVBB_DELTA_YAW_TH_HSP BrkCalVariantCriterion
  /begin VAR_ADDRESS 0x80020DDC 0x800241DC 0x800275DC 0x8002A9DC 0x8002DDDC 0x800311DC 0x800345DC 0x800379DC /end VAR_ADDRESS
 /end VAR_CHARACTERISTIC
 /begin VAR_CHARACTERISTIC TQS16_TVBB_DELTA_YAW_TH_LSP BrkCalVariantCriterion
  /begin VAR_ADDRESS 0x80020DD8 0x800241D8 0x800275D8 0x8002A9D8 0x8002DDD8 0x800311D8 0x800345D8 0x800379D8 /end VAR_ADDRESS
 /end VAR_CHARACTERISTIC
 /begin VAR_CHARACTERISTIC TQS16_TVBB_DELTA_YAW_TH_MSP BrkCalVariantCriterion
  /begin VAR_ADDRESS 0x80020DDA 0x800241DA 0x800275DA 0x8002A9DA 0x8002DDDA 0x800311DA 0x800345DA 0x800379DA /end VAR_ADDRESS
 /end VAR_CHARACTERISTIC
 /begin VAR_CHARACTERISTIC TQS16_TVBB_DEL_YAW_INHIBIT_TH_ENTER BrkCalVariantCriterion
  /begin VAR_ADDRESS 0x80020D64 0x80024164 0x80027564 0x8002A964 0x8002DD64 0x80031164 0x80034564 0x80037964 /end VAR_ADDRESS
 /end VAR_CHARACTERISTIC
 /begin VAR_CHARACTERISTIC TQS16_TVBB_DEL_YAW_INHIBIT_TH_EXIT BrkCalVariantCriterion
  /begin VAR_ADDRESS 0x80020D66 0x80024166 0x80027566 0x8002A966 0x8002DD66 0x80031166 0x80034566 0x80037966 /end VAR_ADDRESS
 /end VAR_CHARACTERISTIC
 /begin VAR_CHARACTERISTIC TQS16_TVBB_ENGINE_HTQ BrkCalVariantCriterion
  /begin VAR_ADDRESS 0x80020DF6 0x800241F6 0x800275F6 0x8002A9F6 0x8002DDF6 0x800311F6 0x800345F6 0x800379F6 /end VAR_ADDRESS
 /end VAR_CHARACTERISTIC
 /begin VAR_CHARACTERISTIC TQS16_TVBB_ENGINE_LTQ BrkCalVariantCriterion
  /begin VAR_ADDRESS 0x80020DF8 0x800241F8 0x800275F8 0x8002A9F8 0x8002DDF8 0x800311F8 0x800345F8 0x800379F8 /end VAR_ADDRESS
 /end VAR_CHARACTERISTIC
 /begin VAR_CHARACTERISTIC TQS16_TVBB_ENGINE_MHTQ BrkCalVariantCriterion
  /begin VAR_ADDRESS 0x80020DFA 0x800241FA 0x800275FA 0x8002A9FA 0x8002DDFA 0x800311FA 0x800345FA 0x800379FA /end VAR_ADDRESS
 /end VAR_CHARACTERISTIC
 /begin VAR_CHARACTERISTIC TQS16_TVBB_ENGINE_MLTQ BrkCalVariantCriterion
  /begin VAR_ADDRESS 0x80020DFC 0x800241FC 0x800275FC 0x8002A9FC 0x8002DDFC 0x800311FC 0x800345FC 0x800379FC /end VAR_ADDRESS
 /end VAR_CHARACTERISTIC
 /begin VAR_CHARACTERISTIC TQS16_TVBB_ENTER_ALATM_TH_HSP BrkCalVariantCriterion
  /begin VAR_ADDRESS 0x80020D70 0x80024170 0x80027570 0x8002A970 0x8002DD70 0x80031170 0x80034570 0x80037970 /end VAR_ADDRESS
 /end VAR_CHARACTERISTIC
 /begin VAR_CHARACTERISTIC TQS16_TVBB_ENTER_ALATM_TH_LSP BrkCalVariantCriterion
  /begin VAR_ADDRESS 0x80020D72 0x80024172 0x80027572 0x8002A972 0x8002DD72 0x80031172 0x80034572 0x80037972 /end VAR_ADDRESS
 /end VAR_CHARACTERISTIC
 /begin VAR_CHARACTERISTIC TQS16_TVBB_ENTER_ALATM_TH_MSP BrkCalVariantCriterion
  /begin VAR_ADDRESS 0x80020D74 0x80024174 0x80027574 0x8002A974 0x8002DD74 0x80031174 0x80034574 0x80037974 /end VAR_ADDRESS
 /end VAR_CHARACTERISTIC
 /begin VAR_CHARACTERISTIC TQS16_TVBB_ENTER_HSPD_LIMIT_HMU BrkCalVariantCriterion
  /begin VAR_ADDRESS 0x80020DD2 0x800241D2 0x800275D2 0x8002A9D2 0x8002DDD2 0x800311D2 0x800345D2 0x800379D2 /end VAR_ADDRESS
 /end VAR_CHARACTERISTIC
 /begin VAR_CHARACTERISTIC TQS16_TVBB_ENTER_HSPD_LIMIT_LMU BrkCalVariantCriterion
  /begin VAR_ADDRESS 0x80020DD6 0x800241D6 0x800275D6 0x8002A9D6 0x8002DDD6 0x800311D6 0x800345D6 0x800379D6 /end VAR_ADDRESS
 /end VAR_CHARACTERISTIC
 /begin VAR_CHARACTERISTIC TQS16_TVBB_ENTER_HSPD_LIMIT_MMU BrkCalVariantCriterion
  /begin VAR_ADDRESS 0x80020DD4 0x800241D4 0x800275D4 0x8002A9D4 0x8002DDD4 0x800311D4 0x800345D4 0x800379D4 /end VAR_ADDRESS
 /end VAR_CHARACTERISTIC
 /begin VAR_CHARACTERISTIC TQS16_TVBB_ENTER_MOMENT BrkCalVariantCriterion
  /begin VAR_ADDRESS 0x80020DFE 0x800241FE 0x800275FE 0x8002A9FE 0x8002DDFE 0x800311FE 0x800345FE 0x800379FE /end VAR_ADDRESS
 /end VAR_CHARACTERISTIC
 /begin VAR_CHARACTERISTIC TQS16_TVBB_ENTER_TH_REF_HSP BrkCalVariantCriterion
  /begin VAR_ADDRESS 0x80020D6E 0x8002416E 0x8002756E 0x8002A96E 0x8002DD6E 0x8003116E 0x8003456E 0x8003796E /end VAR_ADDRESS
 /end VAR_CHARACTERISTIC
 /begin VAR_CHARACTERISTIC TQS16_TVBB_ENTER_TH_REF_LSP BrkCalVariantCriterion
  /begin VAR_ADDRESS 0x80020D6A 0x8002416A 0x8002756A 0x8002A96A 0x8002DD6A 0x8003116A 0x8003456A 0x8003796A /end VAR_ADDRESS
 /end VAR_CHARACTERISTIC
 /begin VAR_CHARACTERISTIC TQS16_TVBB_ENTER_TH_REF_MSP BrkCalVariantCriterion
  /begin VAR_ADDRESS 0x80020D6C 0x8002416C 0x8002756C 0x8002A96C 0x8002DD6C 0x8003116C 0x8003456C 0x8003796C /end VAR_ADDRESS
 /end VAR_CHARACTERISTIC
 /begin VAR_CHARACTERISTIC TQS16_TVBB_EXIT_MOMENT BrkCalVariantCriterion
  /begin VAR_ADDRESS 0x80020E00 0x80024200 0x80027600 0x8002AA00 0x8002DE00 0x80031200 0x80034600 0x80037A00 /end VAR_ADDRESS
 /end VAR_CHARACTERISTIC
 /begin VAR_CHARACTERISTIC TQS16_TVBB_FADE_DEC_GRDT BrkCalVariantCriterion
  /begin VAR_ADDRESS 0x80020E30 0x80024230 0x80027630 0x8002AA30 0x8002DE30 0x80031230 0x80034630 0x80037A30 /end VAR_ADDRESS
 /end VAR_CHARACTERISTIC
 /begin VAR_CHARACTERISTIC TQS16_TVBB_FADE_TORQ_TH BrkCalVariantCriterion
  /begin VAR_ADDRESS 0x80020E32 0x80024232 0x80027632 0x8002AA32 0x8002DE32 0x80031232 0x80034632 0x80037A32 /end VAR_ADDRESS
 /end VAR_CHARACTERISTIC
 /begin VAR_CHARACTERISTIC TQS16_TVBB_HMU_HSPD BrkCalVariantCriterion
  /begin VAR_ADDRESS 0x80020D98 0x80024198 0x80027598 0x8002A998 0x8002DD98 0x80031198 0x80034598 0x80037998 /end VAR_ADDRESS
 /end VAR_CHARACTERISTIC
 /begin VAR_CHARACTERISTIC TQS16_TVBB_HMU_LSPD BrkCalVariantCriterion
  /begin VAR_ADDRESS 0x80020D92 0x80024192 0x80027592 0x8002A992 0x8002DD92 0x80031192 0x80034592 0x80037992 /end VAR_ADDRESS
 /end VAR_CHARACTERISTIC
 /begin VAR_CHARACTERISTIC TQS16_TVBB_HMU_MHSPD BrkCalVariantCriterion
  /begin VAR_ADDRESS 0x80020D96 0x80024196 0x80027596 0x8002A996 0x8002DD96 0x80031196 0x80034596 0x80037996 /end VAR_ADDRESS
 /end VAR_CHARACTERISTIC
 /begin VAR_CHARACTERISTIC TQS16_TVBB_HMU_MLSPD BrkCalVariantCriterion
  /begin VAR_ADDRESS 0x80020D94 0x80024194 0x80027594 0x8002A994 0x8002DD94 0x80031194 0x80034594 0x80037994 /end VAR_ADDRESS
 /end VAR_CHARACTERISTIC
 /begin VAR_CHARACTERISTIC TQS16_TVBB_LMU_HSPD BrkCalVariantCriterion
  /begin VAR_ADDRESS 0x80020DB8 0x800241B8 0x800275B8 0x8002A9B8 0x8002DDB8 0x800311B8 0x800345B8 0x800379B8 /end VAR_ADDRESS
 /end VAR_CHARACTERISTIC
 /begin VAR_CHARACTERISTIC TQS16_TVBB_LMU_LSPD BrkCalVariantCriterion
  /begin VAR_ADDRESS 0x80020DB2 0x800241B2 0x800275B2 0x8002A9B2 0x8002DDB2 0x800311B2 0x800345B2 0x800379B2 /end VAR_ADDRESS
 /end VAR_CHARACTERISTIC
 /begin VAR_CHARACTERISTIC TQS16_TVBB_LMU_MHSPD BrkCalVariantCriterion
  /begin VAR_ADDRESS 0x80020DB6 0x800241B6 0x800275B6 0x8002A9B6 0x8002DDB6 0x800311B6 0x800345B6 0x800379B6 /end VAR_ADDRESS
 /end VAR_CHARACTERISTIC
 /begin VAR_CHARACTERISTIC TQS16_TVBB_LMU_MLSPD BrkCalVariantCriterion
  /begin VAR_ADDRESS 0x80020DB4 0x800241B4 0x800275B4 0x8002A9B4 0x8002DDB4 0x800311B4 0x800345B4 0x800379B4 /end VAR_ADDRESS
 /end VAR_CHARACTERISTIC
 /begin VAR_CHARACTERISTIC TQS16_TVBB_MMU_HSPD BrkCalVariantCriterion
  /begin VAR_ADDRESS 0x80020DA8 0x800241A8 0x800275A8 0x8002A9A8 0x8002DDA8 0x800311A8 0x800345A8 0x800379A8 /end VAR_ADDRESS
 /end VAR_CHARACTERISTIC
 /begin VAR_CHARACTERISTIC TQS16_TVBB_MMU_LSPD BrkCalVariantCriterion
  /begin VAR_ADDRESS 0x80020DA2 0x800241A2 0x800275A2 0x8002A9A2 0x8002DDA2 0x800311A2 0x800345A2 0x800379A2 /end VAR_ADDRESS
 /end VAR_CHARACTERISTIC
 /begin VAR_CHARACTERISTIC TQS16_TVBB_MMU_MHSPD BrkCalVariantCriterion
  /begin VAR_ADDRESS 0x80020DA6 0x800241A6 0x800275A6 0x8002A9A6 0x8002DDA6 0x800311A6 0x800345A6 0x800379A6 /end VAR_ADDRESS
 /end VAR_CHARACTERISTIC
 /begin VAR_CHARACTERISTIC TQS16_TVBB_MMU_MLSPD BrkCalVariantCriterion
  /begin VAR_ADDRESS 0x80020DA4 0x800241A4 0x800275A4 0x8002A9A4 0x8002DDA4 0x800311A4 0x800345A4 0x800379A4 /end VAR_ADDRESS
 /end VAR_CHARACTERISTIC
 /begin VAR_CHARACTERISTIC TQS16_TVBB_SPD_MIN BrkCalVariantCriterion
  /begin VAR_ADDRESS 0x80020D68 0x80024168 0x80027568 0x8002A968 0x8002DD68 0x80031168 0x80034568 0x80037968 /end VAR_ADDRESS
 /end VAR_CHARACTERISTIC
 /begin VAR_CHARACTERISTIC TQS16_TVBB_TH_AY_VX_DOT_GAIN_HM_1 BrkCalVariantCriterion
  /begin VAR_ADDRESS 0x80020E0A 0x8002420A 0x8002760A 0x8002AA0A 0x8002DE0A 0x8003120A 0x8003460A 0x80037A0A /end VAR_ADDRESS
 /end VAR_CHARACTERISTIC
 /begin VAR_CHARACTERISTIC TQS16_TVBB_TH_AY_VX_DOT_GAIN_HM_2 BrkCalVariantCriterion
  /begin VAR_ADDRESS 0x80020E0C 0x8002420C 0x8002760C 0x8002AA0C 0x8002DE0C 0x8003120C 0x8003460C 0x80037A0C /end VAR_ADDRESS
 /end VAR_CHARACTERISTIC
 /begin VAR_CHARACTERISTIC TQS16_TVBB_TH_AY_VX_DOT_GAIN_HM_3 BrkCalVariantCriterion
  /begin VAR_ADDRESS 0x80020E0E 0x8002420E 0x8002760E 0x8002AA0E 0x8002DE0E 0x8003120E 0x8003460E 0x80037A0E /end VAR_ADDRESS
 /end VAR_CHARACTERISTIC
 /begin VAR_CHARACTERISTIC TQS16_TVBB_TH_AY_VX_DOT_GAIN_LM_1 BrkCalVariantCriterion
  /begin VAR_ADDRESS 0x80020E10 0x80024210 0x80027610 0x8002AA10 0x8002DE10 0x80031210 0x80034610 0x80037A10 /end VAR_ADDRESS
 /end VAR_CHARACTERISTIC
 /begin VAR_CHARACTERISTIC TQS16_TVBB_TH_AY_VX_DOT_GAIN_LM_2 BrkCalVariantCriterion
  /begin VAR_ADDRESS 0x80020E12 0x80024212 0x80027612 0x8002AA12 0x8002DE12 0x80031212 0x80034612 0x80037A12 /end VAR_ADDRESS
 /end VAR_CHARACTERISTIC
 /begin VAR_CHARACTERISTIC TQS16_TVBB_TH_AY_VX_DOT_GAIN_LM_3 BrkCalVariantCriterion
  /begin VAR_ADDRESS 0x80020E14 0x80024214 0x80027614 0x8002AA14 0x8002DE14 0x80031214 0x80034614 0x80037A14 /end VAR_ADDRESS
 /end VAR_CHARACTERISTIC
 /begin VAR_CHARACTERISTIC TQS16_TVBB_TH_AY_VX_DOT_GAIN_MM_1 BrkCalVariantCriterion
  /begin VAR_ADDRESS 0x80020E16 0x80024216 0x80027616 0x8002AA16 0x8002DE16 0x80031216 0x80034616 0x80037A16 /end VAR_ADDRESS
 /end VAR_CHARACTERISTIC
 /begin VAR_CHARACTERISTIC TQS16_TVBB_TH_AY_VX_DOT_GAIN_MM_2 BrkCalVariantCriterion
  /begin VAR_ADDRESS 0x80020E18 0x80024218 0x80027618 0x8002AA18 0x8002DE18 0x80031218 0x80034618 0x80037A18 /end VAR_ADDRESS
 /end VAR_CHARACTERISTIC
 /begin VAR_CHARACTERISTIC TQS16_TVBB_TH_AY_VX_DOT_GAIN_MM_3 BrkCalVariantCriterion
  /begin VAR_ADDRESS 0x80020E1A 0x8002421A 0x8002761A 0x8002AA1A 0x8002DE1A 0x8003121A 0x8003461A 0x80037A1A /end VAR_ADDRESS
 /end VAR_CHARACTERISTIC
 /begin VAR_CHARACTERISTIC TQS16_TVBB_TH_REF_AY_VX_DOT_HM_1 BrkCalVariantCriterion
  /begin VAR_ADDRESS 0x80020E1C 0x8002421C 0x8002761C 0x8002AA1C 0x8002DE1C 0x8003121C 0x8003461C 0x80037A1C /end VAR_ADDRESS
 /end VAR_CHARACTERISTIC
 /begin VAR_CHARACTERISTIC TQS16_TVBB_TH_REF_AY_VX_DOT_HM_2 BrkCalVariantCriterion
  /begin VAR_ADDRESS 0x80020E1E 0x8002421E 0x8002761E 0x8002AA1E 0x8002DE1E 0x8003121E 0x8003461E 0x80037A1E /end VAR_ADDRESS
 /end VAR_CHARACTERISTIC
 /begin VAR_CHARACTERISTIC TQS16_TVBB_TH_REF_AY_VX_DOT_HM_3 BrkCalVariantCriterion
  /begin VAR_ADDRESS 0x80020E20 0x80024220 0x80027620 0x8002AA20 0x8002DE20 0x80031220 0x80034620 0x80037A20 /end VAR_ADDRESS
 /end VAR_CHARACTERISTIC
 /begin VAR_CHARACTERISTIC TQS16_TVBB_TH_REF_AY_VX_DOT_LM_1 BrkCalVariantCriterion
  /begin VAR_ADDRESS 0x80020E22 0x80024222 0x80027622 0x8002AA22 0x8002DE22 0x80031222 0x80034622 0x80037A22 /end VAR_ADDRESS
 /end VAR_CHARACTERISTIC
 /begin VAR_CHARACTERISTIC TQS16_TVBB_TH_REF_AY_VX_DOT_LM_2 BrkCalVariantCriterion
  /begin VAR_ADDRESS 0x80020E24 0x80024224 0x80027624 0x8002AA24 0x8002DE24 0x80031224 0x80034624 0x80037A24 /end VAR_ADDRESS
 /end VAR_CHARACTERISTIC
 /begin VAR_CHARACTERISTIC TQS16_TVBB_TH_REF_AY_VX_DOT_LM_3 BrkCalVariantCriterion
  /begin VAR_ADDRESS 0x80020E26 0x80024226 0x80027626 0x8002AA26 0x8002DE26 0x80031226 0x80034626 0x80037A26 /end VAR_ADDRESS
 /end VAR_CHARACTERISTIC
 /begin VAR_CHARACTERISTIC TQS16_TVBB_TH_REF_AY_VX_DOT_MM_1 BrkCalVariantCriterion
  /begin VAR_ADDRESS 0x80020E28 0x80024228 0x80027628 0x8002AA28 0x8002DE28 0x80031228 0x80034628 0x80037A28 /end VAR_ADDRESS
 /end VAR_CHARACTERISTIC
 /begin VAR_CHARACTERISTIC TQS16_TVBB_TH_REF_AY_VX_DOT_MM_2 BrkCalVariantCriterion
  /begin VAR_ADDRESS 0x80020E2A 0x8002422A 0x8002762A 0x8002AA2A 0x8002DE2A 0x8003122A 0x8003462A 0x80037A2A /end VAR_ADDRESS
 /end VAR_CHARACTERISTIC
 /begin VAR_CHARACTERISTIC TQS16_TVBB_TH_REF_AY_VX_DOT_MM_3 BrkCalVariantCriterion
  /begin VAR_ADDRESS 0x80020E2C 0x8002422C 0x8002762C 0x8002AA2C 0x8002DE2C 0x8003122C 0x8003462C 0x80037A2C /end VAR_ADDRESS
 /end VAR_CHARACTERISTIC
 /begin VAR_CHARACTERISTIC TQS16_TVBB_TQ_GRDT_LIMT BrkCalVariantCriterion
  /begin VAR_ADDRESS 0x80020D5C 0x8002415C 0x8002755C 0x8002A95C 0x8002DD5C 0x8003115C 0x8003455C 0x8003795C /end VAR_ADDRESS
 /end VAR_CHARACTERISTIC
 /begin VAR_CHARACTERISTIC TQS16_TVBB_YC_D_GAIN_DEC_HM BrkCalVariantCriterion
  /begin VAR_ADDRESS 0x80020D8C 0x8002418C 0x8002758C 0x8002A98C 0x8002DD8C 0x8003118C 0x8003458C 0x8003798C /end VAR_ADDRESS
 /end VAR_CHARACTERISTIC
 /begin VAR_CHARACTERISTIC TQS16_TVBB_YC_D_GAIN_DEC_LM BrkCalVariantCriterion
  /begin VAR_ADDRESS 0x80020D90 0x80024190 0x80027590 0x8002A990 0x8002DD90 0x80031190 0x80034590 0x80037990 /end VAR_ADDRESS
 /end VAR_CHARACTERISTIC
 /begin VAR_CHARACTERISTIC TQS16_TVBB_YC_D_GAIN_DEC_MM BrkCalVariantCriterion
  /begin VAR_ADDRESS 0x80020D8E 0x8002418E 0x8002758E 0x8002A98E 0x8002DD8E 0x8003118E 0x8003458E 0x8003798E /end VAR_ADDRESS
 /end VAR_CHARACTERISTIC
 /begin VAR_CHARACTERISTIC TQS16_TVBB_YC_D_GAIN_INC_HM BrkCalVariantCriterion
  /begin VAR_ADDRESS 0x80020D80 0x80024180 0x80027580 0x8002A980 0x8002DD80 0x80031180 0x80034580 0x80037980 /end VAR_ADDRESS
 /end VAR_CHARACTERISTIC
 /begin VAR_CHARACTERISTIC TQS16_TVBB_YC_D_GAIN_INC_LM BrkCalVariantCriterion
  /begin VAR_ADDRESS 0x80020D84 0x80024184 0x80027584 0x8002A984 0x8002DD84 0x80031184 0x80034584 0x80037984 /end VAR_ADDRESS
 /end VAR_CHARACTERISTIC
 /begin VAR_CHARACTERISTIC TQS16_TVBB_YC_D_GAIN_INC_MM BrkCalVariantCriterion
  /begin VAR_ADDRESS 0x80020D82 0x80024182 0x80027582 0x8002A982 0x8002DD82 0x80031182 0x80034582 0x80037982 /end VAR_ADDRESS
 /end VAR_CHARACTERISTIC
 /begin VAR_CHARACTERISTIC TQS16_TVBB_YC_P_GAIN_DEC_HM BrkCalVariantCriterion
  /begin VAR_ADDRESS 0x80020D86 0x80024186 0x80027586 0x8002A986 0x8002DD86 0x80031186 0x80034586 0x80037986 /end VAR_ADDRESS
 /end VAR_CHARACTERISTIC
 /begin VAR_CHARACTERISTIC TQS16_TVBB_YC_P_GAIN_DEC_LM BrkCalVariantCriterion
  /begin VAR_ADDRESS 0x80020D8A 0x8002418A 0x8002758A 0x8002A98A 0x8002DD8A 0x8003118A 0x8003458A 0x8003798A /end VAR_ADDRESS
 /end VAR_CHARACTERISTIC
 /begin VAR_CHARACTERISTIC TQS16_TVBB_YC_P_GAIN_DEC_MM BrkCalVariantCriterion
  /begin VAR_ADDRESS 0x80020D88 0x80024188 0x80027588 0x8002A988 0x8002DD88 0x80031188 0x80034588 0x80037988 /end VAR_ADDRESS
 /end VAR_CHARACTERISTIC
 /begin VAR_CHARACTERISTIC TQS16_TVBB_YC_P_GAIN_INC_HM BrkCalVariantCriterion
  /begin VAR_ADDRESS 0x80020D7A 0x8002417A 0x8002757A 0x8002A97A 0x8002DD7A 0x8003117A 0x8003457A 0x8003797A /end VAR_ADDRESS
 /end VAR_CHARACTERISTIC
 /begin VAR_CHARACTERISTIC TQS16_TVBB_YC_P_GAIN_INC_LM BrkCalVariantCriterion
  /begin VAR_ADDRESS 0x80020D7E 0x8002417E 0x8002757E 0x8002A97E 0x8002DD7E 0x8003117E 0x8003457E 0x8003797E /end VAR_ADDRESS
 /end VAR_CHARACTERISTIC
 /begin VAR_CHARACTERISTIC TQS16_TVBB_YC_P_GAIN_INC_MM BrkCalVariantCriterion
  /begin VAR_ADDRESS 0x80020D7C 0x8002417C 0x8002757C 0x8002A97C 0x8002DD7C 0x8003117C 0x8003457C 0x8003797C /end VAR_ADDRESS
 /end VAR_CHARACTERISTIC
 /begin VAR_CHARACTERISTIC TQS16_TorqDec_ABS_Slip_2 BrkCalVariantCriterion
  /begin VAR_ADDRESS 0x80020D2A 0x8002412A 0x8002752A 0x8002A92A 0x8002DD2A 0x8003112A 0x8003452A 0x8003792A /end VAR_ADDRESS
 /end VAR_CHARACTERISTIC
 /begin VAR_CHARACTERISTIC TQS16_TorqDec_ABS_Slip_3 BrkCalVariantCriterion
  /begin VAR_ADDRESS 0x80020D2C 0x8002412C 0x8002752C 0x8002A92C 0x8002DD2C 0x8003112C 0x8003452C 0x8003792C /end VAR_ADDRESS
 /end VAR_CHARACTERISTIC
 /begin VAR_CHARACTERISTIC TQS16_TorqDec_ABS_Slip_4 BrkCalVariantCriterion
  /begin VAR_ADDRESS 0x80020D2E 0x8002412E 0x8002752E 0x8002A92E 0x8002DD2E 0x8003112E 0x8003452E 0x8003792E /end VAR_ADDRESS
 /end VAR_CHARACTERISTIC
 /begin VAR_CHARACTERISTIC TQS16_TorqDec_ABS_Slip_5 BrkCalVariantCriterion
  /begin VAR_ADDRESS 0x80020D30 0x80024130 0x80027530 0x8002A930 0x8002DD30 0x80031130 0x80034530 0x80037930 /end VAR_ADDRESS
 /end VAR_CHARACTERISTIC
 /begin VAR_CHARACTERISTIC TQS16_TorqDec_Add_Slip_2 BrkCalVariantCriterion
  /begin VAR_ADDRESS 0x80020CC2 0x800240C2 0x800274C2 0x8002A8C2 0x8002DCC2 0x800310C2 0x800344C2 0x800378C2 /end VAR_ADDRESS
 /end VAR_CHARACTERISTIC
 /begin VAR_CHARACTERISTIC TQS16_TorqDec_Add_Slip_3 BrkCalVariantCriterion
  /begin VAR_ADDRESS 0x80020CC4 0x800240C4 0x800274C4 0x8002A8C4 0x8002DCC4 0x800310C4 0x800344C4 0x800378C4 /end VAR_ADDRESS
 /end VAR_CHARACTERISTIC
 /begin VAR_CHARACTERISTIC TQS16_TorqDec_Add_Slip_4 BrkCalVariantCriterion
  /begin VAR_ADDRESS 0x80020CC6 0x800240C6 0x800274C6 0x8002A8C6 0x8002DCC6 0x800310C6 0x800344C6 0x800378C6 /end VAR_ADDRESS
 /end VAR_CHARACTERISTIC
 /begin VAR_CHARACTERISTIC TQS16_TorqDec_Add_Slip_5 BrkCalVariantCriterion
  /begin VAR_ADDRESS 0x80020CC8 0x800240C8 0x800274C8 0x8002A8C8 0x8002DCC8 0x800310C8 0x800344C8 0x800378C8 /end VAR_ADDRESS
 /end VAR_CHARACTERISTIC
 /begin VAR_CHARACTERISTIC TQS16_UNDERSTEER_GRADIENT BrkCalVariantCriterion
  /begin VAR_ADDRESS 0x8002005A 0x8002345A 0x8002685A 0x80029C5A 0x8002D05A 0x8003045A 0x8003385A 0x80036C5A /end VAR_ADDRESS
 /end VAR_CHARACTERISTIC
 /begin VAR_CHARACTERISTIC TQS16_UNDER_ENT_DEL_YAW_HMU_HSP BrkCalVariantCriterion
  /begin VAR_ADDRESS 0x80020862 0x80023C62 0x80027062 0x8002A462 0x8002D862 0x80030C62 0x80034062 0x80037462 /end VAR_ADDRESS
 /end VAR_CHARACTERISTIC
 /begin VAR_CHARACTERISTIC TQS16_UNDER_ENT_DEL_YAW_HMU_LSP BrkCalVariantCriterion
  /begin VAR_ADDRESS 0x80020864 0x80023C64 0x80027064 0x8002A464 0x8002D864 0x80030C64 0x80034064 0x80037464 /end VAR_ADDRESS
 /end VAR_CHARACTERISTIC
 /begin VAR_CHARACTERISTIC TQS16_UNDER_ENT_DEL_YAW_HMU_MSP BrkCalVariantCriterion
  /begin VAR_ADDRESS 0x80020866 0x80023C66 0x80027066 0x8002A466 0x8002D866 0x80030C66 0x80034066 0x80037466 /end VAR_ADDRESS
 /end VAR_CHARACTERISTIC
 /begin VAR_CHARACTERISTIC TQS16_UNDER_ENT_DEL_YAW_LMU_HSP BrkCalVariantCriterion
  /begin VAR_ADDRESS 0x8002084A 0x80023C4A 0x8002704A 0x8002A44A 0x8002D84A 0x80030C4A 0x8003404A 0x8003744A /end VAR_ADDRESS
 /end VAR_CHARACTERISTIC
 /begin VAR_CHARACTERISTIC TQS16_UNDER_ENT_DEL_YAW_LMU_LSP BrkCalVariantCriterion
  /begin VAR_ADDRESS 0x8002084C 0x80023C4C 0x8002704C 0x8002A44C 0x8002D84C 0x80030C4C 0x8003404C 0x8003744C /end VAR_ADDRESS
 /end VAR_CHARACTERISTIC
 /begin VAR_CHARACTERISTIC TQS16_UNDER_ENT_DEL_YAW_LMU_MSP BrkCalVariantCriterion
  /begin VAR_ADDRESS 0x8002084E 0x80023C4E 0x8002704E 0x8002A44E 0x8002D84E 0x80030C4E 0x8003404E 0x8003744E /end VAR_ADDRESS
 /end VAR_CHARACTERISTIC
 /begin VAR_CHARACTERISTIC TQS16_UNDER_ENT_DEL_YAW_MMU_HSP BrkCalVariantCriterion
  /begin VAR_ADDRESS 0x80020856 0x80023C56 0x80027056 0x8002A456 0x8002D856 0x80030C56 0x80034056 0x80037456 /end VAR_ADDRESS
 /end VAR_CHARACTERISTIC
 /begin VAR_CHARACTERISTIC TQS16_UNDER_ENT_DEL_YAW_MMU_LSP BrkCalVariantCriterion
  /begin VAR_ADDRESS 0x80020858 0x80023C58 0x80027058 0x8002A458 0x8002D858 0x80030C58 0x80034058 0x80037458 /end VAR_ADDRESS
 /end VAR_CHARACTERISTIC
 /begin VAR_CHARACTERISTIC TQS16_UNDER_ENT_DEL_YAW_MMU_MSP BrkCalVariantCriterion
  /begin VAR_ADDRESS 0x8002085A 0x80023C5A 0x8002705A 0x8002A45A 0x8002D85A 0x80030C5A 0x8003405A 0x8003745A /end VAR_ADDRESS
 /end VAR_CHARACTERISTIC
 /begin VAR_CHARACTERISTIC TQS16_UNDER_EXT_DEL_YAW_HMU_HSP BrkCalVariantCriterion
  /begin VAR_ADDRESS 0x80020868 0x80023C68 0x80027068 0x8002A468 0x8002D868 0x80030C68 0x80034068 0x80037468 /end VAR_ADDRESS
 /end VAR_CHARACTERISTIC
 /begin VAR_CHARACTERISTIC TQS16_UNDER_EXT_DEL_YAW_HMU_LSP BrkCalVariantCriterion
  /begin VAR_ADDRESS 0x8002086A 0x80023C6A 0x8002706A 0x8002A46A 0x8002D86A 0x80030C6A 0x8003406A 0x8003746A /end VAR_ADDRESS
 /end VAR_CHARACTERISTIC
 /begin VAR_CHARACTERISTIC TQS16_UNDER_EXT_DEL_YAW_HMU_MSP BrkCalVariantCriterion
  /begin VAR_ADDRESS 0x8002086C 0x80023C6C 0x8002706C 0x8002A46C 0x8002D86C 0x80030C6C 0x8003406C 0x8003746C /end VAR_ADDRESS
 /end VAR_CHARACTERISTIC
 /begin VAR_CHARACTERISTIC TQS16_UNDER_EXT_DEL_YAW_LMU_HSP BrkCalVariantCriterion
  /begin VAR_ADDRESS 0x80020850 0x80023C50 0x80027050 0x8002A450 0x8002D850 0x80030C50 0x80034050 0x80037450 /end VAR_ADDRESS
 /end VAR_CHARACTERISTIC
 /begin VAR_CHARACTERISTIC TQS16_UNDER_EXT_DEL_YAW_LMU_LSP BrkCalVariantCriterion
  /begin VAR_ADDRESS 0x80020852 0x80023C52 0x80027052 0x8002A452 0x8002D852 0x80030C52 0x80034052 0x80037452 /end VAR_ADDRESS
 /end VAR_CHARACTERISTIC
 /begin VAR_CHARACTERISTIC TQS16_UNDER_EXT_DEL_YAW_LMU_MSP BrkCalVariantCriterion
  /begin VAR_ADDRESS 0x80020854 0x80023C54 0x80027054 0x8002A454 0x8002D854 0x80030C54 0x80034054 0x80037454 /end VAR_ADDRESS
 /end VAR_CHARACTERISTIC
 /begin VAR_CHARACTERISTIC TQS16_UNDER_EXT_DEL_YAW_MMU_HSP BrkCalVariantCriterion
  /begin VAR_ADDRESS 0x8002085C 0x80023C5C 0x8002705C 0x8002A45C 0x8002D85C 0x80030C5C 0x8003405C 0x8003745C /end VAR_ADDRESS
 /end VAR_CHARACTERISTIC
 /begin VAR_CHARACTERISTIC TQS16_UNDER_EXT_DEL_YAW_MMU_LSP BrkCalVariantCriterion
  /begin VAR_ADDRESS 0x8002085E 0x80023C5E 0x8002705E 0x8002A45E 0x8002D85E 0x80030C5E 0x8003405E 0x8003745E /end VAR_ADDRESS
 /end VAR_CHARACTERISTIC
 /begin VAR_CHARACTERISTIC TQS16_UNDER_EXT_DEL_YAW_MMU_MSP BrkCalVariantCriterion
  /begin VAR_ADDRESS 0x80020860 0x80023C60 0x80027060 0x8002A460 0x8002D860 0x80030C60 0x80034060 0x80037460 /end VAR_ADDRESS
 /end VAR_CHARACTERISTIC
 /begin VAR_CHARACTERISTIC TQS16_US2W_CTRL_ENTER_TH BrkCalVariantCriterion
  /begin VAR_ADDRESS 0x80020D56 0x80024156 0x80027556 0x8002A956 0x8002DD56 0x80031156 0x80034556 0x80037956 /end VAR_ADDRESS
 /end VAR_CHARACTERISTIC
 /begin VAR_CHARACTERISTIC TQS16_US2W_CTRL_EXIT_TH BrkCalVariantCriterion
  /begin VAR_ADDRESS 0x80020D58 0x80024158 0x80027558 0x8002A958 0x8002DD58 0x80031158 0x80034558 0x80037958 /end VAR_ADDRESS
 /end VAR_CHARACTERISTIC
 /begin VAR_CHARACTERISTIC TQS16_US2W_CTRL_SLIP_WEG BrkCalVariantCriterion
  /begin VAR_ADDRESS 0x80020D50 0x80024150 0x80027550 0x8002A950 0x8002DD50 0x80031150 0x80034550 0x80037950 /end VAR_ADDRESS
 /end VAR_CHARACTERISTIC
 /begin VAR_CHARACTERISTIC TQS16_US2W_ENTER_TAR_FX_OFFSET BrkCalVariantCriterion
  /begin VAR_ADDRESS 0x80020818 0x80023C18 0x80027018 0x8002A418 0x8002D818 0x80030C18 0x80034018 0x80037418 /end VAR_ADDRESS
 /end VAR_CHARACTERISTIC
 /begin VAR_CHARACTERISTIC TQS16_VEHICLE_MASS_FL BrkCalVariantCriterion
  /begin VAR_ADDRESS 0x8002004C 0x8002344C 0x8002684C 0x80029C4C 0x8002D04C 0x8003044C 0x8003384C 0x80036C4C /end VAR_ADDRESS
 /end VAR_CHARACTERISTIC
 /begin VAR_CHARACTERISTIC TQS16_VEHICLE_MASS_FR BrkCalVariantCriterion
  /begin VAR_ADDRESS 0x8002004E 0x8002344E 0x8002684E 0x80029C4E 0x8002D04E 0x8003044E 0x8003384E 0x80036C4E /end VAR_ADDRESS
 /end VAR_CHARACTERISTIC
 /begin VAR_CHARACTERISTIC TQS16_VEHICLE_MASS_RL BrkCalVariantCriterion
  /begin VAR_ADDRESS 0x80020050 0x80023450 0x80026850 0x80029C50 0x8002D050 0x80030450 0x80033850 0x80036C50 /end VAR_ADDRESS
 /end VAR_CHARACTERISTIC
 /begin VAR_CHARACTERISTIC TQS16_VEHICLE_MASS_RR BrkCalVariantCriterion
  /begin VAR_ADDRESS 0x80020052 0x80023452 0x80026852 0x80029C52 0x8002D052 0x80030452 0x80033852 0x80036C52 /end VAR_ADDRESS
 /end VAR_CHARACTERISTIC
 /begin VAR_CHARACTERISTIC TQS16_WHEEL_TREAD_FRONT BrkCalVariantCriterion
  /begin VAR_ADDRESS 0x80020056 0x80023456 0x80026856 0x80029C56 0x8002D056 0x80030456 0x80033856 0x80036C56 /end VAR_ADDRESS
 /end VAR_CHARACTERISTIC
 /begin VAR_CHARACTERISTIC TQS16_WHEEL_TREAD_REAR BrkCalVariantCriterion
  /begin VAR_ADDRESS 0x80020058 0x80023458 0x80026858 0x80029C58 0x8002D058 0x80030458 0x80033858 0x80036C58 /end VAR_ADDRESS
 /end VAR_CHARACTERISTIC
 /begin VAR_CHARACTERISTIC TQS16_WSTR_THR_LARGE BrkCalVariantCriterion
  /begin VAR_ADDRESS 0x800209EC 0x80023DEC 0x800271EC 0x8002A5EC 0x8002D9EC 0x80030DEC 0x800341EC 0x800375EC /end VAR_ADDRESS
 /end VAR_CHARACTERISTIC
 /begin VAR_CHARACTERISTIC TQS16_WSTR_THR_MEDIU BrkCalVariantCriterion
  /begin VAR_ADDRESS 0x800209EA 0x80023DEA 0x800271EA 0x8002A5EA 0x8002D9EA 0x80030DEA 0x800341EA 0x800375EA /end VAR_ADDRESS
 /end VAR_CHARACTERISTIC
 /begin VAR_CHARACTERISTIC TQS16_WSTR_THR_SMALL BrkCalVariantCriterion
  /begin VAR_ADDRESS 0x800209E8 0x80023DE8 0x800271E8 0x8002A5E8 0x8002D9E8 0x80030DE8 0x800341E8 0x800375E8 /end VAR_ADDRESS
 /end VAR_CHARACTERISTIC
 /begin VAR_CHARACTERISTIC TQS16_X1_Lower_Sus_Bank_Angle BrkCalVariantCriterion
  /begin VAR_ADDRESS 0x800209C6 0x80023DC6 0x800271C6 0x8002A5C6 0x8002D9C6 0x80030DC6 0x800341C6 0x800375C6 /end VAR_ADDRESS
 /end VAR_CHARACTERISTIC
 /begin VAR_CHARACTERISTIC TQS16_X2_Suspect_Bank_Angle BrkCalVariantCriterion
  /begin VAR_ADDRESS 0x800209C8 0x80023DC8 0x800271C8 0x8002A5C8 0x8002D9C8 0x80030DC8 0x800341C8 0x800375C8 /end VAR_ADDRESS
 /end VAR_CHARACTERISTIC
 /begin VAR_CHARACTERISTIC TQS16_X3_Detect_Bank_Angle BrkCalVariantCriterion
  /begin VAR_ADDRESS 0x800209CA 0x80023DCA 0x800271CA 0x8002A5CA 0x8002D9CA 0x80030DCA 0x800341CA 0x800375CA /end VAR_ADDRESS
 /end VAR_CHARACTERISTIC
 /begin VAR_CHARACTERISTIC TQS16_X4_Max_Bank_Angle BrkCalVariantCriterion
  /begin VAR_ADDRESS 0x800209CC 0x80023DCC 0x800271CC 0x8002A5CC 0x8002D9CC 0x80030DCC 0x800341CC 0x800375CC /end VAR_ADDRESS
 /end VAR_CHARACTERISTIC
 /begin VAR_CHARACTERISTIC TQS16_Y1_Bank_Lower_Sus_Add_Thres2 BrkCalVariantCriterion
  /begin VAR_ADDRESS 0x800209CE 0x80023DCE 0x800271CE 0x8002A5CE 0x8002D9CE 0x80030DCE 0x800341CE 0x800375CE /end VAR_ADDRESS
 /end VAR_CHARACTERISTIC
 /begin VAR_CHARACTERISTIC TQS16_Y1_FadeOut_TorqDec_HM BrkCalVariantCriterion
  /begin VAR_ADDRESS 0x80020842 0x80023C42 0x80027042 0x8002A442 0x8002D842 0x80030C42 0x80034042 0x80037442 /end VAR_ADDRESS
 /end VAR_CHARACTERISTIC
 /begin VAR_CHARACTERISTIC TQS16_Y1_FadeOut_TorqDec_LM BrkCalVariantCriterion
  /begin VAR_ADDRESS 0x80020832 0x80023C32 0x80027032 0x8002A432 0x8002D832 0x80030C32 0x80034032 0x80037432 /end VAR_ADDRESS
 /end VAR_CHARACTERISTIC
 /begin VAR_CHARACTERISTIC TQS16_Y1_FadeOut_TorqDec_MM BrkCalVariantCriterion
  /begin VAR_ADDRESS 0x8002083A 0x80023C3A 0x8002703A 0x8002A43A 0x8002D83A 0x80030C3A 0x8003403A 0x8003743A /end VAR_ADDRESS
 /end VAR_CHARACTERISTIC
 /begin VAR_CHARACTERISTIC TQS16_Y2_Bank_Suspect_Add_Thres2 BrkCalVariantCriterion
  /begin VAR_ADDRESS 0x800209D0 0x80023DD0 0x800271D0 0x8002A5D0 0x8002D9D0 0x80030DD0 0x800341D0 0x800375D0 /end VAR_ADDRESS
 /end VAR_CHARACTERISTIC
 /begin VAR_CHARACTERISTIC TQS16_Y2_FadeOut_TorqDec_HM BrkCalVariantCriterion
  /begin VAR_ADDRESS 0x80020844 0x80023C44 0x80027044 0x8002A444 0x8002D844 0x80030C44 0x80034044 0x80037444 /end VAR_ADDRESS
 /end VAR_CHARACTERISTIC
 /begin VAR_CHARACTERISTIC TQS16_Y2_FadeOut_TorqDec_LM BrkCalVariantCriterion
  /begin VAR_ADDRESS 0x80020834 0x80023C34 0x80027034 0x8002A434 0x8002D834 0x80030C34 0x80034034 0x80037434 /end VAR_ADDRESS
 /end VAR_CHARACTERISTIC
 /begin VAR_CHARACTERISTIC TQS16_Y2_FadeOut_TorqDec_MM BrkCalVariantCriterion
  /begin VAR_ADDRESS 0x8002083C 0x80023C3C 0x8002703C 0x8002A43C 0x8002D83C 0x80030C3C 0x8003403C 0x8003743C /end VAR_ADDRESS
 /end VAR_CHARACTERISTIC
 /begin VAR_CHARACTERISTIC TQS16_Y3_Bank_Detect_L_Add_Thres2 BrkCalVariantCriterion
  /begin VAR_ADDRESS 0x800209D2 0x80023DD2 0x800271D2 0x8002A5D2 0x8002D9D2 0x80030DD2 0x800341D2 0x800375D2 /end VAR_ADDRESS
 /end VAR_CHARACTERISTIC
 /begin VAR_CHARACTERISTIC TQS16_Y3_FadeOut_TorqDec_HM BrkCalVariantCriterion
  /begin VAR_ADDRESS 0x80020846 0x80023C46 0x80027046 0x8002A446 0x8002D846 0x80030C46 0x80034046 0x80037446 /end VAR_ADDRESS
 /end VAR_CHARACTERISTIC
 /begin VAR_CHARACTERISTIC TQS16_Y3_FadeOut_TorqDec_LM BrkCalVariantCriterion
  /begin VAR_ADDRESS 0x80020836 0x80023C36 0x80027036 0x8002A436 0x8002D836 0x80030C36 0x80034036 0x80037436 /end VAR_ADDRESS
 /end VAR_CHARACTERISTIC
 /begin VAR_CHARACTERISTIC TQS16_Y3_FadeOut_TorqDec_MM BrkCalVariantCriterion
  /begin VAR_ADDRESS 0x8002083E 0x80023C3E 0x8002703E 0x8002A43E 0x8002D83E 0x80030C3E 0x8003403E 0x8003743E /end VAR_ADDRESS
 /end VAR_CHARACTERISTIC
 /begin VAR_CHARACTERISTIC TQS16_Y4_Bank_Detect_U_Add_Thres2 BrkCalVariantCriterion
  /begin VAR_ADDRESS 0x800209D4 0x80023DD4 0x800271D4 0x8002A5D4 0x8002D9D4 0x80030DD4 0x800341D4 0x800375D4 /end VAR_ADDRESS
 /end VAR_CHARACTERISTIC
 /begin VAR_CHARACTERISTIC TQS16_Y4_FadeOut_TorqDec_HM BrkCalVariantCriterion
  /begin VAR_ADDRESS 0x80020848 0x80023C48 0x80027048 0x8002A448 0x8002D848 0x80030C48 0x80034048 0x80037448 /end VAR_ADDRESS
 /end VAR_CHARACTERISTIC
 /begin VAR_CHARACTERISTIC TQS16_Y4_FadeOut_TorqDec_LM BrkCalVariantCriterion
  /begin VAR_ADDRESS 0x80020838 0x80023C38 0x80027038 0x8002A438 0x8002D838 0x80030C38 0x80034038 0x80037438 /end VAR_ADDRESS
 /end VAR_CHARACTERISTIC
 /begin VAR_CHARACTERISTIC TQS16_Y4_FadeOut_TorqDec_MM BrkCalVariantCriterion
  /begin VAR_ADDRESS 0x80020840 0x80023C40 0x80027040 0x8002A440 0x8002D840 0x80030C40 0x80034040 0x80037440 /end VAR_ADDRESS
 /end VAR_CHARACTERISTIC
 /begin VAR_CHARACTERISTIC TQS16_YAWC_FILTER_20 BrkCalVariantCriterion
  /begin VAR_ADDRESS 0x8002002E 0x8002342E 0x8002682E 0x80029C2E 0x8002D02E 0x8003042E 0x8003382E 0x80036C2E /end VAR_ADDRESS
 /end VAR_CHARACTERISTIC
 /begin VAR_CHARACTERISTIC TQS16_YAWC_FILTER_40 BrkCalVariantCriterion
  /begin VAR_ADDRESS 0x80020030 0x80023430 0x80026830 0x80029C30 0x8002D030 0x80030430 0x80033830 0x80036C30 /end VAR_ADDRESS
 /end VAR_CHARACTERISTIC
 /begin VAR_CHARACTERISTIC TQS16_YAWC_FILTER_60 BrkCalVariantCriterion
  /begin VAR_ADDRESS 0x80020032 0x80023432 0x80026832 0x80029C32 0x8002D032 0x80030432 0x80033832 0x80036C32 /end VAR_ADDRESS
 /end VAR_CHARACTERISTIC
 /begin VAR_CHARACTERISTIC TQS16_YAW_ACCEL_TH_X1 BrkCalVariantCriterion
  /begin VAR_ADDRESS 0x80020C80 0x80024080 0x80027480 0x8002A880 0x8002DC80 0x80031080 0x80034480 0x80037880 /end VAR_ADDRESS
 /end VAR_CHARACTERISTIC
 /begin VAR_CHARACTERISTIC TQS16_YAW_ACCEL_TH_X2 BrkCalVariantCriterion
  /begin VAR_ADDRESS 0x80020C82 0x80024082 0x80027482 0x8002A882 0x8002DC82 0x80031082 0x80034482 0x80037882 /end VAR_ADDRESS
 /end VAR_CHARACTERISTIC
 /begin VAR_CHARACTERISTIC TQS16_YAW_ACCEL_TH_X3 BrkCalVariantCriterion
  /begin VAR_ADDRESS 0x80020C84 0x80024084 0x80027484 0x8002A884 0x8002DC84 0x80031084 0x80034484 0x80037884 /end VAR_ADDRESS
 /end VAR_CHARACTERISTIC
 /begin VAR_CHARACTERISTIC TQS16_YAW_LIMIT_BETAD_H_SP_CON BrkCalVariantCriterion
  /begin VAR_ADDRESS 0x80020AEE 0x80023EEE 0x800272EE 0x8002A6EE 0x8002DAEE 0x80030EEE 0x800342EE 0x800376EE /end VAR_ADDRESS
 /end VAR_CHARACTERISTIC
 /begin VAR_CHARACTERISTIC TQS16_YAW_LIMIT_BETAD_L_SP_CON BrkCalVariantCriterion
  /begin VAR_ADDRESS 0x80020AF0 0x80023EF0 0x800272F0 0x8002A6F0 0x8002DAF0 0x80030EF0 0x800342F0 0x800376F0 /end VAR_ADDRESS
 /end VAR_CHARACTERISTIC
 /begin VAR_CHARACTERISTIC TQS16_YAW_LIMIT_BETAD_M_SP_CON BrkCalVariantCriterion
  /begin VAR_ADDRESS 0x80020AF2 0x80023EF2 0x800272F2 0x8002A6F2 0x8002DAF2 0x80030EF2 0x800342F2 0x800376F2 /end VAR_ADDRESS
 /end VAR_CHARACTERISTIC
 /begin VAR_CHARACTERISTIC TQS16_YAW_LIMIT_DELTA_HIGH_FAST BrkCalVariantCriterion
  /begin VAR_ADDRESS 0x80020AC2 0x80023EC2 0x800272C2 0x8002A6C2 0x8002DAC2 0x80030EC2 0x800342C2 0x800376C2 /end VAR_ADDRESS
 /end VAR_CHARACTERISTIC
 /begin VAR_CHARACTERISTIC TQS16_YAW_LIMIT_DELTA_HIGH_FAST_ABS BrkCalVariantCriterion
  /begin VAR_ADDRESS 0x80020ACE 0x80023ECE 0x800272CE 0x8002A6CE 0x8002DACE 0x80030ECE 0x800342CE 0x800376CE /end VAR_ADDRESS
 /end VAR_CHARACTERISTIC
 /begin VAR_CHARACTERISTIC TQS16_YAW_LIMIT_DELTA_HIGH_SLOW BrkCalVariantCriterion
  /begin VAR_ADDRESS 0x80020AC4 0x80023EC4 0x800272C4 0x8002A6C4 0x8002DAC4 0x80030EC4 0x800342C4 0x800376C4 /end VAR_ADDRESS
 /end VAR_CHARACTERISTIC
 /begin VAR_CHARACTERISTIC TQS16_YAW_LIMIT_DELTA_HIGH_SLOW_ABS BrkCalVariantCriterion
  /begin VAR_ADDRESS 0x80020AD0 0x80023ED0 0x800272D0 0x8002A6D0 0x8002DAD0 0x80030ED0 0x800342D0 0x800376D0 /end VAR_ADDRESS
 /end VAR_CHARACTERISTIC
 /begin VAR_CHARACTERISTIC TQS16_YAW_LIMIT_DELTA_HIGH_VSLOW BrkCalVariantCriterion
  /begin VAR_ADDRESS 0x80020AC6 0x80023EC6 0x800272C6 0x8002A6C6 0x8002DAC6 0x80030EC6 0x800342C6 0x800376C6 /end VAR_ADDRESS
 /end VAR_CHARACTERISTIC
 /begin VAR_CHARACTERISTIC TQS16_YAW_LIMIT_DELTA_HIGH_VSLOW_ABS BrkCalVariantCriterion
  /begin VAR_ADDRESS 0x80020AD2 0x80023ED2 0x800272D2 0x8002A6D2 0x8002DAD2 0x80030ED2 0x800342D2 0x800376D2 /end VAR_ADDRESS
 /end VAR_CHARACTERISTIC
 /begin VAR_CHARACTERISTIC TQS16_YAW_LIMIT_DELTA_HMU_AY_L BrkCalVariantCriterion
  /begin VAR_ADDRESS 0x80020AF4 0x80023EF4 0x800272F4 0x8002A6F4 0x8002DAF4 0x80030EF4 0x800342F4 0x800376F4 /end VAR_ADDRESS
 /end VAR_CHARACTERISTIC
 /begin VAR_CHARACTERISTIC TQS16_YAW_LIMIT_DELTA_HMU_AY_M BrkCalVariantCriterion
  /begin VAR_ADDRESS 0x80020AF6 0x80023EF6 0x800272F6 0x8002A6F6 0x8002DAF6 0x80030EF6 0x800342F6 0x800376F6 /end VAR_ADDRESS
 /end VAR_CHARACTERISTIC
 /begin VAR_CHARACTERISTIC TQS16_YAW_LIMIT_DELTA_LOW_FAST BrkCalVariantCriterion
  /begin VAR_ADDRESS 0x80020AC8 0x80023EC8 0x800272C8 0x8002A6C8 0x8002DAC8 0x80030EC8 0x800342C8 0x800376C8 /end VAR_ADDRESS
 /end VAR_CHARACTERISTIC
 /begin VAR_CHARACTERISTIC TQS16_YAW_LIMIT_DELTA_LOW_FAST_ABS BrkCalVariantCriterion
  /begin VAR_ADDRESS 0x80020AD4 0x80023ED4 0x800272D4 0x8002A6D4 0x8002DAD4 0x80030ED4 0x800342D4 0x800376D4 /end VAR_ADDRESS
 /end VAR_CHARACTERISTIC
 /begin VAR_CHARACTERISTIC TQS16_YAW_LIMIT_DELTA_LOW_SLOW BrkCalVariantCriterion
  /begin VAR_ADDRESS 0x80020ACA 0x80023ECA 0x800272CA 0x8002A6CA 0x8002DACA 0x80030ECA 0x800342CA 0x800376CA /end VAR_ADDRESS
 /end VAR_CHARACTERISTIC
 /begin VAR_CHARACTERISTIC TQS16_YAW_LIMIT_DELTA_LOW_SLOW_ABS BrkCalVariantCriterion
  /begin VAR_ADDRESS 0x80020AD6 0x80023ED6 0x800272D6 0x8002A6D6 0x8002DAD6 0x80030ED6 0x800342D6 0x800376D6 /end VAR_ADDRESS
 /end VAR_CHARACTERISTIC
 /begin VAR_CHARACTERISTIC TQS16_YAW_LIMIT_DELTA_LOW_VSLOW BrkCalVariantCriterion
  /begin VAR_ADDRESS 0x80020ACC 0x80023ECC 0x800272CC 0x8002A6CC 0x8002DACC 0x80030ECC 0x800342CC 0x800376CC /end VAR_ADDRESS
 /end VAR_CHARACTERISTIC
 /begin VAR_CHARACTERISTIC TQS16_YAW_LIMIT_DELTA_LOW_VSLOW_ABS BrkCalVariantCriterion
  /begin VAR_ADDRESS 0x80020AD8 0x80023ED8 0x800272D8 0x8002A6D8 0x8002DAD8 0x80030ED8 0x800342D8 0x800376D8 /end VAR_ADDRESS
 /end VAR_CHARACTERISTIC
 /begin VAR_CHARACTERISTIC TQS16_YAW_LIMIT_DELTA_MMU_AY_L BrkCalVariantCriterion
  /begin VAR_ADDRESS 0x80020AF8 0x80023EF8 0x800272F8 0x8002A6F8 0x8002DAF8 0x80030EF8 0x800342F8 0x800376F8 /end VAR_ADDRESS
 /end VAR_CHARACTERISTIC
 /begin VAR_CHARACTERISTIC TQS16_YAW_LIMIT_DELTA_MMU_AY_M BrkCalVariantCriterion
  /begin VAR_ADDRESS 0x80020AFA 0x80023EFA 0x800272FA 0x8002A6FA 0x8002DAFA 0x80030EFA 0x800342FA 0x800376FA /end VAR_ADDRESS
 /end VAR_CHARACTERISTIC
 /begin VAR_CHARACTERISTIC TQS16_YAW_LIMIT_ENTER_FA_ST_H_SP BrkCalVariantCriterion
  /begin VAR_ADDRESS 0x80020AB8 0x80023EB8 0x800272B8 0x8002A6B8 0x8002DAB8 0x80030EB8 0x800342B8 0x800376B8 /end VAR_ADDRESS
 /end VAR_CHARACTERISTIC
 /begin VAR_CHARACTERISTIC TQS16_YAW_LIMIT_ENTER_FA_ST_L_SP BrkCalVariantCriterion
  /begin VAR_ADDRESS 0x80020ABA 0x80023EBA 0x800272BA 0x8002A6BA 0x8002DABA 0x80030EBA 0x800342BA 0x800376BA /end VAR_ADDRESS
 /end VAR_CHARACTERISTIC
 /begin VAR_CHARACTERISTIC TQS16_YAW_LIMIT_ENTER_FA_ST_M_SP BrkCalVariantCriterion
  /begin VAR_ADDRESS 0x80020ABC 0x80023EBC 0x800272BC 0x8002A6BC 0x8002DABC 0x80030EBC 0x800342BC 0x800376BC /end VAR_ADDRESS
 /end VAR_CHARACTERISTIC
 /begin VAR_CHARACTERISTIC TQS16_YAW_LIMIT_FA_ST_H_SP_ENT_AD BrkCalVariantCriterion
  /begin VAR_ADDRESS 0x80020ABE 0x80023EBE 0x800272BE 0x8002A6BE 0x8002DABE 0x80030EBE 0x800342BE 0x800376BE /end VAR_ADDRESS
 /end VAR_CHARACTERISTIC
 /begin VAR_CHARACTERISTIC TQS16_YAW_LIMIT_FA_ST_M_SP_ENT_AD BrkCalVariantCriterion
  /begin VAR_ADDRESS 0x80020AC0 0x80023EC0 0x800272C0 0x8002A6C0 0x8002DAC0 0x80030EC0 0x800342C0 0x800376C0 /end VAR_ADDRESS
 /end VAR_CHARACTERISTIC
 /begin VAR_CHARACTERISTIC TQS16_YAW_LIMIT_GAIN_H BrkCalVariantCriterion
  /begin VAR_ADDRESS 0x80020A74 0x80023E74 0x80027274 0x8002A674 0x8002DA74 0x80030E74 0x80034274 0x80037674 /end VAR_ADDRESS
 /end VAR_CHARACTERISTIC
 /begin VAR_CHARACTERISTIC TQS16_YAW_LIMIT_GAIN_HMU_ABS BrkCalVariantCriterion
  /begin VAR_ADDRESS 0x80020A08 0x80023E08 0x80027208 0x8002A608 0x8002DA08 0x80030E08 0x80034208 0x80037608 /end VAR_ADDRESS
 /end VAR_CHARACTERISTIC
 /begin VAR_CHARACTERISTIC TQS16_YAW_LIMIT_GAIN_HMU_HSPD BrkCalVariantCriterion
  /begin VAR_ADDRESS 0x80020A06 0x80023E06 0x80027206 0x8002A606 0x8002DA06 0x80030E06 0x80034206 0x80037606 /end VAR_ADDRESS
 /end VAR_CHARACTERISTIC
 /begin VAR_CHARACTERISTIC TQS16_YAW_LIMIT_GAIN_HMU_LSPD BrkCalVariantCriterion
  /begin VAR_ADDRESS 0x80020A02 0x80023E02 0x80027202 0x8002A602 0x8002DA02 0x80030E02 0x80034202 0x80037602 /end VAR_ADDRESS
 /end VAR_CHARACTERISTIC
 /begin VAR_CHARACTERISTIC TQS16_YAW_LIMIT_GAIN_HMU_MSPD BrkCalVariantCriterion
  /begin VAR_ADDRESS 0x80020A04 0x80023E04 0x80027204 0x8002A604 0x8002DA04 0x80030E04 0x80034204 0x80037604 /end VAR_ADDRESS
 /end VAR_CHARACTERISTIC
 /begin VAR_CHARACTERISTIC TQS16_YAW_LIMIT_GAIN_H_ABS BrkCalVariantCriterion
  /begin VAR_ADDRESS 0x80020A76 0x80023E76 0x80027276 0x8002A676 0x8002DA76 0x80030E76 0x80034276 0x80037676 /end VAR_ADDRESS
 /end VAR_CHARACTERISTIC
 /begin VAR_CHARACTERISTIC TQS16_YAW_LIMIT_GAIN_H_SL BrkCalVariantCriterion
  /begin VAR_ADDRESS 0x80020A72 0x80023E72 0x80027272 0x8002A672 0x8002DA72 0x80030E72 0x80034272 0x80037672 /end VAR_ADDRESS
 /end VAR_CHARACTERISTIC
 /begin VAR_CHARACTERISTIC TQS16_YAW_LIMIT_GAIN_H_V1 BrkCalVariantCriterion
  /begin VAR_ADDRESS 0x80020A78 0x80023E78 0x80027278 0x8002A678 0x8002DA78 0x80030E78 0x80034278 0x80037678 /end VAR_ADDRESS
 /end VAR_CHARACTERISTIC
 /begin VAR_CHARACTERISTIC TQS16_YAW_LIMIT_GAIN_H_V2 BrkCalVariantCriterion
  /begin VAR_ADDRESS 0x80020A7A 0x80023E7A 0x8002727A 0x8002A67A 0x8002DA7A 0x80030E7A 0x8003427A 0x8003767A /end VAR_ADDRESS
 /end VAR_CHARACTERISTIC
 /begin VAR_CHARACTERISTIC TQS16_YAW_LIMIT_GAIN_L BrkCalVariantCriterion
  /begin VAR_ADDRESS 0x80020A9E 0x80023E9E 0x8002729E 0x8002A69E 0x8002DA9E 0x80030E9E 0x8003429E 0x8003769E /end VAR_ADDRESS
 /end VAR_CHARACTERISTIC
 /begin VAR_CHARACTERISTIC TQS16_YAW_LIMIT_GAIN_LIMIT_H BrkCalVariantCriterion
  /begin VAR_ADDRESS 0x80020A7C 0x80023E7C 0x8002727C 0x8002A67C 0x8002DA7C 0x80030E7C 0x8003427C 0x8003767C /end VAR_ADDRESS
 /end VAR_CHARACTERISTIC
 /begin VAR_CHARACTERISTIC TQS16_YAW_LIMIT_GAIN_LIMIT_H_V1 BrkCalVariantCriterion
  /begin VAR_ADDRESS 0x80020A7E 0x80023E7E 0x8002727E 0x8002A67E 0x8002DA7E 0x80030E7E 0x8003427E 0x8003767E /end VAR_ADDRESS
 /end VAR_CHARACTERISTIC
 /begin VAR_CHARACTERISTIC TQS16_YAW_LIMIT_GAIN_LIMIT_H_V2 BrkCalVariantCriterion
  /begin VAR_ADDRESS 0x80020A80 0x80023E80 0x80027280 0x8002A680 0x8002DA80 0x80030E80 0x80034280 0x80037680 /end VAR_ADDRESS
 /end VAR_CHARACTERISTIC
 /begin VAR_CHARACTERISTIC TQS16_YAW_LIMIT_GAIN_LIMIT_L BrkCalVariantCriterion
  /begin VAR_ADDRESS 0x80020AA0 0x80023EA0 0x800272A0 0x8002A6A0 0x8002DAA0 0x80030EA0 0x800342A0 0x800376A0 /end VAR_ADDRESS
 /end VAR_CHARACTERISTIC
 /begin VAR_CHARACTERISTIC TQS16_YAW_LIMIT_GAIN_LIMIT_L_V1 BrkCalVariantCriterion
  /begin VAR_ADDRESS 0x80020AA2 0x80023EA2 0x800272A2 0x8002A6A2 0x8002DAA2 0x80030EA2 0x800342A2 0x800376A2 /end VAR_ADDRESS
 /end VAR_CHARACTERISTIC
 /begin VAR_CHARACTERISTIC TQS16_YAW_LIMIT_GAIN_LIMIT_L_V2 BrkCalVariantCriterion
  /begin VAR_ADDRESS 0x80020AA4 0x80023EA4 0x800272A4 0x8002A6A4 0x8002DAA4 0x80030EA4 0x800342A4 0x800376A4 /end VAR_ADDRESS
 /end VAR_CHARACTERISTIC
 /begin VAR_CHARACTERISTIC TQS16_YAW_LIMIT_GAIN_LIMIT_M BrkCalVariantCriterion
  /begin VAR_ADDRESS 0x80020A8A 0x80023E8A 0x8002728A 0x8002A68A 0x8002DA8A 0x80030E8A 0x8003428A 0x8003768A /end VAR_ADDRESS
 /end VAR_CHARACTERISTIC
 /begin VAR_CHARACTERISTIC TQS16_YAW_LIMIT_GAIN_LIMIT_M_V1 BrkCalVariantCriterion
  /begin VAR_ADDRESS 0x80020A8C 0x80023E8C 0x8002728C 0x8002A68C 0x8002DA8C 0x80030E8C 0x8003428C 0x8003768C /end VAR_ADDRESS
 /end VAR_CHARACTERISTIC
 /begin VAR_CHARACTERISTIC TQS16_YAW_LIMIT_GAIN_LIMIT_M_V2 BrkCalVariantCriterion
  /begin VAR_ADDRESS 0x80020A8E 0x80023E8E 0x8002728E 0x8002A68E 0x8002DA8E 0x80030E8E 0x8003428E 0x8003768E /end VAR_ADDRESS
 /end VAR_CHARACTERISTIC
 /begin VAR_CHARACTERISTIC TQS16_YAW_LIMIT_GAIN_LMU_ABS BrkCalVariantCriterion
  /begin VAR_ADDRESS 0x800209F8 0x80023DF8 0x800271F8 0x8002A5F8 0x8002D9F8 0x80030DF8 0x800341F8 0x800375F8 /end VAR_ADDRESS
 /end VAR_CHARACTERISTIC
 /begin VAR_CHARACTERISTIC TQS16_YAW_LIMIT_GAIN_LMU_HSPD BrkCalVariantCriterion
  /begin VAR_ADDRESS 0x800209F6 0x80023DF6 0x800271F6 0x8002A5F6 0x8002D9F6 0x80030DF6 0x800341F6 0x800375F6 /end VAR_ADDRESS
 /end VAR_CHARACTERISTIC
 /begin VAR_CHARACTERISTIC TQS16_YAW_LIMIT_GAIN_LMU_LSPD BrkCalVariantCriterion
  /begin VAR_ADDRESS 0x800209F2 0x80023DF2 0x800271F2 0x8002A5F2 0x8002D9F2 0x80030DF2 0x800341F2 0x800375F2 /end VAR_ADDRESS
 /end VAR_CHARACTERISTIC
 /begin VAR_CHARACTERISTIC TQS16_YAW_LIMIT_GAIN_LMU_MSPD BrkCalVariantCriterion
  /begin VAR_ADDRESS 0x800209F4 0x80023DF4 0x800271F4 0x8002A5F4 0x8002D9F4 0x80030DF4 0x800341F4 0x800375F4 /end VAR_ADDRESS
 /end VAR_CHARACTERISTIC
 /begin VAR_CHARACTERISTIC TQS16_YAW_LIMIT_GAIN_L_ABS BrkCalVariantCriterion
  /begin VAR_ADDRESS 0x80020AA6 0x80023EA6 0x800272A6 0x8002A6A6 0x8002DAA6 0x80030EA6 0x800342A6 0x800376A6 /end VAR_ADDRESS
 /end VAR_CHARACTERISTIC
 /begin VAR_CHARACTERISTIC TQS16_YAW_LIMIT_GAIN_L_V1 BrkCalVariantCriterion
  /begin VAR_ADDRESS 0x80020AA8 0x80023EA8 0x800272A8 0x8002A6A8 0x8002DAA8 0x80030EA8 0x800342A8 0x800376A8 /end VAR_ADDRESS
 /end VAR_CHARACTERISTIC
 /begin VAR_CHARACTERISTIC TQS16_YAW_LIMIT_GAIN_L_V2 BrkCalVariantCriterion
  /begin VAR_ADDRESS 0x80020AAA 0x80023EAA 0x800272AA 0x8002A6AA 0x8002DAAA 0x80030EAA 0x800342AA 0x800376AA /end VAR_ADDRESS
 /end VAR_CHARACTERISTIC
 /begin VAR_CHARACTERISTIC TQS16_YAW_LIMIT_GAIN_M BrkCalVariantCriterion
  /begin VAR_ADDRESS 0x80020A90 0x80023E90 0x80027290 0x8002A690 0x8002DA90 0x80030E90 0x80034290 0x80037690 /end VAR_ADDRESS
 /end VAR_CHARACTERISTIC
 /begin VAR_CHARACTERISTIC TQS16_YAW_LIMIT_GAIN_MMU_ABS BrkCalVariantCriterion
  /begin VAR_ADDRESS 0x80020A00 0x80023E00 0x80027200 0x8002A600 0x8002DA00 0x80030E00 0x80034200 0x80037600 /end VAR_ADDRESS
 /end VAR_CHARACTERISTIC
 /begin VAR_CHARACTERISTIC TQS16_YAW_LIMIT_GAIN_MMU_HSPD BrkCalVariantCriterion
  /begin VAR_ADDRESS 0x800209FE 0x80023DFE 0x800271FE 0x8002A5FE 0x8002D9FE 0x80030DFE 0x800341FE 0x800375FE /end VAR_ADDRESS
 /end VAR_CHARACTERISTIC
 /begin VAR_CHARACTERISTIC TQS16_YAW_LIMIT_GAIN_MMU_LSPD BrkCalVariantCriterion
  /begin VAR_ADDRESS 0x800209FA 0x80023DFA 0x800271FA 0x8002A5FA 0x8002D9FA 0x80030DFA 0x800341FA 0x800375FA /end VAR_ADDRESS
 /end VAR_CHARACTERISTIC
 /begin VAR_CHARACTERISTIC TQS16_YAW_LIMIT_GAIN_MMU_MSPD BrkCalVariantCriterion
  /begin VAR_ADDRESS 0x800209FC 0x80023DFC 0x800271FC 0x8002A5FC 0x8002D9FC 0x80030DFC 0x800341FC 0x800375FC /end VAR_ADDRESS
 /end VAR_CHARACTERISTIC
 /begin VAR_CHARACTERISTIC TQS16_YAW_LIMIT_GAIN_M_ABS BrkCalVariantCriterion
  /begin VAR_ADDRESS 0x80020A92 0x80023E92 0x80027292 0x8002A692 0x8002DA92 0x80030E92 0x80034292 0x80037692 /end VAR_ADDRESS
 /end VAR_CHARACTERISTIC
 /begin VAR_CHARACTERISTIC TQS16_YAW_LIMIT_GAIN_M_V1 BrkCalVariantCriterion
  /begin VAR_ADDRESS 0x80020A94 0x80023E94 0x80027294 0x8002A694 0x8002DA94 0x80030E94 0x80034294 0x80037694 /end VAR_ADDRESS
 /end VAR_CHARACTERISTIC
 /begin VAR_CHARACTERISTIC TQS16_YAW_LIMIT_GAIN_M_V2 BrkCalVariantCriterion
  /begin VAR_ADDRESS 0x80020A96 0x80023E96 0x80027296 0x8002A696 0x8002DA96 0x80030E96 0x80034296 0x80037696 /end VAR_ADDRESS
 /end VAR_CHARACTERISTIC
 /begin VAR_CHARACTERISTIC TQS16_YAW_LIMIT_HMU_DEL_AY BrkCalVariantCriterion
  /begin VAR_ADDRESS 0x80020AFC 0x80023EFC 0x800272FC 0x8002A6FC 0x8002DAFC 0x80030EFC 0x800342FC 0x800376FC /end VAR_ADDRESS
 /end VAR_CHARACTERISTIC
 /begin VAR_CHARACTERISTIC TQS16_YAW_LIMIT_H_SPEED_V1 BrkCalVariantCriterion
  /begin VAR_ADDRESS 0x80020ADA 0x80023EDA 0x800272DA 0x8002A6DA 0x8002DADA 0x80030EDA 0x800342DA 0x800376DA /end VAR_ADDRESS
 /end VAR_CHARACTERISTIC
 /begin VAR_CHARACTERISTIC TQS16_YAW_LIMIT_H_SPEED_V2 BrkCalVariantCriterion
  /begin VAR_ADDRESS 0x80020ADC 0x80023EDC 0x800272DC 0x8002A6DC 0x8002DADC 0x80030EDC 0x800342DC 0x800376DC /end VAR_ADDRESS
 /end VAR_CHARACTERISTIC
 /begin VAR_CHARACTERISTIC TQS16_YAW_LIMIT_H_SPEED_V3 BrkCalVariantCriterion
  /begin VAR_ADDRESS 0x80020ADE 0x80023EDE 0x800272DE 0x8002A6DE 0x8002DADE 0x80030EDE 0x800342DE 0x800376DE /end VAR_ADDRESS
 /end VAR_CHARACTERISTIC
 /begin VAR_CHARACTERISTIC TQS16_YAW_LIMIT_H_V1_INC_DEL_AY BrkCalVariantCriterion
  /begin VAR_ADDRESS 0x80020AE0 0x80023EE0 0x800272E0 0x8002A6E0 0x8002DAE0 0x80030EE0 0x800342E0 0x800376E0 /end VAR_ADDRESS
 /end VAR_CHARACTERISTIC
 /begin VAR_CHARACTERISTIC TQS16_YAW_LIMIT_H_V2_INC_DEL_AY BrkCalVariantCriterion
  /begin VAR_ADDRESS 0x80020AE2 0x80023EE2 0x800272E2 0x8002A6E2 0x8002DAE2 0x80030EE2 0x800342E2 0x800376E2 /end VAR_ADDRESS
 /end VAR_CHARACTERISTIC
 /begin VAR_CHARACTERISTIC TQS16_YAW_LIMIT_MMU_DEL_AY BrkCalVariantCriterion
  /begin VAR_ADDRESS 0x80020AFE 0x80023EFE 0x800272FE 0x8002A6FE 0x8002DAFE 0x80030EFE 0x800342FE 0x800376FE /end VAR_ADDRESS
 /end VAR_CHARACTERISTIC
 /begin VAR_CHARACTERISTIC TQS16_YAW_LIMIT_M_SPEED_V1 BrkCalVariantCriterion
  /begin VAR_ADDRESS 0x80020AE4 0x80023EE4 0x800272E4 0x8002A6E4 0x8002DAE4 0x80030EE4 0x800342E4 0x800376E4 /end VAR_ADDRESS
 /end VAR_CHARACTERISTIC
 /begin VAR_CHARACTERISTIC TQS16_YAW_LIMIT_M_SPEED_V2 BrkCalVariantCriterion
  /begin VAR_ADDRESS 0x80020AE6 0x80023EE6 0x800272E6 0x8002A6E6 0x8002DAE6 0x80030EE6 0x800342E6 0x800376E6 /end VAR_ADDRESS
 /end VAR_CHARACTERISTIC
 /begin VAR_CHARACTERISTIC TQS16_YAW_LIMIT_M_SPEED_V3 BrkCalVariantCriterion
  /begin VAR_ADDRESS 0x80020AE8 0x80023EE8 0x800272E8 0x8002A6E8 0x8002DAE8 0x80030EE8 0x800342E8 0x800376E8 /end VAR_ADDRESS
 /end VAR_CHARACTERISTIC
 /begin VAR_CHARACTERISTIC TQS16_YAW_LIMIT_M_V1_INC_DEL_AY BrkCalVariantCriterion
  /begin VAR_ADDRESS 0x80020AEA 0x80023EEA 0x800272EA 0x8002A6EA 0x8002DAEA 0x80030EEA 0x800342EA 0x800376EA /end VAR_ADDRESS
 /end VAR_CHARACTERISTIC
 /begin VAR_CHARACTERISTIC TQS16_YAW_LIMIT_M_V2_INC_DEL_AY BrkCalVariantCriterion
  /begin VAR_ADDRESS 0x80020AEC 0x80023EEC 0x800272EC 0x8002A6EC 0x8002DAEC 0x80030EEC 0x800342EC 0x800376EC /end VAR_ADDRESS
 /end VAR_CHARACTERISTIC
 /begin VAR_CHARACTERISTIC TQS16_YAW_LIMIT_ST_FAST_ENTER BrkCalVariantCriterion
  /begin VAR_ADDRESS 0x80020AB0 0x80023EB0 0x800272B0 0x8002A6B0 0x8002DAB0 0x80030EB0 0x800342B0 0x800376B0 /end VAR_ADDRESS
 /end VAR_CHARACTERISTIC
 /begin VAR_CHARACTERISTIC TQS16_YAW_LIMIT_ST_SLOW_ENTER BrkCalVariantCriterion
  /begin VAR_ADDRESS 0x80020AB2 0x80023EB2 0x800272B2 0x8002A6B2 0x8002DAB2 0x80030EB2 0x800342B2 0x800376B2 /end VAR_ADDRESS
 /end VAR_CHARACTERISTIC
 /begin VAR_CHARACTERISTIC TQS16_YAW_LIMIT_ST_VSLOW_ENTER_H BrkCalVariantCriterion
  /begin VAR_ADDRESS 0x80020AB4 0x80023EB4 0x800272B4 0x8002A6B4 0x8002DAB4 0x80030EB4 0x800342B4 0x800376B4 /end VAR_ADDRESS
 /end VAR_CHARACTERISTIC
 /begin VAR_CHARACTERISTIC TQS16_YAW_LIMIT_ST_VSLOW_ENTER_M BrkCalVariantCriterion
  /begin VAR_ADDRESS 0x80020AB6 0x80023EB6 0x800272B6 0x8002A6B6 0x8002DAB6 0x80030EB6 0x800342B6 0x800376B6 /end VAR_ADDRESS
 /end VAR_CHARACTERISTIC
 /begin VAR_CHARACTERISTIC TQS16_YAW_LIMIT_WSTR_DEC_GAIN_H BrkCalVariantCriterion
  /begin VAR_ADDRESS 0x80020A82 0x80023E82 0x80027282 0x8002A682 0x8002DA82 0x80030E82 0x80034282 0x80037682 /end VAR_ADDRESS
 /end VAR_CHARACTERISTIC
 /begin VAR_CHARACTERISTIC TQS16_YAW_LIMIT_WSTR_DEC_GAIN_L BrkCalVariantCriterion
  /begin VAR_ADDRESS 0x80020AAC 0x80023EAC 0x800272AC 0x8002A6AC 0x8002DAAC 0x80030EAC 0x800342AC 0x800376AC /end VAR_ADDRESS
 /end VAR_CHARACTERISTIC
 /begin VAR_CHARACTERISTIC TQS16_YAW_LIMIT_WSTR_DEC_GAIN_M BrkCalVariantCriterion
  /begin VAR_ADDRESS 0x80020A98 0x80023E98 0x80027298 0x8002A698 0x8002DA98 0x80030E98 0x80034298 0x80037698 /end VAR_ADDRESS
 /end VAR_CHARACTERISTIC
 /begin VAR_CHARACTERISTIC TQS16_YAW_LMT_WEG_SLOW_STR_MU_H BrkCalVariantCriterion
  /begin VAR_ADDRESS 0x80020A84 0x80023E84 0x80027284 0x8002A684 0x8002DA84 0x80030E84 0x80034284 0x80037684 /end VAR_ADDRESS
 /end VAR_CHARACTERISTIC
 /begin VAR_CHARACTERISTIC TQS16_YAW_LMT_WEG_SLOW_STR_MU_L BrkCalVariantCriterion
  /begin VAR_ADDRESS 0x80020AAE 0x80023EAE 0x800272AE 0x8002A6AE 0x8002DAAE 0x80030EAE 0x800342AE 0x800376AE /end VAR_ADDRESS
 /end VAR_CHARACTERISTIC
 /begin VAR_CHARACTERISTIC TQS16_YAW_LMT_WEG_SLOW_STR_MU_M BrkCalVariantCriterion
  /begin VAR_ADDRESS 0x80020A9A 0x80023E9A 0x8002729A 0x8002A69A 0x8002DA9A 0x80030E9A 0x8003429A 0x8003769A /end VAR_ADDRESS
 /end VAR_CHARACTERISTIC
 /begin VAR_CHARACTERISTIC TQS16_YAW_SIGN_CH_THRESHOLD BrkCalVariantCriterion
  /begin VAR_ADDRESS 0x800209F0 0x80023DF0 0x800271F0 0x8002A5F0 0x8002D9F0 0x80030DF0 0x800341F0 0x800375F0 /end VAR_ADDRESS
 /end VAR_CHARACTERISTIC
 /begin VAR_CHARACTERISTIC TQS16_YC_AR_LIMIT_HIG_SPD_H_MU BrkCalVariantCriterion
  /begin VAR_ADDRESS 0x80020C7E 0x8002407E 0x8002747E 0x8002A87E 0x8002DC7E 0x8003107E 0x8003447E 0x8003787E /end VAR_ADDRESS
 /end VAR_CHARACTERISTIC
 /begin VAR_CHARACTERISTIC TQS16_YC_AR_LIMIT_HIG_SPD_L_MU BrkCalVariantCriterion
  /begin VAR_ADDRESS 0x80020C72 0x80024072 0x80027472 0x8002A872 0x8002DC72 0x80031072 0x80034472 0x80037872 /end VAR_ADDRESS
 /end VAR_CHARACTERISTIC
 /begin VAR_CHARACTERISTIC TQS16_YC_AR_LIMIT_HIG_SPD_M_MU BrkCalVariantCriterion
  /begin VAR_ADDRESS 0x80020C78 0x80024078 0x80027478 0x8002A878 0x8002DC78 0x80031078 0x80034478 0x80037878 /end VAR_ADDRESS
 /end VAR_CHARACTERISTIC
 /begin VAR_CHARACTERISTIC TQS16_YC_AR_LIMIT_LOW_SPD_H_MU BrkCalVariantCriterion
  /begin VAR_ADDRESS 0x80020C7A 0x8002407A 0x8002747A 0x8002A87A 0x8002DC7A 0x8003107A 0x8003447A 0x8003787A /end VAR_ADDRESS
 /end VAR_CHARACTERISTIC
 /begin VAR_CHARACTERISTIC TQS16_YC_AR_LIMIT_LOW_SPD_L_MU BrkCalVariantCriterion
  /begin VAR_ADDRESS 0x80020C6E 0x8002406E 0x8002746E 0x8002A86E 0x8002DC6E 0x8003106E 0x8003446E 0x8003786E /end VAR_ADDRESS
 /end VAR_CHARACTERISTIC
 /begin VAR_CHARACTERISTIC TQS16_YC_AR_LIMIT_LOW_SPD_M_MU BrkCalVariantCriterion
  /begin VAR_ADDRESS 0x80020C74 0x80024074 0x80027474 0x8002A874 0x8002DC74 0x80031074 0x80034474 0x80037874 /end VAR_ADDRESS
 /end VAR_CHARACTERISTIC
 /begin VAR_CHARACTERISTIC TQS16_YC_AR_LIMIT_MED_SPD_H_MU BrkCalVariantCriterion
  /begin VAR_ADDRESS 0x80020C7C 0x8002407C 0x8002747C 0x8002A87C 0x8002DC7C 0x8003107C 0x8003447C 0x8003787C /end VAR_ADDRESS
 /end VAR_CHARACTERISTIC
 /begin VAR_CHARACTERISTIC TQS16_YC_AR_LIMIT_MED_SPD_L_MU BrkCalVariantCriterion
  /begin VAR_ADDRESS 0x80020C70 0x80024070 0x80027470 0x8002A870 0x8002DC70 0x80031070 0x80034470 0x80037870 /end VAR_ADDRESS
 /end VAR_CHARACTERISTIC
 /begin VAR_CHARACTERISTIC TQS16_YC_AR_LIMIT_MED_SPD_M_MU BrkCalVariantCriterion
  /begin VAR_ADDRESS 0x80020C76 0x80024076 0x80027476 0x8002A876 0x8002DC76 0x80031076 0x80034476 0x80037876 /end VAR_ADDRESS
 /end VAR_CHARACTERISTIC
 /begin VAR_CHARACTERISTIC TQS16_YC_AR_M_DEL_YAW_TH_H BrkCalVariantCriterion
  /begin VAR_ADDRESS 0x8002086E 0x80023C6E 0x8002706E 0x8002A46E 0x8002D86E 0x80030C6E 0x8003406E 0x8003746E /end VAR_ADDRESS
 /end VAR_CHARACTERISTIC
 /begin VAR_CHARACTERISTIC TQS16_YC_AR_M_DEL_YAW_TH_L BrkCalVariantCriterion
  /begin VAR_ADDRESS 0x80020872 0x80023C72 0x80027072 0x8002A472 0x8002D872 0x80030C72 0x80034072 0x80037472 /end VAR_ADDRESS
 /end VAR_CHARACTERISTIC
 /begin VAR_CHARACTERISTIC TQS16_YC_AR_M_DEL_YAW_TH_M BrkCalVariantCriterion
  /begin VAR_ADDRESS 0x80020870 0x80023C70 0x80027070 0x8002A470 0x8002D870 0x80030C70 0x80034070 0x80037470 /end VAR_ADDRESS
 /end VAR_CHARACTERISTIC
 /begin VAR_CHARACTERISTIC TQS16_YC_AR_M_DEP_DYAW_WEG_H BrkCalVariantCriterion
  /begin VAR_ADDRESS 0x80020874 0x80023C74 0x80027074 0x8002A474 0x8002D874 0x80030C74 0x80034074 0x80037474 /end VAR_ADDRESS
 /end VAR_CHARACTERISTIC
 /begin VAR_CHARACTERISTIC TQS16_YC_AR_M_DEP_DYAW_WEG_L BrkCalVariantCriterion
  /begin VAR_ADDRESS 0x80020878 0x80023C78 0x80027078 0x8002A478 0x8002D878 0x80030C78 0x80034078 0x80037478 /end VAR_ADDRESS
 /end VAR_CHARACTERISTIC
 /begin VAR_CHARACTERISTIC TQS16_YC_AR_M_DEP_DYAW_WEG_M BrkCalVariantCriterion
  /begin VAR_ADDRESS 0x80020876 0x80023C76 0x80027076 0x8002A476 0x8002D876 0x80030C76 0x80034076 0x80037476 /end VAR_ADDRESS
 /end VAR_CHARACTERISTIC
 /begin VAR_CHARACTERISTIC TQS16_YC_AR_P_GAIN_HIG_MU BrkCalVariantCriterion
  /begin VAR_ADDRESS 0x80020890 0x80023C90 0x80027090 0x8002A490 0x8002D890 0x80030C90 0x80034090 0x80037490 /end VAR_ADDRESS
 /end VAR_CHARACTERISTIC
 /begin VAR_CHARACTERISTIC TQS16_YC_AR_P_GAIN_LOW_MU BrkCalVariantCriterion
  /begin VAR_ADDRESS 0x8002088C 0x80023C8C 0x8002708C 0x8002A48C 0x8002D88C 0x80030C8C 0x8003408C 0x8003748C /end VAR_ADDRESS
 /end VAR_CHARACTERISTIC
 /begin VAR_CHARACTERISTIC TQS16_YC_AR_P_GAIN_MED_MU BrkCalVariantCriterion
  /begin VAR_ADDRESS 0x8002088E 0x80023C8E 0x8002708E 0x8002A48E 0x8002D88E 0x80030C8E 0x8003408E 0x8003748E /end VAR_ADDRESS
 /end VAR_CHARACTERISTIC
 /begin VAR_CHARACTERISTIC TQS16_YC_AR_THRES_HIG_SPD_H_MU BrkCalVariantCriterion
  /begin VAR_ADDRESS 0x80020886 0x80023C86 0x80027086 0x8002A486 0x8002D886 0x80030C86 0x80034086 0x80037486 /end VAR_ADDRESS
 /end VAR_CHARACTERISTIC
 /begin VAR_CHARACTERISTIC TQS16_YC_AR_THRES_HIG_SPD_L_MU BrkCalVariantCriterion
  /begin VAR_ADDRESS 0x8002087A 0x80023C7A 0x8002707A 0x8002A47A 0x8002D87A 0x80030C7A 0x8003407A 0x8003747A /end VAR_ADDRESS
 /end VAR_CHARACTERISTIC
 /begin VAR_CHARACTERISTIC TQS16_YC_AR_THRES_HIG_SPD_M_MU BrkCalVariantCriterion
  /begin VAR_ADDRESS 0x80020880 0x80023C80 0x80027080 0x8002A480 0x8002D880 0x80030C80 0x80034080 0x80037480 /end VAR_ADDRESS
 /end VAR_CHARACTERISTIC
 /begin VAR_CHARACTERISTIC TQS16_YC_AR_THRES_LOW_SPD_H_MU BrkCalVariantCriterion
  /begin VAR_ADDRESS 0x8002088A 0x80023C8A 0x8002708A 0x8002A48A 0x8002D88A 0x80030C8A 0x8003408A 0x8003748A /end VAR_ADDRESS
 /end VAR_CHARACTERISTIC
 /begin VAR_CHARACTERISTIC TQS16_YC_AR_THRES_LOW_SPD_L_MU BrkCalVariantCriterion
  /begin VAR_ADDRESS 0x8002087E 0x80023C7E 0x8002707E 0x8002A47E 0x8002D87E 0x80030C7E 0x8003407E 0x8003747E /end VAR_ADDRESS
 /end VAR_CHARACTERISTIC
 /begin VAR_CHARACTERISTIC TQS16_YC_AR_THRES_LOW_SPD_M_MU BrkCalVariantCriterion
  /begin VAR_ADDRESS 0x80020884 0x80023C84 0x80027084 0x8002A484 0x8002D884 0x80030C84 0x80034084 0x80037484 /end VAR_ADDRESS
 /end VAR_CHARACTERISTIC
 /begin VAR_CHARACTERISTIC TQS16_YC_AR_THRES_MED_SPD_H_MU BrkCalVariantCriterion
  /begin VAR_ADDRESS 0x80020888 0x80023C88 0x80027088 0x8002A488 0x8002D888 0x80030C88 0x80034088 0x80037488 /end VAR_ADDRESS
 /end VAR_CHARACTERISTIC
 /begin VAR_CHARACTERISTIC TQS16_YC_AR_THRES_MED_SPD_L_MU BrkCalVariantCriterion
  /begin VAR_ADDRESS 0x8002087C 0x80023C7C 0x8002707C 0x8002A47C 0x8002D87C 0x80030C7C 0x8003407C 0x8003747C /end VAR_ADDRESS
 /end VAR_CHARACTERISTIC
 /begin VAR_CHARACTERISTIC TQS16_YC_AR_THRES_MED_SPD_M_MU BrkCalVariantCriterion
  /begin VAR_ADDRESS 0x80020882 0x80023C82 0x80027082 0x8002A482 0x8002D882 0x80030C82 0x80034082 0x80037482 /end VAR_ADDRESS
 /end VAR_CHARACTERISTIC
 /begin VAR_CHARACTERISTIC TQS16_YC_AY_VX_DOT_DCT_OS_YAW BrkCalVariantCriterion
  /begin VAR_ADDRESS 0x80020A20 0x80023E20 0x80027220 0x8002A620 0x8002DA20 0x80030E20 0x80034220 0x80037620 /end VAR_ADDRESS
 /end VAR_CHARACTERISTIC
 /begin VAR_CHARACTERISTIC TQS16_YC_AY_VX_DOT_HIG_V_1ST BrkCalVariantCriterion
  /begin VAR_ADDRESS 0x80020A24 0x80023E24 0x80027224 0x8002A624 0x8002DA24 0x80030E24 0x80034224 0x80037624 /end VAR_ADDRESS
 /end VAR_CHARACTERISTIC
 /begin VAR_CHARACTERISTIC TQS16_YC_AY_VX_DOT_HIG_V_1ST_Mmu BrkCalVariantCriterion
  /begin VAR_ADDRESS 0x80020A42 0x80023E42 0x80027242 0x8002A642 0x8002DA42 0x80030E42 0x80034242 0x80037642 /end VAR_ADDRESS
 /end VAR_CHARACTERISTIC
 /begin VAR_CHARACTERISTIC TQS16_YC_AY_VX_DOT_HIG_V_2ND BrkCalVariantCriterion
  /begin VAR_ADDRESS 0x80020A2E 0x80023E2E 0x8002722E 0x8002A62E 0x8002DA2E 0x80030E2E 0x8003422E 0x8003762E /end VAR_ADDRESS
 /end VAR_CHARACTERISTIC
 /begin VAR_CHARACTERISTIC TQS16_YC_AY_VX_DOT_HIG_V_2ND_Mmu BrkCalVariantCriterion
  /begin VAR_ADDRESS 0x80020A4C 0x80023E4C 0x8002724C 0x8002A64C 0x8002DA4C 0x80030E4C 0x8003424C 0x8003764C /end VAR_ADDRESS
 /end VAR_CHARACTERISTIC
 /begin VAR_CHARACTERISTIC TQS16_YC_AY_VX_DOT_LOW_V_1ST BrkCalVariantCriterion
  /begin VAR_ADDRESS 0x80020A28 0x80023E28 0x80027228 0x8002A628 0x8002DA28 0x80030E28 0x80034228 0x80037628 /end VAR_ADDRESS
 /end VAR_CHARACTERISTIC
 /begin VAR_CHARACTERISTIC TQS16_YC_AY_VX_DOT_LOW_V_1ST_Mmu BrkCalVariantCriterion
  /begin VAR_ADDRESS 0x80020A44 0x80023E44 0x80027244 0x8002A644 0x8002DA44 0x80030E44 0x80034244 0x80037644 /end VAR_ADDRESS
 /end VAR_CHARACTERISTIC
 /begin VAR_CHARACTERISTIC TQS16_YC_AY_VX_DOT_LOW_V_2ND BrkCalVariantCriterion
  /begin VAR_ADDRESS 0x80020A32 0x80023E32 0x80027232 0x8002A632 0x8002DA32 0x80030E32 0x80034232 0x80037632 /end VAR_ADDRESS
 /end VAR_CHARACTERISTIC
 /begin VAR_CHARACTERISTIC TQS16_YC_AY_VX_DOT_LOW_V_2ND_Mmu BrkCalVariantCriterion
  /begin VAR_ADDRESS 0x80020A4E 0x80023E4E 0x8002724E 0x8002A64E 0x8002DA4E 0x80030E4E 0x8003424E 0x8003764E /end VAR_ADDRESS
 /end VAR_CHARACTERISTIC
 /begin VAR_CHARACTERISTIC TQS16_YC_AY_VX_DOT_MED1_V_1ST BrkCalVariantCriterion
  /begin VAR_ADDRESS 0x80020A26 0x80023E26 0x80027226 0x8002A626 0x8002DA26 0x80030E26 0x80034226 0x80037626 /end VAR_ADDRESS
 /end VAR_CHARACTERISTIC
 /begin VAR_CHARACTERISTIC TQS16_YC_AY_VX_DOT_MED1_V_1ST_Mmu BrkCalVariantCriterion
  /begin VAR_ADDRESS 0x80020A46 0x80023E46 0x80027246 0x8002A646 0x8002DA46 0x80030E46 0x80034246 0x80037646 /end VAR_ADDRESS
 /end VAR_CHARACTERISTIC
 /begin VAR_CHARACTERISTIC TQS16_YC_AY_VX_DOT_MED1_V_2ND BrkCalVariantCriterion
  /begin VAR_ADDRESS 0x80020A30 0x80023E30 0x80027230 0x8002A630 0x8002DA30 0x80030E30 0x80034230 0x80037630 /end VAR_ADDRESS
 /end VAR_CHARACTERISTIC
 /begin VAR_CHARACTERISTIC TQS16_YC_AY_VX_DOT_MED1_V_2ND_Mmu BrkCalVariantCriterion
  /begin VAR_ADDRESS 0x80020A50 0x80023E50 0x80027250 0x8002A650 0x8002DA50 0x80030E50 0x80034250 0x80037650 /end VAR_ADDRESS
 /end VAR_CHARACTERISTIC
 /begin VAR_CHARACTERISTIC TQS16_YC_AY_VX_DOT_VER_HIG_V_1ST BrkCalVariantCriterion
  /begin VAR_ADDRESS 0x80020A22 0x80023E22 0x80027222 0x8002A622 0x8002DA22 0x80030E22 0x80034222 0x80037622 /end VAR_ADDRESS
 /end VAR_CHARACTERISTIC
 /begin VAR_CHARACTERISTIC TQS16_YC_AY_VX_DOT_VER_HIG_V_1ST_Mmu BrkCalVariantCriterion
  /begin VAR_ADDRESS 0x80020A48 0x80023E48 0x80027248 0x8002A648 0x8002DA48 0x80030E48 0x80034248 0x80037648 /end VAR_ADDRESS
 /end VAR_CHARACTERISTIC
 /begin VAR_CHARACTERISTIC TQS16_YC_AY_VX_DOT_VER_HIG_V_2ND BrkCalVariantCriterion
  /begin VAR_ADDRESS 0x80020A2C 0x80023E2C 0x8002722C 0x8002A62C 0x8002DA2C 0x80030E2C 0x8003422C 0x8003762C /end VAR_ADDRESS
 /end VAR_CHARACTERISTIC
 /begin VAR_CHARACTERISTIC TQS16_YC_AY_VX_DOT_VER_HIG_V_2ND_Mmu BrkCalVariantCriterion
  /begin VAR_ADDRESS 0x80020A52 0x80023E52 0x80027252 0x8002A652 0x8002DA52 0x80030E52 0x80034252 0x80037652 /end VAR_ADDRESS
 /end VAR_CHARACTERISTIC
 /begin VAR_CHARACTERISTIC TQS16_YC_AY_VX_DOT_VLOW_V_1ST BrkCalVariantCriterion
  /begin VAR_ADDRESS 0x80020A2A 0x80023E2A 0x8002722A 0x8002A62A 0x8002DA2A 0x80030E2A 0x8003422A 0x8003762A /end VAR_ADDRESS
 /end VAR_CHARACTERISTIC
 /begin VAR_CHARACTERISTIC TQS16_YC_AY_VX_DOT_VLOW_V_1ST_Mmu BrkCalVariantCriterion
  /begin VAR_ADDRESS 0x80020A4A 0x80023E4A 0x8002724A 0x8002A64A 0x8002DA4A 0x80030E4A 0x8003424A 0x8003764A /end VAR_ADDRESS
 /end VAR_CHARACTERISTIC
 /begin VAR_CHARACTERISTIC TQS16_YC_AY_VX_DOT_VLOW_V_2ND BrkCalVariantCriterion
  /begin VAR_ADDRESS 0x80020A34 0x80023E34 0x80027234 0x8002A634 0x8002DA34 0x80030E34 0x80034234 0x80037634 /end VAR_ADDRESS
 /end VAR_CHARACTERISTIC
 /begin VAR_CHARACTERISTIC TQS16_YC_AY_VX_DOT_VLOW_V_2ND_Mmu BrkCalVariantCriterion
  /begin VAR_ADDRESS 0x80020A54 0x80023E54 0x80027254 0x8002A654 0x8002DA54 0x80030E54 0x80034254 0x80037654 /end VAR_ADDRESS
 /end VAR_CHARACTERISTIC
 /begin VAR_CHARACTERISTIC TQS16_YC_AY_VX_DOT_YAW_LMT_WEG BrkCalVariantCriterion
  /begin VAR_ADDRESS 0x80020A3C 0x80023E3C 0x8002723C 0x8002A63C 0x8002DA3C 0x80030E3C 0x8003423C 0x8003763C /end VAR_ADDRESS
 /end VAR_CHARACTERISTIC
 /begin VAR_CHARACTERISTIC TQS16_YC_AY_VX_DOT_YAW_LMT_WEG_1ST BrkCalVariantCriterion
  /begin VAR_ADDRESS 0x80020A3E 0x80023E3E 0x8002723E 0x8002A63E 0x8002DA3E 0x80030E3E 0x8003423E 0x8003763E /end VAR_ADDRESS
 /end VAR_CHARACTERISTIC
 /begin VAR_CHARACTERISTIC TQS16_YC_AY_VX_DOT_YAW_LMT_WEG_1ST_Mmu BrkCalVariantCriterion
  /begin VAR_ADDRESS 0x80020A36 0x80023E36 0x80027236 0x8002A636 0x8002DA36 0x80030E36 0x80034236 0x80037636 /end VAR_ADDRESS
 /end VAR_CHARACTERISTIC
 /begin VAR_CHARACTERISTIC TQS16_YC_AY_VX_DOT_YAW_LMT_WEG_2ND BrkCalVariantCriterion
  /begin VAR_ADDRESS 0x80020A40 0x80023E40 0x80027240 0x8002A640 0x8002DA40 0x80030E40 0x80034240 0x80037640 /end VAR_ADDRESS
 /end VAR_CHARACTERISTIC
 /begin VAR_CHARACTERISTIC TQS16_YC_AY_VX_DOT_YAW_LMT_WEG_2ND_Mmu BrkCalVariantCriterion
  /begin VAR_ADDRESS 0x80020A38 0x80023E38 0x80027238 0x8002A638 0x8002DA38 0x80030E38 0x80034238 0x80037638 /end VAR_ADDRESS
 /end VAR_CHARACTERISTIC
 /begin VAR_CHARACTERISTIC TQS16_YC_AY_VX_DOT_YAW_LMT_WEG_Mmu BrkCalVariantCriterion
  /begin VAR_ADDRESS 0x80020A3A 0x80023E3A 0x8002723A 0x8002A63A 0x8002DA3A 0x80030E3A 0x8003423A 0x8003763A /end VAR_ADDRESS
 /end VAR_CHARACTERISTIC
 /begin VAR_CHARACTERISTIC TQS16_YC_D_GAIN_F_OS_IN BrkCalVariantCriterion
  /begin VAR_ADDRESS 0x8002093C 0x80023D3C 0x8002713C 0x8002A53C 0x8002D93C 0x80030D3C 0x8003413C 0x8003753C /end VAR_ADDRESS
 /end VAR_CHARACTERISTIC
 /begin VAR_CHARACTERISTIC TQS16_YC_D_GAIN_F_OS_IN_H BrkCalVariantCriterion
  /begin VAR_ADDRESS 0x8002093A 0x80023D3A 0x8002713A 0x8002A53A 0x8002D93A 0x80030D3A 0x8003413A 0x8003753A /end VAR_ADDRESS
 /end VAR_CHARACTERISTIC
 /begin VAR_CHARACTERISTIC TQS16_YC_D_GAIN_F_OS_IN_L BrkCalVariantCriterion
  /begin VAR_ADDRESS 0x8002093E 0x80023D3E 0x8002713E 0x8002A53E 0x8002D93E 0x80030D3E 0x8003413E 0x8003753E /end VAR_ADDRESS
 /end VAR_CHARACTERISTIC
 /begin VAR_CHARACTERISTIC TQS16_YC_D_GAIN_F_OS_OUT_DEC BrkCalVariantCriterion
  /begin VAR_ADDRESS 0x8002094E 0x80023D4E 0x8002714E 0x8002A54E 0x8002D94E 0x80030D4E 0x8003414E 0x8003754E /end VAR_ADDRESS
 /end VAR_CHARACTERISTIC
 /begin VAR_CHARACTERISTIC TQS16_YC_D_GAIN_F_OS_OUT_DEC_H BrkCalVariantCriterion
  /begin VAR_ADDRESS 0x80020946 0x80023D46 0x80027146 0x8002A546 0x8002D946 0x80030D46 0x80034146 0x80037546 /end VAR_ADDRESS
 /end VAR_CHARACTERISTIC
 /begin VAR_CHARACTERISTIC TQS16_YC_D_GAIN_F_OS_OUT_DEC_L BrkCalVariantCriterion
  /begin VAR_ADDRESS 0x80020956 0x80023D56 0x80027156 0x8002A556 0x8002D956 0x80030D56 0x80034156 0x80037556 /end VAR_ADDRESS
 /end VAR_CHARACTERISTIC
 /begin VAR_CHARACTERISTIC TQS16_YC_D_GAIN_F_OS_OUT_INC BrkCalVariantCriterion
  /begin VAR_ADDRESS 0x80020950 0x80023D50 0x80027150 0x8002A550 0x8002D950 0x80030D50 0x80034150 0x80037550 /end VAR_ADDRESS
 /end VAR_CHARACTERISTIC
 /begin VAR_CHARACTERISTIC TQS16_YC_D_GAIN_F_OS_OUT_INC_H BrkCalVariantCriterion
  /begin VAR_ADDRESS 0x80020948 0x80023D48 0x80027148 0x8002A548 0x8002D948 0x80030D48 0x80034148 0x80037548 /end VAR_ADDRESS
 /end VAR_CHARACTERISTIC
 /begin VAR_CHARACTERISTIC TQS16_YC_D_GAIN_F_OS_OUT_INC_L BrkCalVariantCriterion
  /begin VAR_ADDRESS 0x80020958 0x80023D58 0x80027158 0x8002A558 0x8002D958 0x80030D58 0x80034158 0x80037558 /end VAR_ADDRESS
 /end VAR_CHARACTERISTIC
 /begin VAR_CHARACTERISTIC TQS16_YC_D_GAIN_R_US_IN_DEC BrkCalVariantCriterion
  /begin VAR_ADDRESS 0x8002091A 0x80023D1A 0x8002711A 0x8002A51A 0x8002D91A 0x80030D1A 0x8003411A 0x8003751A /end VAR_ADDRESS
 /end VAR_CHARACTERISTIC
 /begin VAR_CHARACTERISTIC TQS16_YC_D_GAIN_R_US_IN_INC BrkCalVariantCriterion
  /begin VAR_ADDRESS 0x8002091C 0x80023D1C 0x8002711C 0x8002A51C 0x8002D91C 0x80030D1C 0x8003411C 0x8003751C /end VAR_ADDRESS
 /end VAR_CHARACTERISTIC
 /begin VAR_CHARACTERISTIC TQS16_YC_D_GAIN_R_US_IN_INC_H BrkCalVariantCriterion
  /begin VAR_ADDRESS 0x8002091E 0x80023D1E 0x8002711E 0x8002A51E 0x8002D91E 0x80030D1E 0x8003411E 0x8003751E /end VAR_ADDRESS
 /end VAR_CHARACTERISTIC
 /begin VAR_CHARACTERISTIC TQS16_YC_D_GAIN_R_US_IN_INC_L BrkCalVariantCriterion
  /begin VAR_ADDRESS 0x80020920 0x80023D20 0x80027120 0x8002A520 0x8002D920 0x80030D20 0x80034120 0x80037520 /end VAR_ADDRESS
 /end VAR_CHARACTERISTIC
 /begin VAR_CHARACTERISTIC TQS16_YC_D_GAIN_R_US_OUT_DEC BrkCalVariantCriterion
  /begin VAR_ADDRESS 0x8002092A 0x80023D2A 0x8002712A 0x8002A52A 0x8002D92A 0x80030D2A 0x8003412A 0x8003752A /end VAR_ADDRESS
 /end VAR_CHARACTERISTIC
 /begin VAR_CHARACTERISTIC TQS16_YC_D_GAIN_R_US_OUT_DEC_H BrkCalVariantCriterion
  /begin VAR_ADDRESS 0x80020932 0x80023D32 0x80027132 0x8002A532 0x8002D932 0x80030D32 0x80034132 0x80037532 /end VAR_ADDRESS
 /end VAR_CHARACTERISTIC
 /begin VAR_CHARACTERISTIC TQS16_YC_D_GAIN_R_US_OUT_DEC_L BrkCalVariantCriterion
  /begin VAR_ADDRESS 0x80020922 0x80023D22 0x80027122 0x8002A522 0x8002D922 0x80030D22 0x80034122 0x80037522 /end VAR_ADDRESS
 /end VAR_CHARACTERISTIC
 /begin VAR_CHARACTERISTIC TQS16_YC_D_GAIN_R_US_OUT_INC BrkCalVariantCriterion
  /begin VAR_ADDRESS 0x8002092C 0x80023D2C 0x8002712C 0x8002A52C 0x8002D92C 0x80030D2C 0x8003412C 0x8003752C /end VAR_ADDRESS
 /end VAR_CHARACTERISTIC
 /begin VAR_CHARACTERISTIC TQS16_YC_D_GAIN_R_US_OUT_INC_H BrkCalVariantCriterion
  /begin VAR_ADDRESS 0x80020934 0x80023D34 0x80027134 0x8002A534 0x8002D934 0x80030D34 0x80034134 0x80037534 /end VAR_ADDRESS
 /end VAR_CHARACTERISTIC
 /begin VAR_CHARACTERISTIC TQS16_YC_D_GAIN_R_US_OUT_INC_L BrkCalVariantCriterion
  /begin VAR_ADDRESS 0x80020924 0x80023D24 0x80027124 0x8002A524 0x8002D924 0x80030D24 0x80034124 0x80037524 /end VAR_ADDRESS
 /end VAR_CHARACTERISTIC
 /begin VAR_CHARACTERISTIC TQS16_YC_FF_GAIN_OS_OUT_HIG_SP_H_MU BrkCalVariantCriterion
  /begin VAR_ADDRESS 0x8002096A 0x80023D6A 0x8002716A 0x8002A56A 0x8002D96A 0x80030D6A 0x8003416A 0x8003756A /end VAR_ADDRESS
 /end VAR_CHARACTERISTIC
 /begin VAR_CHARACTERISTIC TQS16_YC_FF_GAIN_OS_OUT_HIG_SP_L_MU BrkCalVariantCriterion
  /begin VAR_ADDRESS 0x8002095E 0x80023D5E 0x8002715E 0x8002A55E 0x8002D95E 0x80030D5E 0x8003415E 0x8003755E /end VAR_ADDRESS
 /end VAR_CHARACTERISTIC
 /begin VAR_CHARACTERISTIC TQS16_YC_FF_GAIN_OS_OUT_HIG_SP_M_MU BrkCalVariantCriterion
  /begin VAR_ADDRESS 0x80020964 0x80023D64 0x80027164 0x8002A564 0x8002D964 0x80030D64 0x80034164 0x80037564 /end VAR_ADDRESS
 /end VAR_CHARACTERISTIC
 /begin VAR_CHARACTERISTIC TQS16_YC_FF_GAIN_OS_OUT_LOW_SP_H_MU BrkCalVariantCriterion
  /begin VAR_ADDRESS 0x8002096E 0x80023D6E 0x8002716E 0x8002A56E 0x8002D96E 0x80030D6E 0x8003416E 0x8003756E /end VAR_ADDRESS
 /end VAR_CHARACTERISTIC
 /begin VAR_CHARACTERISTIC TQS16_YC_FF_GAIN_OS_OUT_LOW_SP_L_MU BrkCalVariantCriterion
  /begin VAR_ADDRESS 0x80020960 0x80023D60 0x80027160 0x8002A560 0x8002D960 0x80030D60 0x80034160 0x80037560 /end VAR_ADDRESS
 /end VAR_CHARACTERISTIC
 /begin VAR_CHARACTERISTIC TQS16_YC_FF_GAIN_OS_OUT_LOW_SP_M_MU BrkCalVariantCriterion
  /begin VAR_ADDRESS 0x80020966 0x80023D66 0x80027166 0x8002A566 0x8002D966 0x80030D66 0x80034166 0x80037566 /end VAR_ADDRESS
 /end VAR_CHARACTERISTIC
 /begin VAR_CHARACTERISTIC TQS16_YC_FF_GAIN_OS_OUT_MED_SP_H_MU BrkCalVariantCriterion
  /begin VAR_ADDRESS 0x8002096C 0x80023D6C 0x8002716C 0x8002A56C 0x8002D96C 0x80030D6C 0x8003416C 0x8003756C /end VAR_ADDRESS
 /end VAR_CHARACTERISTIC
 /begin VAR_CHARACTERISTIC TQS16_YC_FF_GAIN_OS_OUT_MED_SP_L_MU BrkCalVariantCriterion
  /begin VAR_ADDRESS 0x80020962 0x80023D62 0x80027162 0x8002A562 0x8002D962 0x80030D62 0x80034162 0x80037562 /end VAR_ADDRESS
 /end VAR_CHARACTERISTIC
 /begin VAR_CHARACTERISTIC TQS16_YC_FF_GAIN_OS_OUT_MED_SP_M_MU BrkCalVariantCriterion
  /begin VAR_ADDRESS 0x80020968 0x80023D68 0x80027168 0x8002A568 0x8002D968 0x80030D68 0x80034168 0x80037568 /end VAR_ADDRESS
 /end VAR_CHARACTERISTIC
 /begin VAR_CHARACTERISTIC TQS16_YC_P_GAIN_F_OS_IN_H BrkCalVariantCriterion
  /begin VAR_ADDRESS 0x80020940 0x80023D40 0x80027140 0x8002A540 0x8002D940 0x80030D40 0x80034140 0x80037540 /end VAR_ADDRESS
 /end VAR_CHARACTERISTIC
 /begin VAR_CHARACTERISTIC TQS16_YC_P_GAIN_F_OS_IN_L BrkCalVariantCriterion
  /begin VAR_ADDRESS 0x80020944 0x80023D44 0x80027144 0x8002A544 0x8002D944 0x80030D44 0x80034144 0x80037544 /end VAR_ADDRESS
 /end VAR_CHARACTERISTIC
 /begin VAR_CHARACTERISTIC TQS16_YC_P_GAIN_F_OS_IN_M BrkCalVariantCriterion
  /begin VAR_ADDRESS 0x80020942 0x80023D42 0x80027142 0x8002A542 0x8002D942 0x80030D42 0x80034142 0x80037542 /end VAR_ADDRESS
 /end VAR_CHARACTERISTIC
 /begin VAR_CHARACTERISTIC TQS16_YC_P_GAIN_F_OS_OUT_DEC BrkCalVariantCriterion
  /begin VAR_ADDRESS 0x80020952 0x80023D52 0x80027152 0x8002A552 0x8002D952 0x80030D52 0x80034152 0x80037552 /end VAR_ADDRESS
 /end VAR_CHARACTERISTIC
 /begin VAR_CHARACTERISTIC TQS16_YC_P_GAIN_F_OS_OUT_DEC_H BrkCalVariantCriterion
  /begin VAR_ADDRESS 0x8002094A 0x80023D4A 0x8002714A 0x8002A54A 0x8002D94A 0x80030D4A 0x8003414A 0x8003754A /end VAR_ADDRESS
 /end VAR_CHARACTERISTIC
 /begin VAR_CHARACTERISTIC TQS16_YC_P_GAIN_F_OS_OUT_DEC_L BrkCalVariantCriterion
  /begin VAR_ADDRESS 0x8002095A 0x80023D5A 0x8002715A 0x8002A55A 0x8002D95A 0x80030D5A 0x8003415A 0x8003755A /end VAR_ADDRESS
 /end VAR_CHARACTERISTIC
 /begin VAR_CHARACTERISTIC TQS16_YC_P_GAIN_F_OS_OUT_INC BrkCalVariantCriterion
  /begin VAR_ADDRESS 0x80020954 0x80023D54 0x80027154 0x8002A554 0x8002D954 0x80030D54 0x80034154 0x80037554 /end VAR_ADDRESS
 /end VAR_CHARACTERISTIC
 /begin VAR_CHARACTERISTIC TQS16_YC_P_GAIN_F_OS_OUT_INC_H BrkCalVariantCriterion
  /begin VAR_ADDRESS 0x8002094C 0x80023D4C 0x8002714C 0x8002A54C 0x8002D94C 0x80030D4C 0x8003414C 0x8003754C /end VAR_ADDRESS
 /end VAR_CHARACTERISTIC
 /begin VAR_CHARACTERISTIC TQS16_YC_P_GAIN_F_OS_OUT_INC_L BrkCalVariantCriterion
  /begin VAR_ADDRESS 0x8002095C 0x80023D5C 0x8002715C 0x8002A55C 0x8002D95C 0x80030D5C 0x8003415C 0x8003755C /end VAR_ADDRESS
 /end VAR_CHARACTERISTIC
 /begin VAR_CHARACTERISTIC TQS16_YC_P_GAIN_R_US_OUT_DEC BrkCalVariantCriterion
  /begin VAR_ADDRESS 0x8002092E 0x80023D2E 0x8002712E 0x8002A52E 0x8002D92E 0x80030D2E 0x8003412E 0x8003752E /end VAR_ADDRESS
 /end VAR_CHARACTERISTIC
 /begin VAR_CHARACTERISTIC TQS16_YC_P_GAIN_R_US_OUT_DEC_H BrkCalVariantCriterion
  /begin VAR_ADDRESS 0x80020936 0x80023D36 0x80027136 0x8002A536 0x8002D936 0x80030D36 0x80034136 0x80037536 /end VAR_ADDRESS
 /end VAR_CHARACTERISTIC
 /begin VAR_CHARACTERISTIC TQS16_YC_P_GAIN_R_US_OUT_DEC_L BrkCalVariantCriterion
  /begin VAR_ADDRESS 0x80020928 0x80023D28 0x80027128 0x8002A528 0x8002D928 0x80030D28 0x80034128 0x80037528 /end VAR_ADDRESS
 /end VAR_CHARACTERISTIC
 /begin VAR_CHARACTERISTIC TQS16_YC_P_GAIN_R_US_OUT_INC BrkCalVariantCriterion
  /begin VAR_ADDRESS 0x80020930 0x80023D30 0x80027130 0x8002A530 0x8002D930 0x80030D30 0x80034130 0x80037530 /end VAR_ADDRESS
 /end VAR_CHARACTERISTIC
 /begin VAR_CHARACTERISTIC TQS16_YC_P_GAIN_R_US_OUT_INC_H BrkCalVariantCriterion
  /begin VAR_ADDRESS 0x80020938 0x80023D38 0x80027138 0x8002A538 0x8002D938 0x80030D38 0x80034138 0x80037538 /end VAR_ADDRESS
 /end VAR_CHARACTERISTIC
 /begin VAR_CHARACTERISTIC TQS16_YC_P_GAIN_R_US_OUT_INC_L BrkCalVariantCriterion
  /begin VAR_ADDRESS 0x80020926 0x80023D26 0x80027126 0x8002A526 0x8002D926 0x80030D26 0x80034126 0x80037526 /end VAR_ADDRESS
 /end VAR_CHARACTERISTIC
 /begin VAR_CHARACTERISTIC TQS16_YC_R_SPEED_DEP_HIG_H_GAIN BrkCalVariantCriterion
  /begin VAR_ADDRESS 0x800208DE 0x80023CDE 0x800270DE 0x8002A4DE 0x8002D8DE 0x80030CDE 0x800340DE 0x800374DE /end VAR_ADDRESS
 /end VAR_CHARACTERISTIC
 /begin VAR_CHARACTERISTIC TQS16_YC_R_SPEED_DEP_HIG_L_GAIN BrkCalVariantCriterion
  /begin VAR_ADDRESS 0x800208CE 0x80023CCE 0x800270CE 0x8002A4CE 0x8002D8CE 0x80030CCE 0x800340CE 0x800374CE /end VAR_ADDRESS
 /end VAR_CHARACTERISTIC
 /begin VAR_CHARACTERISTIC TQS16_YC_R_SPEED_DEP_HIG_M_GAIN BrkCalVariantCriterion
  /begin VAR_ADDRESS 0x800208D6 0x80023CD6 0x800270D6 0x8002A4D6 0x8002D8D6 0x80030CD6 0x800340D6 0x800374D6 /end VAR_ADDRESS
 /end VAR_CHARACTERISTIC
 /begin VAR_CHARACTERISTIC TQS16_YC_R_SPEED_DEP_LOW_H_GAIN BrkCalVariantCriterion
  /begin VAR_ADDRESS 0x800208E2 0x80023CE2 0x800270E2 0x8002A4E2 0x8002D8E2 0x80030CE2 0x800340E2 0x800374E2 /end VAR_ADDRESS
 /end VAR_CHARACTERISTIC
 /begin VAR_CHARACTERISTIC TQS16_YC_R_SPEED_DEP_LOW_L_GAIN BrkCalVariantCriterion
  /begin VAR_ADDRESS 0x800208D2 0x80023CD2 0x800270D2 0x8002A4D2 0x8002D8D2 0x80030CD2 0x800340D2 0x800374D2 /end VAR_ADDRESS
 /end VAR_CHARACTERISTIC
 /begin VAR_CHARACTERISTIC TQS16_YC_R_SPEED_DEP_LOW_M_GAIN BrkCalVariantCriterion
  /begin VAR_ADDRESS 0x800208DA 0x80023CDA 0x800270DA 0x8002A4DA 0x8002D8DA 0x80030CDA 0x800340DA 0x800374DA /end VAR_ADDRESS
 /end VAR_CHARACTERISTIC
 /begin VAR_CHARACTERISTIC TQS16_YC_R_SPEED_DEP_MED_H_GAIN BrkCalVariantCriterion
  /begin VAR_ADDRESS 0x800208E0 0x80023CE0 0x800270E0 0x8002A4E0 0x8002D8E0 0x80030CE0 0x800340E0 0x800374E0 /end VAR_ADDRESS
 /end VAR_CHARACTERISTIC
 /begin VAR_CHARACTERISTIC TQS16_YC_R_SPEED_DEP_MED_L_GAIN BrkCalVariantCriterion
  /begin VAR_ADDRESS 0x800208D0 0x80023CD0 0x800270D0 0x8002A4D0 0x8002D8D0 0x80030CD0 0x800340D0 0x800374D0 /end VAR_ADDRESS
 /end VAR_CHARACTERISTIC
 /begin VAR_CHARACTERISTIC TQS16_YC_R_SPEED_DEP_MED_M_GAIN BrkCalVariantCriterion
  /begin VAR_ADDRESS 0x800208D8 0x80023CD8 0x800270D8 0x8002A4D8 0x8002D8D8 0x80030CD8 0x800340D8 0x800374D8 /end VAR_ADDRESS
 /end VAR_CHARACTERISTIC
 /begin VAR_CHARACTERISTIC TQS16_YC_R_SPEED_DEP_VLOW_H_GAIN BrkCalVariantCriterion
  /begin VAR_ADDRESS 0x800208E4 0x80023CE4 0x800270E4 0x8002A4E4 0x8002D8E4 0x80030CE4 0x800340E4 0x800374E4 /end VAR_ADDRESS
 /end VAR_CHARACTERISTIC
 /begin VAR_CHARACTERISTIC TQS16_YC_R_SPEED_DEP_VLOW_L_GAIN BrkCalVariantCriterion
  /begin VAR_ADDRESS 0x800208D4 0x80023CD4 0x800270D4 0x8002A4D4 0x8002D8D4 0x80030CD4 0x800340D4 0x800374D4 /end VAR_ADDRESS
 /end VAR_CHARACTERISTIC
 /begin VAR_CHARACTERISTIC TQS16_YC_R_SPEED_DEP_VLOW_M_GAIN BrkCalVariantCriterion
  /begin VAR_ADDRESS 0x800208DC 0x80023CDC 0x800270DC 0x8002A4DC 0x8002D8DC 0x80030CDC 0x800340DC 0x800374DC /end VAR_ADDRESS
 /end VAR_CHARACTERISTIC
 /begin VAR_CHARACTERISTIC TQS16_YC_R_SP_DEP_HIG_ABS_GAIN BrkCalVariantCriterion
  /begin VAR_ADDRESS 0x800208BE 0x80023CBE 0x800270BE 0x8002A4BE 0x8002D8BE 0x80030CBE 0x800340BE 0x800374BE /end VAR_ADDRESS
 /end VAR_CHARACTERISTIC
 /begin VAR_CHARACTERISTIC TQS16_YC_R_SP_DEP_HIG_ABS_H_GAIN BrkCalVariantCriterion
  /begin VAR_ADDRESS 0x800208C6 0x80023CC6 0x800270C6 0x8002A4C6 0x8002D8C6 0x80030CC6 0x800340C6 0x800374C6 /end VAR_ADDRESS
 /end VAR_CHARACTERISTIC
 /begin VAR_CHARACTERISTIC TQS16_YC_R_SP_DEP_HIG_ABS_L_GAIN BrkCalVariantCriterion
  /begin VAR_ADDRESS 0x800208B6 0x80023CB6 0x800270B6 0x8002A4B6 0x8002D8B6 0x80030CB6 0x800340B6 0x800374B6 /end VAR_ADDRESS
 /end VAR_CHARACTERISTIC
 /begin VAR_CHARACTERISTIC TQS16_YC_R_SP_DEP_LOW_ABS_GAIN BrkCalVariantCriterion
  /begin VAR_ADDRESS 0x800208C2 0x80023CC2 0x800270C2 0x8002A4C2 0x8002D8C2 0x80030CC2 0x800340C2 0x800374C2 /end VAR_ADDRESS
 /end VAR_CHARACTERISTIC
 /begin VAR_CHARACTERISTIC TQS16_YC_R_SP_DEP_LOW_ABS_H_GAIN BrkCalVariantCriterion
  /begin VAR_ADDRESS 0x800208CA 0x80023CCA 0x800270CA 0x8002A4CA 0x8002D8CA 0x80030CCA 0x800340CA 0x800374CA /end VAR_ADDRESS
 /end VAR_CHARACTERISTIC
 /begin VAR_CHARACTERISTIC TQS16_YC_R_SP_DEP_LOW_ABS_L_GAIN BrkCalVariantCriterion
  /begin VAR_ADDRESS 0x800208BA 0x80023CBA 0x800270BA 0x8002A4BA 0x8002D8BA 0x80030CBA 0x800340BA 0x800374BA /end VAR_ADDRESS
 /end VAR_CHARACTERISTIC
 /begin VAR_CHARACTERISTIC TQS16_YC_R_SP_DEP_MED_ABS_GAIN BrkCalVariantCriterion
  /begin VAR_ADDRESS 0x800208C0 0x80023CC0 0x800270C0 0x8002A4C0 0x8002D8C0 0x80030CC0 0x800340C0 0x800374C0 /end VAR_ADDRESS
 /end VAR_CHARACTERISTIC
 /begin VAR_CHARACTERISTIC TQS16_YC_R_SP_DEP_MED_ABS_H_GAIN BrkCalVariantCriterion
  /begin VAR_ADDRESS 0x800208C8 0x80023CC8 0x800270C8 0x8002A4C8 0x8002D8C8 0x80030CC8 0x800340C8 0x800374C8 /end VAR_ADDRESS
 /end VAR_CHARACTERISTIC
 /begin VAR_CHARACTERISTIC TQS16_YC_R_SP_DEP_MED_ABS_L_GAIN BrkCalVariantCriterion
  /begin VAR_ADDRESS 0x800208B8 0x80023CB8 0x800270B8 0x8002A4B8 0x8002D8B8 0x80030CB8 0x800340B8 0x800374B8 /end VAR_ADDRESS
 /end VAR_CHARACTERISTIC
 /begin VAR_CHARACTERISTIC TQS16_YC_R_SP_DEP_VLOW_ABS_GAIN BrkCalVariantCriterion
  /begin VAR_ADDRESS 0x800208C4 0x80023CC4 0x800270C4 0x8002A4C4 0x8002D8C4 0x80030CC4 0x800340C4 0x800374C4 /end VAR_ADDRESS
 /end VAR_CHARACTERISTIC
 /begin VAR_CHARACTERISTIC TQS16_YC_R_SP_DEP_VLOW_ABS_H_GAIN BrkCalVariantCriterion
  /begin VAR_ADDRESS 0x800208CC 0x80023CCC 0x800270CC 0x8002A4CC 0x8002D8CC 0x80030CCC 0x800340CC 0x800374CC /end VAR_ADDRESS
 /end VAR_CHARACTERISTIC
 /begin VAR_CHARACTERISTIC TQS16_YC_R_SP_DEP_VLOW_ABS_L_GAIN BrkCalVariantCriterion
  /begin VAR_ADDRESS 0x800208BC 0x80023CBC 0x800270BC 0x8002A4BC 0x8002D8BC 0x80030CBC 0x800340BC 0x800374BC /end VAR_ADDRESS
 /end VAR_CHARACTERISTIC
 /begin VAR_CHARACTERISTIC TQS16_YC_SPEED_DEP_HIG2_V BrkCalVariantCriterion
  /begin VAR_ADDRESS 0x80020A14 0x80023E14 0x80027214 0x8002A614 0x8002DA14 0x80030E14 0x80034214 0x80037614 /end VAR_ADDRESS
 /end VAR_CHARACTERISTIC
 /begin VAR_CHARACTERISTIC TQS16_YC_SPEED_DEP_HIG_H_GAIN BrkCalVariantCriterion
  /begin VAR_ADDRESS 0x80020912 0x80023D12 0x80027112 0x8002A512 0x8002D912 0x80030D12 0x80034112 0x80037512 /end VAR_ADDRESS
 /end VAR_CHARACTERISTIC
 /begin VAR_CHARACTERISTIC TQS16_YC_SPEED_DEP_HIG_L_GAIN BrkCalVariantCriterion
  /begin VAR_ADDRESS 0x80020902 0x80023D02 0x80027102 0x8002A502 0x8002D902 0x80030D02 0x80034102 0x80037502 /end VAR_ADDRESS
 /end VAR_CHARACTERISTIC
 /begin VAR_CHARACTERISTIC TQS16_YC_SPEED_DEP_HIG_M_GAIN BrkCalVariantCriterion
  /begin VAR_ADDRESS 0x8002090A 0x80023D0A 0x8002710A 0x8002A50A 0x8002D90A 0x80030D0A 0x8003410A 0x8003750A /end VAR_ADDRESS
 /end VAR_CHARACTERISTIC
 /begin VAR_CHARACTERISTIC TQS16_YC_SPEED_DEP_HIG_V BrkCalVariantCriterion
  /begin VAR_ADDRESS 0x80020A12 0x80023E12 0x80027212 0x8002A612 0x8002DA12 0x80030E12 0x80034212 0x80037612 /end VAR_ADDRESS
 /end VAR_CHARACTERISTIC
 /begin VAR_CHARACTERISTIC TQS16_YC_SPEED_DEP_HIG_VH_GAIN BrkCalVariantCriterion
  /begin VAR_ADDRESS 0x80020A56 0x80023E56 0x80027256 0x8002A656 0x8002DA56 0x80030E56 0x80034256 0x80037656 /end VAR_ADDRESS
 /end VAR_CHARACTERISTIC
 /begin VAR_CHARACTERISTIC TQS16_YC_SPEED_DEP_LOW_H_GAIN BrkCalVariantCriterion
  /begin VAR_ADDRESS 0x80020916 0x80023D16 0x80027116 0x8002A516 0x8002D916 0x80030D16 0x80034116 0x80037516 /end VAR_ADDRESS
 /end VAR_CHARACTERISTIC
 /begin VAR_CHARACTERISTIC TQS16_YC_SPEED_DEP_LOW_L_GAIN BrkCalVariantCriterion
  /begin VAR_ADDRESS 0x80020906 0x80023D06 0x80027106 0x8002A506 0x8002D906 0x80030D06 0x80034106 0x80037506 /end VAR_ADDRESS
 /end VAR_CHARACTERISTIC
 /begin VAR_CHARACTERISTIC TQS16_YC_SPEED_DEP_LOW_M_GAIN BrkCalVariantCriterion
  /begin VAR_ADDRESS 0x8002090E 0x80023D0E 0x8002710E 0x8002A50E 0x8002D90E 0x80030D0E 0x8003410E 0x8003750E /end VAR_ADDRESS
 /end VAR_CHARACTERISTIC
 /begin VAR_CHARACTERISTIC TQS16_YC_SPEED_DEP_LOW_V BrkCalVariantCriterion
  /begin VAR_ADDRESS 0x80020A0C 0x80023E0C 0x8002720C 0x8002A60C 0x8002DA0C 0x80030E0C 0x8003420C 0x8003760C /end VAR_ADDRESS
 /end VAR_CHARACTERISTIC
 /begin VAR_CHARACTERISTIC TQS16_YC_SPEED_DEP_LOW_VH_GAIN BrkCalVariantCriterion
  /begin VAR_ADDRESS 0x80020A58 0x80023E58 0x80027258 0x8002A658 0x8002DA58 0x80030E58 0x80034258 0x80037658 /end VAR_ADDRESS
 /end VAR_CHARACTERISTIC
 /begin VAR_CHARACTERISTIC TQS16_YC_SPEED_DEP_MED2_V BrkCalVariantCriterion
  /begin VAR_ADDRESS 0x80020A10 0x80023E10 0x80027210 0x8002A610 0x8002DA10 0x80030E10 0x80034210 0x80037610 /end VAR_ADDRESS
 /end VAR_CHARACTERISTIC
 /begin VAR_CHARACTERISTIC TQS16_YC_SPEED_DEP_MED_H_GAIN BrkCalVariantCriterion
  /begin VAR_ADDRESS 0x80020914 0x80023D14 0x80027114 0x8002A514 0x8002D914 0x80030D14 0x80034114 0x80037514 /end VAR_ADDRESS
 /end VAR_CHARACTERISTIC
 /begin VAR_CHARACTERISTIC TQS16_YC_SPEED_DEP_MED_L_GAIN BrkCalVariantCriterion
  /begin VAR_ADDRESS 0x80020904 0x80023D04 0x80027104 0x8002A504 0x8002D904 0x80030D04 0x80034104 0x80037504 /end VAR_ADDRESS
 /end VAR_CHARACTERISTIC
 /begin VAR_CHARACTERISTIC TQS16_YC_SPEED_DEP_MED_M_GAIN BrkCalVariantCriterion
  /begin VAR_ADDRESS 0x8002090C 0x80023D0C 0x8002710C 0x8002A50C 0x8002D90C 0x80030D0C 0x8003410C 0x8003750C /end VAR_ADDRESS
 /end VAR_CHARACTERISTIC
 /begin VAR_CHARACTERISTIC TQS16_YC_SPEED_DEP_MED_V BrkCalVariantCriterion
  /begin VAR_ADDRESS 0x80020A0E 0x80023E0E 0x8002720E 0x8002A60E 0x8002DA0E 0x80030E0E 0x8003420E 0x8003760E /end VAR_ADDRESS
 /end VAR_CHARACTERISTIC
 /begin VAR_CHARACTERISTIC TQS16_YC_SPEED_DEP_MED_VH_GAIN BrkCalVariantCriterion
  /begin VAR_ADDRESS 0x80020A5A 0x80023E5A 0x8002725A 0x8002A65A 0x8002DA5A 0x80030E5A 0x8003425A 0x8003765A /end VAR_ADDRESS
 /end VAR_CHARACTERISTIC
 /begin VAR_CHARACTERISTIC TQS16_YC_SPEED_DEP_VER_HIG_V BrkCalVariantCriterion
  /begin VAR_ADDRESS 0x80020A16 0x80023E16 0x80027216 0x8002A616 0x8002DA16 0x80030E16 0x80034216 0x80037616 /end VAR_ADDRESS
 /end VAR_CHARACTERISTIC
 /begin VAR_CHARACTERISTIC TQS16_YC_SPEED_DEP_VER_HIG_VH_GAIN BrkCalVariantCriterion
  /begin VAR_ADDRESS 0x80020A5C 0x80023E5C 0x8002725C 0x8002A65C 0x8002DA5C 0x80030E5C 0x8003425C 0x8003765C /end VAR_ADDRESS
 /end VAR_CHARACTERISTIC
 /begin VAR_CHARACTERISTIC TQS16_YC_SPEED_DEP_VLOW_H_GAIN BrkCalVariantCriterion
  /begin VAR_ADDRESS 0x80020918 0x80023D18 0x80027118 0x8002A518 0x8002D918 0x80030D18 0x80034118 0x80037518 /end VAR_ADDRESS
 /end VAR_CHARACTERISTIC
 /begin VAR_CHARACTERISTIC TQS16_YC_SPEED_DEP_VLOW_L_GAIN BrkCalVariantCriterion
  /begin VAR_ADDRESS 0x80020908 0x80023D08 0x80027108 0x8002A508 0x8002D908 0x80030D08 0x80034108 0x80037508 /end VAR_ADDRESS
 /end VAR_CHARACTERISTIC
 /begin VAR_CHARACTERISTIC TQS16_YC_SPEED_DEP_VLOW_M_GAIN BrkCalVariantCriterion
  /begin VAR_ADDRESS 0x80020910 0x80023D10 0x80027110 0x8002A510 0x8002D910 0x80030D10 0x80034110 0x80037510 /end VAR_ADDRESS
 /end VAR_CHARACTERISTIC
 /begin VAR_CHARACTERISTIC TQS16_YC_SPEED_DEP_VLOW_V BrkCalVariantCriterion
  /begin VAR_ADDRESS 0x80020A0A 0x80023E0A 0x8002720A 0x8002A60A 0x8002DA0A 0x80030E0A 0x8003420A 0x8003760A /end VAR_ADDRESS
 /end VAR_CHARACTERISTIC
 /begin VAR_CHARACTERISTIC TQS16_YC_SPEED_DEP_VLOW_VH_GAIN BrkCalVariantCriterion
  /begin VAR_ADDRESS 0x80020A5E 0x80023E5E 0x8002725E 0x8002A65E 0x8002DA5E 0x80030E5E 0x8003425E 0x8003765E /end VAR_ADDRESS
 /end VAR_CHARACTERISTIC
 /begin VAR_CHARACTERISTIC TQS16_YC_SP_DEP_HIG_ABS_GAIN BrkCalVariantCriterion
  /begin VAR_ADDRESS 0x800208EE 0x80023CEE 0x800270EE 0x8002A4EE 0x8002D8EE 0x80030CEE 0x800340EE 0x800374EE /end VAR_ADDRESS
 /end VAR_CHARACTERISTIC
 /begin VAR_CHARACTERISTIC TQS16_YC_SP_DEP_HIG_ABS_H_GAIN BrkCalVariantCriterion
  /begin VAR_ADDRESS 0x800208F8 0x80023CF8 0x800270F8 0x8002A4F8 0x8002D8F8 0x80030CF8 0x800340F8 0x800374F8 /end VAR_ADDRESS
 /end VAR_CHARACTERISTIC
 /begin VAR_CHARACTERISTIC TQS16_YC_SP_DEP_HIG_ABS_L_GAIN BrkCalVariantCriterion
  /begin VAR_ADDRESS 0x800208E6 0x80023CE6 0x800270E6 0x8002A4E6 0x8002D8E6 0x80030CE6 0x800340E6 0x800374E6 /end VAR_ADDRESS
 /end VAR_CHARACTERISTIC
 /begin VAR_CHARACTERISTIC TQS16_YC_SP_DEP_HIG_ABS_VH_GAIN BrkCalVariantCriterion
  /begin VAR_ADDRESS 0x80020A60 0x80023E60 0x80027260 0x8002A660 0x8002DA60 0x80030E60 0x80034260 0x80037660 /end VAR_ADDRESS
 /end VAR_CHARACTERISTIC
 /begin VAR_CHARACTERISTIC TQS16_YC_SP_DEP_LOW_ABS_GAIN BrkCalVariantCriterion
  /begin VAR_ADDRESS 0x800208F2 0x80023CF2 0x800270F2 0x8002A4F2 0x8002D8F2 0x80030CF2 0x800340F2 0x800374F2 /end VAR_ADDRESS
 /end VAR_CHARACTERISTIC
 /begin VAR_CHARACTERISTIC TQS16_YC_SP_DEP_LOW_ABS_H_GAIN BrkCalVariantCriterion
  /begin VAR_ADDRESS 0x800208FC 0x80023CFC 0x800270FC 0x8002A4FC 0x8002D8FC 0x80030CFC 0x800340FC 0x800374FC /end VAR_ADDRESS
 /end VAR_CHARACTERISTIC
 /begin VAR_CHARACTERISTIC TQS16_YC_SP_DEP_LOW_ABS_L_GAIN BrkCalVariantCriterion
  /begin VAR_ADDRESS 0x800208EA 0x80023CEA 0x800270EA 0x8002A4EA 0x8002D8EA 0x80030CEA 0x800340EA 0x800374EA /end VAR_ADDRESS
 /end VAR_CHARACTERISTIC
 /begin VAR_CHARACTERISTIC TQS16_YC_SP_DEP_LOW_ABS_VH_GAIN BrkCalVariantCriterion
  /begin VAR_ADDRESS 0x80020A62 0x80023E62 0x80027262 0x8002A662 0x8002DA62 0x80030E62 0x80034262 0x80037662 /end VAR_ADDRESS
 /end VAR_CHARACTERISTIC
 /begin VAR_CHARACTERISTIC TQS16_YC_SP_DEP_MED_ABS_GAIN BrkCalVariantCriterion
  /begin VAR_ADDRESS 0x800208F0 0x80023CF0 0x800270F0 0x8002A4F0 0x8002D8F0 0x80030CF0 0x800340F0 0x800374F0 /end VAR_ADDRESS
 /end VAR_CHARACTERISTIC
 /begin VAR_CHARACTERISTIC TQS16_YC_SP_DEP_MED_ABS_H_GAIN BrkCalVariantCriterion
  /begin VAR_ADDRESS 0x800208FA 0x80023CFA 0x800270FA 0x8002A4FA 0x8002D8FA 0x80030CFA 0x800340FA 0x800374FA /end VAR_ADDRESS
 /end VAR_CHARACTERISTIC
 /begin VAR_CHARACTERISTIC TQS16_YC_SP_DEP_MED_ABS_L_GAIN BrkCalVariantCriterion
  /begin VAR_ADDRESS 0x800208E8 0x80023CE8 0x800270E8 0x8002A4E8 0x8002D8E8 0x80030CE8 0x800340E8 0x800374E8 /end VAR_ADDRESS
 /end VAR_CHARACTERISTIC
 /begin VAR_CHARACTERISTIC TQS16_YC_SP_DEP_MED_ABS_VH_GAIN BrkCalVariantCriterion
  /begin VAR_ADDRESS 0x80020A64 0x80023E64 0x80027264 0x8002A664 0x8002DA64 0x80030E64 0x80034264 0x80037664 /end VAR_ADDRESS
 /end VAR_CHARACTERISTIC
 /begin VAR_CHARACTERISTIC TQS16_YC_SP_DEP_VLOW_ABS_GAIN BrkCalVariantCriterion
  /begin VAR_ADDRESS 0x800208F4 0x80023CF4 0x800270F4 0x8002A4F4 0x8002D8F4 0x80030CF4 0x800340F4 0x800374F4 /end VAR_ADDRESS
 /end VAR_CHARACTERISTIC
 /begin VAR_CHARACTERISTIC TQS16_YC_SP_DEP_VLOW_ABS_H_GAIN BrkCalVariantCriterion
  /begin VAR_ADDRESS 0x800208FE 0x80023CFE 0x800270FE 0x8002A4FE 0x8002D8FE 0x80030CFE 0x800340FE 0x800374FE /end VAR_ADDRESS
 /end VAR_CHARACTERISTIC
 /begin VAR_CHARACTERISTIC TQS16_YC_SP_DEP_VLOW_ABS_L_GAIN BrkCalVariantCriterion
  /begin VAR_ADDRESS 0x800208EC 0x80023CEC 0x800270EC 0x8002A4EC 0x8002D8EC 0x80030CEC 0x800340EC 0x800374EC /end VAR_ADDRESS
 /end VAR_CHARACTERISTIC
 /begin VAR_CHARACTERISTIC TQS16_YC_SP_DEP_VLOW_ABS_VH_GAIN BrkCalVariantCriterion
  /begin VAR_ADDRESS 0x80020A66 0x80023E66 0x80027266 0x8002A666 0x8002DA66 0x80030E66 0x80034266 0x80037666 /end VAR_ADDRESS
 /end VAR_CHARACTERISTIC
 /begin VAR_CHARACTERISTIC TQS16_YC_SP_DEP_V_HIG_ABS_GAIN BrkCalVariantCriterion
  /begin VAR_ADDRESS 0x800208F6 0x80023CF6 0x800270F6 0x8002A4F6 0x8002D8F6 0x80030CF6 0x800340F6 0x800374F6 /end VAR_ADDRESS
 /end VAR_CHARACTERISTIC
 /begin VAR_CHARACTERISTIC TQS16_YC_SP_DEP_V_HIG_ABS_H_GAIN BrkCalVariantCriterion
  /begin VAR_ADDRESS 0x80020900 0x80023D00 0x80027100 0x8002A500 0x8002D900 0x80030D00 0x80034100 0x80037500 /end VAR_ADDRESS
 /end VAR_CHARACTERISTIC
 /begin VAR_CHARACTERISTIC TQS16_YC_SP_DEP_V_HIG_ABS_L_GAIN BrkCalVariantCriterion
  /begin VAR_ADDRESS 0x80020A6A 0x80023E6A 0x8002726A 0x8002A66A 0x8002DA6A 0x80030E6A 0x8003426A 0x8003766A /end VAR_ADDRESS
 /end VAR_CHARACTERISTIC
 /begin VAR_CHARACTERISTIC TQS16_YC_SP_DEP_V_HIG_ABS_VH_GAIN BrkCalVariantCriterion
  /begin VAR_ADDRESS 0x80020A68 0x80023E68 0x80027268 0x8002A668 0x8002DA68 0x80030E68 0x80034268 0x80037668 /end VAR_ADDRESS
 /end VAR_CHARACTERISTIC
 /begin VAR_CHARACTERISTIC TQS16_Yawm_Filter_Gain_120kph BrkCalVariantCriterion
  /begin VAR_ADDRESS 0x80020098 0x80023498 0x80026898 0x80029C98 0x8002D098 0x80030498 0x80033898 0x80036C98 /end VAR_ADDRESS
 /end VAR_CHARACTERISTIC
 /begin VAR_CHARACTERISTIC TQS16_Yawm_Filter_Gain_150kph BrkCalVariantCriterion
  /begin VAR_ADDRESS 0x8002009A 0x8002349A 0x8002689A 0x80029C9A 0x8002D09A 0x8003049A 0x8003389A 0x80036C9A /end VAR_ADDRESS
 /end VAR_CHARACTERISTIC
 /begin VAR_CHARACTERISTIC TQS16_Yawm_Filter_Gain_60kph BrkCalVariantCriterion
  /begin VAR_ADDRESS 0x80020094 0x80023494 0x80026894 0x80029C94 0x8002D094 0x80030494 0x80033894 0x80036C94 /end VAR_ADDRESS
 /end VAR_CHARACTERISTIC
 /begin VAR_CHARACTERISTIC TQS16_Yawm_Filter_Gain_90kph BrkCalVariantCriterion
  /begin VAR_ADDRESS 0x80020096 0x80023496 0x80026896 0x80029C96 0x8002D096 0x80030496 0x80033896 0x80036C96 /end VAR_ADDRESS
 /end VAR_CHARACTERISTIC
 /begin VAR_CHARACTERISTIC TQS8_DR_2ND_F_ENT_PRESS_OF_OUT_F BrkCalVariantCriterion
  /begin VAR_ADDRESS 0x80020C50 0x80024050 0x80027450 0x8002A850 0x8002DC50 0x80031050 0x80034450 0x80037850 /end VAR_ADDRESS
 /end VAR_CHARACTERISTIC
 /begin VAR_CHARACTERISTIC TQS8_DR_2ND_F_LMT_DEL_SLIP BrkCalVariantCriterion
  /begin VAR_ADDRESS 0x80020C51 0x80024051 0x80027451 0x8002A851 0x8002DC51 0x80031051 0x80034451 0x80037851 /end VAR_ADDRESS
 /end VAR_CHARACTERISTIC
 /begin VAR_CHARACTERISTIC TQS8_DR_2ND_R_ENT_PRESS_OF_OUT_F BrkCalVariantCriterion
  /begin VAR_ADDRESS 0x80020C52 0x80024052 0x80027452 0x8002A852 0x8002DC52 0x80031052 0x80034452 0x80037852 /end VAR_ADDRESS
 /end VAR_CHARACTERISTIC
 /begin VAR_CHARACTERISTIC TQS8_DR_2ND_R_EXT_PRESS_OF_OUT_F BrkCalVariantCriterion
  /begin VAR_ADDRESS 0x80020C53 0x80024053 0x80027453 0x8002A853 0x8002DC53 0x80031053 0x80034453 0x80037853 /end VAR_ADDRESS
 /end VAR_CHARACTERISTIC
 /begin VAR_CHARACTERISTIC TQS8_TVBB_ENTER_WHEEL_SPIN_H BrkCalVariantCriterion
  /begin VAR_ADDRESS 0x80020DE3 0x800241E3 0x800275E3 0x8002A9E3 0x8002DDE3 0x800311E3 0x800345E3 0x800379E3 /end VAR_ADDRESS
 /end VAR_CHARACTERISTIC
 /begin VAR_CHARACTERISTIC TQS8_TVBB_ENTER_WHEEL_SPIN_L BrkCalVariantCriterion
  /begin VAR_ADDRESS 0x80020DE1 0x800241E1 0x800275E1 0x8002A9E1 0x8002DDE1 0x800311E1 0x800345E1 0x800379E1 /end VAR_ADDRESS
 /end VAR_CHARACTERISTIC
 /begin VAR_CHARACTERISTIC TQS8_TVBB_ENTER_WHEEL_SPIN_M BrkCalVariantCriterion
  /begin VAR_ADDRESS 0x80020DE2 0x800241E2 0x800275E2 0x8002A9E2 0x8002DDE2 0x800311E2 0x800345E2 0x800379E2 /end VAR_ADDRESS
 /end VAR_CHARACTERISTIC
 /begin VAR_CHARACTERISTIC TQS8_TVBB_INHIBIT_WH_SLIP_HSP BrkCalVariantCriterion
  /begin VAR_ADDRESS 0x80020D78 0x80024178 0x80027578 0x8002A978 0x8002DD78 0x80031178 0x80034578 0x80037978 /end VAR_ADDRESS
 /end VAR_CHARACTERISTIC
 /begin VAR_CHARACTERISTIC TQS8_TVBB_INHIBIT_WH_SLIP_LSP BrkCalVariantCriterion
  /begin VAR_ADDRESS 0x80020D76 0x80024176 0x80027576 0x8002A976 0x8002DD76 0x80031176 0x80034576 0x80037976 /end VAR_ADDRESS
 /end VAR_CHARACTERISTIC
 /begin VAR_CHARACTERISTIC TQS8_TVBB_INHIBIT_WH_SLIP_MSP BrkCalVariantCriterion
  /begin VAR_ADDRESS 0x80020D77 0x80024177 0x80027577 0x8002A977 0x8002DD77 0x80031177 0x80034577 0x80037977 /end VAR_ADDRESS
 /end VAR_CHARACTERISTIC
 /begin VAR_CHARACTERISTIC TQS8_X1_FadeOut_Ay_Thres_Weg BrkCalVariantCriterion
  /begin VAR_ADDRESS 0x8002082E 0x80023C2E 0x8002702E 0x8002A42E 0x8002D82E 0x80030C2E 0x8003402E 0x8003742E /end VAR_ADDRESS
 /end VAR_CHARACTERISTIC
 /begin VAR_CHARACTERISTIC TQS8_X2_FadeOut_Ay_Thres_Weg BrkCalVariantCriterion
  /begin VAR_ADDRESS 0x8002082F 0x80023C2F 0x8002702F 0x8002A42F 0x8002D82F 0x80030C2F 0x8003402F 0x8003742F /end VAR_ADDRESS
 /end VAR_CHARACTERISTIC
 /begin VAR_CHARACTERISTIC TQS8_X3_FadeOut_Ay_Thres_Weg BrkCalVariantCriterion
  /begin VAR_ADDRESS 0x80020830 0x80023C30 0x80027030 0x8002A430 0x8002D830 0x80030C30 0x80034030 0x80037430 /end VAR_ADDRESS
 /end VAR_CHARACTERISTIC
 /begin VAR_CHARACTERISTIC TQS8_X4_FadeOut_Ay_Thres_Weg BrkCalVariantCriterion
  /begin VAR_ADDRESS 0x80020831 0x80023C31 0x80027031 0x8002A431 0x8002D831 0x80030C31 0x80034031 0x80037431 /end VAR_ADDRESS
 /end VAR_CHARACTERISTIC
 /begin VAR_CHARACTERISTIC TQTQESC_OS_2W_Inhibit BrkCalVariantCriterion
  /begin VAR_ADDRESS 0x80020C98 0x80024098 0x80027498 0x8002A898 0x8002DC98 0x80031098 0x80034498 0x80037898 /end VAR_ADDRESS
 /end VAR_CHARACTERISTIC
 /begin VAR_CHARACTERISTIC TQTQESC_US_2W_Inhibit BrkCalVariantCriterion
  /begin VAR_ADDRESS 0x80020C99 0x80024099 0x80027499 0x8002A899 0x8002DC99 0x80031099 0x80034499 0x80037899 /end VAR_ADDRESS
 /end VAR_CHARACTERISTIC
 /begin VAR_CHARACTERISTIC TQTvbbUint8InhibitionFlag BrkCalVariantCriterion
  /begin VAR_ADDRESS 0x80020D5A 0x8002415A 0x8002755A 0x8002A95A 0x8002DD5A 0x8003115A 0x8003455A 0x8003795A /end VAR_ADDRESS
 /end VAR_CHARACTERISTIC
 /begin VAR_CHARACTERISTIC TQU16_FRNT_WH_PRESS_TO_BRK_TORQ_RATIO BrkCalVariantCriterion
  /begin VAR_ADDRESS 0x800207F2 0x80023BF2 0x80026FF2 0x8002A3F2 0x8002D7F2 0x80030BF2 0x80033FF2 0x800373F2 /end VAR_ADDRESS
 /end VAR_CHARACTERISTIC
 /begin VAR_CHARACTERISTIC TQU16_GAIN_BETA_D_YAW BrkCalVariantCriterion
  /begin VAR_ADDRESS 0x80020022 0x80023422 0x80026822 0x80029C22 0x8002D022 0x80030422 0x80033822 0x80036C22 /end VAR_ADDRESS
 /end VAR_CHARACTERISTIC
 /begin VAR_CHARACTERISTIC TQU16_REAR_WH_PRESS_TO_BRK_TORQ_RATIO BrkCalVariantCriterion
  /begin VAR_ADDRESS 0x800207F4 0x80023BF4 0x80026FF4 0x8002A3F4 0x8002D7F4 0x80030BF4 0x80033FF4 0x800373F4 /end VAR_ADDRESS
 /end VAR_CHARACTERISTIC
 /begin VAR_CHARACTERISTIC TQU8_DEL_M_THR_ENTER_FRONT_HM_HS BrkCalVariantCriterion
  /begin VAR_ADDRESS 0x800208B0 0x80023CB0 0x800270B0 0x8002A4B0 0x8002D8B0 0x80030CB0 0x800340B0 0x800374B0 /end VAR_ADDRESS
 /end VAR_CHARACTERISTIC
 /begin VAR_CHARACTERISTIC TQU8_DEL_M_THR_ENTER_FRONT_HM_LS BrkCalVariantCriterion
  /begin VAR_ADDRESS 0x800208B1 0x80023CB1 0x800270B1 0x8002A4B1 0x8002D8B1 0x80030CB1 0x800340B1 0x800374B1 /end VAR_ADDRESS
 /end VAR_CHARACTERISTIC
 /begin VAR_CHARACTERISTIC TQU8_DEL_M_THR_ENTER_FRONT_HM_MS BrkCalVariantCriterion
  /begin VAR_ADDRESS 0x800208B2 0x80023CB2 0x800270B2 0x8002A4B2 0x8002D8B2 0x80030CB2 0x800340B2 0x800374B2 /end VAR_ADDRESS
 /end VAR_CHARACTERISTIC
 /begin VAR_CHARACTERISTIC TQU8_DEL_M_THR_ENTER_FRONT_LM_HS BrkCalVariantCriterion
  /begin VAR_ADDRESS 0x800208A4 0x80023CA4 0x800270A4 0x8002A4A4 0x8002D8A4 0x80030CA4 0x800340A4 0x800374A4 /end VAR_ADDRESS
 /end VAR_CHARACTERISTIC
 /begin VAR_CHARACTERISTIC TQU8_DEL_M_THR_ENTER_FRONT_LM_LS BrkCalVariantCriterion
  /begin VAR_ADDRESS 0x800208A5 0x80023CA5 0x800270A5 0x8002A4A5 0x8002D8A5 0x80030CA5 0x800340A5 0x800374A5 /end VAR_ADDRESS
 /end VAR_CHARACTERISTIC
 /begin VAR_CHARACTERISTIC TQU8_DEL_M_THR_ENTER_FRONT_LM_MS BrkCalVariantCriterion
  /begin VAR_ADDRESS 0x800208A6 0x80023CA6 0x800270A6 0x8002A4A6 0x8002D8A6 0x80030CA6 0x800340A6 0x800374A6 /end VAR_ADDRESS
 /end VAR_CHARACTERISTIC
 /begin VAR_CHARACTERISTIC TQU8_DEL_M_THR_ENTER_FRONT_MM_HS BrkCalVariantCriterion
  /begin VAR_ADDRESS 0x800208AA 0x80023CAA 0x800270AA 0x8002A4AA 0x8002D8AA 0x80030CAA 0x800340AA 0x800374AA /end VAR_ADDRESS
 /end VAR_CHARACTERISTIC
 /begin VAR_CHARACTERISTIC TQU8_DEL_M_THR_ENTER_FRONT_MM_LS BrkCalVariantCriterion
  /begin VAR_ADDRESS 0x800208AB 0x80023CAB 0x800270AB 0x8002A4AB 0x8002D8AB 0x80030CAB 0x800340AB 0x800374AB /end VAR_ADDRESS
 /end VAR_CHARACTERISTIC
 /begin VAR_CHARACTERISTIC TQU8_DEL_M_THR_ENTER_FRONT_MM_MS BrkCalVariantCriterion
  /begin VAR_ADDRESS 0x800208AC 0x80023CAC 0x800270AC 0x8002A4AC 0x8002D8AC 0x80030CAC 0x800340AC 0x800374AC /end VAR_ADDRESS
 /end VAR_CHARACTERISTIC
 /begin VAR_CHARACTERISTIC TQU8_DEL_M_THR_ENTER_REAR_HM_HS BrkCalVariantCriterion
  /begin VAR_ADDRESS 0x8002089E 0x80023C9E 0x8002709E 0x8002A49E 0x8002D89E 0x80030C9E 0x8003409E 0x8003749E /end VAR_ADDRESS
 /end VAR_CHARACTERISTIC
 /begin VAR_CHARACTERISTIC TQU8_DEL_M_THR_ENTER_REAR_HM_LS BrkCalVariantCriterion
  /begin VAR_ADDRESS 0x8002089F 0x80023C9F 0x8002709F 0x8002A49F 0x8002D89F 0x80030C9F 0x8003409F 0x8003749F /end VAR_ADDRESS
 /end VAR_CHARACTERISTIC
 /begin VAR_CHARACTERISTIC TQU8_DEL_M_THR_ENTER_REAR_HM_MS BrkCalVariantCriterion
  /begin VAR_ADDRESS 0x800208A0 0x80023CA0 0x800270A0 0x8002A4A0 0x8002D8A0 0x80030CA0 0x800340A0 0x800374A0 /end VAR_ADDRESS
 /end VAR_CHARACTERISTIC
 /begin VAR_CHARACTERISTIC TQU8_DEL_M_THR_ENTER_REAR_LM_HS BrkCalVariantCriterion
  /begin VAR_ADDRESS 0x80020892 0x80023C92 0x80027092 0x8002A492 0x8002D892 0x80030C92 0x80034092 0x80037492 /end VAR_ADDRESS
 /end VAR_CHARACTERISTIC
 /begin VAR_CHARACTERISTIC TQU8_DEL_M_THR_ENTER_REAR_LM_LS BrkCalVariantCriterion
  /begin VAR_ADDRESS 0x80020893 0x80023C93 0x80027093 0x8002A493 0x8002D893 0x80030C93 0x80034093 0x80037493 /end VAR_ADDRESS
 /end VAR_CHARACTERISTIC
 /begin VAR_CHARACTERISTIC TQU8_DEL_M_THR_ENTER_REAR_LM_MS BrkCalVariantCriterion
  /begin VAR_ADDRESS 0x80020894 0x80023C94 0x80027094 0x8002A494 0x8002D894 0x80030C94 0x80034094 0x80037494 /end VAR_ADDRESS
 /end VAR_CHARACTERISTIC
 /begin VAR_CHARACTERISTIC TQU8_DEL_M_THR_ENTER_REAR_MM_HS BrkCalVariantCriterion
  /begin VAR_ADDRESS 0x80020898 0x80023C98 0x80027098 0x8002A498 0x8002D898 0x80030C98 0x80034098 0x80037498 /end VAR_ADDRESS
 /end VAR_CHARACTERISTIC
 /begin VAR_CHARACTERISTIC TQU8_DEL_M_THR_ENTER_REAR_MM_LS BrkCalVariantCriterion
  /begin VAR_ADDRESS 0x80020899 0x80023C99 0x80027099 0x8002A499 0x8002D899 0x80030C99 0x80034099 0x80037499 /end VAR_ADDRESS
 /end VAR_CHARACTERISTIC
 /begin VAR_CHARACTERISTIC TQU8_DEL_M_THR_ENTER_REAR_MM_MS BrkCalVariantCriterion
  /begin VAR_ADDRESS 0x8002089A 0x80023C9A 0x8002709A 0x8002A49A 0x8002D89A 0x80030C9A 0x8003409A 0x8003749A /end VAR_ADDRESS
 /end VAR_CHARACTERISTIC
 /begin VAR_CHARACTERISTIC TQU8_DEL_M_THR_EXIT_FRONT_HM_HS BrkCalVariantCriterion
  /begin VAR_ADDRESS 0x800208B3 0x80023CB3 0x800270B3 0x8002A4B3 0x8002D8B3 0x80030CB3 0x800340B3 0x800374B3 /end VAR_ADDRESS
 /end VAR_CHARACTERISTIC
 /begin VAR_CHARACTERISTIC TQU8_DEL_M_THR_EXIT_FRONT_HM_LS BrkCalVariantCriterion
  /begin VAR_ADDRESS 0x800208B4 0x80023CB4 0x800270B4 0x8002A4B4 0x8002D8B4 0x80030CB4 0x800340B4 0x800374B4 /end VAR_ADDRESS
 /end VAR_CHARACTERISTIC
 /begin VAR_CHARACTERISTIC TQU8_DEL_M_THR_EXIT_FRONT_HM_MS BrkCalVariantCriterion
  /begin VAR_ADDRESS 0x800208B5 0x80023CB5 0x800270B5 0x8002A4B5 0x8002D8B5 0x80030CB5 0x800340B5 0x800374B5 /end VAR_ADDRESS
 /end VAR_CHARACTERISTIC
 /begin VAR_CHARACTERISTIC TQU8_DEL_M_THR_EXIT_FRONT_LM_HS BrkCalVariantCriterion
  /begin VAR_ADDRESS 0x800208A7 0x80023CA7 0x800270A7 0x8002A4A7 0x8002D8A7 0x80030CA7 0x800340A7 0x800374A7 /end VAR_ADDRESS
 /end VAR_CHARACTERISTIC
 /begin VAR_CHARACTERISTIC TQU8_DEL_M_THR_EXIT_FRONT_LM_LS BrkCalVariantCriterion
  /begin VAR_ADDRESS 0x800208A8 0x80023CA8 0x800270A8 0x8002A4A8 0x8002D8A8 0x80030CA8 0x800340A8 0x800374A8 /end VAR_ADDRESS
 /end VAR_CHARACTERISTIC
 /begin VAR_CHARACTERISTIC TQU8_DEL_M_THR_EXIT_FRONT_LM_MS BrkCalVariantCriterion
  /begin VAR_ADDRESS 0x800208A9 0x80023CA9 0x800270A9 0x8002A4A9 0x8002D8A9 0x80030CA9 0x800340A9 0x800374A9 /end VAR_ADDRESS
 /end VAR_CHARACTERISTIC
 /begin VAR_CHARACTERISTIC TQU8_DEL_M_THR_EXIT_FRONT_MM_HS BrkCalVariantCriterion
  /begin VAR_ADDRESS 0x800208AD 0x80023CAD 0x800270AD 0x8002A4AD 0x8002D8AD 0x80030CAD 0x800340AD 0x800374AD /end VAR_ADDRESS
 /end VAR_CHARACTERISTIC
 /begin VAR_CHARACTERISTIC TQU8_DEL_M_THR_EXIT_FRONT_MM_LS BrkCalVariantCriterion
  /begin VAR_ADDRESS 0x800208AE 0x80023CAE 0x800270AE 0x8002A4AE 0x8002D8AE 0x80030CAE 0x800340AE 0x800374AE /end VAR_ADDRESS
 /end VAR_CHARACTERISTIC
 /begin VAR_CHARACTERISTIC TQU8_DEL_M_THR_EXIT_FRONT_MM_MS BrkCalVariantCriterion
  /begin VAR_ADDRESS 0x800208AF 0x80023CAF 0x800270AF 0x8002A4AF 0x8002D8AF 0x80030CAF 0x800340AF 0x800374AF /end VAR_ADDRESS
 /end VAR_CHARACTERISTIC
 /begin VAR_CHARACTERISTIC TQU8_DEL_M_THR_EXIT_REAR_HM_HS BrkCalVariantCriterion
  /begin VAR_ADDRESS 0x800208A1 0x80023CA1 0x800270A1 0x8002A4A1 0x8002D8A1 0x80030CA1 0x800340A1 0x800374A1 /end VAR_ADDRESS
 /end VAR_CHARACTERISTIC
 /begin VAR_CHARACTERISTIC TQU8_DEL_M_THR_EXIT_REAR_HM_LS BrkCalVariantCriterion
  /begin VAR_ADDRESS 0x800208A2 0x80023CA2 0x800270A2 0x8002A4A2 0x8002D8A2 0x80030CA2 0x800340A2 0x800374A2 /end VAR_ADDRESS
 /end VAR_CHARACTERISTIC
 /begin VAR_CHARACTERISTIC TQU8_DEL_M_THR_EXIT_REAR_HM_MS BrkCalVariantCriterion
  /begin VAR_ADDRESS 0x800208A3 0x80023CA3 0x800270A3 0x8002A4A3 0x8002D8A3 0x80030CA3 0x800340A3 0x800374A3 /end VAR_ADDRESS
 /end VAR_CHARACTERISTIC
 /begin VAR_CHARACTERISTIC TQU8_DEL_M_THR_EXIT_REAR_LM_HS BrkCalVariantCriterion
  /begin VAR_ADDRESS 0x80020895 0x80023C95 0x80027095 0x8002A495 0x8002D895 0x80030C95 0x80034095 0x80037495 /end VAR_ADDRESS
 /end VAR_CHARACTERISTIC
 /begin VAR_CHARACTERISTIC TQU8_DEL_M_THR_EXIT_REAR_LM_LS BrkCalVariantCriterion
  /begin VAR_ADDRESS 0x80020896 0x80023C96 0x80027096 0x8002A496 0x8002D896 0x80030C96 0x80034096 0x80037496 /end VAR_ADDRESS
 /end VAR_CHARACTERISTIC
 /begin VAR_CHARACTERISTIC TQU8_DEL_M_THR_EXIT_REAR_LM_MS BrkCalVariantCriterion
  /begin VAR_ADDRESS 0x80020897 0x80023C97 0x80027097 0x8002A497 0x8002D897 0x80030C97 0x80034097 0x80037497 /end VAR_ADDRESS
 /end VAR_CHARACTERISTIC
 /begin VAR_CHARACTERISTIC TQU8_DEL_M_THR_EXIT_REAR_MM_HS BrkCalVariantCriterion
  /begin VAR_ADDRESS 0x8002089B 0x80023C9B 0x8002709B 0x8002A49B 0x8002D89B 0x80030C9B 0x8003409B 0x8003749B /end VAR_ADDRESS
 /end VAR_CHARACTERISTIC
 /begin VAR_CHARACTERISTIC TQU8_DEL_M_THR_EXIT_REAR_MM_LS BrkCalVariantCriterion
  /begin VAR_ADDRESS 0x8002089C 0x80023C9C 0x8002709C 0x8002A49C 0x8002D89C 0x80030C9C 0x8003409C 0x8003749C /end VAR_ADDRESS
 /end VAR_CHARACTERISTIC
 /begin VAR_CHARACTERISTIC TQU8_DEL_M_THR_EXIT_REAR_MM_MS BrkCalVariantCriterion
  /begin VAR_ADDRESS 0x8002089D 0x80023C9D 0x8002709D 0x8002A49D 0x8002D89D 0x80030C9D 0x8003409D 0x8003749D /end VAR_ADDRESS
 /end VAR_CHARACTERISTIC
 /begin VAR_CHARACTERISTIC TQU8_MOT_V_TORQ_GRAD_X1 BrkCalVariantCriterion
  /begin VAR_ADDRESS 0x800207D8 0x80023BD8 0x80026FD8 0x8002A3D8 0x8002D7D8 0x80030BD8 0x80033FD8 0x800373D8 /end VAR_ADDRESS
 /end VAR_CHARACTERISTIC
 /begin VAR_CHARACTERISTIC TQU8_MOT_V_TORQ_GRAD_X2 BrkCalVariantCriterion
  /begin VAR_ADDRESS 0x800207D9 0x80023BD9 0x80026FD9 0x8002A3D9 0x8002D7D9 0x80030BD9 0x80033FD9 0x800373D9 /end VAR_ADDRESS
 /end VAR_CHARACTERISTIC
 /begin VAR_CHARACTERISTIC TQU8_MOT_V_TORQ_GRAD_X3 BrkCalVariantCriterion
  /begin VAR_ADDRESS 0x800207DA 0x80023BDA 0x80026FDA 0x8002A3DA 0x8002D7DA 0x80030BDA 0x80033FDA 0x800373DA /end VAR_ADDRESS
 /end VAR_CHARACTERISTIC
 /begin VAR_CHARACTERISTIC TQU8_MOT_V_TORQ_GRAD_X4 BrkCalVariantCriterion
  /begin VAR_ADDRESS 0x800207DB 0x80023BDB 0x80026FDB 0x8002A3DB 0x8002D7DB 0x80030BDB 0x80033FDB 0x800373DB /end VAR_ADDRESS
 /end VAR_CHARACTERISTIC
 /begin VAR_CHARACTERISTIC TQU8_MOT_V_TORQ_GRAD_X5 BrkCalVariantCriterion
  /begin VAR_ADDRESS 0x800207DC 0x80023BDC 0x80026FDC 0x8002A3DC 0x8002D7DC 0x80030BDC 0x80033FDC 0x800373DC /end VAR_ADDRESS
 /end VAR_CHARACTERISTIC
 /begin VAR_CHARACTERISTIC TQU8_RISE_SCAN_HIG_HMU BrkCalVariantCriterion
  /begin VAR_ADDRESS 0x800207F0 0x80023BF0 0x80026FF0 0x8002A3F0 0x8002D7F0 0x80030BF0 0x80033FF0 0x800373F0 /end VAR_ADDRESS
 /end VAR_CHARACTERISTIC
 /begin VAR_CHARACTERISTIC TQU8_RISE_SCAN_HIG_LMU BrkCalVariantCriterion
  /begin VAR_ADDRESS 0x800207EA 0x80023BEA 0x80026FEA 0x8002A3EA 0x8002D7EA 0x80030BEA 0x80033FEA 0x800373EA /end VAR_ADDRESS
 /end VAR_CHARACTERISTIC
 /begin VAR_CHARACTERISTIC TQU8_RISE_SCAN_HIG_MMU BrkCalVariantCriterion
  /begin VAR_ADDRESS 0x800207ED 0x80023BED 0x80026FED 0x8002A3ED 0x8002D7ED 0x80030BED 0x80033FED 0x800373ED /end VAR_ADDRESS
 /end VAR_CHARACTERISTIC
 /begin VAR_CHARACTERISTIC TQU8_RISE_SCAN_LOW_HMU BrkCalVariantCriterion
  /begin VAR_ADDRESS 0x800207EE 0x80023BEE 0x80026FEE 0x8002A3EE 0x8002D7EE 0x80030BEE 0x80033FEE 0x800373EE /end VAR_ADDRESS
 /end VAR_CHARACTERISTIC
 /begin VAR_CHARACTERISTIC TQU8_RISE_SCAN_LOW_LMU BrkCalVariantCriterion
  /begin VAR_ADDRESS 0x800207E8 0x80023BE8 0x80026FE8 0x8002A3E8 0x8002D7E8 0x80030BE8 0x80033FE8 0x800373E8 /end VAR_ADDRESS
 /end VAR_CHARACTERISTIC
 /begin VAR_CHARACTERISTIC TQU8_RISE_SCAN_LOW_MMU BrkCalVariantCriterion
  /begin VAR_ADDRESS 0x800207EB 0x80023BEB 0x80026FEB 0x8002A3EB 0x8002D7EB 0x80030BEB 0x80033FEB 0x800373EB /end VAR_ADDRESS
 /end VAR_CHARACTERISTIC
 /begin VAR_CHARACTERISTIC TQU8_RISE_SCAN_MED_HMU BrkCalVariantCriterion
  /begin VAR_ADDRESS 0x800207EF 0x80023BEF 0x80026FEF 0x8002A3EF 0x8002D7EF 0x80030BEF 0x80033FEF 0x800373EF /end VAR_ADDRESS
 /end VAR_CHARACTERISTIC
 /begin VAR_CHARACTERISTIC TQU8_RISE_SCAN_MED_LMU BrkCalVariantCriterion
  /begin VAR_ADDRESS 0x800207E9 0x80023BE9 0x80026FE9 0x8002A3E9 0x8002D7E9 0x80030BE9 0x80033FE9 0x800373E9 /end VAR_ADDRESS
 /end VAR_CHARACTERISTIC
 /begin VAR_CHARACTERISTIC TQU8_RISE_SCAN_MED_MMU BrkCalVariantCriterion
  /begin VAR_ADDRESS 0x800207EC 0x80023BEC 0x80026FEC 0x8002A3EC 0x8002D7EC 0x80030BEC 0x80033FEC 0x800373EC /end VAR_ADDRESS
 /end VAR_CHARACTERISTIC
 /begin VAR_CHARACTERISTIC TQU8_ROP_AY_VX_DOT_1ST_WEG BrkCalVariantCriterion
  /begin VAR_ADDRESS 0x80020B6B 0x80023F6B 0x8002736B 0x8002A76B 0x8002DB6B 0x80030F6B 0x8003436B 0x8003776B /end VAR_ADDRESS
 /end VAR_CHARACTERISTIC
 /begin VAR_CHARACTERISTIC TQU8_ROP_AY_VX_DOT_2ND_WEG BrkCalVariantCriterion
  /begin VAR_ADDRESS 0x80020B6A 0x80023F6A 0x8002736A 0x8002A76A 0x8002DB6A 0x80030F6A 0x8003436A 0x8003776A /end VAR_ADDRESS
 /end VAR_CHARACTERISTIC
 /begin VAR_CHARACTERISTIC TQU8_ROP_AY_VX_DOT_WEG BrkCalVariantCriterion
  /begin VAR_ADDRESS 0x80020B6C 0x80023F6C 0x8002736C 0x8002A76C 0x8002DB6C 0x80030F6C 0x8003436C 0x8003776C /end VAR_ADDRESS
 /end VAR_CHARACTERISTIC
 /begin VAR_CHARACTERISTIC TQU8_TC_OFFSET_GRAD_X1 BrkCalVariantCriterion
  /begin VAR_ADDRESS 0x800207C9 0x80023BC9 0x80026FC9 0x8002A3C9 0x8002D7C9 0x80030BC9 0x80033FC9 0x800373C9 /end VAR_ADDRESS
 /end VAR_CHARACTERISTIC
 /begin VAR_CHARACTERISTIC TQU8_TC_OFFSET_GRAD_X2 BrkCalVariantCriterion
  /begin VAR_ADDRESS 0x800207CA 0x80023BCA 0x80026FCA 0x8002A3CA 0x8002D7CA 0x80030BCA 0x80033FCA 0x800373CA /end VAR_ADDRESS
 /end VAR_CHARACTERISTIC
 /begin VAR_CHARACTERISTIC TQU8_TC_OFFSET_GRAD_X3 BrkCalVariantCriterion
  /begin VAR_ADDRESS 0x800207CB 0x80023BCB 0x80026FCB 0x8002A3CB 0x8002D7CB 0x80030BCB 0x80033FCB 0x800373CB /end VAR_ADDRESS
 /end VAR_CHARACTERISTIC
 /begin VAR_CHARACTERISTIC TQU8_TC_OFFSET_GRAD_X4 BrkCalVariantCriterion
  /begin VAR_ADDRESS 0x800207CC 0x80023BCC 0x80026FCC 0x8002A3CC 0x8002D7CC 0x80030BCC 0x80033FCC 0x800373CC /end VAR_ADDRESS
 /end VAR_CHARACTERISTIC
 /begin VAR_CHARACTERISTIC TQU8_TC_OFFSET_GRAD_X5 BrkCalVariantCriterion
  /begin VAR_ADDRESS 0x800207CD 0x80023BCD 0x80026FCD 0x8002A3CD 0x8002D7CD 0x80030BCD 0x80033FCD 0x800373CD /end VAR_ADDRESS
 /end VAR_CHARACTERISTIC
 /begin VAR_CHARACTERISTIC TQU8_TC_RISE_SCAN_HIG_HMU BrkCalVariantCriterion
  /begin VAR_ADDRESS 0x800207C8 0x80023BC8 0x80026FC8 0x8002A3C8 0x8002D7C8 0x80030BC8 0x80033FC8 0x800373C8 /end VAR_ADDRESS
 /end VAR_CHARACTERISTIC
 /begin VAR_CHARACTERISTIC TQU8_TC_RISE_SCAN_HIG_LMU BrkCalVariantCriterion
  /begin VAR_ADDRESS 0x800207C2 0x80023BC2 0x80026FC2 0x8002A3C2 0x8002D7C2 0x80030BC2 0x80033FC2 0x800373C2 /end VAR_ADDRESS
 /end VAR_CHARACTERISTIC
 /begin VAR_CHARACTERISTIC TQU8_TC_RISE_SCAN_HIG_MMU BrkCalVariantCriterion
  /begin VAR_ADDRESS 0x800207C5 0x80023BC5 0x80026FC5 0x8002A3C5 0x8002D7C5 0x80030BC5 0x80033FC5 0x800373C5 /end VAR_ADDRESS
 /end VAR_CHARACTERISTIC
 /begin VAR_CHARACTERISTIC TQU8_TC_RISE_SCAN_LOW_HMU BrkCalVariantCriterion
  /begin VAR_ADDRESS 0x800207C6 0x80023BC6 0x80026FC6 0x8002A3C6 0x8002D7C6 0x80030BC6 0x80033FC6 0x800373C6 /end VAR_ADDRESS
 /end VAR_CHARACTERISTIC
 /begin VAR_CHARACTERISTIC TQU8_TC_RISE_SCAN_LOW_LMU BrkCalVariantCriterion
  /begin VAR_ADDRESS 0x800207C0 0x80023BC0 0x80026FC0 0x8002A3C0 0x8002D7C0 0x80030BC0 0x80033FC0 0x800373C0 /end VAR_ADDRESS
 /end VAR_CHARACTERISTIC
 /begin VAR_CHARACTERISTIC TQU8_TC_RISE_SCAN_LOW_MMU BrkCalVariantCriterion
  /begin VAR_ADDRESS 0x800207C3 0x80023BC3 0x80026FC3 0x8002A3C3 0x8002D7C3 0x80030BC3 0x80033FC3 0x800373C3 /end VAR_ADDRESS
 /end VAR_CHARACTERISTIC
 /begin VAR_CHARACTERISTIC TQU8_TC_RISE_SCAN_MED_HMU BrkCalVariantCriterion
  /begin VAR_ADDRESS 0x800207C7 0x80023BC7 0x80026FC7 0x8002A3C7 0x8002D7C7 0x80030BC7 0x80033FC7 0x800373C7 /end VAR_ADDRESS
 /end VAR_CHARACTERISTIC
 /begin VAR_CHARACTERISTIC TQU8_TC_RISE_SCAN_MED_LMU BrkCalVariantCriterion
  /begin VAR_ADDRESS 0x800207C1 0x80023BC1 0x80026FC1 0x8002A3C1 0x8002D7C1 0x80030BC1 0x80033FC1 0x800373C1 /end VAR_ADDRESS
 /end VAR_CHARACTERISTIC
 /begin VAR_CHARACTERISTIC TQU8_TC_RISE_SCAN_MED_MMU BrkCalVariantCriterion
  /begin VAR_ADDRESS 0x800207C4 0x80023BC4 0x80026FC4 0x8002A3C4 0x8002D7C4 0x80030BC4 0x80033FC4 0x800373C4 /end VAR_ADDRESS
 /end VAR_CHARACTERISTIC
 /begin VAR_CHARACTERISTIC TQU8_TVBB_ACT_IN_ETCS BrkCalVariantCriterion
  /begin VAR_ADDRESS 0x80020E2E 0x8002422E 0x8002762E 0x8002AA2E 0x8002DE2E 0x8003122E 0x8003462E 0x80037A2E /end VAR_ADDRESS
 /end VAR_CHARACTERISTIC
 /begin VAR_CHARACTERISTIC TQU8_TVBB_APS_TH BrkCalVariantCriterion
  /begin VAR_ADDRESS 0x80020D5F 0x8002415F 0x8002755F 0x8002A95F 0x8002DD5F 0x8003115F 0x8003455F 0x8003795F /end VAR_ADDRESS
 /end VAR_CHARACTERISTIC
 /begin VAR_CHARACTERISTIC TQU8_TVBB_CTRL_WEG_FOR_SLIP_HMU_1 BrkCalVariantCriterion
  /begin VAR_ADDRESS 0x80020DCC 0x800241CC 0x800275CC 0x8002A9CC 0x8002DDCC 0x800311CC 0x800345CC 0x800379CC /end VAR_ADDRESS
 /end VAR_CHARACTERISTIC
 /begin VAR_CHARACTERISTIC TQU8_TVBB_CTRL_WEG_FOR_SLIP_HMU_2 BrkCalVariantCriterion
  /begin VAR_ADDRESS 0x80020DCD 0x800241CD 0x800275CD 0x8002A9CD 0x8002DDCD 0x800311CD 0x800345CD 0x800379CD /end VAR_ADDRESS
 /end VAR_CHARACTERISTIC
 /begin VAR_CHARACTERISTIC TQU8_TVBB_CTRL_WEG_FOR_SLIP_HMU_3 BrkCalVariantCriterion
  /begin VAR_ADDRESS 0x80020DCE 0x800241CE 0x800275CE 0x8002A9CE 0x8002DDCE 0x800311CE 0x800345CE 0x800379CE /end VAR_ADDRESS
 /end VAR_CHARACTERISTIC
 /begin VAR_CHARACTERISTIC TQU8_TVBB_CTRL_WEG_FOR_SLIP_HMU_4 BrkCalVariantCriterion
  /begin VAR_ADDRESS 0x80020DCF 0x800241CF 0x800275CF 0x8002A9CF 0x8002DDCF 0x800311CF 0x800345CF 0x800379CF /end VAR_ADDRESS
 /end VAR_CHARACTERISTIC
 /begin VAR_CHARACTERISTIC TQU8_TVBB_CTRL_WEG_FOR_SLIP_HMU_5 BrkCalVariantCriterion
  /begin VAR_ADDRESS 0x80020DD0 0x800241D0 0x800275D0 0x8002A9D0 0x8002DDD0 0x800311D0 0x800345D0 0x800379D0 /end VAR_ADDRESS
 /end VAR_CHARACTERISTIC
 /begin VAR_CHARACTERISTIC TQU8_TVBB_ENTER_SPIN_REF_ALATM_H BrkCalVariantCriterion
  /begin VAR_ADDRESS 0x80020DE0 0x800241E0 0x800275E0 0x8002A9E0 0x8002DDE0 0x800311E0 0x800345E0 0x800379E0 /end VAR_ADDRESS
 /end VAR_CHARACTERISTIC
 /begin VAR_CHARACTERISTIC TQU8_TVBB_ENTER_SPIN_REF_ALATM_L BrkCalVariantCriterion
  /begin VAR_ADDRESS 0x80020DDE 0x800241DE 0x800275DE 0x8002A9DE 0x8002DDDE 0x800311DE 0x800345DE 0x800379DE /end VAR_ADDRESS
 /end VAR_CHARACTERISTIC
 /begin VAR_CHARACTERISTIC TQU8_TVBB_ENTER_SPIN_REF_ALATM_M BrkCalVariantCriterion
  /begin VAR_ADDRESS 0x80020DDF 0x800241DF 0x800275DF 0x8002A9DF 0x8002DDDF 0x800311DF 0x800345DF 0x800379DF /end VAR_ADDRESS
 /end VAR_CHARACTERISTIC
 /begin VAR_CHARACTERISTIC TQU8_TVBB_TURN_INTENT_DCT_TIME BrkCalVariantCriterion
  /begin VAR_ADDRESS 0x80020D62 0x80024162 0x80027562 0x8002A962 0x8002DD62 0x80031162 0x80034562 0x80037962 /end VAR_ADDRESS
 /end VAR_CHARACTERISTIC
 /begin VAR_CHARACTERISTIC TQYAW_CONTORL_P_GAIN_BETA_H BrkCalVariantCriterion
  /begin VAR_ADDRESS 0x80020A6C 0x80023E6C 0x8002726C 0x8002A66C 0x8002DA6C 0x80030E6C 0x8003426C 0x8003766C /end VAR_ADDRESS
 /end VAR_CHARACTERISTIC
 /begin VAR_CHARACTERISTIC TQYAW_CONTORL_P_GAIN_BETA_L BrkCalVariantCriterion
  /begin VAR_ADDRESS 0x80020A6E 0x80023E6E 0x8002726E 0x8002A66E 0x8002DA6E 0x80030E6E 0x8003426E 0x8003766E /end VAR_ADDRESS
 /end VAR_CHARACTERISTIC
 /begin VAR_CHARACTERISTIC TQYAW_CONTORL_P_GAIN_BETA_M BrkCalVariantCriterion
  /begin VAR_ADDRESS 0x80020A70 0x80023E70 0x80027270 0x8002A670 0x8002DA70 0x80030E70 0x80034270 0x80037670 /end VAR_ADDRESS
 /end VAR_CHARACTERISTIC
 /begin VAR_CHARACTERISTIC TQYc_Map[0][0] BrkCalVariantCriterion
  /begin VAR_ADDRESS 0x8002009C 0x8002349C 0x8002689C 0x80029C9C 0x8002D09C 0x8003049C 0x8003389C 0x80036C9C /end VAR_ADDRESS
 /end VAR_CHARACTERISTIC
 /begin VAR_CHARACTERISTIC TQYc_Map[0][10] BrkCalVariantCriterion
  /begin VAR_ADDRESS 0x800200B0 0x800234B0 0x800268B0 0x80029CB0 0x8002D0B0 0x800304B0 0x800338B0 0x80036CB0 /end VAR_ADDRESS
 /end VAR_CHARACTERISTIC
 /begin VAR_CHARACTERISTIC TQYc_Map[0][11] BrkCalVariantCriterion
  /begin VAR_ADDRESS 0x800200B2 0x800234B2 0x800268B2 0x80029CB2 0x8002D0B2 0x800304B2 0x800338B2 0x80036CB2 /end VAR_ADDRESS
 /end VAR_CHARACTERISTIC
 /begin VAR_CHARACTERISTIC TQYc_Map[0][1] BrkCalVariantCriterion
  /begin VAR_ADDRESS 0x8002009E 0x8002349E 0x8002689E 0x80029C9E 0x8002D09E 0x8003049E 0x8003389E 0x80036C9E /end VAR_ADDRESS
 /end VAR_CHARACTERISTIC
 /begin VAR_CHARACTERISTIC TQYc_Map[0][2] BrkCalVariantCriterion
  /begin VAR_ADDRESS 0x800200A0 0x800234A0 0x800268A0 0x80029CA0 0x8002D0A0 0x800304A0 0x800338A0 0x80036CA0 /end VAR_ADDRESS
 /end VAR_CHARACTERISTIC
 /begin VAR_CHARACTERISTIC TQYc_Map[0][3] BrkCalVariantCriterion
  /begin VAR_ADDRESS 0x800200A2 0x800234A2 0x800268A2 0x80029CA2 0x8002D0A2 0x800304A2 0x800338A2 0x80036CA2 /end VAR_ADDRESS
 /end VAR_CHARACTERISTIC
 /begin VAR_CHARACTERISTIC TQYc_Map[0][4] BrkCalVariantCriterion
  /begin VAR_ADDRESS 0x800200A4 0x800234A4 0x800268A4 0x80029CA4 0x8002D0A4 0x800304A4 0x800338A4 0x80036CA4 /end VAR_ADDRESS
 /end VAR_CHARACTERISTIC
 /begin VAR_CHARACTERISTIC TQYc_Map[0][5] BrkCalVariantCriterion
  /begin VAR_ADDRESS 0x800200A6 0x800234A6 0x800268A6 0x80029CA6 0x8002D0A6 0x800304A6 0x800338A6 0x80036CA6 /end VAR_ADDRESS
 /end VAR_CHARACTERISTIC
 /begin VAR_CHARACTERISTIC TQYc_Map[0][6] BrkCalVariantCriterion
  /begin VAR_ADDRESS 0x800200A8 0x800234A8 0x800268A8 0x80029CA8 0x8002D0A8 0x800304A8 0x800338A8 0x80036CA8 /end VAR_ADDRESS
 /end VAR_CHARACTERISTIC
 /begin VAR_CHARACTERISTIC TQYc_Map[0][7] BrkCalVariantCriterion
  /begin VAR_ADDRESS 0x800200AA 0x800234AA 0x800268AA 0x80029CAA 0x8002D0AA 0x800304AA 0x800338AA 0x80036CAA /end VAR_ADDRESS
 /end VAR_CHARACTERISTIC
 /begin VAR_CHARACTERISTIC TQYc_Map[0][8] BrkCalVariantCriterion
  /begin VAR_ADDRESS 0x800200AC 0x800234AC 0x800268AC 0x80029CAC 0x8002D0AC 0x800304AC 0x800338AC 0x80036CAC /end VAR_ADDRESS
 /end VAR_CHARACTERISTIC
 /begin VAR_CHARACTERISTIC TQYc_Map[0][9] BrkCalVariantCriterion
  /begin VAR_ADDRESS 0x800200AE 0x800234AE 0x800268AE 0x80029CAE 0x8002D0AE 0x800304AE 0x800338AE 0x80036CAE /end VAR_ADDRESS
 /end VAR_CHARACTERISTIC
 /begin VAR_CHARACTERISTIC TQYc_Map[10][0] BrkCalVariantCriterion
  /begin VAR_ADDRESS 0x8002018C 0x8002358C 0x8002698C 0x80029D8C 0x8002D18C 0x8003058C 0x8003398C 0x80036D8C /end VAR_ADDRESS
 /end VAR_CHARACTERISTIC
 /begin VAR_CHARACTERISTIC TQYc_Map[10][10] BrkCalVariantCriterion
  /begin VAR_ADDRESS 0x800201A0 0x800235A0 0x800269A0 0x80029DA0 0x8002D1A0 0x800305A0 0x800339A0 0x80036DA0 /end VAR_ADDRESS
 /end VAR_CHARACTERISTIC
 /begin VAR_CHARACTERISTIC TQYc_Map[10][11] BrkCalVariantCriterion
  /begin VAR_ADDRESS 0x800201A2 0x800235A2 0x800269A2 0x80029DA2 0x8002D1A2 0x800305A2 0x800339A2 0x80036DA2 /end VAR_ADDRESS
 /end VAR_CHARACTERISTIC
 /begin VAR_CHARACTERISTIC TQYc_Map[10][1] BrkCalVariantCriterion
  /begin VAR_ADDRESS 0x8002018E 0x8002358E 0x8002698E 0x80029D8E 0x8002D18E 0x8003058E 0x8003398E 0x80036D8E /end VAR_ADDRESS
 /end VAR_CHARACTERISTIC
 /begin VAR_CHARACTERISTIC TQYc_Map[10][2] BrkCalVariantCriterion
  /begin VAR_ADDRESS 0x80020190 0x80023590 0x80026990 0x80029D90 0x8002D190 0x80030590 0x80033990 0x80036D90 /end VAR_ADDRESS
 /end VAR_CHARACTERISTIC
 /begin VAR_CHARACTERISTIC TQYc_Map[10][3] BrkCalVariantCriterion
  /begin VAR_ADDRESS 0x80020192 0x80023592 0x80026992 0x80029D92 0x8002D192 0x80030592 0x80033992 0x80036D92 /end VAR_ADDRESS
 /end VAR_CHARACTERISTIC
 /begin VAR_CHARACTERISTIC TQYc_Map[10][4] BrkCalVariantCriterion
  /begin VAR_ADDRESS 0x80020194 0x80023594 0x80026994 0x80029D94 0x8002D194 0x80030594 0x80033994 0x80036D94 /end VAR_ADDRESS
 /end VAR_CHARACTERISTIC
 /begin VAR_CHARACTERISTIC TQYc_Map[10][5] BrkCalVariantCriterion
  /begin VAR_ADDRESS 0x80020196 0x80023596 0x80026996 0x80029D96 0x8002D196 0x80030596 0x80033996 0x80036D96 /end VAR_ADDRESS
 /end VAR_CHARACTERISTIC
 /begin VAR_CHARACTERISTIC TQYc_Map[10][6] BrkCalVariantCriterion
  /begin VAR_ADDRESS 0x80020198 0x80023598 0x80026998 0x80029D98 0x8002D198 0x80030598 0x80033998 0x80036D98 /end VAR_ADDRESS
 /end VAR_CHARACTERISTIC
 /begin VAR_CHARACTERISTIC TQYc_Map[10][7] BrkCalVariantCriterion
  /begin VAR_ADDRESS 0x8002019A 0x8002359A 0x8002699A 0x80029D9A 0x8002D19A 0x8003059A 0x8003399A 0x80036D9A /end VAR_ADDRESS
 /end VAR_CHARACTERISTIC
 /begin VAR_CHARACTERISTIC TQYc_Map[10][8] BrkCalVariantCriterion
  /begin VAR_ADDRESS 0x8002019C 0x8002359C 0x8002699C 0x80029D9C 0x8002D19C 0x8003059C 0x8003399C 0x80036D9C /end VAR_ADDRESS
 /end VAR_CHARACTERISTIC
 /begin VAR_CHARACTERISTIC TQYc_Map[10][9] BrkCalVariantCriterion
  /begin VAR_ADDRESS 0x8002019E 0x8002359E 0x8002699E 0x80029D9E 0x8002D19E 0x8003059E 0x8003399E 0x80036D9E /end VAR_ADDRESS
 /end VAR_CHARACTERISTIC
 /begin VAR_CHARACTERISTIC TQYc_Map[11][0] BrkCalVariantCriterion
  /begin VAR_ADDRESS 0x800201A4 0x800235A4 0x800269A4 0x80029DA4 0x8002D1A4 0x800305A4 0x800339A4 0x80036DA4 /end VAR_ADDRESS
 /end VAR_CHARACTERISTIC
 /begin VAR_CHARACTERISTIC TQYc_Map[11][10] BrkCalVariantCriterion
  /begin VAR_ADDRESS 0x800201B8 0x800235B8 0x800269B8 0x80029DB8 0x8002D1B8 0x800305B8 0x800339B8 0x80036DB8 /end VAR_ADDRESS
 /end VAR_CHARACTERISTIC
 /begin VAR_CHARACTERISTIC TQYc_Map[11][11] BrkCalVariantCriterion
  /begin VAR_ADDRESS 0x800201BA 0x800235BA 0x800269BA 0x80029DBA 0x8002D1BA 0x800305BA 0x800339BA 0x80036DBA /end VAR_ADDRESS
 /end VAR_CHARACTERISTIC
 /begin VAR_CHARACTERISTIC TQYc_Map[11][1] BrkCalVariantCriterion
  /begin VAR_ADDRESS 0x800201A6 0x800235A6 0x800269A6 0x80029DA6 0x8002D1A6 0x800305A6 0x800339A6 0x80036DA6 /end VAR_ADDRESS
 /end VAR_CHARACTERISTIC
 /begin VAR_CHARACTERISTIC TQYc_Map[11][2] BrkCalVariantCriterion
  /begin VAR_ADDRESS 0x800201A8 0x800235A8 0x800269A8 0x80029DA8 0x8002D1A8 0x800305A8 0x800339A8 0x80036DA8 /end VAR_ADDRESS
 /end VAR_CHARACTERISTIC
 /begin VAR_CHARACTERISTIC TQYc_Map[11][3] BrkCalVariantCriterion
  /begin VAR_ADDRESS 0x800201AA 0x800235AA 0x800269AA 0x80029DAA 0x8002D1AA 0x800305AA 0x800339AA 0x80036DAA /end VAR_ADDRESS
 /end VAR_CHARACTERISTIC
 /begin VAR_CHARACTERISTIC TQYc_Map[11][4] BrkCalVariantCriterion
  /begin VAR_ADDRESS 0x800201AC 0x800235AC 0x800269AC 0x80029DAC 0x8002D1AC 0x800305AC 0x800339AC 0x80036DAC /end VAR_ADDRESS
 /end VAR_CHARACTERISTIC
 /begin VAR_CHARACTERISTIC TQYc_Map[11][5] BrkCalVariantCriterion
  /begin VAR_ADDRESS 0x800201AE 0x800235AE 0x800269AE 0x80029DAE 0x8002D1AE 0x800305AE 0x800339AE 0x80036DAE /end VAR_ADDRESS
 /end VAR_CHARACTERISTIC
 /begin VAR_CHARACTERISTIC TQYc_Map[11][6] BrkCalVariantCriterion
  /begin VAR_ADDRESS 0x800201B0 0x800235B0 0x800269B0 0x80029DB0 0x8002D1B0 0x800305B0 0x800339B0 0x80036DB0 /end VAR_ADDRESS
 /end VAR_CHARACTERISTIC
 /begin VAR_CHARACTERISTIC TQYc_Map[11][7] BrkCalVariantCriterion
  /begin VAR_ADDRESS 0x800201B2 0x800235B2 0x800269B2 0x80029DB2 0x8002D1B2 0x800305B2 0x800339B2 0x80036DB2 /end VAR_ADDRESS
 /end VAR_CHARACTERISTIC
 /begin VAR_CHARACTERISTIC TQYc_Map[11][8] BrkCalVariantCriterion
  /begin VAR_ADDRESS 0x800201B4 0x800235B4 0x800269B4 0x80029DB4 0x8002D1B4 0x800305B4 0x800339B4 0x80036DB4 /end VAR_ADDRESS
 /end VAR_CHARACTERISTIC
 /begin VAR_CHARACTERISTIC TQYc_Map[11][9] BrkCalVariantCriterion
  /begin VAR_ADDRESS 0x800201B6 0x800235B6 0x800269B6 0x80029DB6 0x8002D1B6 0x800305B6 0x800339B6 0x80036DB6 /end VAR_ADDRESS
 /end VAR_CHARACTERISTIC
 /begin VAR_CHARACTERISTIC TQYc_Map[12][0] BrkCalVariantCriterion
  /begin VAR_ADDRESS 0x800201BC 0x800235BC 0x800269BC 0x80029DBC 0x8002D1BC 0x800305BC 0x800339BC 0x80036DBC /end VAR_ADDRESS
 /end VAR_CHARACTERISTIC
 /begin VAR_CHARACTERISTIC TQYc_Map[12][10] BrkCalVariantCriterion
  /begin VAR_ADDRESS 0x800201D0 0x800235D0 0x800269D0 0x80029DD0 0x8002D1D0 0x800305D0 0x800339D0 0x80036DD0 /end VAR_ADDRESS
 /end VAR_CHARACTERISTIC
 /begin VAR_CHARACTERISTIC TQYc_Map[12][11] BrkCalVariantCriterion
  /begin VAR_ADDRESS 0x800201D2 0x800235D2 0x800269D2 0x80029DD2 0x8002D1D2 0x800305D2 0x800339D2 0x80036DD2 /end VAR_ADDRESS
 /end VAR_CHARACTERISTIC
 /begin VAR_CHARACTERISTIC TQYc_Map[12][1] BrkCalVariantCriterion
  /begin VAR_ADDRESS 0x800201BE 0x800235BE 0x800269BE 0x80029DBE 0x8002D1BE 0x800305BE 0x800339BE 0x80036DBE /end VAR_ADDRESS
 /end VAR_CHARACTERISTIC
 /begin VAR_CHARACTERISTIC TQYc_Map[12][2] BrkCalVariantCriterion
  /begin VAR_ADDRESS 0x800201C0 0x800235C0 0x800269C0 0x80029DC0 0x8002D1C0 0x800305C0 0x800339C0 0x80036DC0 /end VAR_ADDRESS
 /end VAR_CHARACTERISTIC
 /begin VAR_CHARACTERISTIC TQYc_Map[12][3] BrkCalVariantCriterion
  /begin VAR_ADDRESS 0x800201C2 0x800235C2 0x800269C2 0x80029DC2 0x8002D1C2 0x800305C2 0x800339C2 0x80036DC2 /end VAR_ADDRESS
 /end VAR_CHARACTERISTIC
 /begin VAR_CHARACTERISTIC TQYc_Map[12][4] BrkCalVariantCriterion
  /begin VAR_ADDRESS 0x800201C4 0x800235C4 0x800269C4 0x80029DC4 0x8002D1C4 0x800305C4 0x800339C4 0x80036DC4 /end VAR_ADDRESS
 /end VAR_CHARACTERISTIC
 /begin VAR_CHARACTERISTIC TQYc_Map[12][5] BrkCalVariantCriterion
  /begin VAR_ADDRESS 0x800201C6 0x800235C6 0x800269C6 0x80029DC6 0x8002D1C6 0x800305C6 0x800339C6 0x80036DC6 /end VAR_ADDRESS
 /end VAR_CHARACTERISTIC
 /begin VAR_CHARACTERISTIC TQYc_Map[12][6] BrkCalVariantCriterion
  /begin VAR_ADDRESS 0x800201C8 0x800235C8 0x800269C8 0x80029DC8 0x8002D1C8 0x800305C8 0x800339C8 0x80036DC8 /end VAR_ADDRESS
 /end VAR_CHARACTERISTIC
 /begin VAR_CHARACTERISTIC TQYc_Map[12][7] BrkCalVariantCriterion
  /begin VAR_ADDRESS 0x800201CA 0x800235CA 0x800269CA 0x80029DCA 0x8002D1CA 0x800305CA 0x800339CA 0x80036DCA /end VAR_ADDRESS
 /end VAR_CHARACTERISTIC
 /begin VAR_CHARACTERISTIC TQYc_Map[12][8] BrkCalVariantCriterion
  /begin VAR_ADDRESS 0x800201CC 0x800235CC 0x800269CC 0x80029DCC 0x8002D1CC 0x800305CC 0x800339CC 0x80036DCC /end VAR_ADDRESS
 /end VAR_CHARACTERISTIC
 /begin VAR_CHARACTERISTIC TQYc_Map[12][9] BrkCalVariantCriterion
  /begin VAR_ADDRESS 0x800201CE 0x800235CE 0x800269CE 0x80029DCE 0x8002D1CE 0x800305CE 0x800339CE 0x80036DCE /end VAR_ADDRESS
 /end VAR_CHARACTERISTIC
 /begin VAR_CHARACTERISTIC TQYc_Map[13][0] BrkCalVariantCriterion
  /begin VAR_ADDRESS 0x800201D4 0x800235D4 0x800269D4 0x80029DD4 0x8002D1D4 0x800305D4 0x800339D4 0x80036DD4 /end VAR_ADDRESS
 /end VAR_CHARACTERISTIC
 /begin VAR_CHARACTERISTIC TQYc_Map[13][10] BrkCalVariantCriterion
  /begin VAR_ADDRESS 0x800201E8 0x800235E8 0x800269E8 0x80029DE8 0x8002D1E8 0x800305E8 0x800339E8 0x80036DE8 /end VAR_ADDRESS
 /end VAR_CHARACTERISTIC
 /begin VAR_CHARACTERISTIC TQYc_Map[13][11] BrkCalVariantCriterion
  /begin VAR_ADDRESS 0x800201EA 0x800235EA 0x800269EA 0x80029DEA 0x8002D1EA 0x800305EA 0x800339EA 0x80036DEA /end VAR_ADDRESS
 /end VAR_CHARACTERISTIC
 /begin VAR_CHARACTERISTIC TQYc_Map[13][1] BrkCalVariantCriterion
  /begin VAR_ADDRESS 0x800201D6 0x800235D6 0x800269D6 0x80029DD6 0x8002D1D6 0x800305D6 0x800339D6 0x80036DD6 /end VAR_ADDRESS
 /end VAR_CHARACTERISTIC
 /begin VAR_CHARACTERISTIC TQYc_Map[13][2] BrkCalVariantCriterion
  /begin VAR_ADDRESS 0x800201D8 0x800235D8 0x800269D8 0x80029DD8 0x8002D1D8 0x800305D8 0x800339D8 0x80036DD8 /end VAR_ADDRESS
 /end VAR_CHARACTERISTIC
 /begin VAR_CHARACTERISTIC TQYc_Map[13][3] BrkCalVariantCriterion
  /begin VAR_ADDRESS 0x800201DA 0x800235DA 0x800269DA 0x80029DDA 0x8002D1DA 0x800305DA 0x800339DA 0x80036DDA /end VAR_ADDRESS
 /end VAR_CHARACTERISTIC
 /begin VAR_CHARACTERISTIC TQYc_Map[13][4] BrkCalVariantCriterion
  /begin VAR_ADDRESS 0x800201DC 0x800235DC 0x800269DC 0x80029DDC 0x8002D1DC 0x800305DC 0x800339DC 0x80036DDC /end VAR_ADDRESS
 /end VAR_CHARACTERISTIC
 /begin VAR_CHARACTERISTIC TQYc_Map[13][5] BrkCalVariantCriterion
  /begin VAR_ADDRESS 0x800201DE 0x800235DE 0x800269DE 0x80029DDE 0x8002D1DE 0x800305DE 0x800339DE 0x80036DDE /end VAR_ADDRESS
 /end VAR_CHARACTERISTIC
 /begin VAR_CHARACTERISTIC TQYc_Map[13][6] BrkCalVariantCriterion
  /begin VAR_ADDRESS 0x800201E0 0x800235E0 0x800269E0 0x80029DE0 0x8002D1E0 0x800305E0 0x800339E0 0x80036DE0 /end VAR_ADDRESS
 /end VAR_CHARACTERISTIC
 /begin VAR_CHARACTERISTIC TQYc_Map[13][7] BrkCalVariantCriterion
  /begin VAR_ADDRESS 0x800201E2 0x800235E2 0x800269E2 0x80029DE2 0x8002D1E2 0x800305E2 0x800339E2 0x80036DE2 /end VAR_ADDRESS
 /end VAR_CHARACTERISTIC
 /begin VAR_CHARACTERISTIC TQYc_Map[13][8] BrkCalVariantCriterion
  /begin VAR_ADDRESS 0x800201E4 0x800235E4 0x800269E4 0x80029DE4 0x8002D1E4 0x800305E4 0x800339E4 0x80036DE4 /end VAR_ADDRESS
 /end VAR_CHARACTERISTIC
 /begin VAR_CHARACTERISTIC TQYc_Map[13][9] BrkCalVariantCriterion
  /begin VAR_ADDRESS 0x800201E6 0x800235E6 0x800269E6 0x80029DE6 0x8002D1E6 0x800305E6 0x800339E6 0x80036DE6 /end VAR_ADDRESS
 /end VAR_CHARACTERISTIC
 /begin VAR_CHARACTERISTIC TQYc_Map[14][0] BrkCalVariantCriterion
  /begin VAR_ADDRESS 0x800201EC 0x800235EC 0x800269EC 0x80029DEC 0x8002D1EC 0x800305EC 0x800339EC 0x80036DEC /end VAR_ADDRESS
 /end VAR_CHARACTERISTIC
 /begin VAR_CHARACTERISTIC TQYc_Map[14][10] BrkCalVariantCriterion
  /begin VAR_ADDRESS 0x80020200 0x80023600 0x80026A00 0x80029E00 0x8002D200 0x80030600 0x80033A00 0x80036E00 /end VAR_ADDRESS
 /end VAR_CHARACTERISTIC
 /begin VAR_CHARACTERISTIC TQYc_Map[14][11] BrkCalVariantCriterion
  /begin VAR_ADDRESS 0x80020202 0x80023602 0x80026A02 0x80029E02 0x8002D202 0x80030602 0x80033A02 0x80036E02 /end VAR_ADDRESS
 /end VAR_CHARACTERISTIC
 /begin VAR_CHARACTERISTIC TQYc_Map[14][1] BrkCalVariantCriterion
  /begin VAR_ADDRESS 0x800201EE 0x800235EE 0x800269EE 0x80029DEE 0x8002D1EE 0x800305EE 0x800339EE 0x80036DEE /end VAR_ADDRESS
 /end VAR_CHARACTERISTIC
 /begin VAR_CHARACTERISTIC TQYc_Map[14][2] BrkCalVariantCriterion
  /begin VAR_ADDRESS 0x800201F0 0x800235F0 0x800269F0 0x80029DF0 0x8002D1F0 0x800305F0 0x800339F0 0x80036DF0 /end VAR_ADDRESS
 /end VAR_CHARACTERISTIC
 /begin VAR_CHARACTERISTIC TQYc_Map[14][3] BrkCalVariantCriterion
  /begin VAR_ADDRESS 0x800201F2 0x800235F2 0x800269F2 0x80029DF2 0x8002D1F2 0x800305F2 0x800339F2 0x80036DF2 /end VAR_ADDRESS
 /end VAR_CHARACTERISTIC
 /begin VAR_CHARACTERISTIC TQYc_Map[14][4] BrkCalVariantCriterion
  /begin VAR_ADDRESS 0x800201F4 0x800235F4 0x800269F4 0x80029DF4 0x8002D1F4 0x800305F4 0x800339F4 0x80036DF4 /end VAR_ADDRESS
 /end VAR_CHARACTERISTIC
 /begin VAR_CHARACTERISTIC TQYc_Map[14][5] BrkCalVariantCriterion
  /begin VAR_ADDRESS 0x800201F6 0x800235F6 0x800269F6 0x80029DF6 0x8002D1F6 0x800305F6 0x800339F6 0x80036DF6 /end VAR_ADDRESS
 /end VAR_CHARACTERISTIC
 /begin VAR_CHARACTERISTIC TQYc_Map[14][6] BrkCalVariantCriterion
  /begin VAR_ADDRESS 0x800201F8 0x800235F8 0x800269F8 0x80029DF8 0x8002D1F8 0x800305F8 0x800339F8 0x80036DF8 /end VAR_ADDRESS
 /end VAR_CHARACTERISTIC
 /begin VAR_CHARACTERISTIC TQYc_Map[14][7] BrkCalVariantCriterion
  /begin VAR_ADDRESS 0x800201FA 0x800235FA 0x800269FA 0x80029DFA 0x8002D1FA 0x800305FA 0x800339FA 0x80036DFA /end VAR_ADDRESS
 /end VAR_CHARACTERISTIC
 /begin VAR_CHARACTERISTIC TQYc_Map[14][8] BrkCalVariantCriterion
  /begin VAR_ADDRESS 0x800201FC 0x800235FC 0x800269FC 0x80029DFC 0x8002D1FC 0x800305FC 0x800339FC 0x80036DFC /end VAR_ADDRESS
 /end VAR_CHARACTERISTIC
 /begin VAR_CHARACTERISTIC TQYc_Map[14][9] BrkCalVariantCriterion
  /begin VAR_ADDRESS 0x800201FE 0x800235FE 0x800269FE 0x80029DFE 0x8002D1FE 0x800305FE 0x800339FE 0x80036DFE /end VAR_ADDRESS
 /end VAR_CHARACTERISTIC
 /begin VAR_CHARACTERISTIC TQYc_Map[1][0] BrkCalVariantCriterion
  /begin VAR_ADDRESS 0x800200B4 0x800234B4 0x800268B4 0x80029CB4 0x8002D0B4 0x800304B4 0x800338B4 0x80036CB4 /end VAR_ADDRESS
 /end VAR_CHARACTERISTIC
 /begin VAR_CHARACTERISTIC TQYc_Map[1][10] BrkCalVariantCriterion
  /begin VAR_ADDRESS 0x800200C8 0x800234C8 0x800268C8 0x80029CC8 0x8002D0C8 0x800304C8 0x800338C8 0x80036CC8 /end VAR_ADDRESS
 /end VAR_CHARACTERISTIC
 /begin VAR_CHARACTERISTIC TQYc_Map[1][11] BrkCalVariantCriterion
  /begin VAR_ADDRESS 0x800200CA 0x800234CA 0x800268CA 0x80029CCA 0x8002D0CA 0x800304CA 0x800338CA 0x80036CCA /end VAR_ADDRESS
 /end VAR_CHARACTERISTIC
 /begin VAR_CHARACTERISTIC TQYc_Map[1][1] BrkCalVariantCriterion
  /begin VAR_ADDRESS 0x800200B6 0x800234B6 0x800268B6 0x80029CB6 0x8002D0B6 0x800304B6 0x800338B6 0x80036CB6 /end VAR_ADDRESS
 /end VAR_CHARACTERISTIC
 /begin VAR_CHARACTERISTIC TQYc_Map[1][2] BrkCalVariantCriterion
  /begin VAR_ADDRESS 0x800200B8 0x800234B8 0x800268B8 0x80029CB8 0x8002D0B8 0x800304B8 0x800338B8 0x80036CB8 /end VAR_ADDRESS
 /end VAR_CHARACTERISTIC
 /begin VAR_CHARACTERISTIC TQYc_Map[1][3] BrkCalVariantCriterion
  /begin VAR_ADDRESS 0x800200BA 0x800234BA 0x800268BA 0x80029CBA 0x8002D0BA 0x800304BA 0x800338BA 0x80036CBA /end VAR_ADDRESS
 /end VAR_CHARACTERISTIC
 /begin VAR_CHARACTERISTIC TQYc_Map[1][4] BrkCalVariantCriterion
  /begin VAR_ADDRESS 0x800200BC 0x800234BC 0x800268BC 0x80029CBC 0x8002D0BC 0x800304BC 0x800338BC 0x80036CBC /end VAR_ADDRESS
 /end VAR_CHARACTERISTIC
 /begin VAR_CHARACTERISTIC TQYc_Map[1][5] BrkCalVariantCriterion
  /begin VAR_ADDRESS 0x800200BE 0x800234BE 0x800268BE 0x80029CBE 0x8002D0BE 0x800304BE 0x800338BE 0x80036CBE /end VAR_ADDRESS
 /end VAR_CHARACTERISTIC
 /begin VAR_CHARACTERISTIC TQYc_Map[1][6] BrkCalVariantCriterion
  /begin VAR_ADDRESS 0x800200C0 0x800234C0 0x800268C0 0x80029CC0 0x8002D0C0 0x800304C0 0x800338C0 0x80036CC0 /end VAR_ADDRESS
 /end VAR_CHARACTERISTIC
 /begin VAR_CHARACTERISTIC TQYc_Map[1][7] BrkCalVariantCriterion
  /begin VAR_ADDRESS 0x800200C2 0x800234C2 0x800268C2 0x80029CC2 0x8002D0C2 0x800304C2 0x800338C2 0x80036CC2 /end VAR_ADDRESS
 /end VAR_CHARACTERISTIC
 /begin VAR_CHARACTERISTIC TQYc_Map[1][8] BrkCalVariantCriterion
  /begin VAR_ADDRESS 0x800200C4 0x800234C4 0x800268C4 0x80029CC4 0x8002D0C4 0x800304C4 0x800338C4 0x80036CC4 /end VAR_ADDRESS
 /end VAR_CHARACTERISTIC
 /begin VAR_CHARACTERISTIC TQYc_Map[1][9] BrkCalVariantCriterion
  /begin VAR_ADDRESS 0x800200C6 0x800234C6 0x800268C6 0x80029CC6 0x8002D0C6 0x800304C6 0x800338C6 0x80036CC6 /end VAR_ADDRESS
 /end VAR_CHARACTERISTIC
 /begin VAR_CHARACTERISTIC TQYc_Map[2][0] BrkCalVariantCriterion
  /begin VAR_ADDRESS 0x800200CC 0x800234CC 0x800268CC 0x80029CCC 0x8002D0CC 0x800304CC 0x800338CC 0x80036CCC /end VAR_ADDRESS
 /end VAR_CHARACTERISTIC
 /begin VAR_CHARACTERISTIC TQYc_Map[2][10] BrkCalVariantCriterion
  /begin VAR_ADDRESS 0x800200E0 0x800234E0 0x800268E0 0x80029CE0 0x8002D0E0 0x800304E0 0x800338E0 0x80036CE0 /end VAR_ADDRESS
 /end VAR_CHARACTERISTIC
 /begin VAR_CHARACTERISTIC TQYc_Map[2][11] BrkCalVariantCriterion
  /begin VAR_ADDRESS 0x800200E2 0x800234E2 0x800268E2 0x80029CE2 0x8002D0E2 0x800304E2 0x800338E2 0x80036CE2 /end VAR_ADDRESS
 /end VAR_CHARACTERISTIC
 /begin VAR_CHARACTERISTIC TQYc_Map[2][1] BrkCalVariantCriterion
  /begin VAR_ADDRESS 0x800200CE 0x800234CE 0x800268CE 0x80029CCE 0x8002D0CE 0x800304CE 0x800338CE 0x80036CCE /end VAR_ADDRESS
 /end VAR_CHARACTERISTIC
 /begin VAR_CHARACTERISTIC TQYc_Map[2][2] BrkCalVariantCriterion
  /begin VAR_ADDRESS 0x800200D0 0x800234D0 0x800268D0 0x80029CD0 0x8002D0D0 0x800304D0 0x800338D0 0x80036CD0 /end VAR_ADDRESS
 /end VAR_CHARACTERISTIC
 /begin VAR_CHARACTERISTIC TQYc_Map[2][3] BrkCalVariantCriterion
  /begin VAR_ADDRESS 0x800200D2 0x800234D2 0x800268D2 0x80029CD2 0x8002D0D2 0x800304D2 0x800338D2 0x80036CD2 /end VAR_ADDRESS
 /end VAR_CHARACTERISTIC
 /begin VAR_CHARACTERISTIC TQYc_Map[2][4] BrkCalVariantCriterion
  /begin VAR_ADDRESS 0x800200D4 0x800234D4 0x800268D4 0x80029CD4 0x8002D0D4 0x800304D4 0x800338D4 0x80036CD4 /end VAR_ADDRESS
 /end VAR_CHARACTERISTIC
 /begin VAR_CHARACTERISTIC TQYc_Map[2][5] BrkCalVariantCriterion
  /begin VAR_ADDRESS 0x800200D6 0x800234D6 0x800268D6 0x80029CD6 0x8002D0D6 0x800304D6 0x800338D6 0x80036CD6 /end VAR_ADDRESS
 /end VAR_CHARACTERISTIC
 /begin VAR_CHARACTERISTIC TQYc_Map[2][6] BrkCalVariantCriterion
  /begin VAR_ADDRESS 0x800200D8 0x800234D8 0x800268D8 0x80029CD8 0x8002D0D8 0x800304D8 0x800338D8 0x80036CD8 /end VAR_ADDRESS
 /end VAR_CHARACTERISTIC
 /begin VAR_CHARACTERISTIC TQYc_Map[2][7] BrkCalVariantCriterion
  /begin VAR_ADDRESS 0x800200DA 0x800234DA 0x800268DA 0x80029CDA 0x8002D0DA 0x800304DA 0x800338DA 0x80036CDA /end VAR_ADDRESS
 /end VAR_CHARACTERISTIC
 /begin VAR_CHARACTERISTIC TQYc_Map[2][8] BrkCalVariantCriterion
  /begin VAR_ADDRESS 0x800200DC 0x800234DC 0x800268DC 0x80029CDC 0x8002D0DC 0x800304DC 0x800338DC 0x80036CDC /end VAR_ADDRESS
 /end VAR_CHARACTERISTIC
 /begin VAR_CHARACTERISTIC TQYc_Map[2][9] BrkCalVariantCriterion
  /begin VAR_ADDRESS 0x800200DE 0x800234DE 0x800268DE 0x80029CDE 0x8002D0DE 0x800304DE 0x800338DE 0x80036CDE /end VAR_ADDRESS
 /end VAR_CHARACTERISTIC
 /begin VAR_CHARACTERISTIC TQYc_Map[3][0] BrkCalVariantCriterion
  /begin VAR_ADDRESS 0x800200E4 0x800234E4 0x800268E4 0x80029CE4 0x8002D0E4 0x800304E4 0x800338E4 0x80036CE4 /end VAR_ADDRESS
 /end VAR_CHARACTERISTIC
 /begin VAR_CHARACTERISTIC TQYc_Map[3][10] BrkCalVariantCriterion
  /begin VAR_ADDRESS 0x800200F8 0x800234F8 0x800268F8 0x80029CF8 0x8002D0F8 0x800304F8 0x800338F8 0x80036CF8 /end VAR_ADDRESS
 /end VAR_CHARACTERISTIC
 /begin VAR_CHARACTERISTIC TQYc_Map[3][11] BrkCalVariantCriterion
  /begin VAR_ADDRESS 0x800200FA 0x800234FA 0x800268FA 0x80029CFA 0x8002D0FA 0x800304FA 0x800338FA 0x80036CFA /end VAR_ADDRESS
 /end VAR_CHARACTERISTIC
 /begin VAR_CHARACTERISTIC TQYc_Map[3][1] BrkCalVariantCriterion
  /begin VAR_ADDRESS 0x800200E6 0x800234E6 0x800268E6 0x80029CE6 0x8002D0E6 0x800304E6 0x800338E6 0x80036CE6 /end VAR_ADDRESS
 /end VAR_CHARACTERISTIC
 /begin VAR_CHARACTERISTIC TQYc_Map[3][2] BrkCalVariantCriterion
  /begin VAR_ADDRESS 0x800200E8 0x800234E8 0x800268E8 0x80029CE8 0x8002D0E8 0x800304E8 0x800338E8 0x80036CE8 /end VAR_ADDRESS
 /end VAR_CHARACTERISTIC
 /begin VAR_CHARACTERISTIC TQYc_Map[3][3] BrkCalVariantCriterion
  /begin VAR_ADDRESS 0x800200EA 0x800234EA 0x800268EA 0x80029CEA 0x8002D0EA 0x800304EA 0x800338EA 0x80036CEA /end VAR_ADDRESS
 /end VAR_CHARACTERISTIC
 /begin VAR_CHARACTERISTIC TQYc_Map[3][4] BrkCalVariantCriterion
  /begin VAR_ADDRESS 0x800200EC 0x800234EC 0x800268EC 0x80029CEC 0x8002D0EC 0x800304EC 0x800338EC 0x80036CEC /end VAR_ADDRESS
 /end VAR_CHARACTERISTIC
 /begin VAR_CHARACTERISTIC TQYc_Map[3][5] BrkCalVariantCriterion
  /begin VAR_ADDRESS 0x800200EE 0x800234EE 0x800268EE 0x80029CEE 0x8002D0EE 0x800304EE 0x800338EE 0x80036CEE /end VAR_ADDRESS
 /end VAR_CHARACTERISTIC
 /begin VAR_CHARACTERISTIC TQYc_Map[3][6] BrkCalVariantCriterion
  /begin VAR_ADDRESS 0x800200F0 0x800234F0 0x800268F0 0x80029CF0 0x8002D0F0 0x800304F0 0x800338F0 0x80036CF0 /end VAR_ADDRESS
 /end VAR_CHARACTERISTIC
 /begin VAR_CHARACTERISTIC TQYc_Map[3][7] BrkCalVariantCriterion
  /begin VAR_ADDRESS 0x800200F2 0x800234F2 0x800268F2 0x80029CF2 0x8002D0F2 0x800304F2 0x800338F2 0x80036CF2 /end VAR_ADDRESS
 /end VAR_CHARACTERISTIC
 /begin VAR_CHARACTERISTIC TQYc_Map[3][8] BrkCalVariantCriterion
  /begin VAR_ADDRESS 0x800200F4 0x800234F4 0x800268F4 0x80029CF4 0x8002D0F4 0x800304F4 0x800338F4 0x80036CF4 /end VAR_ADDRESS
 /end VAR_CHARACTERISTIC
 /begin VAR_CHARACTERISTIC TQYc_Map[3][9] BrkCalVariantCriterion
  /begin VAR_ADDRESS 0x800200F6 0x800234F6 0x800268F6 0x80029CF6 0x8002D0F6 0x800304F6 0x800338F6 0x80036CF6 /end VAR_ADDRESS
 /end VAR_CHARACTERISTIC
 /begin VAR_CHARACTERISTIC TQYc_Map[4][0] BrkCalVariantCriterion
  /begin VAR_ADDRESS 0x800200FC 0x800234FC 0x800268FC 0x80029CFC 0x8002D0FC 0x800304FC 0x800338FC 0x80036CFC /end VAR_ADDRESS
 /end VAR_CHARACTERISTIC
 /begin VAR_CHARACTERISTIC TQYc_Map[4][10] BrkCalVariantCriterion
  /begin VAR_ADDRESS 0x80020110 0x80023510 0x80026910 0x80029D10 0x8002D110 0x80030510 0x80033910 0x80036D10 /end VAR_ADDRESS
 /end VAR_CHARACTERISTIC
 /begin VAR_CHARACTERISTIC TQYc_Map[4][11] BrkCalVariantCriterion
  /begin VAR_ADDRESS 0x80020112 0x80023512 0x80026912 0x80029D12 0x8002D112 0x80030512 0x80033912 0x80036D12 /end VAR_ADDRESS
 /end VAR_CHARACTERISTIC
 /begin VAR_CHARACTERISTIC TQYc_Map[4][1] BrkCalVariantCriterion
  /begin VAR_ADDRESS 0x800200FE 0x800234FE 0x800268FE 0x80029CFE 0x8002D0FE 0x800304FE 0x800338FE 0x80036CFE /end VAR_ADDRESS
 /end VAR_CHARACTERISTIC
 /begin VAR_CHARACTERISTIC TQYc_Map[4][2] BrkCalVariantCriterion
  /begin VAR_ADDRESS 0x80020100 0x80023500 0x80026900 0x80029D00 0x8002D100 0x80030500 0x80033900 0x80036D00 /end VAR_ADDRESS
 /end VAR_CHARACTERISTIC
 /begin VAR_CHARACTERISTIC TQYc_Map[4][3] BrkCalVariantCriterion
  /begin VAR_ADDRESS 0x80020102 0x80023502 0x80026902 0x80029D02 0x8002D102 0x80030502 0x80033902 0x80036D02 /end VAR_ADDRESS
 /end VAR_CHARACTERISTIC
 /begin VAR_CHARACTERISTIC TQYc_Map[4][4] BrkCalVariantCriterion
  /begin VAR_ADDRESS 0x80020104 0x80023504 0x80026904 0x80029D04 0x8002D104 0x80030504 0x80033904 0x80036D04 /end VAR_ADDRESS
 /end VAR_CHARACTERISTIC
 /begin VAR_CHARACTERISTIC TQYc_Map[4][5] BrkCalVariantCriterion
  /begin VAR_ADDRESS 0x80020106 0x80023506 0x80026906 0x80029D06 0x8002D106 0x80030506 0x80033906 0x80036D06 /end VAR_ADDRESS
 /end VAR_CHARACTERISTIC
 /begin VAR_CHARACTERISTIC TQYc_Map[4][6] BrkCalVariantCriterion
  /begin VAR_ADDRESS 0x80020108 0x80023508 0x80026908 0x80029D08 0x8002D108 0x80030508 0x80033908 0x80036D08 /end VAR_ADDRESS
 /end VAR_CHARACTERISTIC
 /begin VAR_CHARACTERISTIC TQYc_Map[4][7] BrkCalVariantCriterion
  /begin VAR_ADDRESS 0x8002010A 0x8002350A 0x8002690A 0x80029D0A 0x8002D10A 0x8003050A 0x8003390A 0x80036D0A /end VAR_ADDRESS
 /end VAR_CHARACTERISTIC
 /begin VAR_CHARACTERISTIC TQYc_Map[4][8] BrkCalVariantCriterion
  /begin VAR_ADDRESS 0x8002010C 0x8002350C 0x8002690C 0x80029D0C 0x8002D10C 0x8003050C 0x8003390C 0x80036D0C /end VAR_ADDRESS
 /end VAR_CHARACTERISTIC
 /begin VAR_CHARACTERISTIC TQYc_Map[4][9] BrkCalVariantCriterion
  /begin VAR_ADDRESS 0x8002010E 0x8002350E 0x8002690E 0x80029D0E 0x8002D10E 0x8003050E 0x8003390E 0x80036D0E /end VAR_ADDRESS
 /end VAR_CHARACTERISTIC
 /begin VAR_CHARACTERISTIC TQYc_Map[5][0] BrkCalVariantCriterion
  /begin VAR_ADDRESS 0x80020114 0x80023514 0x80026914 0x80029D14 0x8002D114 0x80030514 0x80033914 0x80036D14 /end VAR_ADDRESS
 /end VAR_CHARACTERISTIC
 /begin VAR_CHARACTERISTIC TQYc_Map[5][10] BrkCalVariantCriterion
  /begin VAR_ADDRESS 0x80020128 0x80023528 0x80026928 0x80029D28 0x8002D128 0x80030528 0x80033928 0x80036D28 /end VAR_ADDRESS
 /end VAR_CHARACTERISTIC
 /begin VAR_CHARACTERISTIC TQYc_Map[5][11] BrkCalVariantCriterion
  /begin VAR_ADDRESS 0x8002012A 0x8002352A 0x8002692A 0x80029D2A 0x8002D12A 0x8003052A 0x8003392A 0x80036D2A /end VAR_ADDRESS
 /end VAR_CHARACTERISTIC
 /begin VAR_CHARACTERISTIC TQYc_Map[5][1] BrkCalVariantCriterion
  /begin VAR_ADDRESS 0x80020116 0x80023516 0x80026916 0x80029D16 0x8002D116 0x80030516 0x80033916 0x80036D16 /end VAR_ADDRESS
 /end VAR_CHARACTERISTIC
 /begin VAR_CHARACTERISTIC TQYc_Map[5][2] BrkCalVariantCriterion
  /begin VAR_ADDRESS 0x80020118 0x80023518 0x80026918 0x80029D18 0x8002D118 0x80030518 0x80033918 0x80036D18 /end VAR_ADDRESS
 /end VAR_CHARACTERISTIC
 /begin VAR_CHARACTERISTIC TQYc_Map[5][3] BrkCalVariantCriterion
  /begin VAR_ADDRESS 0x8002011A 0x8002351A 0x8002691A 0x80029D1A 0x8002D11A 0x8003051A 0x8003391A 0x80036D1A /end VAR_ADDRESS
 /end VAR_CHARACTERISTIC
 /begin VAR_CHARACTERISTIC TQYc_Map[5][4] BrkCalVariantCriterion
  /begin VAR_ADDRESS 0x8002011C 0x8002351C 0x8002691C 0x80029D1C 0x8002D11C 0x8003051C 0x8003391C 0x80036D1C /end VAR_ADDRESS
 /end VAR_CHARACTERISTIC
 /begin VAR_CHARACTERISTIC TQYc_Map[5][5] BrkCalVariantCriterion
  /begin VAR_ADDRESS 0x8002011E 0x8002351E 0x8002691E 0x80029D1E 0x8002D11E 0x8003051E 0x8003391E 0x80036D1E /end VAR_ADDRESS
 /end VAR_CHARACTERISTIC
 /begin VAR_CHARACTERISTIC TQYc_Map[5][6] BrkCalVariantCriterion
  /begin VAR_ADDRESS 0x80020120 0x80023520 0x80026920 0x80029D20 0x8002D120 0x80030520 0x80033920 0x80036D20 /end VAR_ADDRESS
 /end VAR_CHARACTERISTIC
 /begin VAR_CHARACTERISTIC TQYc_Map[5][7] BrkCalVariantCriterion
  /begin VAR_ADDRESS 0x80020122 0x80023522 0x80026922 0x80029D22 0x8002D122 0x80030522 0x80033922 0x80036D22 /end VAR_ADDRESS
 /end VAR_CHARACTERISTIC
 /begin VAR_CHARACTERISTIC TQYc_Map[5][8] BrkCalVariantCriterion
  /begin VAR_ADDRESS 0x80020124 0x80023524 0x80026924 0x80029D24 0x8002D124 0x80030524 0x80033924 0x80036D24 /end VAR_ADDRESS
 /end VAR_CHARACTERISTIC
 /begin VAR_CHARACTERISTIC TQYc_Map[5][9] BrkCalVariantCriterion
  /begin VAR_ADDRESS 0x80020126 0x80023526 0x80026926 0x80029D26 0x8002D126 0x80030526 0x80033926 0x80036D26 /end VAR_ADDRESS
 /end VAR_CHARACTERISTIC
 /begin VAR_CHARACTERISTIC TQYc_Map[6][0] BrkCalVariantCriterion
  /begin VAR_ADDRESS 0x8002012C 0x8002352C 0x8002692C 0x80029D2C 0x8002D12C 0x8003052C 0x8003392C 0x80036D2C /end VAR_ADDRESS
 /end VAR_CHARACTERISTIC
 /begin VAR_CHARACTERISTIC TQYc_Map[6][10] BrkCalVariantCriterion
  /begin VAR_ADDRESS 0x80020140 0x80023540 0x80026940 0x80029D40 0x8002D140 0x80030540 0x80033940 0x80036D40 /end VAR_ADDRESS
 /end VAR_CHARACTERISTIC
 /begin VAR_CHARACTERISTIC TQYc_Map[6][11] BrkCalVariantCriterion
  /begin VAR_ADDRESS 0x80020142 0x80023542 0x80026942 0x80029D42 0x8002D142 0x80030542 0x80033942 0x80036D42 /end VAR_ADDRESS
 /end VAR_CHARACTERISTIC
 /begin VAR_CHARACTERISTIC TQYc_Map[6][1] BrkCalVariantCriterion
  /begin VAR_ADDRESS 0x8002012E 0x8002352E 0x8002692E 0x80029D2E 0x8002D12E 0x8003052E 0x8003392E 0x80036D2E /end VAR_ADDRESS
 /end VAR_CHARACTERISTIC
 /begin VAR_CHARACTERISTIC TQYc_Map[6][2] BrkCalVariantCriterion
  /begin VAR_ADDRESS 0x80020130 0x80023530 0x80026930 0x80029D30 0x8002D130 0x80030530 0x80033930 0x80036D30 /end VAR_ADDRESS
 /end VAR_CHARACTERISTIC
 /begin VAR_CHARACTERISTIC TQYc_Map[6][3] BrkCalVariantCriterion
  /begin VAR_ADDRESS 0x80020132 0x80023532 0x80026932 0x80029D32 0x8002D132 0x80030532 0x80033932 0x80036D32 /end VAR_ADDRESS
 /end VAR_CHARACTERISTIC
 /begin VAR_CHARACTERISTIC TQYc_Map[6][4] BrkCalVariantCriterion
  /begin VAR_ADDRESS 0x80020134 0x80023534 0x80026934 0x80029D34 0x8002D134 0x80030534 0x80033934 0x80036D34 /end VAR_ADDRESS
 /end VAR_CHARACTERISTIC
 /begin VAR_CHARACTERISTIC TQYc_Map[6][5] BrkCalVariantCriterion
  /begin VAR_ADDRESS 0x80020136 0x80023536 0x80026936 0x80029D36 0x8002D136 0x80030536 0x80033936 0x80036D36 /end VAR_ADDRESS
 /end VAR_CHARACTERISTIC
 /begin VAR_CHARACTERISTIC TQYc_Map[6][6] BrkCalVariantCriterion
  /begin VAR_ADDRESS 0x80020138 0x80023538 0x80026938 0x80029D38 0x8002D138 0x80030538 0x80033938 0x80036D38 /end VAR_ADDRESS
 /end VAR_CHARACTERISTIC
 /begin VAR_CHARACTERISTIC TQYc_Map[6][7] BrkCalVariantCriterion
  /begin VAR_ADDRESS 0x8002013A 0x8002353A 0x8002693A 0x80029D3A 0x8002D13A 0x8003053A 0x8003393A 0x80036D3A /end VAR_ADDRESS
 /end VAR_CHARACTERISTIC
 /begin VAR_CHARACTERISTIC TQYc_Map[6][8] BrkCalVariantCriterion
  /begin VAR_ADDRESS 0x8002013C 0x8002353C 0x8002693C 0x80029D3C 0x8002D13C 0x8003053C 0x8003393C 0x80036D3C /end VAR_ADDRESS
 /end VAR_CHARACTERISTIC
 /begin VAR_CHARACTERISTIC TQYc_Map[6][9] BrkCalVariantCriterion
  /begin VAR_ADDRESS 0x8002013E 0x8002353E 0x8002693E 0x80029D3E 0x8002D13E 0x8003053E 0x8003393E 0x80036D3E /end VAR_ADDRESS
 /end VAR_CHARACTERISTIC
 /begin VAR_CHARACTERISTIC TQYc_Map[7][0] BrkCalVariantCriterion
  /begin VAR_ADDRESS 0x80020144 0x80023544 0x80026944 0x80029D44 0x8002D144 0x80030544 0x80033944 0x80036D44 /end VAR_ADDRESS
 /end VAR_CHARACTERISTIC
 /begin VAR_CHARACTERISTIC TQYc_Map[7][10] BrkCalVariantCriterion
  /begin VAR_ADDRESS 0x80020158 0x80023558 0x80026958 0x80029D58 0x8002D158 0x80030558 0x80033958 0x80036D58 /end VAR_ADDRESS
 /end VAR_CHARACTERISTIC
/end VARIANT_CODING
/end MODULE
/end PROJECT
