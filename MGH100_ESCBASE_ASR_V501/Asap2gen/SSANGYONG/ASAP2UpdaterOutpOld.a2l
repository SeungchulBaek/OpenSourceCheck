/* generated by ASAP2 Updater - ASAP2 Tool-Set Version 11.0.10 */
ASAP2_VERSION 1 60
/begin PROJECT Master ""
/begin MODULE CPP ""
/begin MOD_PAR "" /end MOD_PAR
/begin MOD_COMMON "" BYTE_ORDER MSB_LAST ALIGNMENT_BYTE 1 ALIGNMENT_WORD 1 ALIGNMENT_LONG 1 ALIGNMENT_FLOAT32_IEEE 1 ALIGNMENT_FLOAT64_IEEE 1 ALIGNMENT_INT64 1 /end MOD_COMMON
/begin IF_DATA XCP
 /begin PROTOCOL_LAYER 0x0101 0x07D0 0x2710 0x00 0x00 0x00 0x00 0x00 0xFF 0xFA BYTE_ORDER_MSB_LAST ADDRESS_GRANULARITY_BYTE OPTIONAL_CMD ALLOC_ODT_ENTRY OPTIONAL_CMD ALLOC_ODT OPTIONAL_CMD ALLOC_DAQ OPTIONAL_CMD FREE_DAQ OPTIONAL_CMD GET_DAQ_EVENT_INFO OPTIONAL_CMD GET_DAQ_LIST_INFO OPTIONAL_CMD GET_DAQ_RESOLUTION_INFO OPTIONAL_CMD GET_DAQ_PROCESSOR_INFO OPTIONAL_CMD GET_DAQ_CLOCK OPTIONAL_CMD START_STOP_SYNCH OPTIONAL_CMD START_STOP_DAQ_LIST OPTIONAL_CMD GET_DAQ_LIST_MODE OPTIONAL_CMD SET_DAQ_LIST_MODE OPTIONAL_CMD WRITE_DAQ OPTIONAL_CMD SET_DAQ_PTR OPTIONAL_CMD CLEAR_DAQ_LIST OPTIONAL_CMD SHORT_DOWNLOAD OPTIONAL_CMD DOWNLOAD OPTIONAL_CMD SHORT_UPLOAD OPTIONAL_CMD UPLOAD OPTIONAL_CMD SET_MTA OPTIONAL_CMD GET_COMM_MODE_INFO /end PROTOCOL_LAYER
 /begin DAQ DYNAMIC 0x00 0x02 0x00 OPTIMISATION_TYPE_DEFAULT ADDRESS_EXTENSION_FREE IDENTIFICATION_FIELD_TYPE_RELATIVE_BYTE GRANULARITY_ODT_ENTRY_SIZE_DAQ_BYTE 0xF8 OVERLOAD_INDICATION_PID /begin STIM GRANULARITY_ODT_ENTRY_SIZE_STIM_BYTE 0xF8 /end STIM /begin TIMESTAMP_SUPPORTED 0x01 SIZE_DWORD UNIT_10NS /end TIMESTAMP_SUPPORTED
  /begin DAQ_LIST 0x00 DAQ_LIST_TYPE DAQ MAX_ODT 0x01 MAX_ODT_ENTRIES 0x96 FIRST_PID 0x00 EVENT_FIXED 0x00 /end DAQ_LIST
  /begin DAQ_LIST 0x01 DAQ_LIST_TYPE DAQ MAX_ODT 0x01 MAX_ODT_ENTRIES 0x96 FIRST_PID 0x00 EVENT_FIXED 0x01 /end DAQ_LIST
  /begin DAQ_LIST 0x02 DAQ_LIST_TYPE DAQ MAX_ODT 0x01 MAX_ODT_ENTRIES 0x96 EVENT_FIXED 0x02 /end DAQ_LIST
  /begin DAQ_LIST 0x03 DAQ_LIST_TYPE DAQ MAX_ODT 0x01 MAX_ODT_ENTRIES 0x96 EVENT_FIXED 0x03 /end DAQ_LIST
  /begin DAQ_LIST 0x04 DAQ_LIST_TYPE DAQ MAX_ODT 0x01 MAX_ODT_ENTRIES 0x96 EVENT_FIXED 0x04 /end DAQ_LIST
  /begin DAQ_LIST 0x05 DAQ_LIST_TYPE DAQ MAX_ODT 0x01 MAX_ODT_ENTRIES 0x96 EVENT_FIXED 0x05 /end DAQ_LIST
  /begin DAQ_LIST 0x06 DAQ_LIST_TYPE DAQ MAX_ODT 0x01 MAX_ODT_ENTRIES 0x96 EVENT_FIXED 0x06 /end DAQ_LIST
  /begin DAQ_LIST 0x07 DAQ_LIST_TYPE DAQ MAX_ODT 0x01 MAX_ODT_ENTRIES 0x96 EVENT_FIXED 0x07 /end DAQ_LIST
  /begin DAQ_LIST 0x08 DAQ_LIST_TYPE DAQ MAX_ODT 0x01 MAX_ODT_ENTRIES 0x96 EVENT_FIXED 0x08 /end DAQ_LIST
  /begin DAQ_LIST 0x09 DAQ_LIST_TYPE DAQ MAX_ODT 0x01 MAX_ODT_ENTRIES 0x96 EVENT_FIXED 0x09 /end DAQ_LIST
  /begin DAQ_LIST 0x0A DAQ_LIST_TYPE DAQ MAX_ODT 0x01 MAX_ODT_ENTRIES 0x64 EVENT_FIXED 0x10 /end DAQ_LIST
  /begin DAQ_LIST 0x0B DAQ_LIST_TYPE DAQ MAX_ODT 0x01 MAX_ODT_ENTRIES 0x64 EVENT_FIXED 0x11 /end DAQ_LIST
  /begin DAQ_LIST 0x0C DAQ_LIST_TYPE DAQ MAX_ODT 0x01 MAX_ODT_ENTRIES 0x64 EVENT_FIXED 0x12 /end DAQ_LIST
  /begin DAQ_LIST 0x0D DAQ_LIST_TYPE DAQ MAX_ODT 0x01 MAX_ODT_ENTRIES 0x64 EVENT_FIXED 0x13 /end DAQ_LIST
  /begin DAQ_LIST 0x0E DAQ_LIST_TYPE DAQ MAX_ODT 0x01 MAX_ODT_ENTRIES 0x64 EVENT_FIXED 0x14 /end DAQ_LIST
  /begin DAQ_LIST 0x0F DAQ_LIST_TYPE DAQ MAX_ODT 0x01 MAX_ODT_ENTRIES 0x64 EVENT_FIXED 0x15 /end DAQ_LIST
  /begin DAQ_LIST 0x10 DAQ_LIST_TYPE DAQ MAX_ODT 0x01 MAX_ODT_ENTRIES 0x64 EVENT_FIXED 0x16 /end DAQ_LIST
  /begin DAQ_LIST 0x11 DAQ_LIST_TYPE DAQ MAX_ODT 0x01 MAX_ODT_ENTRIES 0x64 EVENT_FIXED 0x17 /end DAQ_LIST
  /begin DAQ_LIST 0x12 DAQ_LIST_TYPE DAQ MAX_ODT 0x01 MAX_ODT_ENTRIES 0x64 EVENT_FIXED 0x18 /end DAQ_LIST
  /begin DAQ_LIST 0x13 DAQ_LIST_TYPE DAQ MAX_ODT 0x01 MAX_ODT_ENTRIES 0x64 EVENT_FIXED 0x19 /end DAQ_LIST
  /begin DAQ_LIST 0x14 DAQ_LIST_TYPE DAQ MAX_ODT 0x01 MAX_ODT_ENTRIES 0x96 EVENT_FIXED 0x1A /end DAQ_LIST
  /begin DAQ_LIST 0x15 DAQ_LIST_TYPE DAQ MAX_ODT 0x01 MAX_ODT_ENTRIES 0x96 EVENT_FIXED 0x1B /end DAQ_LIST
  /begin EVENT "1ms" "1ms" 0x00 DAQ 0xFF 0x01 0x06 0x00 /end EVENT
  /begin EVENT "5ms" "5ms" 0x01 DAQ 0xFF 0x05 0x06 0x00 /end EVENT
 /end DAQ
 /begin PAG 0x00 /end PAG
 /begin PGM PGM_MODE_ABSOLUTE 0x00 0x00 /end PGM
 /begin XCP_ON_TCP_IP 0x0100 0x15B3 ADDRESS "192.168.0.2" /end XCP_ON_TCP_IP
/end IF_DATA
/begin VARIANT_CODING
 /begin VAR_CRITERION BrkCalVariantCriterion "..." BrkCalVrntCtaDft01 BrkCalVrntCtaDft02 BrkCalVrntCtaDft03 BrkCalVrntCtaDft04 BrkCalVrntCtaDft05 BrkCalVrntCtaDft06 BrkCalVrntCtaDft07 BrkCalVrntCtaDft08 VAR_SELECTION_CHARACTERISTIC BrkCalVrntCtaDft /end VAR_CRITERION
 /begin VAR_CRITERION EngCalVariantCriterion "..." EngCalVrntCtaDft01 EngCalVrntCtaDft02 EngCalVrntCtaDft03 EngCalVrntCtaDft04 EngCalVrntCtaDft05 EngCalVrntCtaDft06 EngCalVrntCtaDft07 EngCalVrntCtaDft08 EngCalVrntCtaDft09 EngCalVrntCtaDft10 EngCalVrntCtaDft11 EngCalVrntCtaDft12 EngCalVrntCtaDft13 EngCalVrntCtaDft14 EngCalVrntCtaDft15 EngCalVrntCtaDft16 EngCalVrntCtaDft17 EngCalVrntCtaDft18 EngCalVrntCtaDft19 EngCalVrntCtaDft20 EngCalVrntCtaDft21 EngCalVrntCtaDft22 EngCalVrntCtaDft23 EngCalVrntCtaDft24 VAR_SELECTION_CHARACTERISTIC EngCalVrntCtaDft /end VAR_CRITERION
 /begin VAR_CHARACTERISTIC BAC_PBA_EXIT_CONTROL_TIME BrkCalVariantCriterion
  /begin VAR_ADDRESS 0x80020F60 0x80024360 0x80027760 0x8002AB60 0x8002DF60 0x80031360 0x80034760 0x80037B60 /end VAR_ADDRESS
 /end VAR_CHARACTERISTIC
 /begin VAR_CHARACTERISTIC BAC_S16_BAC_SLIP_SPEED_GAIN_DEP_H_V BrkCalVariantCriterion
  /begin VAR_ADDRESS 0x80020F6A 0x8002436A 0x8002776A 0x8002AB6A 0x8002DF6A 0x8003136A 0x8003476A 0x80037B6A /end VAR_ADDRESS
 /end VAR_CHARACTERISTIC
 /begin VAR_CHARACTERISTIC BAC_S16_BAC_SLIP_SPEED_GAIN_DEP_L_V BrkCalVariantCriterion
  /begin VAR_ADDRESS 0x80020F66 0x80024366 0x80027766 0x8002AB66 0x8002DF66 0x80031366 0x80034766 0x80037B66 /end VAR_ADDRESS
 /end VAR_CHARACTERISTIC
 /begin VAR_CHARACTERISTIC BAC_S16_BAC_SLIP_SPEED_GAIN_DEP_M_V BrkCalVariantCriterion
  /begin VAR_ADDRESS 0x80020F68 0x80024368 0x80027768 0x8002AB68 0x8002DF68 0x80031368 0x80034768 0x80037B68 /end VAR_ADDRESS
 /end VAR_CHARACTERISTIC
 /begin VAR_CHARACTERISTIC BAC_S16_BRAKE_DISK_FADE_TEMPERATURE BrkCalVariantCriterion
  /begin VAR_ADDRESS 0x80020F70 0x80024370 0x80027770 0x8002AB70 0x8002DF70 0x80031370 0x80034770 0x80037B70 /end VAR_ADDRESS
 /end VAR_CHARACTERISTIC
 /begin VAR_CHARACTERISTIC BAC_S16_BRAKE_DISK_MONITOR_TEMPERATURE BrkCalVariantCriterion
  /begin VAR_ADDRESS 0x80020F72 0x80024372 0x80027772 0x8002AB72 0x8002DF72 0x80031372 0x80034772 0x80037B72 /end VAR_ADDRESS
 /end VAR_CHARACTERISTIC
 /begin VAR_CHARACTERISTIC BAC_S16_BRAKE_High_MCPRESS BrkCalVariantCriterion
  /begin VAR_ADDRESS 0x80020F74 0x80024374 0x80027774 0x8002AB74 0x8002DF74 0x80031374 0x80034774 0x80037B74 /end VAR_ADDRESS
 /end VAR_CHARACTERISTIC
 /begin VAR_CHARACTERISTIC BAC_S16_BRAKE_LOWMU_ABSPRESS BrkCalVariantCriterion
  /begin VAR_ADDRESS 0x80020F76 0x80024376 0x80027776 0x8002AB76 0x8002DF76 0x80031376 0x80034776 0x80037B76 /end VAR_ADDRESS
 /end VAR_CHARACTERISTIC
 /begin VAR_CHARACTERISTIC BAC_S16_BRAKE_Low_MCPRESS BrkCalVariantCriterion
  /begin VAR_ADDRESS 0x80020F78 0x80024378 0x80027778 0x8002AB78 0x8002DF78 0x80031378 0x80034778 0x80037B78 /end VAR_ADDRESS
 /end VAR_CHARACTERISTIC
 /begin VAR_CHARACTERISTIC BAC_S16_BRAKE_Med_MCPRESS BrkCalVariantCriterion
  /begin VAR_ADDRESS 0x80020F7A 0x8002437A 0x8002777A 0x8002AB7A 0x8002DF7A 0x8003137A 0x8003477A 0x80037B7A /end VAR_ADDRESS
 /end VAR_CHARACTERISTIC
 /begin VAR_CHARACTERISTIC BAC_S16_FBC_ENTER_DECEL BrkCalVariantCriterion
  /begin VAR_ADDRESS 0x80020F80 0x80024380 0x80027780 0x8002AB80 0x8002DF80 0x80031380 0x80034780 0x80037B80 /end VAR_ADDRESS
 /end VAR_CHARACTERISTIC
 /begin VAR_CHARACTERISTIC BAC_S16_FBC_MAX_TARGET_PRESS BrkCalVariantCriterion
  /begin VAR_ADDRESS 0x80020FA2 0x800243A2 0x800277A2 0x8002ABA2 0x8002DFA2 0x800313A2 0x800347A2 0x80037BA2 /end VAR_ADDRESS
 /end VAR_CHARACTERISTIC
 /begin VAR_CHARACTERISTIC BAC_S16_FBC_PRESS_ENTER_THR BrkCalVariantCriterion
  /begin VAR_ADDRESS 0x80020F82 0x80024382 0x80027782 0x8002AB82 0x8002DF82 0x80031382 0x80034782 0x80037B82 /end VAR_ADDRESS
 /end VAR_CHARACTERISTIC
 /begin VAR_CHARACTERISTIC BAC_S16_FBC_PRESS_EXIT_THR1 BrkCalVariantCriterion
  /begin VAR_ADDRESS 0x80020F88 0x80024388 0x80027788 0x8002AB88 0x8002DF88 0x80031388 0x80034788 0x80037B88 /end VAR_ADDRESS
 /end VAR_CHARACTERISTIC
 /begin VAR_CHARACTERISTIC BAC_S16_FBC_PRESS_EXIT_THR2 BrkCalVariantCriterion
  /begin VAR_ADDRESS 0x80020F8A 0x8002438A 0x8002778A 0x8002AB8A 0x8002DF8A 0x8003138A 0x8003478A 0x80037B8A /end VAR_ADDRESS
 /end VAR_CHARACTERISTIC
 /begin VAR_CHARACTERISTIC BAC_S16_FBC_PRESS_EXIT_THR3 BrkCalVariantCriterion
  /begin VAR_ADDRESS 0x80020F8C 0x8002438C 0x8002778C 0x8002AB8C 0x8002DF8C 0x8003138C 0x8003478C 0x80037B8C /end VAR_ADDRESS
 /end VAR_CHARACTERISTIC
 /begin VAR_CHARACTERISTIC BAC_S16_FBC_PRESS_RATE_ENTER_THR BrkCalVariantCriterion
  /begin VAR_ADDRESS 0x80020F84 0x80024384 0x80027784 0x8002AB84 0x8002DF84 0x80031384 0x80034784 0x80037B84 /end VAR_ADDRESS
 /end VAR_CHARACTERISTIC
 /begin VAR_CHARACTERISTIC BAC_S16_FBC_SPEED_ENTER_THR BrkCalVariantCriterion
  /begin VAR_ADDRESS 0x80020F86 0x80024386 0x80027786 0x8002AB86 0x8002DF86 0x80031386 0x80034786 0x80037B86 /end VAR_ADDRESS
 /end VAR_CHARACTERISTIC
 /begin VAR_CHARACTERISTIC BAC_S16_FBC_SPEED_EXIT_THR BrkCalVariantCriterion
  /begin VAR_ADDRESS 0x80020F8E 0x8002438E 0x8002778E 0x8002AB8E 0x8002DF8E 0x8003138E 0x8003478E 0x80037B8E /end VAR_ADDRESS
 /end VAR_CHARACTERISTIC
 /begin VAR_CHARACTERISTIC BAC_S16_FBC_Temp1 BrkCalVariantCriterion
  /begin VAR_ADDRESS 0x80020FA4 0x800243A4 0x800277A4 0x8002ABA4 0x8002DFA4 0x800313A4 0x800347A4 0x80037BA4 /end VAR_ADDRESS
 /end VAR_CHARACTERISTIC
 /begin VAR_CHARACTERISTIC BAC_S16_FBC_Temp2 BrkCalVariantCriterion
  /begin VAR_ADDRESS 0x80020FA6 0x800243A6 0x800277A6 0x8002ABA6 0x8002DFA6 0x800313A6 0x800347A6 0x80037BA6 /end VAR_ADDRESS
 /end VAR_CHARACTERISTIC
 /begin VAR_CHARACTERISTIC BAC_S16_FBC_Temp3 BrkCalVariantCriterion
  /begin VAR_ADDRESS 0x80020FA8 0x800243A8 0x800277A8 0x8002ABA8 0x8002DFA8 0x800313A8 0x800347A8 0x80037BA8 /end VAR_ADDRESS
 /end VAR_CHARACTERISTIC
 /begin VAR_CHARACTERISTIC BAC_S16_FBC_Temp4 BrkCalVariantCriterion
  /begin VAR_ADDRESS 0x80020FAA 0x800243AA 0x800277AA 0x8002ABAA 0x8002DFAA 0x800313AA 0x800347AA 0x80037BAA /end VAR_ADDRESS
 /end VAR_CHARACTERISTIC
 /begin VAR_CHARACTERISTIC BAC_S16_FBC_Temp5 BrkCalVariantCriterion
  /begin VAR_ADDRESS 0x80020FAC 0x800243AC 0x800277AC 0x8002ABAC 0x8002DFAC 0x800313AC 0x800347AC 0x80037BAC /end VAR_ADDRESS
 /end VAR_CHARACTERISTIC
 /begin VAR_CHARACTERISTIC BAC_S16_LOW_MPRESS_FBC_ON_TIME_ACCEL BrkCalVariantCriterion
  /begin VAR_ADDRESS 0x80020F92 0x80024392 0x80027792 0x8002AB92 0x8002DF92 0x80031392 0x80034792 0x80037B92 /end VAR_ADDRESS
 /end VAR_CHARACTERISTIC
 /begin VAR_CHARACTERISTIC BAC_S16_LOW_MPRESS_FBC_ON_TIME_BRAKING BrkCalVariantCriterion
  /begin VAR_ADDRESS 0x80020F94 0x80024394 0x80027794 0x8002AB94 0x8002DF94 0x80031394 0x80034794 0x80037B94 /end VAR_ADDRESS
 /end VAR_CHARACTERISTIC
 /begin VAR_CHARACTERISTIC BAC_S16_LOW_MPRESS_FBC_ON_TIME_DEFAULT BrkCalVariantCriterion
  /begin VAR_ADDRESS 0x80020F96 0x80024396 0x80027796 0x8002AB96 0x8002DF96 0x80031396 0x80034796 0x80037B96 /end VAR_ADDRESS
 /end VAR_CHARACTERISTIC
 /begin VAR_CHARACTERISTIC BAC_S16_PBA_MAX_TARGET_PRESS BrkCalVariantCriterion
  /begin VAR_ADDRESS 0x80020F62 0x80024362 0x80027762 0x8002AB62 0x8002DF62 0x80031362 0x80034762 0x80037B62 /end VAR_ADDRESS
 /end VAR_CHARACTERISTIC
 /begin VAR_CHARACTERISTIC BAC_S8_BAC_ENTER_SLIP_HSP BrkCalVariantCriterion
  /begin VAR_ADDRESS 0x80020F6E 0x8002436E 0x8002776E 0x8002AB6E 0x8002DF6E 0x8003136E 0x8003476E 0x80037B6E /end VAR_ADDRESS
 /end VAR_CHARACTERISTIC
 /begin VAR_CHARACTERISTIC BAC_S8_BAC_ENTER_SLIP_LSP BrkCalVariantCriterion
  /begin VAR_ADDRESS 0x80020F6C 0x8002436C 0x8002776C 0x8002AB6C 0x8002DF6C 0x8003136C 0x8003476C 0x80037B6C /end VAR_ADDRESS
 /end VAR_CHARACTERISTIC
 /begin VAR_CHARACTERISTIC BAC_S8_BAC_ENTER_SLIP_MSP BrkCalVariantCriterion
  /begin VAR_ADDRESS 0x80020F6D 0x8002436D 0x8002776D 0x8002AB6D 0x8002DF6D 0x8003136D 0x8003476D 0x80037B6D /end VAR_ADDRESS
 /end VAR_CHARACTERISTIC
 /begin VAR_CHARACTERISTIC BAC_U16_FBC_MAX_APPLY_TIME_BEFORE_ABS BrkCalVariantCriterion
  /begin VAR_ADDRESS 0x80020F9C 0x8002439C 0x8002779C 0x8002AB9C 0x8002DF9C 0x8003139C 0x8003479C 0x80037B9C /end VAR_ADDRESS
 /end VAR_CHARACTERISTIC
 /begin VAR_CHARACTERISTIC BAC_U16_PBA_BIG_SLOPE_EXIT_TIME1 BrkCalVariantCriterion
  /begin VAR_ADDRESS 0x80020F56 0x80024356 0x80027756 0x8002AB56 0x8002DF56 0x80031356 0x80034756 0x80037B56 /end VAR_ADDRESS
 /end VAR_CHARACTERISTIC
 /begin VAR_CHARACTERISTIC BAC_U16_PBA_BIG_SLOPE_EXIT_TIME2 BrkCalVariantCriterion
  /begin VAR_ADDRESS 0x80020F58 0x80024358 0x80027758 0x8002AB58 0x8002DF58 0x80031358 0x80034758 0x80037B58 /end VAR_ADDRESS
 /end VAR_CHARACTERISTIC
 /begin VAR_CHARACTERISTIC BAC_U16_PBA_ESP_MU_HIGH BrkCalVariantCriterion
  /begin VAR_ADDRESS 0x80020F48 0x80024348 0x80027748 0x8002AB48 0x8002DF48 0x80031348 0x80034748 0x80037B48 /end VAR_ADDRESS
 /end VAR_CHARACTERISTIC
 /begin VAR_CHARACTERISTIC BAC_U16_PBA_ESP_MU_LOW BrkCalVariantCriterion
  /begin VAR_ADDRESS 0x80020F4A 0x8002434A 0x8002774A 0x8002AB4A 0x8002DF4A 0x8003134A 0x8003474A 0x80037B4A /end VAR_ADDRESS
 /end VAR_CHARACTERISTIC
 /begin VAR_CHARACTERISTIC BAC_U16_PBA_ESP_MU_MEDIUM BrkCalVariantCriterion
  /begin VAR_ADDRESS 0x80020F4C 0x8002434C 0x8002774C 0x8002AB4C 0x8002DF4C 0x8003134C 0x8003474C 0x80037B4C /end VAR_ADDRESS
 /end VAR_CHARACTERISTIC
 /begin VAR_CHARACTERISTIC BAC_U16_PBA_PRESS_ENTER_THR BrkCalVariantCriterion
  /begin VAR_ADDRESS 0x80020F4E 0x8002434E 0x8002774E 0x8002AB4E 0x8002DF4E 0x8003134E 0x8003474E 0x80037B4E /end VAR_ADDRESS
 /end VAR_CHARACTERISTIC
 /begin VAR_CHARACTERISTIC BAC_U16_PBA_PRESS_EXIT_THR1 BrkCalVariantCriterion
  /begin VAR_ADDRESS 0x80020F5A 0x8002435A 0x8002775A 0x8002AB5A 0x8002DF5A 0x8003135A 0x8003475A 0x80037B5A /end VAR_ADDRESS
 /end VAR_CHARACTERISTIC
 /begin VAR_CHARACTERISTIC BAC_U16_PBA_PRESS_EXIT_THR2 BrkCalVariantCriterion
  /begin VAR_ADDRESS 0x80020F5C 0x8002435C 0x8002775C 0x8002AB5C 0x8002DF5C 0x8003135C 0x8003475C 0x80037B5C /end VAR_ADDRESS
 /end VAR_CHARACTERISTIC
 /begin VAR_CHARACTERISTIC BAC_U16_PBA_PRESS_RISE_RATE_THR1 BrkCalVariantCriterion
  /begin VAR_ADDRESS 0x80020F50 0x80024350 0x80027750 0x8002AB50 0x8002DF50 0x80031350 0x80034750 0x80037B50 /end VAR_ADDRESS
 /end VAR_CHARACTERISTIC
 /begin VAR_CHARACTERISTIC BAC_U16_PBA_PRESS_RISE_RATE_THR2 BrkCalVariantCriterion
  /begin VAR_ADDRESS 0x80020F52 0x80024352 0x80027752 0x8002AB52 0x8002DF52 0x80031352 0x80034752 0x80037B52 /end VAR_ADDRESS
 /end VAR_CHARACTERISTIC
 /begin VAR_CHARACTERISTIC BAC_U16_PBA_SPEED_ENTER_THR BrkCalVariantCriterion
  /begin VAR_ADDRESS 0x80020F54 0x80024354 0x80027754 0x8002AB54 0x8002DF54 0x80031354 0x80034754 0x80037B54 /end VAR_ADDRESS
 /end VAR_CHARACTERISTIC
 /begin VAR_CHARACTERISTIC BAC_U16_PBA_SPEED_EXIT_THR BrkCalVariantCriterion
  /begin VAR_ADDRESS 0x80020F5E 0x8002435E 0x8002775E 0x8002AB5E 0x8002DF5E 0x8003135E 0x8003475E 0x80037B5E /end VAR_ADDRESS
 /end VAR_CHARACTERISTIC
 /begin VAR_CHARACTERISTIC BAC_U8_BRAKE_High_Decel BrkCalVariantCriterion
  /begin VAR_ADDRESS 0x80020F7C 0x8002437C 0x8002777C 0x8002AB7C 0x8002DF7C 0x8003137C 0x8003477C 0x80037B7C /end VAR_ADDRESS
 /end VAR_CHARACTERISTIC
 /begin VAR_CHARACTERISTIC BAC_U8_BRAKE_Low_Decel BrkCalVariantCriterion
  /begin VAR_ADDRESS 0x80020F7D 0x8002437D 0x8002777D 0x8002AB7D 0x8002DF7D 0x8003137D 0x8003477D 0x80037B7D /end VAR_ADDRESS
 /end VAR_CHARACTERISTIC
 /begin VAR_CHARACTERISTIC BAC_U8_BRAKE_Med_Decel BrkCalVariantCriterion
  /begin VAR_ADDRESS 0x80020F7E 0x8002437E 0x8002777E 0x8002AB7E 0x8002DF7E 0x8003137E 0x8003477E 0x80037B7E /end VAR_ADDRESS
 /end VAR_CHARACTERISTIC
 /begin VAR_CHARACTERISTIC BAC_U8_FBC_APPLY_TIME BrkCalVariantCriterion
  /begin VAR_ADDRESS 0x80020FA0 0x800243A0 0x800277A0 0x8002ABA0 0x8002DFA0 0x800313A0 0x800347A0 0x80037BA0 /end VAR_ADDRESS
 /end VAR_CHARACTERISTIC
 /begin VAR_CHARACTERISTIC BAC_U8_FBC_DUMP_MODE_HOLD_TIME BrkCalVariantCriterion
  /begin VAR_ADDRESS 0x80020F9E 0x8002439E 0x8002779E 0x8002AB9E 0x8002DF9E 0x8003139E 0x8003479E 0x80037B9E /end VAR_ADDRESS
 /end VAR_CHARACTERISTIC
 /begin VAR_CHARACTERISTIC BAC_U8_FBC_DUMP_MODE_MAX_TIME BrkCalVariantCriterion
  /begin VAR_ADDRESS 0x80020F9F 0x8002439F 0x8002779F 0x8002AB9F 0x8002DF9F 0x8003139F 0x8003479F 0x80037B9F /end VAR_ADDRESS
 /end VAR_CHARACTERISTIC
 /begin VAR_CHARACTERISTIC BAC_U8_FBC_EXIT_CONTROL_TIME BrkCalVariantCriterion
  /begin VAR_ADDRESS 0x80020F9A 0x8002439A 0x8002779A 0x8002AB9A 0x8002DF9A 0x8003139A 0x8003479A 0x80037B9A /end VAR_ADDRESS
 /end VAR_CHARACTERISTIC
 /begin VAR_CHARACTERISTIC BAC_U8_FBC_EXIT_MTP1 BrkCalVariantCriterion
  /begin VAR_ADDRESS 0x80020F98 0x80024398 0x80027798 0x8002AB98 0x8002DF98 0x80031398 0x80034798 0x80037B98 /end VAR_ADDRESS
 /end VAR_CHARACTERISTIC
 /begin VAR_CHARACTERISTIC BAC_U8_FBC_EXIT_MTP2 BrkCalVariantCriterion
  /begin VAR_ADDRESS 0x80020F99 0x80024399 0x80027799 0x8002AB99 0x8002DF99 0x80031399 0x80034799 0x80037B99 /end VAR_ADDRESS
 /end VAR_CHARACTERISTIC
 /begin VAR_CHARACTERISTIC BAC_U8_FBC_FADING_DCT_COUNT_MAX BrkCalVariantCriterion
  /begin VAR_ADDRESS 0x80020F7F 0x8002437F 0x8002777F 0x8002AB7F 0x8002DF7F 0x8003137F 0x8003477F 0x80037B7F /end VAR_ADDRESS
 /end VAR_CHARACTERISTIC
 /begin VAR_CHARACTERISTIC BAC_U8_FBC_PRESS_EXIT_THR3_TIMER BrkCalVariantCriterion
  /begin VAR_ADDRESS 0x80020F90 0x80024390 0x80027790 0x8002AB90 0x8002DF90 0x80031390 0x80034790 0x80037B90 /end VAR_ADDRESS
 /end VAR_CHARACTERISTIC
 /begin VAR_CHARACTERISTIC BAC_U8_PBA_APPLY_TIME BrkCalVariantCriterion
  /begin VAR_ADDRESS 0x80020F64 0x80024364 0x80027764 0x8002AB64 0x8002DF64 0x80031364 0x80034764 0x80037B64 /end VAR_ADDRESS
 /end VAR_CHARACTERISTIC
 /begin VAR_CHARACTERISTIC LPC_S16_BDW_ACTIVE_TIME BrkCalVariantCriterion
  /begin VAR_ADDRESS 0x80020FCA 0x800243CA 0x800277CA 0x8002ABCA 0x8002DFCA 0x800313CA 0x800347CA 0x80037BCA /end VAR_ADDRESS
 /end VAR_CHARACTERISTIC
 /begin VAR_CHARACTERISTIC LPC_S16_BDW_DISABLE_DISK_TEMP BrkCalVariantCriterion
  /begin VAR_ADDRESS 0x80020FCE 0x800243CE 0x800277CE 0x8002ABCE 0x8002DFCE 0x800313CE 0x800347CE 0x80037BCE /end VAR_ADDRESS
 /end VAR_CHARACTERISTIC
 /begin VAR_CHARACTERISTIC LPC_S16_BDW_ENABLE_DISK_TEMP BrkCalVariantCriterion
  /begin VAR_ADDRESS 0x80020FBC 0x800243BC 0x800277BC 0x8002ABBC 0x8002DFBC 0x800313BC 0x800347BC 0x80037BBC /end VAR_ADDRESS
 /end VAR_CHARACTERISTIC
 /begin VAR_CHARACTERISTIC LPC_S16_BDW_ENT_ALATM BrkCalVariantCriterion
  /begin VAR_ADDRESS 0x80020FBE 0x800243BE 0x800277BE 0x8002ABBE 0x8002DFBE 0x800313BE 0x800347BE 0x80037BBE /end VAR_ADDRESS
 /end VAR_CHARACTERISTIC
 /begin VAR_CHARACTERISTIC LPC_S16_BDW_ENT_MPRESS BrkCalVariantCriterion
  /begin VAR_ADDRESS 0x80020FC0 0x800243C0 0x800277C0 0x8002ABC0 0x8002DFC0 0x800313C0 0x800347C0 0x80037BC0 /end VAR_ADDRESS
 /end VAR_CHARACTERISTIC
 /begin VAR_CHARACTERISTIC LPC_S16_BDW_ENT_MTP BrkCalVariantCriterion
  /begin VAR_ADDRESS 0x80020FC2 0x800243C2 0x800277C2 0x8002ABC2 0x8002DFC2 0x800313C2 0x800347C2 0x80037BC2 /end VAR_ADDRESS
 /end VAR_CHARACTERISTIC
 /begin VAR_CHARACTERISTIC LPC_S16_BDW_ENT_SPEED BrkCalVariantCriterion
  /begin VAR_ADDRESS 0x80020FC4 0x800243C4 0x800277C4 0x8002ABC4 0x8002DFC4 0x800313C4 0x800347C4 0x80037BC4 /end VAR_ADDRESS
 /end VAR_CHARACTERISTIC
 /begin VAR_CHARACTERISTIC LPC_S16_BDW_EXT_ALATM BrkCalVariantCriterion
  /begin VAR_ADDRESS 0x80020FD0 0x800243D0 0x800277D0 0x8002ABD0 0x8002DFD0 0x800313D0 0x800347D0 0x80037BD0 /end VAR_ADDRESS
 /end VAR_CHARACTERISTIC
 /begin VAR_CHARACTERISTIC LPC_S16_BDW_EXT_MPRESS BrkCalVariantCriterion
  /begin VAR_ADDRESS 0x80020FD2 0x800243D2 0x800277D2 0x8002ABD2 0x8002DFD2 0x800313D2 0x800347D2 0x80037BD2 /end VAR_ADDRESS
 /end VAR_CHARACTERISTIC
 /begin VAR_CHARACTERISTIC LPC_S16_BDW_EXT_MTP BrkCalVariantCriterion
  /begin VAR_ADDRESS 0x80020FD4 0x800243D4 0x800277D4 0x8002ABD4 0x8002DFD4 0x800313D4 0x800347D4 0x80037BD4 /end VAR_ADDRESS
 /end VAR_CHARACTERISTIC
 /begin VAR_CHARACTERISTIC LPC_S16_BDW_EXT_SPEED BrkCalVariantCriterion
  /begin VAR_ADDRESS 0x80020FD6 0x800243D6 0x800277D6 0x8002ABD6 0x8002DFD6 0x800313D6 0x800347D6 0x80037BD6 /end VAR_ADDRESS
 /end VAR_CHARACTERISTIC
 /begin VAR_CHARACTERISTIC LPC_S16_BDW_INTERVAL_TIME BrkCalVariantCriterion
  /begin VAR_ADDRESS 0x80020FCC 0x800243CC 0x800277CC 0x8002ABCC 0x8002DFCC 0x800313CC 0x800347CC 0x80037BCC /end VAR_ADDRESS
 /end VAR_CHARACTERISTIC
 /begin VAR_CHARACTERISTIC LPC_S16_BDW_RAIN_DETECT_TIME BrkCalVariantCriterion
  /begin VAR_ADDRESS 0x80020FC6 0x800243C6 0x800277C6 0x8002ABC6 0x8002DFC6 0x800313C6 0x800347C6 0x80037BC6 /end VAR_ADDRESS
 /end VAR_CHARACTERISTIC
 /begin VAR_CHARACTERISTIC LPC_S16_BDW_Temp1 BrkCalVariantCriterion
  /begin VAR_ADDRESS 0x80020FD8 0x800243D8 0x800277D8 0x8002ABD8 0x8002DFD8 0x800313D8 0x800347D8 0x80037BD8 /end VAR_ADDRESS
 /end VAR_CHARACTERISTIC
 /begin VAR_CHARACTERISTIC LPC_S16_BDW_Temp2 BrkCalVariantCriterion
  /begin VAR_ADDRESS 0x80020FDA 0x800243DA 0x800277DA 0x8002ABDA 0x8002DFDA 0x800313DA 0x800347DA 0x80037BDA /end VAR_ADDRESS
 /end VAR_CHARACTERISTIC
 /begin VAR_CHARACTERISTIC LPC_S16_BDW_Temp3 BrkCalVariantCriterion
  /begin VAR_ADDRESS 0x80020FDC 0x800243DC 0x800277DC 0x8002ABDC 0x8002DFDC 0x800313DC 0x800347DC 0x80037BDC /end VAR_ADDRESS
 /end VAR_CHARACTERISTIC
 /begin VAR_CHARACTERISTIC LPC_S16_BDW_Temp4 BrkCalVariantCriterion
  /begin VAR_ADDRESS 0x80020FDE 0x800243DE 0x800277DE 0x8002ABDE 0x8002DFDE 0x800313DE 0x800347DE 0x80037BDE /end VAR_ADDRESS
 /end VAR_CHARACTERISTIC
 /begin VAR_CHARACTERISTIC LPC_S16_BDW_Temp5 BrkCalVariantCriterion
  /begin VAR_ADDRESS 0x80020FE0 0x800243E0 0x800277E0 0x8002ABE0 0x8002DFE0 0x800313E0 0x800347E0 0x80037BE0 /end VAR_ADDRESS
 /end VAR_CHARACTERISTIC
 /begin VAR_CHARACTERISTIC LPC_S16_EBP_TARGET_PRESS BrkCalVariantCriterion
  /begin VAR_ADDRESS 0x80020FB2 0x800243B2 0x800277B2 0x8002ABB2 0x8002DFB2 0x800313B2 0x800347B2 0x80037BB2 /end VAR_ADDRESS
 /end VAR_CHARACTERISTIC
 /begin VAR_CHARACTERISTIC LPC_U8_BDW_Initial_Clean_Enable BrkCalVariantCriterion
  /begin VAR_ADDRESS 0x80020FC8 0x800243C8 0x800277C8 0x8002ABC8 0x8002DFC8 0x800313C8 0x800347C8 0x80037BC8 /end VAR_ADDRESS
 /end VAR_CHARACTERISTIC
 /begin VAR_CHARACTERISTIC LPC_U8_EBP_APPLY_TIME BrkCalVariantCriterion
  /begin VAR_ADDRESS 0x80020FB1 0x800243B1 0x800277B1 0x8002ABB1 0x8002DFB1 0x800313B1 0x800347B1 0x80037BB1 /end VAR_ADDRESS
 /end VAR_CHARACTERISTIC
 /begin VAR_CHARACTERISTIC LPC_U8_EBP_ENABLE_TIME_THR BrkCalVariantCriterion
  /begin VAR_ADDRESS 0x80020FB0 0x800243B0 0x800277B0 0x8002ABB0 0x8002DFB0 0x800313B0 0x800347B0 0x80037BB0 /end VAR_ADDRESS
 /end VAR_CHARACTERISTIC
 /begin VAR_CHARACTERISTIC LPC_U8_EBP_ENTER_MPRESS BrkCalVariantCriterion
  /begin VAR_ADDRESS 0x80020FB4 0x800243B4 0x800277B4 0x8002ABB4 0x8002DFB4 0x800313B4 0x800347B4 0x80037BB4 /end VAR_ADDRESS
 /end VAR_CHARACTERISTIC
 /begin VAR_CHARACTERISTIC LPC_U8_EBP_ENTER_SPEED BrkCalVariantCriterion
  /begin VAR_ADDRESS 0x80020FB5 0x800243B5 0x800277B5 0x8002ABB5 0x8002DFB5 0x800313B5 0x800347B5 0x80037BB5 /end VAR_ADDRESS
 /end VAR_CHARACTERISTIC
 /begin VAR_CHARACTERISTIC LPC_U8_EBP_EXIT_MPRESS BrkCalVariantCriterion
  /begin VAR_ADDRESS 0x80020FB9 0x800243B9 0x800277B9 0x8002ABB9 0x8002DFB9 0x800313B9 0x800347B9 0x80037BB9 /end VAR_ADDRESS
 /end VAR_CHARACTERISTIC
 /begin VAR_CHARACTERISTIC LPC_U8_EBP_EXIT_MTP BrkCalVariantCriterion
  /begin VAR_ADDRESS 0x80020FBA 0x800243BA 0x800277BA 0x8002ABBA 0x8002DFBA 0x800313BA 0x800347BA 0x80037BBA /end VAR_ADDRESS
 /end VAR_CHARACTERISTIC
 /begin VAR_CHARACTERISTIC LPC_U8_EBP_MTP_DIFF_LV1 BrkCalVariantCriterion
  /begin VAR_ADDRESS 0x80020FB6 0x800243B6 0x800277B6 0x8002ABB6 0x8002DFB6 0x800313B6 0x800347B6 0x80037BB6 /end VAR_ADDRESS
 /end VAR_CHARACTERISTIC
 /begin VAR_CHARACTERISTIC LPC_U8_EBP_MTP_DIFF_LV2 BrkCalVariantCriterion
  /begin VAR_ADDRESS 0x80020FB7 0x800243B7 0x800277B7 0x8002ABB7 0x8002DFB7 0x800313B7 0x800347B7 0x80037BB7 /end VAR_ADDRESS
 /end VAR_CHARACTERISTIC
 /begin VAR_CHARACTERISTIC LPC_U8_EBP_MTP_DIFF_LV3 BrkCalVariantCriterion
  /begin VAR_ADDRESS 0x80020FB8 0x800243B8 0x800277B8 0x8002ABB8 0x8002DFB8 0x800313B8 0x800347B8 0x80037BB8 /end VAR_ADDRESS
 /end VAR_CHARACTERISTIC
 /begin VAR_CHARACTERISTIC S16EpsiHndlgAgToTqGainRoadFric1 BrkCalVariantCriterion
  /begin VAR_ADDRESS 0x80021882 0x80024C82 0x80028082 0x8002B482 0x8002E882 0x80031C82 0x80035082 0x80038482 /end VAR_ADDRESS
 /end VAR_CHARACTERISTIC
 /begin VAR_CHARACTERISTIC S16EpsiHndlgAgToTqGainRoadFric2 BrkCalVariantCriterion
  /begin VAR_ADDRESS 0x80021884 0x80024C84 0x80028084 0x8002B484 0x8002E884 0x80031C84 0x80035084 0x80038484 /end VAR_ADDRESS
 /end VAR_CHARACTERISTIC
 /begin VAR_CHARACTERISTIC S16EpsiHndlgAgToTqGainRoadFric3 BrkCalVariantCriterion
  /begin VAR_ADDRESS 0x80021886 0x80024C86 0x80028086 0x8002B486 0x8002E886 0x80031C86 0x80035086 0x80038486 /end VAR_ADDRESS
 /end VAR_CHARACTERISTIC
 /begin VAR_CHARACTERISTIC S16_ACC_BRAKE_FADE_OUT_RATE BrkCalVariantCriterion
  /begin VAR_ADDRESS 0x80021028 0x80024428 0x80027828 0x8002AC28 0x8002E028 0x80031428 0x80034828 0x80037C28 /end VAR_ADDRESS
 /end VAR_CHARACTERISTIC
 /begin VAR_CHARACTERISTIC S16_ACC_EPB_DEMAND_MAX_CNT BrkCalVariantCriterion
  /begin VAR_ADDRESS 0x8002102E 0x8002442E 0x8002782E 0x8002AC2E 0x8002E02E 0x8003142E 0x8003482E 0x80037C2E /end VAR_ADDRESS
 /end VAR_CHARACTERISTIC
 /begin VAR_CHARACTERISTIC S16_ACC_PRESS_MAX BrkCalVariantCriterion
  /begin VAR_ADDRESS 0x8002102A 0x8002442A 0x8002782A 0x8002AC2A 0x8002E02A 0x8003142A 0x8003482A 0x80037C2A /end VAR_ADDRESS
 /end VAR_CHARACTERISTIC
 /begin VAR_CHARACTERISTIC S16_ACC_TARGETG_LIMIT_MAX BrkCalVariantCriterion
  /begin VAR_ADDRESS 0x8002101C 0x8002441C 0x8002781C 0x8002AC1C 0x8002E01C 0x8003141C 0x8003481C 0x80037C1C /end VAR_ADDRESS
 /end VAR_CHARACTERISTIC
 /begin VAR_CHARACTERISTIC S16_ACC_TARGETG_LIMIT_MIN BrkCalVariantCriterion
  /begin VAR_ADDRESS 0x8002101E 0x8002441E 0x8002781E 0x8002AC1E 0x8002E01E 0x8003141E 0x8003481E 0x80037C1E /end VAR_ADDRESS
 /end VAR_CHARACTERISTIC
 /begin VAR_CHARACTERISTIC S16_ACC_TARGETG_MAX_STOP BrkCalVariantCriterion
  /begin VAR_ADDRESS 0x80021020 0x80024420 0x80027820 0x8002AC20 0x8002E020 0x80031420 0x80034820 0x80037C20 /end VAR_ADDRESS
 /end VAR_CHARACTERISTIC
 /begin VAR_CHARACTERISTIC S16_ACC_TARGETG_MIN_HILLUP_STOP BrkCalVariantCriterion
  /begin VAR_ADDRESS 0x80021022 0x80024422 0x80027822 0x8002AC22 0x8002E022 0x80031422 0x80034822 0x80037C22 /end VAR_ADDRESS
 /end VAR_CHARACTERISTIC
 /begin VAR_CHARACTERISTIC S16_ACC_TARGETG_MIN_HILL_STOP BrkCalVariantCriterion
  /begin VAR_ADDRESS 0x80021024 0x80024424 0x80027824 0x8002AC24 0x8002E024 0x80031424 0x80034824 0x80037C24 /end VAR_ADDRESS
 /end VAR_CHARACTERISTIC
 /begin VAR_CHARACTERISTIC S16_ACC_TARGETG_MIN_STOP BrkCalVariantCriterion
  /begin VAR_ADDRESS 0x80021026 0x80024426 0x80027826 0x8002AC26 0x8002E026 0x80031426 0x80034826 0x80037C26 /end VAR_ADDRESS
 /end VAR_CHARACTERISTIC
 /begin VAR_CHARACTERISTIC S16_AEB_BRAKE_FADE_OUT_RATE BrkCalVariantCriterion
  /begin VAR_ADDRESS 0x80021052 0x80024452 0x80027852 0x8002AC52 0x8002E052 0x80031452 0x80034852 0x80037C52 /end VAR_ADDRESS
 /end VAR_CHARACTERISTIC
 /begin VAR_CHARACTERISTIC S16_AEB_ME_PED_DGAIN_HIGH EngCalVariantCriterion
  /begin VAR_ADDRESS 0x8003A922 0x8003B722 0x8003C522 0x8003D322 0x8003E122 0x8003EF22 0x8003FD22 0x80040B22 0x80041922 0x80042722 0x80043522 0x80044322 0x80045122 0x80045F22 0x80046D22 0x80047B22 0x80048922 0x80049722 0x8004A522 0x8004B322 0x8004C122 0x8004CF22 0x8004DD22 0x8004EB22 /end VAR_ADDRESS
 /end VAR_CHARACTERISTIC
 /begin VAR_CHARACTERISTIC S16_AEB_ME_PED_DGAIN_LOW EngCalVariantCriterion
  /begin VAR_ADDRESS 0x8003A91C 0x8003B71C 0x8003C51C 0x8003D31C 0x8003E11C 0x8003EF1C 0x8003FD1C 0x80040B1C 0x8004191C 0x8004271C 0x8004351C 0x8004431C 0x8004511C 0x80045F1C 0x80046D1C 0x80047B1C 0x8004891C 0x8004971C 0x8004A51C 0x8004B31C 0x8004C11C 0x8004CF1C 0x8004DD1C 0x8004EB1C /end VAR_ADDRESS
 /end VAR_CHARACTERISTIC
 /begin VAR_CHARACTERISTIC S16_AEB_ME_PED_IGAIN_HIGH EngCalVariantCriterion
  /begin VAR_ADDRESS 0x8003A920 0x8003B720 0x8003C520 0x8003D320 0x8003E120 0x8003EF20 0x8003FD20 0x80040B20 0x80041920 0x80042720 0x80043520 0x80044320 0x80045120 0x80045F20 0x80046D20 0x80047B20 0x80048920 0x80049720 0x8004A520 0x8004B320 0x8004C120 0x8004CF20 0x8004DD20 0x8004EB20 /end VAR_ADDRESS
 /end VAR_CHARACTERISTIC
 /begin VAR_CHARACTERISTIC S16_AEB_ME_PED_IGAIN_LOW EngCalVariantCriterion
  /begin VAR_ADDRESS 0x8003A91A 0x8003B71A 0x8003C51A 0x8003D31A 0x8003E11A 0x8003EF1A 0x8003FD1A 0x80040B1A 0x8004191A 0x8004271A 0x8004351A 0x8004431A 0x8004511A 0x80045F1A 0x80046D1A 0x80047B1A 0x8004891A 0x8004971A 0x8004A51A 0x8004B31A 0x8004C11A 0x8004CF1A 0x8004DD1A 0x8004EB1A /end VAR_ADDRESS
 /end VAR_CHARACTERISTIC
 /begin VAR_CHARACTERISTIC S16_AEB_ME_PED_PGAIN_HIGH EngCalVariantCriterion
  /begin VAR_ADDRESS 0x8003A91E 0x8003B71E 0x8003C51E 0x8003D31E 0x8003E11E 0x8003EF1E 0x8003FD1E 0x80040B1E 0x8004191E 0x8004271E 0x8004351E 0x8004431E 0x8004511E 0x80045F1E 0x80046D1E 0x80047B1E 0x8004891E 0x8004971E 0x8004A51E 0x8004B31E 0x8004C11E 0x8004CF1E 0x8004DD1E 0x8004EB1E /end VAR_ADDRESS
 /end VAR_CHARACTERISTIC
 /begin VAR_CHARACTERISTIC S16_AEB_ME_PED_PGAIN_LOW EngCalVariantCriterion
  /begin VAR_ADDRESS 0x8003A918 0x8003B718 0x8003C518 0x8003D318 0x8003E118 0x8003EF18 0x8003FD18 0x80040B18 0x80041918 0x80042718 0x80043518 0x80044318 0x80045118 0x80045F18 0x80046D18 0x80047B18 0x80048918 0x80049718 0x8004A518 0x8004B318 0x8004C118 0x8004CF18 0x8004DD18 0x8004EB18 /end VAR_ADDRESS
 /end VAR_CHARACTERISTIC
 /begin VAR_CHARACTERISTIC S16_AEB_PE_PED_DGAIN_HIGH EngCalVariantCriterion
  /begin VAR_ADDRESS 0x8003A916 0x8003B716 0x8003C516 0x8003D316 0x8003E116 0x8003EF16 0x8003FD16 0x80040B16 0x80041916 0x80042716 0x80043516 0x80044316 0x80045116 0x80045F16 0x80046D16 0x80047B16 0x80048916 0x80049716 0x8004A516 0x8004B316 0x8004C116 0x8004CF16 0x8004DD16 0x8004EB16 /end VAR_ADDRESS
 /end VAR_CHARACTERISTIC
 /begin VAR_CHARACTERISTIC S16_AEB_PE_PED_DGAIN_LOW EngCalVariantCriterion
  /begin VAR_ADDRESS 0x8003A910 0x8003B710 0x8003C510 0x8003D310 0x8003E110 0x8003EF10 0x8003FD10 0x80040B10 0x80041910 0x80042710 0x80043510 0x80044310 0x80045110 0x80045F10 0x80046D10 0x80047B10 0x80048910 0x80049710 0x8004A510 0x8004B310 0x8004C110 0x8004CF10 0x8004DD10 0x8004EB10 /end VAR_ADDRESS
 /end VAR_CHARACTERISTIC
 /begin VAR_CHARACTERISTIC S16_AEB_PE_PED_IGAIN_HIGH EngCalVariantCriterion
  /begin VAR_ADDRESS 0x8003A914 0x8003B714 0x8003C514 0x8003D314 0x8003E114 0x8003EF14 0x8003FD14 0x80040B14 0x80041914 0x80042714 0x80043514 0x80044314 0x80045114 0x80045F14 0x80046D14 0x80047B14 0x80048914 0x80049714 0x8004A514 0x8004B314 0x8004C114 0x8004CF14 0x8004DD14 0x8004EB14 /end VAR_ADDRESS
 /end VAR_CHARACTERISTIC
 /begin VAR_CHARACTERISTIC S16_AEB_PE_PED_IGAIN_LOW EngCalVariantCriterion
  /begin VAR_ADDRESS 0x8003A90E 0x8003B70E 0x8003C50E 0x8003D30E 0x8003E10E 0x8003EF0E 0x8003FD0E 0x80040B0E 0x8004190E 0x8004270E 0x8004350E 0x8004430E 0x8004510E 0x80045F0E 0x80046D0E 0x80047B0E 0x8004890E 0x8004970E 0x8004A50E 0x8004B30E 0x8004C10E 0x8004CF0E 0x8004DD0E 0x8004EB0E /end VAR_ADDRESS
 /end VAR_CHARACTERISTIC
 /begin VAR_CHARACTERISTIC S16_AEB_PE_PED_PGAIN_HIGH EngCalVariantCriterion
  /begin VAR_ADDRESS 0x8003A912 0x8003B712 0x8003C512 0x8003D312 0x8003E112 0x8003EF12 0x8003FD12 0x80040B12 0x80041912 0x80042712 0x80043512 0x80044312 0x80045112 0x80045F12 0x80046D12 0x80047B12 0x80048912 0x80049712 0x8004A512 0x8004B312 0x8004C112 0x8004CF12 0x8004DD12 0x8004EB12 /end VAR_ADDRESS
 /end VAR_CHARACTERISTIC
 /begin VAR_CHARACTERISTIC S16_AEB_PE_PED_PGAIN_LOW EngCalVariantCriterion
  /begin VAR_ADDRESS 0x8003A90C 0x8003B70C 0x8003C50C 0x8003D30C 0x8003E10C 0x8003EF0C 0x8003FD0C 0x80040B0C 0x8004190C 0x8004270C 0x8004350C 0x8004430C 0x8004510C 0x80045F0C 0x80046D0C 0x80047B0C 0x8004890C 0x8004970C 0x8004A50C 0x8004B30C 0x8004C10C 0x8004CF0C 0x8004DD0C 0x8004EB0C /end VAR_ADDRESS
 /end VAR_CHARACTERISTIC
 /begin VAR_CHARACTERISTIC S16_AEB_PRESS_MAX BrkCalVariantCriterion
  /begin VAR_ADDRESS 0x80021050 0x80024450 0x80027850 0x8002AC50 0x8002E050 0x80031450 0x80034850 0x80037C50 /end VAR_ADDRESS
 /end VAR_CHARACTERISTIC
 /begin VAR_CHARACTERISTIC S16_AEB_TARGETG_MAX_STOP BrkCalVariantCriterion
  /begin VAR_ADDRESS 0x8002104C 0x8002444C 0x8002784C 0x8002AC4C 0x8002E04C 0x8003144C 0x8003484C 0x80037C4C /end VAR_ADDRESS
 /end VAR_CHARACTERISTIC
 /begin VAR_CHARACTERISTIC S16_AEB_TARGETG_MIN_STOP BrkCalVariantCriterion
  /begin VAR_ADDRESS 0x8002104A 0x8002444A 0x8002784A 0x8002AC4A 0x8002E04A 0x8003144A 0x8003484A 0x80037C4A /end VAR_ADDRESS
 /end VAR_CHARACTERISTIC
 /begin VAR_CHARACTERISTIC S16_AEB_TEMP_01 BrkCalVariantCriterion
  /begin VAR_ADDRESS 0x80021060 0x80024460 0x80027860 0x8002AC60 0x8002E060 0x80031460 0x80034860 0x80037C60 /end VAR_ADDRESS
 /end VAR_CHARACTERISTIC
 /begin VAR_CHARACTERISTIC S16_AEB_TEMP_02 BrkCalVariantCriterion
  /begin VAR_ADDRESS 0x80021062 0x80024462 0x80027862 0x8002AC62 0x8002E062 0x80031462 0x80034862 0x80037C62 /end VAR_ADDRESS
 /end VAR_CHARACTERISTIC
 /begin VAR_CHARACTERISTIC S16_AEB_TEMP_03 BrkCalVariantCriterion
  /begin VAR_ADDRESS 0x80021064 0x80024464 0x80027864 0x8002AC64 0x8002E064 0x80031464 0x80034864 0x80037C64 /end VAR_ADDRESS
 /end VAR_CHARACTERISTIC
 /begin VAR_CHARACTERISTIC S16_DPB_DEAD_ZONE_ERROR_HIGH BrkCalVariantCriterion
  /begin VAR_ADDRESS 0x8002107E 0x8002447E 0x8002787E 0x8002AC7E 0x8002E07E 0x8003147E 0x8003487E 0x80037C7E /end VAR_ADDRESS
 /end VAR_CHARACTERISTIC
 /begin VAR_CHARACTERISTIC S16_DPB_DEAD_ZONE_ERROR_LOW BrkCalVariantCriterion
  /begin VAR_ADDRESS 0x80021080 0x80024480 0x80027880 0x8002AC80 0x8002E080 0x80031480 0x80034880 0x80037C80 /end VAR_ADDRESS
 /end VAR_CHARACTERISTIC
 /begin VAR_CHARACTERISTIC S16_DPB_FF_TQ_GRD BrkCalVariantCriterion
  /begin VAR_ADDRESS 0x80021084 0x80024484 0x80027884 0x8002AC84 0x8002E084 0x80031484 0x80034884 0x80037C84 /end VAR_ADDRESS
 /end VAR_CHARACTERISTIC
 /begin VAR_CHARACTERISTIC S16_DPB_FF_TQ_INIT_GRD BrkCalVariantCriterion
  /begin VAR_ADDRESS 0x80021082 0x80024482 0x80027882 0x8002AC82 0x8002E082 0x80031482 0x80034882 0x80037C82 /end VAR_ADDRESS
 /end VAR_CHARACTERISTIC
 /begin VAR_CHARACTERISTIC S16_DPB_FINE_GAP_ERROR_HIGH BrkCalVariantCriterion
  /begin VAR_ADDRESS 0x8002107A 0x8002447A 0x8002787A 0x8002AC7A 0x8002E07A 0x8003147A 0x8003487A 0x80037C7A /end VAR_ADDRESS
 /end VAR_CHARACTERISTIC
 /begin VAR_CHARACTERISTIC S16_DPB_FINE_GAP_ERROR_LOW BrkCalVariantCriterion
  /begin VAR_ADDRESS 0x8002107C 0x8002447C 0x8002787C 0x8002AC7C 0x8002E07C 0x8003147C 0x8003487C 0x80037C7C /end VAR_ADDRESS
 /end VAR_CHARACTERISTIC
 /begin VAR_CHARACTERISTIC S16_DPB_FORCED_HOLD_SPD EngCalVariantCriterion
  /begin VAR_ADDRESS 0x8003A92E 0x8003B72E 0x8003C52E 0x8003D32E 0x8003E12E 0x8003EF2E 0x8003FD2E 0x80040B2E 0x8004192E 0x8004272E 0x8004352E 0x8004432E 0x8004512E 0x80045F2E 0x80046D2E 0x80047B2E 0x8004892E 0x8004972E 0x8004A52E 0x8004B32E 0x8004C12E 0x8004CF2E 0x8004DD2E 0x8004EB2E /end VAR_ADDRESS
 /end VAR_CHARACTERISTIC
 /begin VAR_CHARACTERISTIC S16_DPB_ME_MED_DGAIN EngCalVariantCriterion
  /begin VAR_ADDRESS 0x8003A94E 0x8003B74E 0x8003C54E 0x8003D34E 0x8003E14E 0x8003EF4E 0x8003FD4E 0x80040B4E 0x8004194E 0x8004274E 0x8004354E 0x8004434E 0x8004514E 0x80045F4E 0x80046D4E 0x80047B4E 0x8004894E 0x8004974E 0x8004A54E 0x8004B34E 0x8004C14E 0x8004CF4E 0x8004DD4E 0x8004EB4E /end VAR_ADDRESS
 /end VAR_CHARACTERISTIC
 /begin VAR_CHARACTERISTIC S16_DPB_ME_MED_IGAIN EngCalVariantCriterion
  /begin VAR_ADDRESS 0x8003A94C 0x8003B74C 0x8003C54C 0x8003D34C 0x8003E14C 0x8003EF4C 0x8003FD4C 0x80040B4C 0x8004194C 0x8004274C 0x8004354C 0x8004434C 0x8004514C 0x80045F4C 0x80046D4C 0x80047B4C 0x8004894C 0x8004974C 0x8004A54C 0x8004B34C 0x8004C14C 0x8004CF4C 0x8004DD4C 0x8004EB4C /end VAR_ADDRESS
 /end VAR_CHARACTERISTIC
 /begin VAR_CHARACTERISTIC S16_DPB_ME_MED_PGAIN EngCalVariantCriterion
  /begin VAR_ADDRESS 0x8003A94A 0x8003B74A 0x8003C54A 0x8003D34A 0x8003E14A 0x8003EF4A 0x8003FD4A 0x80040B4A 0x8004194A 0x8004274A 0x8004354A 0x8004434A 0x8004514A 0x80045F4A 0x80046D4A 0x80047B4A 0x8004894A 0x8004974A 0x8004A54A 0x8004B34A 0x8004C14A 0x8004CF4A 0x8004DD4A 0x8004EB4A /end VAR_ADDRESS
 /end VAR_CHARACTERISTIC
 /begin VAR_CHARACTERISTIC S16_DPB_ME_PED_DGAIN EngCalVariantCriterion
  /begin VAR_ADDRESS 0x8003A948 0x8003B748 0x8003C548 0x8003D348 0x8003E148 0x8003EF48 0x8003FD48 0x80040B48 0x80041948 0x80042748 0x80043548 0x80044348 0x80045148 0x80045F48 0x80046D48 0x80047B48 0x80048948 0x80049748 0x8004A548 0x8004B348 0x8004C148 0x8004CF48 0x8004DD48 0x8004EB48 /end VAR_ADDRESS
 /end VAR_CHARACTERISTIC
 /begin VAR_CHARACTERISTIC S16_DPB_ME_PED_IGAIN EngCalVariantCriterion
  /begin VAR_ADDRESS 0x8003A946 0x8003B746 0x8003C546 0x8003D346 0x8003E146 0x8003EF46 0x8003FD46 0x80040B46 0x80041946 0x80042746 0x80043546 0x80044346 0x80045146 0x80045F46 0x80046D46 0x80047B46 0x80048946 0x80049746 0x8004A546 0x8004B346 0x8004C146 0x8004CF46 0x8004DD46 0x8004EB46 /end VAR_ADDRESS
 /end VAR_CHARACTERISTIC
 /begin VAR_CHARACTERISTIC S16_DPB_ME_PED_PGAIN EngCalVariantCriterion
  /begin VAR_ADDRESS 0x8003A944 0x8003B744 0x8003C544 0x8003D344 0x8003E144 0x8003EF44 0x8003FD44 0x80040B44 0x80041944 0x80042744 0x80043544 0x80044344 0x80045144 0x80045F44 0x80046D44 0x80047B44 0x80048944 0x80049744 0x8004A544 0x8004B344 0x8004C144 0x8004CF44 0x8004DD44 0x8004EB44 /end VAR_ADDRESS
 /end VAR_CHARACTERISTIC
 /begin VAR_CHARACTERISTIC S16_DPB_PE_MED_DGAIN EngCalVariantCriterion
  /begin VAR_ADDRESS 0x8003A942 0x8003B742 0x8003C542 0x8003D342 0x8003E142 0x8003EF42 0x8003FD42 0x80040B42 0x80041942 0x80042742 0x80043542 0x80044342 0x80045142 0x80045F42 0x80046D42 0x80047B42 0x80048942 0x80049742 0x8004A542 0x8004B342 0x8004C142 0x8004CF42 0x8004DD42 0x8004EB42 /end VAR_ADDRESS
 /end VAR_CHARACTERISTIC
 /begin VAR_CHARACTERISTIC S16_DPB_PE_MED_IGAIN EngCalVariantCriterion
  /begin VAR_ADDRESS 0x8003A940 0x8003B740 0x8003C540 0x8003D340 0x8003E140 0x8003EF40 0x8003FD40 0x80040B40 0x80041940 0x80042740 0x80043540 0x80044340 0x80045140 0x80045F40 0x80046D40 0x80047B40 0x80048940 0x80049740 0x8004A540 0x8004B340 0x8004C140 0x8004CF40 0x8004DD40 0x8004EB40 /end VAR_ADDRESS
 /end VAR_CHARACTERISTIC
 /begin VAR_CHARACTERISTIC S16_DPB_PE_MED_PGAIN EngCalVariantCriterion
  /begin VAR_ADDRESS 0x8003A93E 0x8003B73E 0x8003C53E 0x8003D33E 0x8003E13E 0x8003EF3E 0x8003FD3E 0x80040B3E 0x8004193E 0x8004273E 0x8004353E 0x8004433E 0x8004513E 0x80045F3E 0x80046D3E 0x80047B3E 0x8004893E 0x8004973E 0x8004A53E 0x8004B33E 0x8004C13E 0x8004CF3E 0x8004DD3E 0x8004EB3E /end VAR_ADDRESS
 /end VAR_CHARACTERISTIC
 /begin VAR_CHARACTERISTIC S16_DPB_PE_PED_DGAIN EngCalVariantCriterion
  /begin VAR_ADDRESS 0x8003A93C 0x8003B73C 0x8003C53C 0x8003D33C 0x8003E13C 0x8003EF3C 0x8003FD3C 0x80040B3C 0x8004193C 0x8004273C 0x8004353C 0x8004433C 0x8004513C 0x80045F3C 0x80046D3C 0x80047B3C 0x8004893C 0x8004973C 0x8004A53C 0x8004B33C 0x8004C13C 0x8004CF3C 0x8004DD3C 0x8004EB3C /end VAR_ADDRESS
 /end VAR_CHARACTERISTIC
 /begin VAR_CHARACTERISTIC S16_DPB_PE_PED_IGAIN EngCalVariantCriterion
  /begin VAR_ADDRESS 0x8003A93A 0x8003B73A 0x8003C53A 0x8003D33A 0x8003E13A 0x8003EF3A 0x8003FD3A 0x80040B3A 0x8004193A 0x8004273A 0x8004353A 0x8004433A 0x8004513A 0x80045F3A 0x80046D3A 0x80047B3A 0x8004893A 0x8004973A 0x8004A53A 0x8004B33A 0x8004C13A 0x8004CF3A 0x8004DD3A 0x8004EB3A /end VAR_ADDRESS
 /end VAR_CHARACTERISTIC
 /begin VAR_CHARACTERISTIC S16_DPB_PE_PED_PGAIN EngCalVariantCriterion
  /begin VAR_ADDRESS 0x8003A938 0x8003B738 0x8003C538 0x8003D338 0x8003E138 0x8003EF38 0x8003FD38 0x80040B38 0x80041938 0x80042738 0x80043538 0x80044338 0x80045138 0x80045F38 0x80046D38 0x80047B38 0x80048938 0x80049738 0x8004A538 0x8004B338 0x8004C138 0x8004CF38 0x8004DD38 0x8004EB38 /end VAR_ADDRESS
 /end VAR_CHARACTERISTIC
 /begin VAR_CHARACTERISTIC S16_DPB_TARGET_DECEL EngCalVariantCriterion
  /begin VAR_ADDRESS 0x8003A92C 0x8003B72C 0x8003C52C 0x8003D32C 0x8003E12C 0x8003EF2C 0x8003FD2C 0x80040B2C 0x8004192C 0x8004272C 0x8004352C 0x8004432C 0x8004512C 0x80045F2C 0x80046D2C 0x80047B2C 0x8004892C 0x8004972C 0x8004A52C 0x8004B32C 0x8004C12C 0x8004CF2C 0x8004DD2C 0x8004EB2C /end VAR_ADDRESS
 /end VAR_CHARACTERISTIC
 /begin VAR_CHARACTERISTIC S16_DPB_TQ_D_GRD_D_GAIN BrkCalVariantCriterion
  /begin VAR_ADDRESS 0x80021076 0x80024476 0x80027876 0x8002AC76 0x8002E076 0x80031476 0x80034876 0x80037C76 /end VAR_ADDRESS
 /end VAR_CHARACTERISTIC
 /begin VAR_CHARACTERISTIC S16_DPB_TQ_D_GRD_I_GAIN BrkCalVariantCriterion
  /begin VAR_ADDRESS 0x80021078 0x80024478 0x80027878 0x8002AC78 0x8002E078 0x80031478 0x80034878 0x80037C78 /end VAR_ADDRESS
 /end VAR_CHARACTERISTIC
 /begin VAR_CHARACTERISTIC S16_DPB_TQ_GRD_DUMP_TH BrkCalVariantCriterion
  /begin VAR_ADDRESS 0x8002108A 0x8002448A 0x8002788A 0x8002AC8A 0x8002E08A 0x8003148A 0x8003488A 0x80037C8A /end VAR_ADDRESS
 /end VAR_CHARACTERISTIC
 /begin VAR_CHARACTERISTIC S16_DPB_TQ_P_GRD_P_GAIN BrkCalVariantCriterion
  /begin VAR_ADDRESS 0x80021074 0x80024474 0x80027874 0x8002AC74 0x8002E074 0x80031474 0x80034874 0x80037C74 /end VAR_ADDRESS
 /end VAR_CHARACTERISTIC
 /begin VAR_CHARACTERISTIC S16_VLC_BRAKE_CONTROL_MIN_TORQUE EngCalVariantCriterion
  /begin VAR_ADDRESS 0x8003A8CC 0x8003B6CC 0x8003C4CC 0x8003D2CC 0x8003E0CC 0x8003EECC 0x8003FCCC 0x80040ACC 0x800418CC 0x800426CC 0x800434CC 0x800442CC 0x800450CC 0x80045ECC 0x80046CCC 0x80047ACC 0x800488CC 0x800496CC 0x8004A4CC 0x8004B2CC 0x8004C0CC 0x8004CECC 0x8004DCCC 0x8004EACC /end VAR_ADDRESS
 /end VAR_CHARACTERISTIC
 /begin VAR_CHARACTERISTIC S16_VLC_MAX_ENGINE_DRAG_TORQUE_COMP EngCalVariantCriterion
  /begin VAR_ADDRESS 0x8003A8CE 0x8003B6CE 0x8003C4CE 0x8003D2CE 0x8003E0CE 0x8003EECE 0x8003FCCE 0x80040ACE 0x800418CE 0x800426CE 0x800434CE 0x800442CE 0x800450CE 0x80045ECE 0x80046CCE 0x80047ACE 0x800488CE 0x800496CE 0x8004A4CE 0x8004B2CE 0x8004C0CE 0x8004CECE 0x8004DCCE 0x8004EACE /end VAR_ADDRESS
 /end VAR_CHARACTERISTIC
 /begin VAR_CHARACTERISTIC S16_WPE_Caliper_Model_Press_1 BrkCalVariantCriterion
  /begin VAR_ADDRESS 0x8002155A 0x8002495A 0x80027D5A 0x8002B15A 0x8002E55A 0x8003195A 0x80034D5A 0x8003815A /end VAR_ADDRESS
 /end VAR_CHARACTERISTIC
 /begin VAR_CHARACTERISTIC S16_WPE_Caliper_Model_Press_10 BrkCalVariantCriterion
  /begin VAR_ADDRESS 0x8002156C 0x8002496C 0x80027D6C 0x8002B16C 0x8002E56C 0x8003196C 0x80034D6C 0x8003816C /end VAR_ADDRESS
 /end VAR_CHARACTERISTIC
 /begin VAR_CHARACTERISTIC S16_WPE_Caliper_Model_Press_11 BrkCalVariantCriterion
  /begin VAR_ADDRESS 0x8002156E 0x8002496E 0x80027D6E 0x8002B16E 0x8002E56E 0x8003196E 0x80034D6E 0x8003816E /end VAR_ADDRESS
 /end VAR_CHARACTERISTIC
 /begin VAR_CHARACTERISTIC S16_WPE_Caliper_Model_Press_12 BrkCalVariantCriterion
  /begin VAR_ADDRESS 0x80021570 0x80024970 0x80027D70 0x8002B170 0x8002E570 0x80031970 0x80034D70 0x80038170 /end VAR_ADDRESS
 /end VAR_CHARACTERISTIC
 /begin VAR_CHARACTERISTIC S16_WPE_Caliper_Model_Press_13 BrkCalVariantCriterion
  /begin VAR_ADDRESS 0x80021572 0x80024972 0x80027D72 0x8002B172 0x8002E572 0x80031972 0x80034D72 0x80038172 /end VAR_ADDRESS
 /end VAR_CHARACTERISTIC
 /begin VAR_CHARACTERISTIC S16_WPE_Caliper_Model_Press_14 BrkCalVariantCriterion
  /begin VAR_ADDRESS 0x80021574 0x80024974 0x80027D74 0x8002B174 0x8002E574 0x80031974 0x80034D74 0x80038174 /end VAR_ADDRESS
 /end VAR_CHARACTERISTIC
 /begin VAR_CHARACTERISTIC S16_WPE_Caliper_Model_Press_15 BrkCalVariantCriterion
  /begin VAR_ADDRESS 0x80021576 0x80024976 0x80027D76 0x8002B176 0x8002E576 0x80031976 0x80034D76 0x80038176 /end VAR_ADDRESS
 /end VAR_CHARACTERISTIC
 /begin VAR_CHARACTERISTIC S16_WPE_Caliper_Model_Press_16 BrkCalVariantCriterion
  /begin VAR_ADDRESS 0x80021578 0x80024978 0x80027D78 0x8002B178 0x8002E578 0x80031978 0x80034D78 0x80038178 /end VAR_ADDRESS
 /end VAR_CHARACTERISTIC
 /begin VAR_CHARACTERISTIC S16_WPE_Caliper_Model_Press_2 BrkCalVariantCriterion
  /begin VAR_ADDRESS 0x8002155C 0x8002495C 0x80027D5C 0x8002B15C 0x8002E55C 0x8003195C 0x80034D5C 0x8003815C /end VAR_ADDRESS
 /end VAR_CHARACTERISTIC
 /begin VAR_CHARACTERISTIC S16_WPE_Caliper_Model_Press_3 BrkCalVariantCriterion
  /begin VAR_ADDRESS 0x8002155E 0x8002495E 0x80027D5E 0x8002B15E 0x8002E55E 0x8003195E 0x80034D5E 0x8003815E /end VAR_ADDRESS
 /end VAR_CHARACTERISTIC
 /begin VAR_CHARACTERISTIC S16_WPE_Caliper_Model_Press_4 BrkCalVariantCriterion
  /begin VAR_ADDRESS 0x80021560 0x80024960 0x80027D60 0x8002B160 0x8002E560 0x80031960 0x80034D60 0x80038160 /end VAR_ADDRESS
 /end VAR_CHARACTERISTIC
 /begin VAR_CHARACTERISTIC S16_WPE_Caliper_Model_Press_5 BrkCalVariantCriterion
  /begin VAR_ADDRESS 0x80021562 0x80024962 0x80027D62 0x8002B162 0x8002E562 0x80031962 0x80034D62 0x80038162 /end VAR_ADDRESS
 /end VAR_CHARACTERISTIC
 /begin VAR_CHARACTERISTIC S16_WPE_Caliper_Model_Press_6 BrkCalVariantCriterion
  /begin VAR_ADDRESS 0x80021564 0x80024964 0x80027D64 0x8002B164 0x8002E564 0x80031964 0x80034D64 0x80038164 /end VAR_ADDRESS
 /end VAR_CHARACTERISTIC
 /begin VAR_CHARACTERISTIC S16_WPE_Caliper_Model_Press_7 BrkCalVariantCriterion
  /begin VAR_ADDRESS 0x80021566 0x80024966 0x80027D66 0x8002B166 0x8002E566 0x80031966 0x80034D66 0x80038166 /end VAR_ADDRESS
 /end VAR_CHARACTERISTIC
 /begin VAR_CHARACTERISTIC S16_WPE_Caliper_Model_Press_8 BrkCalVariantCriterion
  /begin VAR_ADDRESS 0x80021568 0x80024968 0x80027D68 0x8002B168 0x8002E568 0x80031968 0x80034D68 0x80038168 /end VAR_ADDRESS
 /end VAR_CHARACTERISTIC
 /begin VAR_CHARACTERISTIC S16_WPE_Caliper_Model_Press_9 BrkCalVariantCriterion
  /begin VAR_ADDRESS 0x8002156A 0x8002496A 0x80027D6A 0x8002B16A 0x8002E56A 0x8003196A 0x80034D6A 0x8003816A /end VAR_ADDRESS
 /end VAR_CHARACTERISTIC
 /begin VAR_CHARACTERISTIC S16_WPE_Caliper_Model_Volume_No_f BrkCalVariantCriterion
  /begin VAR_ADDRESS 0x80021556 0x80024956 0x80027D56 0x8002B156 0x8002E556 0x80031956 0x80034D56 0x80038156 /end VAR_ADDRESS
 /end VAR_CHARACTERISTIC
 /begin VAR_CHARACTERISTIC S16_WPE_Caliper_Model_Volume_No_r BrkCalVariantCriterion
  /begin VAR_ADDRESS 0x80021558 0x80024958 0x80027D58 0x8002B158 0x8002E558 0x80031958 0x80034D58 0x80038158 /end VAR_ADDRESS
 /end VAR_CHARACTERISTIC
 /begin VAR_CHARACTERISTIC S16_WPE_Caliper_Model_Volume_f_1 BrkCalVariantCriterion
  /begin VAR_ADDRESS 0x8002157A 0x8002497A 0x80027D7A 0x8002B17A 0x8002E57A 0x8003197A 0x80034D7A 0x8003817A /end VAR_ADDRESS
 /end VAR_CHARACTERISTIC
 /begin VAR_CHARACTERISTIC S16_WPE_Caliper_Model_Volume_f_10 BrkCalVariantCriterion
  /begin VAR_ADDRESS 0x8002158C 0x8002498C 0x80027D8C 0x8002B18C 0x8002E58C 0x8003198C 0x80034D8C 0x8003818C /end VAR_ADDRESS
 /end VAR_CHARACTERISTIC
 /begin VAR_CHARACTERISTIC S16_WPE_Caliper_Model_Volume_f_11 BrkCalVariantCriterion
  /begin VAR_ADDRESS 0x8002158E 0x8002498E 0x80027D8E 0x8002B18E 0x8002E58E 0x8003198E 0x80034D8E 0x8003818E /end VAR_ADDRESS
 /end VAR_CHARACTERISTIC
 /begin VAR_CHARACTERISTIC S16_WPE_Caliper_Model_Volume_f_12 BrkCalVariantCriterion
  /begin VAR_ADDRESS 0x80021590 0x80024990 0x80027D90 0x8002B190 0x8002E590 0x80031990 0x80034D90 0x80038190 /end VAR_ADDRESS
 /end VAR_CHARACTERISTIC
 /begin VAR_CHARACTERISTIC S16_WPE_Caliper_Model_Volume_f_13 BrkCalVariantCriterion
  /begin VAR_ADDRESS 0x80021592 0x80024992 0x80027D92 0x8002B192 0x8002E592 0x80031992 0x80034D92 0x80038192 /end VAR_ADDRESS
 /end VAR_CHARACTERISTIC
 /begin VAR_CHARACTERISTIC S16_WPE_Caliper_Model_Volume_f_14 BrkCalVariantCriterion
  /begin VAR_ADDRESS 0x80021594 0x80024994 0x80027D94 0x8002B194 0x8002E594 0x80031994 0x80034D94 0x80038194 /end VAR_ADDRESS
 /end VAR_CHARACTERISTIC
 /begin VAR_CHARACTERISTIC S16_WPE_Caliper_Model_Volume_f_15 BrkCalVariantCriterion
  /begin VAR_ADDRESS 0x80021596 0x80024996 0x80027D96 0x8002B196 0x8002E596 0x80031996 0x80034D96 0x80038196 /end VAR_ADDRESS
 /end VAR_CHARACTERISTIC
 /begin VAR_CHARACTERISTIC S16_WPE_Caliper_Model_Volume_f_16 BrkCalVariantCriterion
  /begin VAR_ADDRESS 0x80021598 0x80024998 0x80027D98 0x8002B198 0x8002E598 0x80031998 0x80034D98 0x80038198 /end VAR_ADDRESS
 /end VAR_CHARACTERISTIC
 /begin VAR_CHARACTERISTIC S16_WPE_Caliper_Model_Volume_f_2 BrkCalVariantCriterion
  /begin VAR_ADDRESS 0x8002157C 0x8002497C 0x80027D7C 0x8002B17C 0x8002E57C 0x8003197C 0x80034D7C 0x8003817C /end VAR_ADDRESS
 /end VAR_CHARACTERISTIC
 /begin VAR_CHARACTERISTIC S16_WPE_Caliper_Model_Volume_f_3 BrkCalVariantCriterion
  /begin VAR_ADDRESS 0x8002157E 0x8002497E 0x80027D7E 0x8002B17E 0x8002E57E 0x8003197E 0x80034D7E 0x8003817E /end VAR_ADDRESS
 /end VAR_CHARACTERISTIC
 /begin VAR_CHARACTERISTIC S16_WPE_Caliper_Model_Volume_f_4 BrkCalVariantCriterion
  /begin VAR_ADDRESS 0x80021580 0x80024980 0x80027D80 0x8002B180 0x8002E580 0x80031980 0x80034D80 0x80038180 /end VAR_ADDRESS
 /end VAR_CHARACTERISTIC
 /begin VAR_CHARACTERISTIC S16_WPE_Caliper_Model_Volume_f_5 BrkCalVariantCriterion
  /begin VAR_ADDRESS 0x80021582 0x80024982 0x80027D82 0x8002B182 0x8002E582 0x80031982 0x80034D82 0x80038182 /end VAR_ADDRESS
 /end VAR_CHARACTERISTIC
 /begin VAR_CHARACTERISTIC S16_WPE_Caliper_Model_Volume_f_6 BrkCalVariantCriterion
  /begin VAR_ADDRESS 0x80021584 0x80024984 0x80027D84 0x8002B184 0x8002E584 0x80031984 0x80034D84 0x80038184 /end VAR_ADDRESS
 /end VAR_CHARACTERISTIC
 /begin VAR_CHARACTERISTIC S16_WPE_Caliper_Model_Volume_f_7 BrkCalVariantCriterion
  /begin VAR_ADDRESS 0x80021586 0x80024986 0x80027D86 0x8002B186 0x8002E586 0x80031986 0x80034D86 0x80038186 /end VAR_ADDRESS
 /end VAR_CHARACTERISTIC
 /begin VAR_CHARACTERISTIC S16_WPE_Caliper_Model_Volume_f_8 BrkCalVariantCriterion
  /begin VAR_ADDRESS 0x80021588 0x80024988 0x80027D88 0x8002B188 0x8002E588 0x80031988 0x80034D88 0x80038188 /end VAR_ADDRESS
 /end VAR_CHARACTERISTIC
 /begin VAR_CHARACTERISTIC S16_WPE_Caliper_Model_Volume_f_9 BrkCalVariantCriterion
  /begin VAR_ADDRESS 0x8002158A 0x8002498A 0x80027D8A 0x8002B18A 0x8002E58A 0x8003198A 0x80034D8A 0x8003818A /end VAR_ADDRESS
 /end VAR_CHARACTERISTIC
 /begin VAR_CHARACTERISTIC S16_WPE_Caliper_Model_Volume_r_1 BrkCalVariantCriterion
  /begin VAR_ADDRESS 0x8002159A 0x8002499A 0x80027D9A 0x8002B19A 0x8002E59A 0x8003199A 0x80034D9A 0x8003819A /end VAR_ADDRESS
 /end VAR_CHARACTERISTIC
 /begin VAR_CHARACTERISTIC S16_WPE_Caliper_Model_Volume_r_10 BrkCalVariantCriterion
  /begin VAR_ADDRESS 0x800215AC 0x800249AC 0x80027DAC 0x8002B1AC 0x8002E5AC 0x800319AC 0x80034DAC 0x800381AC /end VAR_ADDRESS
 /end VAR_CHARACTERISTIC
 /begin VAR_CHARACTERISTIC S16_WPE_Caliper_Model_Volume_r_11 BrkCalVariantCriterion
  /begin VAR_ADDRESS 0x800215AE 0x800249AE 0x80027DAE 0x8002B1AE 0x8002E5AE 0x800319AE 0x80034DAE 0x800381AE /end VAR_ADDRESS
 /end VAR_CHARACTERISTIC
 /begin VAR_CHARACTERISTIC S16_WPE_Caliper_Model_Volume_r_12 BrkCalVariantCriterion
  /begin VAR_ADDRESS 0x800215B0 0x800249B0 0x80027DB0 0x8002B1B0 0x8002E5B0 0x800319B0 0x80034DB0 0x800381B0 /end VAR_ADDRESS
 /end VAR_CHARACTERISTIC
 /begin VAR_CHARACTERISTIC S16_WPE_Caliper_Model_Volume_r_13 BrkCalVariantCriterion
  /begin VAR_ADDRESS 0x800215B2 0x800249B2 0x80027DB2 0x8002B1B2 0x8002E5B2 0x800319B2 0x80034DB2 0x800381B2 /end VAR_ADDRESS
 /end VAR_CHARACTERISTIC
 /begin VAR_CHARACTERISTIC S16_WPE_Caliper_Model_Volume_r_14 BrkCalVariantCriterion
  /begin VAR_ADDRESS 0x800215B4 0x800249B4 0x80027DB4 0x8002B1B4 0x8002E5B4 0x800319B4 0x80034DB4 0x800381B4 /end VAR_ADDRESS
 /end VAR_CHARACTERISTIC
 /begin VAR_CHARACTERISTIC S16_WPE_Caliper_Model_Volume_r_15 BrkCalVariantCriterion
  /begin VAR_ADDRESS 0x800215B6 0x800249B6 0x80027DB6 0x8002B1B6 0x8002E5B6 0x800319B6 0x80034DB6 0x800381B6 /end VAR_ADDRESS
 /end VAR_CHARACTERISTIC
 /begin VAR_CHARACTERISTIC S16_WPE_Caliper_Model_Volume_r_16 BrkCalVariantCriterion
  /begin VAR_ADDRESS 0x800215B8 0x800249B8 0x80027DB8 0x8002B1B8 0x8002E5B8 0x800319B8 0x80034DB8 0x800381B8 /end VAR_ADDRESS
 /end VAR_CHARACTERISTIC
 /begin VAR_CHARACTERISTIC S16_WPE_Caliper_Model_Volume_r_2 BrkCalVariantCriterion
  /begin VAR_ADDRESS 0x8002159C 0x8002499C 0x80027D9C 0x8002B19C 0x8002E59C 0x8003199C 0x80034D9C 0x8003819C /end VAR_ADDRESS
 /end VAR_CHARACTERISTIC
 /begin VAR_CHARACTERISTIC S16_WPE_Caliper_Model_Volume_r_3 BrkCalVariantCriterion
  /begin VAR_ADDRESS 0x8002159E 0x8002499E 0x80027D9E 0x8002B19E 0x8002E59E 0x8003199E 0x80034D9E 0x8003819E /end VAR_ADDRESS
 /end VAR_CHARACTERISTIC
 /begin VAR_CHARACTERISTIC S16_WPE_Caliper_Model_Volume_r_4 BrkCalVariantCriterion
  /begin VAR_ADDRESS 0x800215A0 0x800249A0 0x80027DA0 0x8002B1A0 0x8002E5A0 0x800319A0 0x80034DA0 0x800381A0 /end VAR_ADDRESS
 /end VAR_CHARACTERISTIC
 /begin VAR_CHARACTERISTIC S16_WPE_Caliper_Model_Volume_r_5 BrkCalVariantCriterion
  /begin VAR_ADDRESS 0x800215A2 0x800249A2 0x80027DA2 0x8002B1A2 0x8002E5A2 0x800319A2 0x80034DA2 0x800381A2 /end VAR_ADDRESS
 /end VAR_CHARACTERISTIC
 /begin VAR_CHARACTERISTIC S16_WPE_Caliper_Model_Volume_r_6 BrkCalVariantCriterion
  /begin VAR_ADDRESS 0x800215A4 0x800249A4 0x80027DA4 0x8002B1A4 0x8002E5A4 0x800319A4 0x80034DA4 0x800381A4 /end VAR_ADDRESS
 /end VAR_CHARACTERISTIC
 /begin VAR_CHARACTERISTIC S16_WPE_Caliper_Model_Volume_r_7 BrkCalVariantCriterion
  /begin VAR_ADDRESS 0x800215A6 0x800249A6 0x80027DA6 0x8002B1A6 0x8002E5A6 0x800319A6 0x80034DA6 0x800381A6 /end VAR_ADDRESS
 /end VAR_CHARACTERISTIC
 /begin VAR_CHARACTERISTIC S16_WPE_Caliper_Model_Volume_r_8 BrkCalVariantCriterion
  /begin VAR_ADDRESS 0x800215A8 0x800249A8 0x80027DA8 0x8002B1A8 0x8002E5A8 0x800319A8 0x80034DA8 0x800381A8 /end VAR_ADDRESS
 /end VAR_CHARACTERISTIC
 /begin VAR_CHARACTERISTIC S16_WPE_Caliper_Model_Volume_r_9 BrkCalVariantCriterion
  /begin VAR_ADDRESS 0x800215AA 0x800249AA 0x80027DAA 0x8002B1AA 0x8002E5AA 0x800319AA 0x80034DAA 0x800381AA /end VAR_ADDRESS
 /end VAR_CHARACTERISTIC
 /begin VAR_CHARACTERISTIC S16_WPE_LFC_ESC_MP_Rise_Gain_f_1st BrkCalVariantCriterion
  /begin VAR_ADDRESS 0x80021750 0x80024B50 0x80027F50 0x8002B350 0x8002E750 0x80031B50 0x80034F50 0x80038350 /end VAR_ADDRESS
 /end VAR_CHARACTERISTIC
 /begin VAR_CHARACTERISTIC S16_WPE_LFC_ESC_MP_Rise_Gain_f_2nd BrkCalVariantCriterion
  /begin VAR_ADDRESS 0x80021752 0x80024B52 0x80027F52 0x8002B352 0x8002E752 0x80031B52 0x80034F52 0x80038352 /end VAR_ADDRESS
 /end VAR_CHARACTERISTIC
 /begin VAR_CHARACTERISTIC S16_WPE_LFC_ESC_MP_Rise_Gain_f_3rd BrkCalVariantCriterion
  /begin VAR_ADDRESS 0x80021754 0x80024B54 0x80027F54 0x8002B354 0x8002E754 0x80031B54 0x80034F54 0x80038354 /end VAR_ADDRESS
 /end VAR_CHARACTERISTIC
 /begin VAR_CHARACTERISTIC S16_WPE_LFC_ESC_MP_Rise_Gain_f_4th BrkCalVariantCriterion
  /begin VAR_ADDRESS 0x80021756 0x80024B56 0x80027F56 0x8002B356 0x8002E756 0x80031B56 0x80034F56 0x80038356 /end VAR_ADDRESS
 /end VAR_CHARACTERISTIC
 /begin VAR_CHARACTERISTIC S16_WPE_LFC_ESC_MP_Rise_Gain_f_5th BrkCalVariantCriterion
  /begin VAR_ADDRESS 0x80021758 0x80024B58 0x80027F58 0x8002B358 0x8002E758 0x80031B58 0x80034F58 0x80038358 /end VAR_ADDRESS
 /end VAR_CHARACTERISTIC
 /begin VAR_CHARACTERISTIC S16_WPE_LFC_ESC_MP_Rise_Gain_f_6th BrkCalVariantCriterion
  /begin VAR_ADDRESS 0x8002175A 0x80024B5A 0x80027F5A 0x8002B35A 0x8002E75A 0x80031B5A 0x80034F5A 0x8003835A /end VAR_ADDRESS
 /end VAR_CHARACTERISTIC
 /begin VAR_CHARACTERISTIC S16_WPE_LFC_ESC_MP_Rise_Gain_r_1st BrkCalVariantCriterion
  /begin VAR_ADDRESS 0x80021762 0x80024B62 0x80027F62 0x8002B362 0x8002E762 0x80031B62 0x80034F62 0x80038362 /end VAR_ADDRESS
 /end VAR_CHARACTERISTIC
 /begin VAR_CHARACTERISTIC S16_WPE_LFC_ESC_MP_Rise_Gain_r_2nd BrkCalVariantCriterion
  /begin VAR_ADDRESS 0x80021764 0x80024B64 0x80027F64 0x8002B364 0x8002E764 0x80031B64 0x80034F64 0x80038364 /end VAR_ADDRESS
 /end VAR_CHARACTERISTIC
 /begin VAR_CHARACTERISTIC S16_WPE_LFC_ESC_MP_Rise_Gain_r_3rd BrkCalVariantCriterion
  /begin VAR_ADDRESS 0x80021766 0x80024B66 0x80027F66 0x8002B366 0x8002E766 0x80031B66 0x80034F66 0x80038366 /end VAR_ADDRESS
 /end VAR_CHARACTERISTIC
 /begin VAR_CHARACTERISTIC S16_WPE_LFC_ESC_MP_Rise_Gain_r_4th BrkCalVariantCriterion
  /begin VAR_ADDRESS 0x80021768 0x80024B68 0x80027F68 0x8002B368 0x8002E768 0x80031B68 0x80034F68 0x80038368 /end VAR_ADDRESS
 /end VAR_CHARACTERISTIC
 /begin VAR_CHARACTERISTIC S16_WPE_LFC_ESC_MP_Rise_Gain_r_5th BrkCalVariantCriterion
  /begin VAR_ADDRESS 0x8002176A 0x80024B6A 0x80027F6A 0x8002B36A 0x8002E76A 0x80031B6A 0x80034F6A 0x8003836A /end VAR_ADDRESS
 /end VAR_CHARACTERISTIC
 /begin VAR_CHARACTERISTIC S16_WPE_LFC_ESC_MP_Rise_Gain_r_6th BrkCalVariantCriterion
  /begin VAR_ADDRESS 0x8002176C 0x80024B6C 0x80027F6C 0x8002B36C 0x8002E76C 0x80031B6C 0x80034F6C 0x8003836C /end VAR_ADDRESS
 /end VAR_CHARACTERISTIC
 /begin VAR_CHARACTERISTIC S16_WPE_LFC_ESC_Rise_Gain_2_f_1st BrkCalVariantCriterion
  /begin VAR_ADDRESS 0x80021726 0x80024B26 0x80027F26 0x8002B326 0x8002E726 0x80031B26 0x80034F26 0x80038326 /end VAR_ADDRESS
 /end VAR_CHARACTERISTIC
 /begin VAR_CHARACTERISTIC S16_WPE_LFC_ESC_Rise_Gain_2_f_2nd BrkCalVariantCriterion
  /begin VAR_ADDRESS 0x80021728 0x80024B28 0x80027F28 0x8002B328 0x8002E728 0x80031B28 0x80034F28 0x80038328 /end VAR_ADDRESS
 /end VAR_CHARACTERISTIC
 /begin VAR_CHARACTERISTIC S16_WPE_LFC_ESC_Rise_Gain_2_f_3rd BrkCalVariantCriterion
  /begin VAR_ADDRESS 0x8002172A 0x80024B2A 0x80027F2A 0x8002B32A 0x8002E72A 0x80031B2A 0x80034F2A 0x8003832A /end VAR_ADDRESS
 /end VAR_CHARACTERISTIC
 /begin VAR_CHARACTERISTIC S16_WPE_LFC_ESC_Rise_Gain_2_f_4th BrkCalVariantCriterion
  /begin VAR_ADDRESS 0x8002172C 0x80024B2C 0x80027F2C 0x8002B32C 0x8002E72C 0x80031B2C 0x80034F2C 0x8003832C /end VAR_ADDRESS
 /end VAR_CHARACTERISTIC
 /begin VAR_CHARACTERISTIC S16_WPE_LFC_ESC_Rise_Gain_2_f_5th BrkCalVariantCriterion
  /begin VAR_ADDRESS 0x8002172E 0x80024B2E 0x80027F2E 0x8002B32E 0x8002E72E 0x80031B2E 0x80034F2E 0x8003832E /end VAR_ADDRESS
 /end VAR_CHARACTERISTIC
 /begin VAR_CHARACTERISTIC S16_WPE_LFC_ESC_Rise_Gain_2_f_6th BrkCalVariantCriterion
  /begin VAR_ADDRESS 0x80021730 0x80024B30 0x80027F30 0x8002B330 0x8002E730 0x80031B30 0x80034F30 0x80038330 /end VAR_ADDRESS
 /end VAR_CHARACTERISTIC
 /begin VAR_CHARACTERISTIC S16_WPE_LFC_ESC_Rise_Gain_2_r_1st BrkCalVariantCriterion
  /begin VAR_ADDRESS 0x8002173E 0x80024B3E 0x80027F3E 0x8002B33E 0x8002E73E 0x80031B3E 0x80034F3E 0x8003833E /end VAR_ADDRESS
 /end VAR_CHARACTERISTIC
 /begin VAR_CHARACTERISTIC S16_WPE_LFC_ESC_Rise_Gain_2_r_2nd BrkCalVariantCriterion
  /begin VAR_ADDRESS 0x80021740 0x80024B40 0x80027F40 0x8002B340 0x8002E740 0x80031B40 0x80034F40 0x80038340 /end VAR_ADDRESS
 /end VAR_CHARACTERISTIC
 /begin VAR_CHARACTERISTIC S16_WPE_LFC_ESC_Rise_Gain_2_r_3rd BrkCalVariantCriterion
  /begin VAR_ADDRESS 0x80021742 0x80024B42 0x80027F42 0x8002B342 0x8002E742 0x80031B42 0x80034F42 0x80038342 /end VAR_ADDRESS
 /end VAR_CHARACTERISTIC
 /begin VAR_CHARACTERISTIC S16_WPE_LFC_ESC_Rise_Gain_2_r_4th BrkCalVariantCriterion
  /begin VAR_ADDRESS 0x80021744 0x80024B44 0x80027F44 0x8002B344 0x8002E744 0x80031B44 0x80034F44 0x80038344 /end VAR_ADDRESS
 /end VAR_CHARACTERISTIC
 /begin VAR_CHARACTERISTIC S16_WPE_LFC_ESC_Rise_Gain_2_r_5th BrkCalVariantCriterion
  /begin VAR_ADDRESS 0x80021746 0x80024B46 0x80027F46 0x8002B346 0x8002E746 0x80031B46 0x80034F46 0x80038346 /end VAR_ADDRESS
 /end VAR_CHARACTERISTIC
 /begin VAR_CHARACTERISTIC S16_WPE_LFC_ESC_Rise_Gain_2_r_6th BrkCalVariantCriterion
  /begin VAR_ADDRESS 0x80021748 0x80024B48 0x80027F48 0x8002B348 0x8002E748 0x80031B48 0x80034F48 0x80038348 /end VAR_ADDRESS
 /end VAR_CHARACTERISTIC
 /begin VAR_CHARACTERISTIC S16_WPE_LFC_ESC_Rise_Gain_f_1st BrkCalVariantCriterion
  /begin VAR_ADDRESS 0x800216FC 0x80024AFC 0x80027EFC 0x8002B2FC 0x8002E6FC 0x80031AFC 0x80034EFC 0x800382FC /end VAR_ADDRESS
 /end VAR_CHARACTERISTIC
 /begin VAR_CHARACTERISTIC S16_WPE_LFC_ESC_Rise_Gain_f_2nd BrkCalVariantCriterion
  /begin VAR_ADDRESS 0x800216FE 0x80024AFE 0x80027EFE 0x8002B2FE 0x8002E6FE 0x80031AFE 0x80034EFE 0x800382FE /end VAR_ADDRESS
 /end VAR_CHARACTERISTIC
 /begin VAR_CHARACTERISTIC S16_WPE_LFC_ESC_Rise_Gain_f_3rd BrkCalVariantCriterion
  /begin VAR_ADDRESS 0x80021700 0x80024B00 0x80027F00 0x8002B300 0x8002E700 0x80031B00 0x80034F00 0x80038300 /end VAR_ADDRESS
 /end VAR_CHARACTERISTIC
 /begin VAR_CHARACTERISTIC S16_WPE_LFC_ESC_Rise_Gain_f_4th BrkCalVariantCriterion
  /begin VAR_ADDRESS 0x80021702 0x80024B02 0x80027F02 0x8002B302 0x8002E702 0x80031B02 0x80034F02 0x80038302 /end VAR_ADDRESS
 /end VAR_CHARACTERISTIC
 /begin VAR_CHARACTERISTIC S16_WPE_LFC_ESC_Rise_Gain_f_5th BrkCalVariantCriterion
  /begin VAR_ADDRESS 0x80021704 0x80024B04 0x80027F04 0x8002B304 0x8002E704 0x80031B04 0x80034F04 0x80038304 /end VAR_ADDRESS
 /end VAR_CHARACTERISTIC
 /begin VAR_CHARACTERISTIC S16_WPE_LFC_ESC_Rise_Gain_f_6th BrkCalVariantCriterion
  /begin VAR_ADDRESS 0x80021706 0x80024B06 0x80027F06 0x8002B306 0x8002E706 0x80031B06 0x80034F06 0x80038306 /end VAR_ADDRESS
 /end VAR_CHARACTERISTIC
 /begin VAR_CHARACTERISTIC S16_WPE_LFC_ESC_Rise_Gain_r_1st BrkCalVariantCriterion
  /begin VAR_ADDRESS 0x8002170E 0x80024B0E 0x80027F0E 0x8002B30E 0x8002E70E 0x80031B0E 0x80034F0E 0x8003830E /end VAR_ADDRESS
 /end VAR_CHARACTERISTIC
 /begin VAR_CHARACTERISTIC S16_WPE_LFC_ESC_Rise_Gain_r_2nd BrkCalVariantCriterion
  /begin VAR_ADDRESS 0x80021710 0x80024B10 0x80027F10 0x8002B310 0x8002E710 0x80031B10 0x80034F10 0x80038310 /end VAR_ADDRESS
 /end VAR_CHARACTERISTIC
 /begin VAR_CHARACTERISTIC S16_WPE_LFC_ESC_Rise_Gain_r_3rd BrkCalVariantCriterion
  /begin VAR_ADDRESS 0x80021712 0x80024B12 0x80027F12 0x8002B312 0x8002E712 0x80031B12 0x80034F12 0x80038312 /end VAR_ADDRESS
 /end VAR_CHARACTERISTIC
 /begin VAR_CHARACTERISTIC S16_WPE_LFC_ESC_Rise_Gain_r_4th BrkCalVariantCriterion
  /begin VAR_ADDRESS 0x80021714 0x80024B14 0x80027F14 0x8002B314 0x8002E714 0x80031B14 0x80034F14 0x80038314 /end VAR_ADDRESS
 /end VAR_CHARACTERISTIC
 /begin VAR_CHARACTERISTIC S16_WPE_LFC_ESC_Rise_Gain_r_5th BrkCalVariantCriterion
  /begin VAR_ADDRESS 0x80021716 0x80024B16 0x80027F16 0x8002B316 0x8002E716 0x80031B16 0x80034F16 0x80038316 /end VAR_ADDRESS
 /end VAR_CHARACTERISTIC
 /begin VAR_CHARACTERISTIC S16_WPE_LFC_ESC_Rise_Gain_r_6th BrkCalVariantCriterion
  /begin VAR_ADDRESS 0x80021718 0x80024B18 0x80027F18 0x8002B318 0x8002E718 0x80031B18 0x80034F18 0x80038318 /end VAR_ADDRESS
 /end VAR_CHARACTERISTIC
 /begin VAR_CHARACTERISTIC S16_WPE_LFC_ESC_Rise_Press_f_1st BrkCalVariantCriterion
  /begin VAR_ADDRESS 0x8002171A 0x80024B1A 0x80027F1A 0x8002B31A 0x8002E71A 0x80031B1A 0x80034F1A 0x8003831A /end VAR_ADDRESS
 /end VAR_CHARACTERISTIC
 /begin VAR_CHARACTERISTIC S16_WPE_LFC_ESC_Rise_Press_f_2nd BrkCalVariantCriterion
  /begin VAR_ADDRESS 0x8002171C 0x80024B1C 0x80027F1C 0x8002B31C 0x8002E71C 0x80031B1C 0x80034F1C 0x8003831C /end VAR_ADDRESS
 /end VAR_CHARACTERISTIC
 /begin VAR_CHARACTERISTIC S16_WPE_LFC_ESC_Rise_Press_f_3rd BrkCalVariantCriterion
  /begin VAR_ADDRESS 0x8002171E 0x80024B1E 0x80027F1E 0x8002B31E 0x8002E71E 0x80031B1E 0x80034F1E 0x8003831E /end VAR_ADDRESS
 /end VAR_CHARACTERISTIC
 /begin VAR_CHARACTERISTIC S16_WPE_LFC_ESC_Rise_Press_f_4th BrkCalVariantCriterion
  /begin VAR_ADDRESS 0x80021720 0x80024B20 0x80027F20 0x8002B320 0x8002E720 0x80031B20 0x80034F20 0x80038320 /end VAR_ADDRESS
 /end VAR_CHARACTERISTIC
 /begin VAR_CHARACTERISTIC S16_WPE_LFC_ESC_Rise_Press_f_5th BrkCalVariantCriterion
  /begin VAR_ADDRESS 0x80021722 0x80024B22 0x80027F22 0x8002B322 0x8002E722 0x80031B22 0x80034F22 0x80038322 /end VAR_ADDRESS
 /end VAR_CHARACTERISTIC
 /begin VAR_CHARACTERISTIC S16_WPE_LFC_ESC_Rise_Press_f_6th BrkCalVariantCriterion
  /begin VAR_ADDRESS 0x80021724 0x80024B24 0x80027F24 0x8002B324 0x8002E724 0x80031B24 0x80034F24 0x80038324 /end VAR_ADDRESS
 /end VAR_CHARACTERISTIC
 /begin VAR_CHARACTERISTIC S16_WPE_LFC_ESC_Rise_Press_r_1st BrkCalVariantCriterion
  /begin VAR_ADDRESS 0x80021732 0x80024B32 0x80027F32 0x8002B332 0x8002E732 0x80031B32 0x80034F32 0x80038332 /end VAR_ADDRESS
 /end VAR_CHARACTERISTIC
 /begin VAR_CHARACTERISTIC S16_WPE_LFC_ESC_Rise_Press_r_2nd BrkCalVariantCriterion
  /begin VAR_ADDRESS 0x80021734 0x80024B34 0x80027F34 0x8002B334 0x8002E734 0x80031B34 0x80034F34 0x80038334 /end VAR_ADDRESS
 /end VAR_CHARACTERISTIC
 /begin VAR_CHARACTERISTIC S16_WPE_LFC_ESC_Rise_Press_r_3rd BrkCalVariantCriterion
  /begin VAR_ADDRESS 0x80021736 0x80024B36 0x80027F36 0x8002B336 0x8002E736 0x80031B36 0x80034F36 0x80038336 /end VAR_ADDRESS
 /end VAR_CHARACTERISTIC
 /begin VAR_CHARACTERISTIC S16_WPE_LFC_ESC_Rise_Press_r_4th BrkCalVariantCriterion
  /begin VAR_ADDRESS 0x80021738 0x80024B38 0x80027F38 0x8002B338 0x8002E738 0x80031B38 0x80034F38 0x80038338 /end VAR_ADDRESS
 /end VAR_CHARACTERISTIC
 /begin VAR_CHARACTERISTIC S16_WPE_LFC_ESC_Rise_Press_r_5th BrkCalVariantCriterion
  /begin VAR_ADDRESS 0x8002173A 0x80024B3A 0x80027F3A 0x8002B33A 0x8002E73A 0x80031B3A 0x80034F3A 0x8003833A /end VAR_ADDRESS
 /end VAR_CHARACTERISTIC
 /begin VAR_CHARACTERISTIC S16_WPE_LFC_ESC_Rise_Press_r_6th BrkCalVariantCriterion
  /begin VAR_ADDRESS 0x8002173C 0x80024B3C 0x80027F3C 0x8002B33C 0x8002E73C 0x80031B3C 0x80034F3C 0x8003833C /end VAR_ADDRESS
 /end VAR_CHARACTERISTIC
 /begin VAR_CHARACTERISTIC S16_WPE_LFC_Hold_press_f_10th BrkCalVariantCriterion
  /begin VAR_ADDRESS 0x80021674 0x80024A74 0x80027E74 0x8002B274 0x8002E674 0x80031A74 0x80034E74 0x80038274 /end VAR_ADDRESS
 /end VAR_CHARACTERISTIC
 /begin VAR_CHARACTERISTIC S16_WPE_LFC_Hold_press_f_11th BrkCalVariantCriterion
  /begin VAR_ADDRESS 0x80021676 0x80024A76 0x80027E76 0x8002B276 0x8002E676 0x80031A76 0x80034E76 0x80038276 /end VAR_ADDRESS
 /end VAR_CHARACTERISTIC
 /begin VAR_CHARACTERISTIC S16_WPE_LFC_Hold_press_f_12th BrkCalVariantCriterion
  /begin VAR_ADDRESS 0x80021678 0x80024A78 0x80027E78 0x8002B278 0x8002E678 0x80031A78 0x80034E78 0x80038278 /end VAR_ADDRESS
 /end VAR_CHARACTERISTIC
 /begin VAR_CHARACTERISTIC S16_WPE_LFC_Hold_press_f_13th BrkCalVariantCriterion
  /begin VAR_ADDRESS 0x8002167A 0x80024A7A 0x80027E7A 0x8002B27A 0x8002E67A 0x80031A7A 0x80034E7A 0x8003827A /end VAR_ADDRESS
 /end VAR_CHARACTERISTIC
 /begin VAR_CHARACTERISTIC S16_WPE_LFC_Hold_press_f_14th BrkCalVariantCriterion
  /begin VAR_ADDRESS 0x8002167C 0x80024A7C 0x80027E7C 0x8002B27C 0x8002E67C 0x80031A7C 0x80034E7C 0x8003827C /end VAR_ADDRESS
 /end VAR_CHARACTERISTIC
 /begin VAR_CHARACTERISTIC S16_WPE_LFC_Hold_press_f_15th BrkCalVariantCriterion
  /begin VAR_ADDRESS 0x8002167E 0x80024A7E 0x80027E7E 0x8002B27E 0x8002E67E 0x80031A7E 0x80034E7E 0x8003827E /end VAR_ADDRESS
 /end VAR_CHARACTERISTIC
 /begin VAR_CHARACTERISTIC S16_WPE_LFC_Hold_press_f_16th BrkCalVariantCriterion
  /begin VAR_ADDRESS 0x80021680 0x80024A80 0x80027E80 0x8002B280 0x8002E680 0x80031A80 0x80034E80 0x80038280 /end VAR_ADDRESS
 /end VAR_CHARACTERISTIC
 /begin VAR_CHARACTERISTIC S16_WPE_LFC_Hold_press_f_1st BrkCalVariantCriterion
  /begin VAR_ADDRESS 0x80021662 0x80024A62 0x80027E62 0x8002B262 0x8002E662 0x80031A62 0x80034E62 0x80038262 /end VAR_ADDRESS
 /end VAR_CHARACTERISTIC
 /begin VAR_CHARACTERISTIC S16_WPE_LFC_Hold_press_f_2nd BrkCalVariantCriterion
  /begin VAR_ADDRESS 0x80021664 0x80024A64 0x80027E64 0x8002B264 0x8002E664 0x80031A64 0x80034E64 0x80038264 /end VAR_ADDRESS
 /end VAR_CHARACTERISTIC
 /begin VAR_CHARACTERISTIC S16_WPE_LFC_Hold_press_f_3rd BrkCalVariantCriterion
  /begin VAR_ADDRESS 0x80021666 0x80024A66 0x80027E66 0x8002B266 0x8002E666 0x80031A66 0x80034E66 0x80038266 /end VAR_ADDRESS
 /end VAR_CHARACTERISTIC
 /begin VAR_CHARACTERISTIC S16_WPE_LFC_Hold_press_f_4th BrkCalVariantCriterion
  /begin VAR_ADDRESS 0x80021668 0x80024A68 0x80027E68 0x8002B268 0x8002E668 0x80031A68 0x80034E68 0x80038268 /end VAR_ADDRESS
 /end VAR_CHARACTERISTIC
 /begin VAR_CHARACTERISTIC S16_WPE_LFC_Hold_press_f_5th BrkCalVariantCriterion
  /begin VAR_ADDRESS 0x8002166A 0x80024A6A 0x80027E6A 0x8002B26A 0x8002E66A 0x80031A6A 0x80034E6A 0x8003826A /end VAR_ADDRESS
 /end VAR_CHARACTERISTIC
 /begin VAR_CHARACTERISTIC S16_WPE_LFC_Hold_press_f_6th BrkCalVariantCriterion
  /begin VAR_ADDRESS 0x8002166C 0x80024A6C 0x80027E6C 0x8002B26C 0x8002E66C 0x80031A6C 0x80034E6C 0x8003826C /end VAR_ADDRESS
 /end VAR_CHARACTERISTIC
 /begin VAR_CHARACTERISTIC S16_WPE_LFC_Hold_press_f_7th BrkCalVariantCriterion
  /begin VAR_ADDRESS 0x8002166E 0x80024A6E 0x80027E6E 0x8002B26E 0x8002E66E 0x80031A6E 0x80034E6E 0x8003826E /end VAR_ADDRESS
 /end VAR_CHARACTERISTIC
 /begin VAR_CHARACTERISTIC S16_WPE_LFC_Hold_press_f_8th BrkCalVariantCriterion
  /begin VAR_ADDRESS 0x80021670 0x80024A70 0x80027E70 0x8002B270 0x8002E670 0x80031A70 0x80034E70 0x80038270 /end VAR_ADDRESS
 /end VAR_CHARACTERISTIC
 /begin VAR_CHARACTERISTIC S16_WPE_LFC_Hold_press_f_9th BrkCalVariantCriterion
  /begin VAR_ADDRESS 0x80021672 0x80024A72 0x80027E72 0x8002B272 0x8002E672 0x80031A72 0x80034E72 0x80038272 /end VAR_ADDRESS
 /end VAR_CHARACTERISTIC
 /begin VAR_CHARACTERISTIC S16_WPE_LFC_Hold_press_r_10th BrkCalVariantCriterion
  /begin VAR_ADDRESS 0x800216A4 0x80024AA4 0x80027EA4 0x8002B2A4 0x8002E6A4 0x80031AA4 0x80034EA4 0x800382A4 /end VAR_ADDRESS
 /end VAR_CHARACTERISTIC
 /begin VAR_CHARACTERISTIC S16_WPE_LFC_Hold_press_r_11th BrkCalVariantCriterion
  /begin VAR_ADDRESS 0x800216A6 0x80024AA6 0x80027EA6 0x8002B2A6 0x8002E6A6 0x80031AA6 0x80034EA6 0x800382A6 /end VAR_ADDRESS
 /end VAR_CHARACTERISTIC
 /begin VAR_CHARACTERISTIC S16_WPE_LFC_Hold_press_r_12th BrkCalVariantCriterion
  /begin VAR_ADDRESS 0x800216A8 0x80024AA8 0x80027EA8 0x8002B2A8 0x8002E6A8 0x80031AA8 0x80034EA8 0x800382A8 /end VAR_ADDRESS
 /end VAR_CHARACTERISTIC
 /begin VAR_CHARACTERISTIC S16_WPE_LFC_Hold_press_r_13th BrkCalVariantCriterion
  /begin VAR_ADDRESS 0x800216AA 0x80024AAA 0x80027EAA 0x8002B2AA 0x8002E6AA 0x80031AAA 0x80034EAA 0x800382AA /end VAR_ADDRESS
 /end VAR_CHARACTERISTIC
 /begin VAR_CHARACTERISTIC S16_WPE_LFC_Hold_press_r_14th BrkCalVariantCriterion
  /begin VAR_ADDRESS 0x800216AC 0x80024AAC 0x80027EAC 0x8002B2AC 0x8002E6AC 0x80031AAC 0x80034EAC 0x800382AC /end VAR_ADDRESS
 /end VAR_CHARACTERISTIC
 /begin VAR_CHARACTERISTIC S16_WPE_LFC_Hold_press_r_15th BrkCalVariantCriterion
  /begin VAR_ADDRESS 0x800216AE 0x80024AAE 0x80027EAE 0x8002B2AE 0x8002E6AE 0x80031AAE 0x80034EAE 0x800382AE /end VAR_ADDRESS
 /end VAR_CHARACTERISTIC
 /begin VAR_CHARACTERISTIC S16_WPE_LFC_Hold_press_r_16th BrkCalVariantCriterion
  /begin VAR_ADDRESS 0x800216B0 0x80024AB0 0x80027EB0 0x8002B2B0 0x8002E6B0 0x80031AB0 0x80034EB0 0x800382B0 /end VAR_ADDRESS
 /end VAR_CHARACTERISTIC
 /begin VAR_CHARACTERISTIC S16_WPE_LFC_Hold_press_r_1st BrkCalVariantCriterion
  /begin VAR_ADDRESS 0x80021692 0x80024A92 0x80027E92 0x8002B292 0x8002E692 0x80031A92 0x80034E92 0x80038292 /end VAR_ADDRESS
 /end VAR_CHARACTERISTIC
 /begin VAR_CHARACTERISTIC S16_WPE_LFC_Hold_press_r_2nd BrkCalVariantCriterion
  /begin VAR_ADDRESS 0x80021694 0x80024A94 0x80027E94 0x8002B294 0x8002E694 0x80031A94 0x80034E94 0x80038294 /end VAR_ADDRESS
 /end VAR_CHARACTERISTIC
 /begin VAR_CHARACTERISTIC S16_WPE_LFC_Hold_press_r_3rd BrkCalVariantCriterion
  /begin VAR_ADDRESS 0x80021696 0x80024A96 0x80027E96 0x8002B296 0x8002E696 0x80031A96 0x80034E96 0x80038296 /end VAR_ADDRESS
 /end VAR_CHARACTERISTIC
 /begin VAR_CHARACTERISTIC S16_WPE_LFC_Hold_press_r_4th BrkCalVariantCriterion
  /begin VAR_ADDRESS 0x80021698 0x80024A98 0x80027E98 0x8002B298 0x8002E698 0x80031A98 0x80034E98 0x80038298 /end VAR_ADDRESS
 /end VAR_CHARACTERISTIC
 /begin VAR_CHARACTERISTIC S16_WPE_LFC_Hold_press_r_5th BrkCalVariantCriterion
  /begin VAR_ADDRESS 0x8002169A 0x80024A9A 0x80027E9A 0x8002B29A 0x8002E69A 0x80031A9A 0x80034E9A 0x8003829A /end VAR_ADDRESS
 /end VAR_CHARACTERISTIC
 /begin VAR_CHARACTERISTIC S16_WPE_LFC_Hold_press_r_6th BrkCalVariantCriterion
  /begin VAR_ADDRESS 0x8002169C 0x80024A9C 0x80027E9C 0x8002B29C 0x8002E69C 0x80031A9C 0x80034E9C 0x8003829C /end VAR_ADDRESS
 /end VAR_CHARACTERISTIC
 /begin VAR_CHARACTERISTIC S16_WPE_LFC_Hold_press_r_7th BrkCalVariantCriterion
  /begin VAR_ADDRESS 0x8002169E 0x80024A9E 0x80027E9E 0x8002B29E 0x8002E69E 0x80031A9E 0x80034E9E 0x8003829E /end VAR_ADDRESS
 /end VAR_CHARACTERISTIC
 /begin VAR_CHARACTERISTIC S16_WPE_LFC_Hold_press_r_8th BrkCalVariantCriterion
  /begin VAR_ADDRESS 0x800216A0 0x80024AA0 0x80027EA0 0x8002B2A0 0x8002E6A0 0x80031AA0 0x80034EA0 0x800382A0 /end VAR_ADDRESS
 /end VAR_CHARACTERISTIC
 /begin VAR_CHARACTERISTIC S16_WPE_LFC_Hold_press_r_9th BrkCalVariantCriterion
  /begin VAR_ADDRESS 0x800216A2 0x80024AA2 0x80027EA2 0x8002B2A2 0x8002E6A2 0x80031AA2 0x80034EA2 0x800382A2 /end VAR_ADDRESS
 /end VAR_CHARACTERISTIC
 /begin VAR_CHARACTERISTIC S16_WPE_LFC_Rise_Gain_f_10th BrkCalVariantCriterion
  /begin VAR_ADDRESS 0x800216D0 0x80024AD0 0x80027ED0 0x8002B2D0 0x8002E6D0 0x80031AD0 0x80034ED0 0x800382D0 /end VAR_ADDRESS
 /end VAR_CHARACTERISTIC
 /begin VAR_CHARACTERISTIC S16_WPE_LFC_Rise_Gain_f_11th BrkCalVariantCriterion
  /begin VAR_ADDRESS 0x800216D2 0x80024AD2 0x80027ED2 0x8002B2D2 0x8002E6D2 0x80031AD2 0x80034ED2 0x800382D2 /end VAR_ADDRESS
 /end VAR_CHARACTERISTIC
 /begin VAR_CHARACTERISTIC S16_WPE_LFC_Rise_Gain_f_1st BrkCalVariantCriterion
  /begin VAR_ADDRESS 0x800216BE 0x80024ABE 0x80027EBE 0x8002B2BE 0x8002E6BE 0x80031ABE 0x80034EBE 0x800382BE /end VAR_ADDRESS
 /end VAR_CHARACTERISTIC
 /begin VAR_CHARACTERISTIC S16_WPE_LFC_Rise_Gain_f_2nd BrkCalVariantCriterion
  /begin VAR_ADDRESS 0x800216C0 0x80024AC0 0x80027EC0 0x8002B2C0 0x8002E6C0 0x80031AC0 0x80034EC0 0x800382C0 /end VAR_ADDRESS
 /end VAR_CHARACTERISTIC
 /begin VAR_CHARACTERISTIC S16_WPE_LFC_Rise_Gain_f_3rd BrkCalVariantCriterion
  /begin VAR_ADDRESS 0x800216C2 0x80024AC2 0x80027EC2 0x8002B2C2 0x8002E6C2 0x80031AC2 0x80034EC2 0x800382C2 /end VAR_ADDRESS
 /end VAR_CHARACTERISTIC
 /begin VAR_CHARACTERISTIC S16_WPE_LFC_Rise_Gain_f_4th BrkCalVariantCriterion
  /begin VAR_ADDRESS 0x800216C4 0x80024AC4 0x80027EC4 0x8002B2C4 0x8002E6C4 0x80031AC4 0x80034EC4 0x800382C4 /end VAR_ADDRESS
 /end VAR_CHARACTERISTIC
 /begin VAR_CHARACTERISTIC S16_WPE_LFC_Rise_Gain_f_5th BrkCalVariantCriterion
  /begin VAR_ADDRESS 0x800216C6 0x80024AC6 0x80027EC6 0x8002B2C6 0x8002E6C6 0x80031AC6 0x80034EC6 0x800382C6 /end VAR_ADDRESS
 /end VAR_CHARACTERISTIC
 /begin VAR_CHARACTERISTIC S16_WPE_LFC_Rise_Gain_f_6th BrkCalVariantCriterion
  /begin VAR_ADDRESS 0x800216C8 0x80024AC8 0x80027EC8 0x8002B2C8 0x8002E6C8 0x80031AC8 0x80034EC8 0x800382C8 /end VAR_ADDRESS
 /end VAR_CHARACTERISTIC
 /begin VAR_CHARACTERISTIC S16_WPE_LFC_Rise_Gain_f_7th BrkCalVariantCriterion
  /begin VAR_ADDRESS 0x800216CA 0x80024ACA 0x80027ECA 0x8002B2CA 0x8002E6CA 0x80031ACA 0x80034ECA 0x800382CA /end VAR_ADDRESS
 /end VAR_CHARACTERISTIC
 /begin VAR_CHARACTERISTIC S16_WPE_LFC_Rise_Gain_f_8th BrkCalVariantCriterion
  /begin VAR_ADDRESS 0x800216CC 0x80024ACC 0x80027ECC 0x8002B2CC 0x8002E6CC 0x80031ACC 0x80034ECC 0x800382CC /end VAR_ADDRESS
 /end VAR_CHARACTERISTIC
 /begin VAR_CHARACTERISTIC S16_WPE_LFC_Rise_Gain_f_9th BrkCalVariantCriterion
  /begin VAR_ADDRESS 0x800216CE 0x80024ACE 0x80027ECE 0x8002B2CE 0x8002E6CE 0x80031ACE 0x80034ECE 0x800382CE /end VAR_ADDRESS
 /end VAR_CHARACTERISTIC
 /begin VAR_CHARACTERISTIC S16_WPE_LFC_Rise_Gain_r_10th BrkCalVariantCriterion
  /begin VAR_ADDRESS 0x800216F2 0x80024AF2 0x80027EF2 0x8002B2F2 0x8002E6F2 0x80031AF2 0x80034EF2 0x800382F2 /end VAR_ADDRESS
 /end VAR_CHARACTERISTIC
 /begin VAR_CHARACTERISTIC S16_WPE_LFC_Rise_Gain_r_11th BrkCalVariantCriterion
  /begin VAR_ADDRESS 0x800216F4 0x80024AF4 0x80027EF4 0x8002B2F4 0x8002E6F4 0x80031AF4 0x80034EF4 0x800382F4 /end VAR_ADDRESS
 /end VAR_CHARACTERISTIC
 /begin VAR_CHARACTERISTIC S16_WPE_LFC_Rise_Gain_r_1st BrkCalVariantCriterion
  /begin VAR_ADDRESS 0x800216E0 0x80024AE0 0x80027EE0 0x8002B2E0 0x8002E6E0 0x80031AE0 0x80034EE0 0x800382E0 /end VAR_ADDRESS
 /end VAR_CHARACTERISTIC
 /begin VAR_CHARACTERISTIC S16_WPE_LFC_Rise_Gain_r_2nd BrkCalVariantCriterion
  /begin VAR_ADDRESS 0x800216E2 0x80024AE2 0x80027EE2 0x8002B2E2 0x8002E6E2 0x80031AE2 0x80034EE2 0x800382E2 /end VAR_ADDRESS
 /end VAR_CHARACTERISTIC
 /begin VAR_CHARACTERISTIC S16_WPE_LFC_Rise_Gain_r_3rd BrkCalVariantCriterion
  /begin VAR_ADDRESS 0x800216E4 0x80024AE4 0x80027EE4 0x8002B2E4 0x8002E6E4 0x80031AE4 0x80034EE4 0x800382E4 /end VAR_ADDRESS
 /end VAR_CHARACTERISTIC
 /begin VAR_CHARACTERISTIC S16_WPE_LFC_Rise_Gain_r_4th BrkCalVariantCriterion
  /begin VAR_ADDRESS 0x800216E6 0x80024AE6 0x80027EE6 0x8002B2E6 0x8002E6E6 0x80031AE6 0x80034EE6 0x800382E6 /end VAR_ADDRESS
 /end VAR_CHARACTERISTIC
 /begin VAR_CHARACTERISTIC S16_WPE_LFC_Rise_Gain_r_5th BrkCalVariantCriterion
  /begin VAR_ADDRESS 0x800216E8 0x80024AE8 0x80027EE8 0x8002B2E8 0x8002E6E8 0x80031AE8 0x80034EE8 0x800382E8 /end VAR_ADDRESS
 /end VAR_CHARACTERISTIC
 /begin VAR_CHARACTERISTIC S16_WPE_LFC_Rise_Gain_r_6th BrkCalVariantCriterion
  /begin VAR_ADDRESS 0x800216EA 0x80024AEA 0x80027EEA 0x8002B2EA 0x8002E6EA 0x80031AEA 0x80034EEA 0x800382EA /end VAR_ADDRESS
 /end VAR_CHARACTERISTIC
 /begin VAR_CHARACTERISTIC S16_WPE_LFC_Rise_Gain_r_7th BrkCalVariantCriterion
  /begin VAR_ADDRESS 0x800216EC 0x80024AEC 0x80027EEC 0x8002B2EC 0x8002E6EC 0x80031AEC 0x80034EEC 0x800382EC /end VAR_ADDRESS
 /end VAR_CHARACTERISTIC
 /begin VAR_CHARACTERISTIC S16_WPE_LFC_Rise_Gain_r_8th BrkCalVariantCriterion
  /begin VAR_ADDRESS 0x800216EE 0x80024AEE 0x80027EEE 0x8002B2EE 0x8002E6EE 0x80031AEE 0x80034EEE 0x800382EE /end VAR_ADDRESS
 /end VAR_CHARACTERISTIC
 /begin VAR_CHARACTERISTIC S16_WPE_LFC_Rise_Gain_r_9th BrkCalVariantCriterion
  /begin VAR_ADDRESS 0x800216F0 0x80024AF0 0x80027EF0 0x8002B2F0 0x8002E6F0 0x80031AF0 0x80034EF0 0x800382F0 /end VAR_ADDRESS
 /end VAR_CHARACTERISTIC
 /begin VAR_CHARACTERISTIC S16_WPE_MP_Rise_Gain_f_1_volume BrkCalVariantCriterion
  /begin VAR_ADDRESS 0x800215C6 0x800249C6 0x80027DC6 0x8002B1C6 0x8002E5C6 0x800319C6 0x80034DC6 0x800381C6 /end VAR_ADDRESS
 /end VAR_CHARACTERISTIC
 /begin VAR_CHARACTERISTIC S16_WPE_MP_Rise_Gain_f_2_volume BrkCalVariantCriterion
  /begin VAR_ADDRESS 0x800215C8 0x800249C8 0x80027DC8 0x8002B1C8 0x8002E5C8 0x800319C8 0x80034DC8 0x800381C8 /end VAR_ADDRESS
 /end VAR_CHARACTERISTIC
 /begin VAR_CHARACTERISTIC S16_WPE_MP_Rise_Gain_f_3_volume BrkCalVariantCriterion
  /begin VAR_ADDRESS 0x800215CA 0x800249CA 0x80027DCA 0x8002B1CA 0x8002E5CA 0x800319CA 0x80034DCA 0x800381CA /end VAR_ADDRESS
 /end VAR_CHARACTERISTIC
 /begin VAR_CHARACTERISTIC S16_WPE_MP_Rise_Gain_f_4_volume BrkCalVariantCriterion
  /begin VAR_ADDRESS 0x800215CC 0x800249CC 0x80027DCC 0x8002B1CC 0x8002E5CC 0x800319CC 0x80034DCC 0x800381CC /end VAR_ADDRESS
 /end VAR_CHARACTERISTIC
 /begin VAR_CHARACTERISTIC S16_WPE_MP_Rise_Gain_f_5_volume BrkCalVariantCriterion
  /begin VAR_ADDRESS 0x800215CE 0x800249CE 0x80027DCE 0x8002B1CE 0x8002E5CE 0x800319CE 0x80034DCE 0x800381CE /end VAR_ADDRESS
 /end VAR_CHARACTERISTIC
 /begin VAR_CHARACTERISTIC S16_WPE_MP_Rise_Gain_f_6_volume BrkCalVariantCriterion
  /begin VAR_ADDRESS 0x800215D0 0x800249D0 0x80027DD0 0x8002B1D0 0x8002E5D0 0x800319D0 0x80034DD0 0x800381D0 /end VAR_ADDRESS
 /end VAR_CHARACTERISTIC
 /begin VAR_CHARACTERISTIC S16_WPE_MP_Rise_Gain_r_1_volume BrkCalVariantCriterion
  /begin VAR_ADDRESS 0x800215DE 0x800249DE 0x80027DDE 0x8002B1DE 0x8002E5DE 0x800319DE 0x80034DDE 0x800381DE /end VAR_ADDRESS
 /end VAR_CHARACTERISTIC
 /begin VAR_CHARACTERISTIC S16_WPE_MP_Rise_Gain_r_2_volume BrkCalVariantCriterion
  /begin VAR_ADDRESS 0x800215E0 0x800249E0 0x80027DE0 0x8002B1E0 0x8002E5E0 0x800319E0 0x80034DE0 0x800381E0 /end VAR_ADDRESS
 /end VAR_CHARACTERISTIC
 /begin VAR_CHARACTERISTIC S16_WPE_MP_Rise_Gain_r_3_volume BrkCalVariantCriterion
  /begin VAR_ADDRESS 0x800215E2 0x800249E2 0x80027DE2 0x8002B1E2 0x8002E5E2 0x800319E2 0x80034DE2 0x800381E2 /end VAR_ADDRESS
 /end VAR_CHARACTERISTIC
 /begin VAR_CHARACTERISTIC S16_WPE_MP_Rise_Gain_r_4_volume BrkCalVariantCriterion
  /begin VAR_ADDRESS 0x800215E4 0x800249E4 0x80027DE4 0x8002B1E4 0x8002E5E4 0x800319E4 0x80034DE4 0x800381E4 /end VAR_ADDRESS
 /end VAR_CHARACTERISTIC
 /begin VAR_CHARACTERISTIC S16_WPE_MP_Rise_Gain_r_5_volume BrkCalVariantCriterion
  /begin VAR_ADDRESS 0x800215E6 0x800249E6 0x80027DE6 0x8002B1E6 0x8002E5E6 0x800319E6 0x80034DE6 0x800381E6 /end VAR_ADDRESS
 /end VAR_CHARACTERISTIC
 /begin VAR_CHARACTERISTIC S16_WPE_MP_Rise_Gain_r_6_volume BrkCalVariantCriterion
  /begin VAR_ADDRESS 0x800215E8 0x800249E8 0x80027DE8 0x8002B1E8 0x8002E5E8 0x800319E8 0x80034DE8 0x800381E8 /end VAR_ADDRESS
 /end VAR_CHARACTERISTIC
 /begin VAR_CHARACTERISTIC S16_WPE_MP_Rise_Press_f_1_volume BrkCalVariantCriterion
  /begin VAR_ADDRESS 0x800215BA 0x800249BA 0x80027DBA 0x8002B1BA 0x8002E5BA 0x800319BA 0x80034DBA 0x800381BA /end VAR_ADDRESS
 /end VAR_CHARACTERISTIC
 /begin VAR_CHARACTERISTIC S16_WPE_MP_Rise_Press_f_2_volume BrkCalVariantCriterion
  /begin VAR_ADDRESS 0x800215BC 0x800249BC 0x80027DBC 0x8002B1BC 0x8002E5BC 0x800319BC 0x80034DBC 0x800381BC /end VAR_ADDRESS
 /end VAR_CHARACTERISTIC
 /begin VAR_CHARACTERISTIC S16_WPE_MP_Rise_Press_f_3_volume BrkCalVariantCriterion
  /begin VAR_ADDRESS 0x800215BE 0x800249BE 0x80027DBE 0x8002B1BE 0x8002E5BE 0x800319BE 0x80034DBE 0x800381BE /end VAR_ADDRESS
 /end VAR_CHARACTERISTIC
 /begin VAR_CHARACTERISTIC S16_WPE_MP_Rise_Press_f_4_volume BrkCalVariantCriterion
  /begin VAR_ADDRESS 0x800215C0 0x800249C0 0x80027DC0 0x8002B1C0 0x8002E5C0 0x800319C0 0x80034DC0 0x800381C0 /end VAR_ADDRESS
 /end VAR_CHARACTERISTIC
 /begin VAR_CHARACTERISTIC S16_WPE_MP_Rise_Press_f_5_volume BrkCalVariantCriterion
  /begin VAR_ADDRESS 0x800215C2 0x800249C2 0x80027DC2 0x8002B1C2 0x8002E5C2 0x800319C2 0x80034DC2 0x800381C2 /end VAR_ADDRESS
 /end VAR_CHARACTERISTIC
 /begin VAR_CHARACTERISTIC S16_WPE_MP_Rise_Press_f_6_volume BrkCalVariantCriterion
  /begin VAR_ADDRESS 0x800215C4 0x800249C4 0x80027DC4 0x8002B1C4 0x8002E5C4 0x800319C4 0x80034DC4 0x800381C4 /end VAR_ADDRESS
 /end VAR_CHARACTERISTIC
 /begin VAR_CHARACTERISTIC S16_WPE_MP_Rise_Press_r_1_volume BrkCalVariantCriterion
  /begin VAR_ADDRESS 0x800215D2 0x800249D2 0x80027DD2 0x8002B1D2 0x8002E5D2 0x800319D2 0x80034DD2 0x800381D2 /end VAR_ADDRESS
 /end VAR_CHARACTERISTIC
 /begin VAR_CHARACTERISTIC S16_WPE_MP_Rise_Press_r_2_volume BrkCalVariantCriterion
  /begin VAR_ADDRESS 0x800215D4 0x800249D4 0x80027DD4 0x8002B1D4 0x8002E5D4 0x800319D4 0x80034DD4 0x800381D4 /end VAR_ADDRESS
 /end VAR_CHARACTERISTIC
 /begin VAR_CHARACTERISTIC S16_WPE_MP_Rise_Press_r_3_volume BrkCalVariantCriterion
  /begin VAR_ADDRESS 0x800215D6 0x800249D6 0x80027DD6 0x8002B1D6 0x8002E5D6 0x800319D6 0x80034DD6 0x800381D6 /end VAR_ADDRESS
 /end VAR_CHARACTERISTIC
 /begin VAR_CHARACTERISTIC S16_WPE_MP_Rise_Press_r_4_volume BrkCalVariantCriterion
  /begin VAR_ADDRESS 0x800215D8 0x800249D8 0x80027DD8 0x8002B1D8 0x8002E5D8 0x800319D8 0x80034DD8 0x800381D8 /end VAR_ADDRESS
 /end VAR_CHARACTERISTIC
 /begin VAR_CHARACTERISTIC S16_WPE_MP_Rise_Press_r_5_volume BrkCalVariantCriterion
  /begin VAR_ADDRESS 0x800215DA 0x800249DA 0x80027DDA 0x8002B1DA 0x8002E5DA 0x800319DA 0x80034DDA 0x800381DA /end VAR_ADDRESS
 /end VAR_CHARACTERISTIC
 /begin VAR_CHARACTERISTIC S16_WPE_MP_Rise_Press_r_6_volume BrkCalVariantCriterion
  /begin VAR_ADDRESS 0x800215DC 0x800249DC 0x80027DDC 0x8002B1DC 0x8002E5DC 0x800319DC 0x80034DDC 0x800381DC /end VAR_ADDRESS
 /end VAR_CHARACTERISTIC
 /begin VAR_CHARACTERISTIC S16_WPE_Motor_Eff_Gain_1st BrkCalVariantCriterion
  /begin VAR_ADDRESS 0x80021542 0x80024942 0x80027D42 0x8002B142 0x8002E542 0x80031942 0x80034D42 0x80038142 /end VAR_ADDRESS
 /end VAR_CHARACTERISTIC
 /begin VAR_CHARACTERISTIC S16_WPE_Motor_Eff_Gain_2nd BrkCalVariantCriterion
  /begin VAR_ADDRESS 0x80021544 0x80024944 0x80027D44 0x8002B144 0x8002E544 0x80031944 0x80034D44 0x80038144 /end VAR_ADDRESS
 /end VAR_CHARACTERISTIC
 /begin VAR_CHARACTERISTIC S16_WPE_Motor_Eff_Gain_3rd BrkCalVariantCriterion
  /begin VAR_ADDRESS 0x80021546 0x80024946 0x80027D46 0x8002B146 0x8002E546 0x80031946 0x80034D46 0x80038146 /end VAR_ADDRESS
 /end VAR_CHARACTERISTIC
 /begin VAR_CHARACTERISTIC S16_WPE_Motor_Eff_Gain_4th BrkCalVariantCriterion
  /begin VAR_ADDRESS 0x80021548 0x80024948 0x80027D48 0x8002B148 0x8002E548 0x80031948 0x80034D48 0x80038148 /end VAR_ADDRESS
 /end VAR_CHARACTERISTIC
 /begin VAR_CHARACTERISTIC S16_WPE_Motor_Eff_Gain_5th BrkCalVariantCriterion
  /begin VAR_ADDRESS 0x8002154A 0x8002494A 0x80027D4A 0x8002B14A 0x8002E54A 0x8003194A 0x80034D4A 0x8003814A /end VAR_ADDRESS
 /end VAR_CHARACTERISTIC
 /begin VAR_CHARACTERISTIC S16_WPE_Motor_Eff_Gain_6th BrkCalVariantCriterion
  /begin VAR_ADDRESS 0x8002154C 0x8002494C 0x80027D4C 0x8002B14C 0x8002E54C 0x8003194C 0x80034D4C 0x8003814C /end VAR_ADDRESS
 /end VAR_CHARACTERISTIC
 /begin VAR_CHARACTERISTIC S16_WPE_Motor_Eff_MPress_1st BrkCalVariantCriterion
  /begin VAR_ADDRESS 0x80021536 0x80024936 0x80027D36 0x8002B136 0x8002E536 0x80031936 0x80034D36 0x80038136 /end VAR_ADDRESS
 /end VAR_CHARACTERISTIC
 /begin VAR_CHARACTERISTIC S16_WPE_Motor_Eff_MPress_2nd BrkCalVariantCriterion
  /begin VAR_ADDRESS 0x80021538 0x80024938 0x80027D38 0x8002B138 0x8002E538 0x80031938 0x80034D38 0x80038138 /end VAR_ADDRESS
 /end VAR_CHARACTERISTIC
 /begin VAR_CHARACTERISTIC S16_WPE_Motor_Eff_MPress_3rd BrkCalVariantCriterion
  /begin VAR_ADDRESS 0x8002153A 0x8002493A 0x80027D3A 0x8002B13A 0x8002E53A 0x8003193A 0x80034D3A 0x8003813A /end VAR_ADDRESS
 /end VAR_CHARACTERISTIC
 /begin VAR_CHARACTERISTIC S16_WPE_Motor_Eff_MPress_4th BrkCalVariantCriterion
  /begin VAR_ADDRESS 0x8002153C 0x8002493C 0x80027D3C 0x8002B13C 0x8002E53C 0x8003193C 0x80034D3C 0x8003813C /end VAR_ADDRESS
 /end VAR_CHARACTERISTIC
 /begin VAR_CHARACTERISTIC S16_WPE_Motor_Eff_MPress_5th BrkCalVariantCriterion
  /begin VAR_ADDRESS 0x8002153E 0x8002493E 0x80027D3E 0x8002B13E 0x8002E53E 0x8003193E 0x80034D3E 0x8003813E /end VAR_ADDRESS
 /end VAR_CHARACTERISTIC
 /begin VAR_CHARACTERISTIC S16_WPE_Motor_Eff_MPress_6th BrkCalVariantCriterion
  /begin VAR_ADDRESS 0x80021540 0x80024940 0x80027D40 0x8002B140 0x8002E540 0x80031940 0x80034D40 0x80038140 /end VAR_ADDRESS
 /end VAR_CHARACTERISTIC
 /begin VAR_CHARACTERISTIC S16_WPE_NC_Dump_Gain_Press_f_1st BrkCalVariantCriterion
  /begin VAR_ADDRESS 0x8002176E 0x80024B6E 0x80027F6E 0x8002B36E 0x8002E76E 0x80031B6E 0x80034F6E 0x8003836E /end VAR_ADDRESS
 /end VAR_CHARACTERISTIC
 /begin VAR_CHARACTERISTIC S16_WPE_NC_Dump_Gain_Press_f_2nd BrkCalVariantCriterion
  /begin VAR_ADDRESS 0x80021770 0x80024B70 0x80027F70 0x8002B370 0x8002E770 0x80031B70 0x80034F70 0x80038370 /end VAR_ADDRESS
 /end VAR_CHARACTERISTIC
 /begin VAR_CHARACTERISTIC S16_WPE_NC_Dump_Gain_Press_f_3rd BrkCalVariantCriterion
  /begin VAR_ADDRESS 0x80021772 0x80024B72 0x80027F72 0x8002B372 0x8002E772 0x80031B72 0x80034F72 0x80038372 /end VAR_ADDRESS
 /end VAR_CHARACTERISTIC
 /begin VAR_CHARACTERISTIC S16_WPE_NC_Dump_Gain_Press_f_4th BrkCalVariantCriterion
  /begin VAR_ADDRESS 0x80021774 0x80024B74 0x80027F74 0x8002B374 0x8002E774 0x80031B74 0x80034F74 0x80038374 /end VAR_ADDRESS
 /end VAR_CHARACTERISTIC
 /begin VAR_CHARACTERISTIC S16_WPE_NC_Dump_Gain_Press_f_5th BrkCalVariantCriterion
  /begin VAR_ADDRESS 0x80021776 0x80024B76 0x80027F76 0x8002B376 0x8002E776 0x80031B76 0x80034F76 0x80038376 /end VAR_ADDRESS
 /end VAR_CHARACTERISTIC
 /begin VAR_CHARACTERISTIC S16_WPE_NC_Dump_Gain_Press_f_6th BrkCalVariantCriterion
  /begin VAR_ADDRESS 0x80021778 0x80024B78 0x80027F78 0x8002B378 0x8002E778 0x80031B78 0x80034F78 0x80038378 /end VAR_ADDRESS
 /end VAR_CHARACTERISTIC
 /begin VAR_CHARACTERISTIC S16_WPE_NC_Dump_Gain_Press_r_1st BrkCalVariantCriterion
  /begin VAR_ADDRESS 0x80021786 0x80024B86 0x80027F86 0x8002B386 0x8002E786 0x80031B86 0x80034F86 0x80038386 /end VAR_ADDRESS
 /end VAR_CHARACTERISTIC
 /begin VAR_CHARACTERISTIC S16_WPE_NC_Dump_Gain_Press_r_2nd BrkCalVariantCriterion
  /begin VAR_ADDRESS 0x80021788 0x80024B88 0x80027F88 0x8002B388 0x8002E788 0x80031B88 0x80034F88 0x80038388 /end VAR_ADDRESS
 /end VAR_CHARACTERISTIC
 /begin VAR_CHARACTERISTIC S16_WPE_NC_Dump_Gain_Press_r_3rd BrkCalVariantCriterion
  /begin VAR_ADDRESS 0x8002178A 0x80024B8A 0x80027F8A 0x8002B38A 0x8002E78A 0x80031B8A 0x80034F8A 0x8003838A /end VAR_ADDRESS
 /end VAR_CHARACTERISTIC
 /begin VAR_CHARACTERISTIC S16_WPE_NC_Dump_Gain_Press_r_4th BrkCalVariantCriterion
  /begin VAR_ADDRESS 0x8002178C 0x80024B8C 0x80027F8C 0x8002B38C 0x8002E78C 0x80031B8C 0x80034F8C 0x8003838C /end VAR_ADDRESS
 /end VAR_CHARACTERISTIC
 /begin VAR_CHARACTERISTIC S16_WPE_NC_Dump_Gain_Press_r_5th BrkCalVariantCriterion
  /begin VAR_ADDRESS 0x8002178E 0x80024B8E 0x80027F8E 0x8002B38E 0x8002E78E 0x80031B8E 0x80034F8E 0x8003838E /end VAR_ADDRESS
 /end VAR_CHARACTERISTIC
 /begin VAR_CHARACTERISTIC S16_WPE_NC_Dump_Gain_Press_r_6th BrkCalVariantCriterion
  /begin VAR_ADDRESS 0x80021790 0x80024B90 0x80027F90 0x8002B390 0x8002E790 0x80031B90 0x80034F90 0x80038390 /end VAR_ADDRESS
 /end VAR_CHARACTERISTIC
 /begin VAR_CHARACTERISTIC S16_WPE_NC_Dump_Gain_f_1st BrkCalVariantCriterion
  /begin VAR_ADDRESS 0x8002177A 0x80024B7A 0x80027F7A 0x8002B37A 0x8002E77A 0x80031B7A 0x80034F7A 0x8003837A /end VAR_ADDRESS
 /end VAR_CHARACTERISTIC
 /begin VAR_CHARACTERISTIC S16_WPE_NC_Dump_Gain_f_2nd BrkCalVariantCriterion
  /begin VAR_ADDRESS 0x8002177C 0x80024B7C 0x80027F7C 0x8002B37C 0x8002E77C 0x80031B7C 0x80034F7C 0x8003837C /end VAR_ADDRESS
 /end VAR_CHARACTERISTIC
 /begin VAR_CHARACTERISTIC S16_WPE_NC_Dump_Gain_f_3rd BrkCalVariantCriterion
  /begin VAR_ADDRESS 0x8002177E 0x80024B7E 0x80027F7E 0x8002B37E 0x8002E77E 0x80031B7E 0x80034F7E 0x8003837E /end VAR_ADDRESS
 /end VAR_CHARACTERISTIC
 /begin VAR_CHARACTERISTIC S16_WPE_NC_Dump_Gain_f_4th BrkCalVariantCriterion
  /begin VAR_ADDRESS 0x80021780 0x80024B80 0x80027F80 0x8002B380 0x8002E780 0x80031B80 0x80034F80 0x80038380 /end VAR_ADDRESS
 /end VAR_CHARACTERISTIC
 /begin VAR_CHARACTERISTIC S16_WPE_NC_Dump_Gain_f_5th BrkCalVariantCriterion
  /begin VAR_ADDRESS 0x80021782 0x80024B82 0x80027F82 0x8002B382 0x8002E782 0x80031B82 0x80034F82 0x80038382 /end VAR_ADDRESS
 /end VAR_CHARACTERISTIC
 /begin VAR_CHARACTERISTIC S16_WPE_NC_Dump_Gain_f_6th BrkCalVariantCriterion
  /begin VAR_ADDRESS 0x80021784 0x80024B84 0x80027F84 0x8002B384 0x8002E784 0x80031B84 0x80034F84 0x80038384 /end VAR_ADDRESS
 /end VAR_CHARACTERISTIC
 /begin VAR_CHARACTERISTIC S16_WPE_NC_Dump_Gain_r_1st BrkCalVariantCriterion
  /begin VAR_ADDRESS 0x80021792 0x80024B92 0x80027F92 0x8002B392 0x8002E792 0x80031B92 0x80034F92 0x80038392 /end VAR_ADDRESS
 /end VAR_CHARACTERISTIC
 /begin VAR_CHARACTERISTIC S16_WPE_NC_Dump_Gain_r_2nd BrkCalVariantCriterion
  /begin VAR_ADDRESS 0x80021794 0x80024B94 0x80027F94 0x8002B394 0x8002E794 0x80031B94 0x80034F94 0x80038394 /end VAR_ADDRESS
 /end VAR_CHARACTERISTIC
 /begin VAR_CHARACTERISTIC S16_WPE_NC_Dump_Gain_r_3rd BrkCalVariantCriterion
  /begin VAR_ADDRESS 0x80021796 0x80024B96 0x80027F96 0x8002B396 0x8002E796 0x80031B96 0x80034F96 0x80038396 /end VAR_ADDRESS
 /end VAR_CHARACTERISTIC
 /begin VAR_CHARACTERISTIC S16_WPE_NC_Dump_Gain_r_4th BrkCalVariantCriterion
  /begin VAR_ADDRESS 0x80021798 0x80024B98 0x80027F98 0x8002B398 0x8002E798 0x80031B98 0x80034F98 0x80038398 /end VAR_ADDRESS
 /end VAR_CHARACTERISTIC
 /begin VAR_CHARACTERISTIC S16_WPE_NC_Dump_Gain_r_5th BrkCalVariantCriterion
  /begin VAR_ADDRESS 0x8002179A 0x80024B9A 0x80027F9A 0x8002B39A 0x8002E79A 0x80031B9A 0x80034F9A 0x8003839A /end VAR_ADDRESS
 /end VAR_CHARACTERISTIC
 /begin VAR_CHARACTERISTIC S16_WPE_NC_Dump_Gain_r_6th BrkCalVariantCriterion
  /begin VAR_ADDRESS 0x8002179C 0x80024B9C 0x80027F9C 0x8002B39C 0x8002E79C 0x80031B9C 0x80034F9C 0x8003839C /end VAR_ADDRESS
 /end VAR_CHARACTERISTIC
 /begin VAR_CHARACTERISTIC S16_WPE_TC_Dump_Gain_Press_f_1st BrkCalVariantCriterion
  /begin VAR_ADDRESS 0x800215EA 0x800249EA 0x80027DEA 0x8002B1EA 0x8002E5EA 0x800319EA 0x80034DEA 0x800381EA /end VAR_ADDRESS
 /end VAR_CHARACTERISTIC
 /begin VAR_CHARACTERISTIC S16_WPE_TC_Dump_Gain_Press_f_2nd BrkCalVariantCriterion
  /begin VAR_ADDRESS 0x800215EC 0x800249EC 0x80027DEC 0x8002B1EC 0x8002E5EC 0x800319EC 0x80034DEC 0x800381EC /end VAR_ADDRESS
 /end VAR_CHARACTERISTIC
 /begin VAR_CHARACTERISTIC S16_WPE_TC_Dump_Gain_Press_f_3rd BrkCalVariantCriterion
  /begin VAR_ADDRESS 0x800215EE 0x800249EE 0x80027DEE 0x8002B1EE 0x8002E5EE 0x800319EE 0x80034DEE 0x800381EE /end VAR_ADDRESS
 /end VAR_CHARACTERISTIC
 /begin VAR_CHARACTERISTIC S16_WPE_TC_Dump_Gain_Press_f_4th BrkCalVariantCriterion
  /begin VAR_ADDRESS 0x800215F0 0x800249F0 0x80027DF0 0x8002B1F0 0x8002E5F0 0x800319F0 0x80034DF0 0x800381F0 /end VAR_ADDRESS
 /end VAR_CHARACTERISTIC
 /begin VAR_CHARACTERISTIC S16_WPE_TC_Dump_Gain_Press_f_5th BrkCalVariantCriterion
  /begin VAR_ADDRESS 0x800215F2 0x800249F2 0x80027DF2 0x8002B1F2 0x8002E5F2 0x800319F2 0x80034DF2 0x800381F2 /end VAR_ADDRESS
 /end VAR_CHARACTERISTIC
 /begin VAR_CHARACTERISTIC S16_WPE_TC_Dump_Gain_Press_f_6th BrkCalVariantCriterion
  /begin VAR_ADDRESS 0x800215F4 0x800249F4 0x80027DF4 0x8002B1F4 0x8002E5F4 0x800319F4 0x80034DF4 0x800381F4 /end VAR_ADDRESS
 /end VAR_CHARACTERISTIC
 /begin VAR_CHARACTERISTIC S16_WPE_TC_Dump_Gain_Press_r_1st BrkCalVariantCriterion
  /begin VAR_ADDRESS 0x80021602 0x80024A02 0x80027E02 0x8002B202 0x8002E602 0x80031A02 0x80034E02 0x80038202 /end VAR_ADDRESS
 /end VAR_CHARACTERISTIC
 /begin VAR_CHARACTERISTIC S16_WPE_TC_Dump_Gain_Press_r_2nd BrkCalVariantCriterion
  /begin VAR_ADDRESS 0x80021604 0x80024A04 0x80027E04 0x8002B204 0x8002E604 0x80031A04 0x80034E04 0x80038204 /end VAR_ADDRESS
 /end VAR_CHARACTERISTIC
 /begin VAR_CHARACTERISTIC S16_WPE_TC_Dump_Gain_Press_r_3rd BrkCalVariantCriterion
  /begin VAR_ADDRESS 0x80021606 0x80024A06 0x80027E06 0x8002B206 0x8002E606 0x80031A06 0x80034E06 0x80038206 /end VAR_ADDRESS
 /end VAR_CHARACTERISTIC
 /begin VAR_CHARACTERISTIC S16_WPE_TC_Dump_Gain_Press_r_4th BrkCalVariantCriterion
  /begin VAR_ADDRESS 0x80021608 0x80024A08 0x80027E08 0x8002B208 0x8002E608 0x80031A08 0x80034E08 0x80038208 /end VAR_ADDRESS
 /end VAR_CHARACTERISTIC
 /begin VAR_CHARACTERISTIC S16_WPE_TC_Dump_Gain_Press_r_5th BrkCalVariantCriterion
  /begin VAR_ADDRESS 0x8002160A 0x80024A0A 0x80027E0A 0x8002B20A 0x8002E60A 0x80031A0A 0x80034E0A 0x8003820A /end VAR_ADDRESS
 /end VAR_CHARACTERISTIC
 /begin VAR_CHARACTERISTIC S16_WPE_TC_Dump_Gain_Press_r_6th BrkCalVariantCriterion
  /begin VAR_ADDRESS 0x8002160C 0x80024A0C 0x80027E0C 0x8002B20C 0x8002E60C 0x80031A0C 0x80034E0C 0x8003820C /end VAR_ADDRESS
 /end VAR_CHARACTERISTIC
 /begin VAR_CHARACTERISTIC S16_WPE_TC_Dump_Gain_f_1st BrkCalVariantCriterion
  /begin VAR_ADDRESS 0x800215F6 0x800249F6 0x80027DF6 0x8002B1F6 0x8002E5F6 0x800319F6 0x80034DF6 0x800381F6 /end VAR_ADDRESS
 /end VAR_CHARACTERISTIC
 /begin VAR_CHARACTERISTIC S16_WPE_TC_Dump_Gain_f_2nd BrkCalVariantCriterion
  /begin VAR_ADDRESS 0x800215F8 0x800249F8 0x80027DF8 0x8002B1F8 0x8002E5F8 0x800319F8 0x80034DF8 0x800381F8 /end VAR_ADDRESS
 /end VAR_CHARACTERISTIC
 /begin VAR_CHARACTERISTIC S16_WPE_TC_Dump_Gain_f_3rd BrkCalVariantCriterion
  /begin VAR_ADDRESS 0x800215FA 0x800249FA 0x80027DFA 0x8002B1FA 0x8002E5FA 0x800319FA 0x80034DFA 0x800381FA /end VAR_ADDRESS
 /end VAR_CHARACTERISTIC
 /begin VAR_CHARACTERISTIC S16_WPE_TC_Dump_Gain_f_4th BrkCalVariantCriterion
  /begin VAR_ADDRESS 0x800215FC 0x800249FC 0x80027DFC 0x8002B1FC 0x8002E5FC 0x800319FC 0x80034DFC 0x800381FC /end VAR_ADDRESS
 /end VAR_CHARACTERISTIC
 /begin VAR_CHARACTERISTIC S16_WPE_TC_Dump_Gain_f_5th BrkCalVariantCriterion
  /begin VAR_ADDRESS 0x800215FE 0x800249FE 0x80027DFE 0x8002B1FE 0x8002E5FE 0x800319FE 0x80034DFE 0x800381FE /end VAR_ADDRESS
 /end VAR_CHARACTERISTIC
 /begin VAR_CHARACTERISTIC S16_WPE_TC_Dump_Gain_f_6th BrkCalVariantCriterion
  /begin VAR_ADDRESS 0x80021600 0x80024A00 0x80027E00 0x8002B200 0x8002E600 0x80031A00 0x80034E00 0x80038200 /end VAR_ADDRESS
 /end VAR_CHARACTERISTIC
 /begin VAR_CHARACTERISTIC S16_WPE_TC_Dump_Gain_r_1st BrkCalVariantCriterion
  /begin VAR_ADDRESS 0x8002160E 0x80024A0E 0x80027E0E 0x8002B20E 0x8002E60E 0x80031A0E 0x80034E0E 0x8003820E /end VAR_ADDRESS
 /end VAR_CHARACTERISTIC
 /begin VAR_CHARACTERISTIC S16_WPE_TC_Dump_Gain_r_2nd BrkCalVariantCriterion
  /begin VAR_ADDRESS 0x80021610 0x80024A10 0x80027E10 0x8002B210 0x8002E610 0x80031A10 0x80034E10 0x80038210 /end VAR_ADDRESS
 /end VAR_CHARACTERISTIC
 /begin VAR_CHARACTERISTIC S16_WPE_TC_Dump_Gain_r_3rd BrkCalVariantCriterion
  /begin VAR_ADDRESS 0x80021612 0x80024A12 0x80027E12 0x8002B212 0x8002E612 0x80031A12 0x80034E12 0x80038212 /end VAR_ADDRESS
 /end VAR_CHARACTERISTIC
 /begin VAR_CHARACTERISTIC S16_WPE_TC_Dump_Gain_r_4th BrkCalVariantCriterion
  /begin VAR_ADDRESS 0x80021614 0x80024A14 0x80027E14 0x8002B214 0x8002E614 0x80031A14 0x80034E14 0x80038214 /end VAR_ADDRESS
 /end VAR_CHARACTERISTIC
 /begin VAR_CHARACTERISTIC S16_WPE_TC_Dump_Gain_r_5th BrkCalVariantCriterion
  /begin VAR_ADDRESS 0x80021616 0x80024A16 0x80027E16 0x8002B216 0x8002E616 0x80031A16 0x80034E16 0x80038216 /end VAR_ADDRESS
 /end VAR_CHARACTERISTIC
 /begin VAR_CHARACTERISTIC S16_WPE_TC_Dump_Gain_r_6th BrkCalVariantCriterion
  /begin VAR_ADDRESS 0x80021618 0x80024A18 0x80027E18 0x8002B218 0x8002E618 0x80031A18 0x80034E18 0x80038218 /end VAR_ADDRESS
 /end VAR_CHARACTERISTIC
 /begin VAR_CHARACTERISTIC S16_WPE_TC_Rels_Comp_Gain_f_1 BrkCalVariantCriterion
  /begin VAR_ADDRESS 0x8002162E 0x80024A2E 0x80027E2E 0x8002B22E 0x8002E62E 0x80031A2E 0x80034E2E 0x8003822E /end VAR_ADDRESS
 /end VAR_CHARACTERISTIC
 /begin VAR_CHARACTERISTIC S16_WPE_TC_Rels_Comp_Gain_f_2 BrkCalVariantCriterion
  /begin VAR_ADDRESS 0x80021630 0x80024A30 0x80027E30 0x8002B230 0x8002E630 0x80031A30 0x80034E30 0x80038230 /end VAR_ADDRESS
 /end VAR_CHARACTERISTIC
 /begin VAR_CHARACTERISTIC S16_WPE_TC_Rels_Comp_Gain_f_3 BrkCalVariantCriterion
  /begin VAR_ADDRESS 0x80021632 0x80024A32 0x80027E32 0x8002B232 0x8002E632 0x80031A32 0x80034E32 0x80038232 /end VAR_ADDRESS
 /end VAR_CHARACTERISTIC
 /begin VAR_CHARACTERISTIC S16_WPE_TC_Rels_Comp_Gain_f_4 BrkCalVariantCriterion
  /begin VAR_ADDRESS 0x80021634 0x80024A34 0x80027E34 0x8002B234 0x8002E634 0x80031A34 0x80034E34 0x80038234 /end VAR_ADDRESS
 /end VAR_CHARACTERISTIC
 /begin VAR_CHARACTERISTIC S16_WPE_TC_Rels_Comp_Gain_f_5 BrkCalVariantCriterion
  /begin VAR_ADDRESS 0x80021636 0x80024A36 0x80027E36 0x8002B236 0x8002E636 0x80031A36 0x80034E36 0x80038236 /end VAR_ADDRESS
 /end VAR_CHARACTERISTIC
 /begin VAR_CHARACTERISTIC S16_WPE_TC_Rels_Comp_Gain_f_6 BrkCalVariantCriterion
  /begin VAR_ADDRESS 0x80021638 0x80024A38 0x80027E38 0x8002B238 0x8002E638 0x80031A38 0x80034E38 0x80038238 /end VAR_ADDRESS
 /end VAR_CHARACTERISTIC
 /begin VAR_CHARACTERISTIC S16_WPE_TC_Rels_Comp_Gain_r_1 BrkCalVariantCriterion
  /begin VAR_ADDRESS 0x80021646 0x80024A46 0x80027E46 0x8002B246 0x8002E646 0x80031A46 0x80034E46 0x80038246 /end VAR_ADDRESS
 /end VAR_CHARACTERISTIC
 /begin VAR_CHARACTERISTIC S16_WPE_TC_Rels_Comp_Gain_r_2 BrkCalVariantCriterion
  /begin VAR_ADDRESS 0x80021648 0x80024A48 0x80027E48 0x8002B248 0x8002E648 0x80031A48 0x80034E48 0x80038248 /end VAR_ADDRESS
 /end VAR_CHARACTERISTIC
 /begin VAR_CHARACTERISTIC S16_WPE_TC_Rels_Comp_Gain_r_3 BrkCalVariantCriterion
  /begin VAR_ADDRESS 0x8002164A 0x80024A4A 0x80027E4A 0x8002B24A 0x8002E64A 0x80031A4A 0x80034E4A 0x8003824A /end VAR_ADDRESS
 /end VAR_CHARACTERISTIC
 /begin VAR_CHARACTERISTIC S16_WPE_TC_Rels_Comp_Gain_r_4 BrkCalVariantCriterion
  /begin VAR_ADDRESS 0x8002164C 0x80024A4C 0x80027E4C 0x8002B24C 0x8002E64C 0x80031A4C 0x80034E4C 0x8003824C /end VAR_ADDRESS
 /end VAR_CHARACTERISTIC
 /begin VAR_CHARACTERISTIC S16_WPE_TC_Rels_Comp_Gain_r_5 BrkCalVariantCriterion
  /begin VAR_ADDRESS 0x8002164E 0x80024A4E 0x80027E4E 0x8002B24E 0x8002E64E 0x80031A4E 0x80034E4E 0x8003824E /end VAR_ADDRESS
 /end VAR_CHARACTERISTIC
 /begin VAR_CHARACTERISTIC S16_WPE_TC_Rels_Comp_Gain_r_6 BrkCalVariantCriterion
  /begin VAR_ADDRESS 0x80021650 0x80024A50 0x80027E50 0x8002B250 0x8002E650 0x80031A50 0x80034E50 0x80038250 /end VAR_ADDRESS
 /end VAR_CHARACTERISTIC
 /begin VAR_CHARACTERISTIC S16_WPE_TC_Rels_Comp_Press_f_1 BrkCalVariantCriterion
  /begin VAR_ADDRESS 0x80021622 0x80024A22 0x80027E22 0x8002B222 0x8002E622 0x80031A22 0x80034E22 0x80038222 /end VAR_ADDRESS
 /end VAR_CHARACTERISTIC
 /begin VAR_CHARACTERISTIC S16_WPE_TC_Rels_Comp_Press_f_2 BrkCalVariantCriterion
  /begin VAR_ADDRESS 0x80021624 0x80024A24 0x80027E24 0x8002B224 0x8002E624 0x80031A24 0x80034E24 0x80038224 /end VAR_ADDRESS
 /end VAR_CHARACTERISTIC
 /begin VAR_CHARACTERISTIC S16_WPE_TC_Rels_Comp_Press_f_3 BrkCalVariantCriterion
  /begin VAR_ADDRESS 0x80021626 0x80024A26 0x80027E26 0x8002B226 0x8002E626 0x80031A26 0x80034E26 0x80038226 /end VAR_ADDRESS
 /end VAR_CHARACTERISTIC
 /begin VAR_CHARACTERISTIC S16_WPE_TC_Rels_Comp_Press_f_4 BrkCalVariantCriterion
  /begin VAR_ADDRESS 0x80021628 0x80024A28 0x80027E28 0x8002B228 0x8002E628 0x80031A28 0x80034E28 0x80038228 /end VAR_ADDRESS
 /end VAR_CHARACTERISTIC
 /begin VAR_CHARACTERISTIC S16_WPE_TC_Rels_Comp_Press_f_5 BrkCalVariantCriterion
  /begin VAR_ADDRESS 0x8002162A 0x80024A2A 0x80027E2A 0x8002B22A 0x8002E62A 0x80031A2A 0x80034E2A 0x8003822A /end VAR_ADDRESS
 /end VAR_CHARACTERISTIC
 /begin VAR_CHARACTERISTIC S16_WPE_TC_Rels_Comp_Press_f_6 BrkCalVariantCriterion
  /begin VAR_ADDRESS 0x8002162C 0x80024A2C 0x80027E2C 0x8002B22C 0x8002E62C 0x80031A2C 0x80034E2C 0x8003822C /end VAR_ADDRESS
 /end VAR_CHARACTERISTIC
 /begin VAR_CHARACTERISTIC S16_WPE_TC_Rels_Comp_Press_r_1 BrkCalVariantCriterion
  /begin VAR_ADDRESS 0x8002163A 0x80024A3A 0x80027E3A 0x8002B23A 0x8002E63A 0x80031A3A 0x80034E3A 0x8003823A /end VAR_ADDRESS
 /end VAR_CHARACTERISTIC
 /begin VAR_CHARACTERISTIC S16_WPE_TC_Rels_Comp_Press_r_2 BrkCalVariantCriterion
  /begin VAR_ADDRESS 0x8002163C 0x80024A3C 0x80027E3C 0x8002B23C 0x8002E63C 0x80031A3C 0x80034E3C 0x8003823C /end VAR_ADDRESS
 /end VAR_CHARACTERISTIC
 /begin VAR_CHARACTERISTIC S16_WPE_TC_Rels_Comp_Press_r_3 BrkCalVariantCriterion
  /begin VAR_ADDRESS 0x8002163E 0x80024A3E 0x80027E3E 0x8002B23E 0x8002E63E 0x80031A3E 0x80034E3E 0x8003823E /end VAR_ADDRESS
 /end VAR_CHARACTERISTIC
 /begin VAR_CHARACTERISTIC S16_WPE_TC_Rels_Comp_Press_r_4 BrkCalVariantCriterion
  /begin VAR_ADDRESS 0x80021640 0x80024A40 0x80027E40 0x8002B240 0x8002E640 0x80031A40 0x80034E40 0x80038240 /end VAR_ADDRESS
 /end VAR_CHARACTERISTIC
 /begin VAR_CHARACTERISTIC S16_WPE_TC_Rels_Comp_Press_r_5 BrkCalVariantCriterion
  /begin VAR_ADDRESS 0x80021642 0x80024A42 0x80027E42 0x8002B242 0x8002E642 0x80031A42 0x80034E42 0x80038242 /end VAR_ADDRESS
 /end VAR_CHARACTERISTIC
 /begin VAR_CHARACTERISTIC S16_WPE_TC_Rels_Comp_Press_r_6 BrkCalVariantCriterion
  /begin VAR_ADDRESS 0x80021644 0x80024A44 0x80027E44 0x8002B244 0x8002E644 0x80031A44 0x80034E44 0x80038244 /end VAR_ADDRESS
 /end VAR_CHARACTERISTIC
 /begin VAR_CHARACTERISTIC S16_WPE_TC_Valve_Hold_Duty_V_1 BrkCalVariantCriterion
  /begin VAR_ADDRESS 0x800214F2 0x800248F2 0x80027CF2 0x8002B0F2 0x8002E4F2 0x800318F2 0x80034CF2 0x800380F2 /end VAR_ADDRESS
 /end VAR_CHARACTERISTIC
 /begin VAR_CHARACTERISTIC S16_WPE_TC_Valve_Hold_Duty_V_10 BrkCalVariantCriterion
  /begin VAR_ADDRESS 0x80021504 0x80024904 0x80027D04 0x8002B104 0x8002E504 0x80031904 0x80034D04 0x80038104 /end VAR_ADDRESS
 /end VAR_CHARACTERISTIC
 /begin VAR_CHARACTERISTIC S16_WPE_TC_Valve_Hold_Duty_V_11 BrkCalVariantCriterion
  /begin VAR_ADDRESS 0x80021506 0x80024906 0x80027D06 0x8002B106 0x8002E506 0x80031906 0x80034D06 0x80038106 /end VAR_ADDRESS
 /end VAR_CHARACTERISTIC
 /begin VAR_CHARACTERISTIC S16_WPE_TC_Valve_Hold_Duty_V_12 BrkCalVariantCriterion
  /begin VAR_ADDRESS 0x80021508 0x80024908 0x80027D08 0x8002B108 0x8002E508 0x80031908 0x80034D08 0x80038108 /end VAR_ADDRESS
 /end VAR_CHARACTERISTIC
 /begin VAR_CHARACTERISTIC S16_WPE_TC_Valve_Hold_Duty_V_13 BrkCalVariantCriterion
  /begin VAR_ADDRESS 0x8002150A 0x8002490A 0x80027D0A 0x8002B10A 0x8002E50A 0x8003190A 0x80034D0A 0x8003810A /end VAR_ADDRESS
 /end VAR_CHARACTERISTIC
 /begin VAR_CHARACTERISTIC S16_WPE_TC_Valve_Hold_Duty_V_14 BrkCalVariantCriterion
  /begin VAR_ADDRESS 0x8002150C 0x8002490C 0x80027D0C 0x8002B10C 0x8002E50C 0x8003190C 0x80034D0C 0x8003810C /end VAR_ADDRESS
 /end VAR_CHARACTERISTIC
 /begin VAR_CHARACTERISTIC S16_WPE_TC_Valve_Hold_Duty_V_15 BrkCalVariantCriterion
  /begin VAR_ADDRESS 0x8002150E 0x8002490E 0x80027D0E 0x8002B10E 0x8002E50E 0x8003190E 0x80034D0E 0x8003810E /end VAR_ADDRESS
 /end VAR_CHARACTERISTIC
 /begin VAR_CHARACTERISTIC S16_WPE_TC_Valve_Hold_Duty_V_16 BrkCalVariantCriterion
  /begin VAR_ADDRESS 0x80021510 0x80024910 0x80027D10 0x8002B110 0x8002E510 0x80031910 0x80034D10 0x80038110 /end VAR_ADDRESS
 /end VAR_CHARACTERISTIC
 /begin VAR_CHARACTERISTIC S16_WPE_TC_Valve_Hold_Duty_V_2 BrkCalVariantCriterion
  /begin VAR_ADDRESS 0x800214F4 0x800248F4 0x80027CF4 0x8002B0F4 0x8002E4F4 0x800318F4 0x80034CF4 0x800380F4 /end VAR_ADDRESS
 /end VAR_CHARACTERISTIC
 /begin VAR_CHARACTERISTIC S16_WPE_TC_Valve_Hold_Duty_V_3 BrkCalVariantCriterion
  /begin VAR_ADDRESS 0x800214F6 0x800248F6 0x80027CF6 0x8002B0F6 0x8002E4F6 0x800318F6 0x80034CF6 0x800380F6 /end VAR_ADDRESS
 /end VAR_CHARACTERISTIC
 /begin VAR_CHARACTERISTIC S16_WPE_TC_Valve_Hold_Duty_V_4 BrkCalVariantCriterion
  /begin VAR_ADDRESS 0x800214F8 0x800248F8 0x80027CF8 0x8002B0F8 0x8002E4F8 0x800318F8 0x80034CF8 0x800380F8 /end VAR_ADDRESS
 /end VAR_CHARACTERISTIC
 /begin VAR_CHARACTERISTIC S16_WPE_TC_Valve_Hold_Duty_V_5 BrkCalVariantCriterion
  /begin VAR_ADDRESS 0x800214FA 0x800248FA 0x80027CFA 0x8002B0FA 0x8002E4FA 0x800318FA 0x80034CFA 0x800380FA /end VAR_ADDRESS
 /end VAR_CHARACTERISTIC
 /begin VAR_CHARACTERISTIC S16_WPE_TC_Valve_Hold_Duty_V_6 BrkCalVariantCriterion
  /begin VAR_ADDRESS 0x800214FC 0x800248FC 0x80027CFC 0x8002B0FC 0x8002E4FC 0x800318FC 0x80034CFC 0x800380FC /end VAR_ADDRESS
 /end VAR_CHARACTERISTIC
 /begin VAR_CHARACTERISTIC S16_WPE_TC_Valve_Hold_Duty_V_7 BrkCalVariantCriterion
  /begin VAR_ADDRESS 0x800214FE 0x800248FE 0x80027CFE 0x8002B0FE 0x8002E4FE 0x800318FE 0x80034CFE 0x800380FE /end VAR_ADDRESS
 /end VAR_CHARACTERISTIC
 /begin VAR_CHARACTERISTIC S16_WPE_TC_Valve_Hold_Duty_V_8 BrkCalVariantCriterion
  /begin VAR_ADDRESS 0x80021500 0x80024900 0x80027D00 0x8002B100 0x8002E500 0x80031900 0x80034D00 0x80038100 /end VAR_ADDRESS
 /end VAR_CHARACTERISTIC
 /begin VAR_CHARACTERISTIC S16_WPE_TC_Valve_Hold_Duty_V_9 BrkCalVariantCriterion
  /begin VAR_ADDRESS 0x80021502 0x80024902 0x80027D02 0x8002B102 0x8002E502 0x80031902 0x80034D02 0x80038102 /end VAR_ADDRESS
 /end VAR_CHARACTERISTIC
 /begin VAR_CHARACTERISTIC S16_WPE_TC_Valve_Hold_Press_V_1 BrkCalVariantCriterion
  /begin VAR_ADDRESS 0x80021512 0x80024912 0x80027D12 0x8002B112 0x8002E512 0x80031912 0x80034D12 0x80038112 /end VAR_ADDRESS
 /end VAR_CHARACTERISTIC
 /begin VAR_CHARACTERISTIC S16_WPE_TC_Valve_Hold_Press_V_10 BrkCalVariantCriterion
  /begin VAR_ADDRESS 0x80021524 0x80024924 0x80027D24 0x8002B124 0x8002E524 0x80031924 0x80034D24 0x80038124 /end VAR_ADDRESS
 /end VAR_CHARACTERISTIC
 /begin VAR_CHARACTERISTIC S16_WPE_TC_Valve_Hold_Press_V_11 BrkCalVariantCriterion
  /begin VAR_ADDRESS 0x80021526 0x80024926 0x80027D26 0x8002B126 0x8002E526 0x80031926 0x80034D26 0x80038126 /end VAR_ADDRESS
 /end VAR_CHARACTERISTIC
 /begin VAR_CHARACTERISTIC S16_WPE_TC_Valve_Hold_Press_V_12 BrkCalVariantCriterion
  /begin VAR_ADDRESS 0x80021528 0x80024928 0x80027D28 0x8002B128 0x8002E528 0x80031928 0x80034D28 0x80038128 /end VAR_ADDRESS
 /end VAR_CHARACTERISTIC
 /begin VAR_CHARACTERISTIC S16_WPE_TC_Valve_Hold_Press_V_13 BrkCalVariantCriterion
  /begin VAR_ADDRESS 0x8002152A 0x8002492A 0x80027D2A 0x8002B12A 0x8002E52A 0x8003192A 0x80034D2A 0x8003812A /end VAR_ADDRESS
 /end VAR_CHARACTERISTIC
 /begin VAR_CHARACTERISTIC S16_WPE_TC_Valve_Hold_Press_V_14 BrkCalVariantCriterion
  /begin VAR_ADDRESS 0x8002152C 0x8002492C 0x80027D2C 0x8002B12C 0x8002E52C 0x8003192C 0x80034D2C 0x8003812C /end VAR_ADDRESS
 /end VAR_CHARACTERISTIC
 /begin VAR_CHARACTERISTIC S16_WPE_TC_Valve_Hold_Press_V_15 BrkCalVariantCriterion
  /begin VAR_ADDRESS 0x8002152E 0x8002492E 0x80027D2E 0x8002B12E 0x8002E52E 0x8003192E 0x80034D2E 0x8003812E /end VAR_ADDRESS
 /end VAR_CHARACTERISTIC
 /begin VAR_CHARACTERISTIC S16_WPE_TC_Valve_Hold_Press_V_16 BrkCalVariantCriterion
  /begin VAR_ADDRESS 0x80021530 0x80024930 0x80027D30 0x8002B130 0x8002E530 0x80031930 0x80034D30 0x80038130 /end VAR_ADDRESS
 /end VAR_CHARACTERISTIC
 /begin VAR_CHARACTERISTIC S16_WPE_TC_Valve_Hold_Press_V_2 BrkCalVariantCriterion
  /begin VAR_ADDRESS 0x80021514 0x80024914 0x80027D14 0x8002B114 0x8002E514 0x80031914 0x80034D14 0x80038114 /end VAR_ADDRESS
 /end VAR_CHARACTERISTIC
 /begin VAR_CHARACTERISTIC S16_WPE_TC_Valve_Hold_Press_V_3 BrkCalVariantCriterion
  /begin VAR_ADDRESS 0x80021516 0x80024916 0x80027D16 0x8002B116 0x8002E516 0x80031916 0x80034D16 0x80038116 /end VAR_ADDRESS
 /end VAR_CHARACTERISTIC
 /begin VAR_CHARACTERISTIC S16_WPE_TC_Valve_Hold_Press_V_4 BrkCalVariantCriterion
  /begin VAR_ADDRESS 0x80021518 0x80024918 0x80027D18 0x8002B118 0x8002E518 0x80031918 0x80034D18 0x80038118 /end VAR_ADDRESS
 /end VAR_CHARACTERISTIC
 /begin VAR_CHARACTERISTIC S16_WPE_TC_Valve_Hold_Press_V_5 BrkCalVariantCriterion
  /begin VAR_ADDRESS 0x8002151A 0x8002491A 0x80027D1A 0x8002B11A 0x8002E51A 0x8003191A 0x80034D1A 0x8003811A /end VAR_ADDRESS
 /end VAR_CHARACTERISTIC
 /begin VAR_CHARACTERISTIC S16_WPE_TC_Valve_Hold_Press_V_6 BrkCalVariantCriterion
  /begin VAR_ADDRESS 0x8002151C 0x8002491C 0x80027D1C 0x8002B11C 0x8002E51C 0x8003191C 0x80034D1C 0x8003811C /end VAR_ADDRESS
 /end VAR_CHARACTERISTIC
 /begin VAR_CHARACTERISTIC S16_WPE_TC_Valve_Hold_Press_V_7 BrkCalVariantCriterion
  /begin VAR_ADDRESS 0x8002151E 0x8002491E 0x80027D1E 0x8002B11E 0x8002E51E 0x8003191E 0x80034D1E 0x8003811E /end VAR_ADDRESS
 /end VAR_CHARACTERISTIC
 /begin VAR_CHARACTERISTIC S16_WPE_TC_Valve_Hold_Press_V_8 BrkCalVariantCriterion
  /begin VAR_ADDRESS 0x80021520 0x80024920 0x80027D20 0x8002B120 0x8002E520 0x80031920 0x80034D20 0x80038120 /end VAR_ADDRESS
 /end VAR_CHARACTERISTIC
 /begin VAR_CHARACTERISTIC S16_WPE_TC_Valve_Hold_Press_V_9 BrkCalVariantCriterion
  /begin VAR_ADDRESS 0x80021522 0x80024922 0x80027D22 0x8002B122 0x8002E522 0x80031922 0x80034D22 0x80038122 /end VAR_ADDRESS
 /end VAR_CHARACTERISTIC
 /begin VAR_CHARACTERISTIC S16_WPE_WPE_Max_TCMF_Hold_Press BrkCalVariantCriterion
  /begin VAR_ADDRESS 0x8002161A 0x80024A1A 0x80027E1A 0x8002B21A 0x8002E61A 0x80031A1A 0x80034E1A 0x8003821A /end VAR_ADDRESS
 /end VAR_CHARACTERISTIC
 /begin VAR_CHARACTERISTIC S16_WPE_WPE_MotorEff_MPRESS_ON_BAR BrkCalVariantCriterion
  /begin VAR_ADDRESS 0x80021534 0x80024934 0x80027D34 0x8002B134 0x8002E534 0x80031934 0x80034D34 0x80038134 /end VAR_ADDRESS
 /end VAR_CHARACTERISTIC
 /begin VAR_CHARACTERISTIC S8_ACC_CONT_B_D_GAIN EngCalVariantCriterion
  /begin VAR_ADDRESS 0x8003A8E9 0x8003B6E9 0x8003C4E9 0x8003D2E9 0x8003E0E9 0x8003EEE9 0x8003FCE9 0x80040AE9 0x800418E9 0x800426E9 0x800434E9 0x800442E9 0x800450E9 0x80045EE9 0x80046CE9 0x80047AE9 0x800488E9 0x800496E9 0x8004A4E9 0x8004B2E9 0x8004C0E9 0x8004CEE9 0x8004DCE9 0x8004EAE9 /end VAR_ADDRESS
 /end VAR_CHARACTERISTIC
 /begin VAR_CHARACTERISTIC S8_ACC_CONT_B_G1_D_GAIN EngCalVariantCriterion
  /begin VAR_ADDRESS 0x8003A8E5 0x8003B6E5 0x8003C4E5 0x8003D2E5 0x8003E0E5 0x8003EEE5 0x8003FCE5 0x80040AE5 0x800418E5 0x800426E5 0x800434E5 0x800442E5 0x800450E5 0x80045EE5 0x80046CE5 0x80047AE5 0x800488E5 0x800496E5 0x8004A4E5 0x8004B2E5 0x8004C0E5 0x8004CEE5 0x8004DCE5 0x8004EAE5 /end VAR_ADDRESS
 /end VAR_CHARACTERISTIC
 /begin VAR_CHARACTERISTIC S8_ACC_CONT_B_G1_I_GAIN EngCalVariantCriterion
  /begin VAR_ADDRESS 0x8003A8E6 0x8003B6E6 0x8003C4E6 0x8003D2E6 0x8003E0E6 0x8003EEE6 0x8003FCE6 0x80040AE6 0x800418E6 0x800426E6 0x800434E6 0x800442E6 0x800450E6 0x80045EE6 0x80046CE6 0x80047AE6 0x800488E6 0x800496E6 0x8004A4E6 0x8004B2E6 0x8004C0E6 0x8004CEE6 0x8004DCE6 0x8004EAE6 /end VAR_ADDRESS
 /end VAR_CHARACTERISTIC
 /begin VAR_CHARACTERISTIC S8_ACC_CONT_B_G1_P_GAIN EngCalVariantCriterion
  /begin VAR_ADDRESS 0x8003A8E7 0x8003B6E7 0x8003C4E7 0x8003D2E7 0x8003E0E7 0x8003EEE7 0x8003FCE7 0x80040AE7 0x800418E7 0x800426E7 0x800434E7 0x800442E7 0x800450E7 0x80045EE7 0x80046CE7 0x80047AE7 0x800488E7 0x800496E7 0x8004A4E7 0x8004B2E7 0x8004C0E7 0x8004CEE7 0x8004DCE7 0x8004EAE7 /end VAR_ADDRESS
 /end VAR_CHARACTERISTIC
 /begin VAR_CHARACTERISTIC S8_ACC_CONT_B_G1_P_GAIN_MINUS_G_ERR EngCalVariantCriterion
  /begin VAR_ADDRESS 0x8003A8E8 0x8003B6E8 0x8003C4E8 0x8003D2E8 0x8003E0E8 0x8003EEE8 0x8003FCE8 0x80040AE8 0x800418E8 0x800426E8 0x800434E8 0x800442E8 0x800450E8 0x80045EE8 0x80046CE8 0x80047AE8 0x800488E8 0x800496E8 0x8004A4E8 0x8004B2E8 0x8004C0E8 0x8004CEE8 0x8004DCE8 0x8004EAE8 /end VAR_ADDRESS
 /end VAR_CHARACTERISTIC
 /begin VAR_CHARACTERISTIC S8_ACC_CONT_B_HILLDOWN_STOP_D_GAIN EngCalVariantCriterion
  /begin VAR_ADDRESS 0x8003A8F3 0x8003B6F3 0x8003C4F3 0x8003D2F3 0x8003E0F3 0x8003EEF3 0x8003FCF3 0x80040AF3 0x800418F3 0x800426F3 0x800434F3 0x800442F3 0x800450F3 0x80045EF3 0x80046CF3 0x80047AF3 0x800488F3 0x800496F3 0x8004A4F3 0x8004B2F3 0x8004C0F3 0x8004CEF3 0x8004DCF3 0x8004EAF3 /end VAR_ADDRESS
 /end VAR_CHARACTERISTIC
 /begin VAR_CHARACTERISTIC S8_ACC_CONT_B_HILLDOWN_STOP_I_GAIN EngCalVariantCriterion
  /begin VAR_ADDRESS 0x8003A8F4 0x8003B6F4 0x8003C4F4 0x8003D2F4 0x8003E0F4 0x8003EEF4 0x8003FCF4 0x80040AF4 0x800418F4 0x800426F4 0x800434F4 0x800442F4 0x800450F4 0x80045EF4 0x80046CF4 0x80047AF4 0x800488F4 0x800496F4 0x8004A4F4 0x8004B2F4 0x8004C0F4 0x8004CEF4 0x8004DCF4 0x8004EAF4 /end VAR_ADDRESS
 /end VAR_CHARACTERISTIC
 /begin VAR_CHARACTERISTIC S8_ACC_CONT_B_HILLDOWN_STOP_P_GAIN EngCalVariantCriterion
  /begin VAR_ADDRESS 0x8003A8F5 0x8003B6F5 0x8003C4F5 0x8003D2F5 0x8003E0F5 0x8003EEF5 0x8003FCF5 0x80040AF5 0x800418F5 0x800426F5 0x800434F5 0x800442F5 0x800450F5 0x80045EF5 0x80046CF5 0x80047AF5 0x800488F5 0x800496F5 0x8004A4F5 0x8004B2F5 0x8004C0F5 0x8004CEF5 0x8004DCF5 0x8004EAF5 /end VAR_ADDRESS
 /end VAR_CHARACTERISTIC
 /begin VAR_CHARACTERISTIC S8_ACC_CONT_B_HILLUP_STOP_D_GAIN EngCalVariantCriterion
  /begin VAR_ADDRESS 0x8003A8F0 0x8003B6F0 0x8003C4F0 0x8003D2F0 0x8003E0F0 0x8003EEF0 0x8003FCF0 0x80040AF0 0x800418F0 0x800426F0 0x800434F0 0x800442F0 0x800450F0 0x80045EF0 0x80046CF0 0x80047AF0 0x800488F0 0x800496F0 0x8004A4F0 0x8004B2F0 0x8004C0F0 0x8004CEF0 0x8004DCF0 0x8004EAF0 /end VAR_ADDRESS
 /end VAR_CHARACTERISTIC
 /begin VAR_CHARACTERISTIC S8_ACC_CONT_B_HILLUP_STOP_I_GAIN EngCalVariantCriterion
  /begin VAR_ADDRESS 0x8003A8F1 0x8003B6F1 0x8003C4F1 0x8003D2F1 0x8003E0F1 0x8003EEF1 0x8003FCF1 0x80040AF1 0x800418F1 0x800426F1 0x800434F1 0x800442F1 0x800450F1 0x80045EF1 0x80046CF1 0x80047AF1 0x800488F1 0x800496F1 0x8004A4F1 0x8004B2F1 0x8004C0F1 0x8004CEF1 0x8004DCF1 0x8004EAF1 /end VAR_ADDRESS
 /end VAR_CHARACTERISTIC
 /begin VAR_CHARACTERISTIC S8_ACC_CONT_B_HILLUP_STOP_P_GAIN EngCalVariantCriterion
  /begin VAR_ADDRESS 0x8003A8F2 0x8003B6F2 0x8003C4F2 0x8003D2F2 0x8003E0F2 0x8003EEF2 0x8003FCF2 0x80040AF2 0x800418F2 0x800426F2 0x800434F2 0x800442F2 0x800450F2 0x80045EF2 0x80046CF2 0x80047AF2 0x800488F2 0x800496F2 0x8004A4F2 0x8004B2F2 0x8004C0F2 0x8004CEF2 0x8004DCF2 0x8004EAF2 /end VAR_ADDRESS
 /end VAR_CHARACTERISTIC
 /begin VAR_CHARACTERISTIC S8_ACC_CONT_B_I_GAIN EngCalVariantCriterion
  /begin VAR_ADDRESS 0x8003A8EA 0x8003B6EA 0x8003C4EA 0x8003D2EA 0x8003E0EA 0x8003EEEA 0x8003FCEA 0x80040AEA 0x800418EA 0x800426EA 0x800434EA 0x800442EA 0x800450EA 0x80045EEA 0x80046CEA 0x80047AEA 0x800488EA 0x800496EA 0x8004A4EA 0x8004B2EA 0x8004C0EA 0x8004CEEA 0x8004DCEA 0x8004EAEA /end VAR_ADDRESS
 /end VAR_CHARACTERISTIC
 /begin VAR_CHARACTERISTIC S8_ACC_CONT_B_P_GAIN EngCalVariantCriterion
  /begin VAR_ADDRESS 0x8003A8EB 0x8003B6EB 0x8003C4EB 0x8003D2EB 0x8003E0EB 0x8003EEEB 0x8003FCEB 0x80040AEB 0x800418EB 0x800426EB 0x800434EB 0x800442EB 0x800450EB 0x80045EEB 0x80046CEB 0x80047AEB 0x800488EB 0x800496EB 0x8004A4EB 0x8004B2EB 0x8004C0EB 0x8004CEEB 0x8004DCEB 0x8004EAEB /end VAR_ADDRESS
 /end VAR_CHARACTERISTIC
 /begin VAR_CHARACTERISTIC S8_ACC_CONT_B_P_GAIN_MINUS_G_ERR EngCalVariantCriterion
  /begin VAR_ADDRESS 0x8003A8EC 0x8003B6EC 0x8003C4EC 0x8003D2EC 0x8003E0EC 0x8003EEEC 0x8003FCEC 0x80040AEC 0x800418EC 0x800426EC 0x800434EC 0x800442EC 0x800450EC 0x80045EEC 0x80046CEC 0x80047AEC 0x800488EC 0x800496EC 0x8004A4EC 0x8004B2EC 0x8004C0EC 0x8004CEEC 0x8004DCEC 0x8004EAEC /end VAR_ADDRESS
 /end VAR_CHARACTERISTIC
 /begin VAR_CHARACTERISTIC S8_ACC_CONT_B_STOP_D_GAIN EngCalVariantCriterion
  /begin VAR_ADDRESS 0x8003A8ED 0x8003B6ED 0x8003C4ED 0x8003D2ED 0x8003E0ED 0x8003EEED 0x8003FCED 0x80040AED 0x800418ED 0x800426ED 0x800434ED 0x800442ED 0x800450ED 0x80045EED 0x80046CED 0x80047AED 0x800488ED 0x800496ED 0x8004A4ED 0x8004B2ED 0x8004C0ED 0x8004CEED 0x8004DCED 0x8004EAED /end VAR_ADDRESS
 /end VAR_CHARACTERISTIC
 /begin VAR_CHARACTERISTIC S8_ACC_CONT_B_STOP_I_GAIN EngCalVariantCriterion
  /begin VAR_ADDRESS 0x8003A8EE 0x8003B6EE 0x8003C4EE 0x8003D2EE 0x8003E0EE 0x8003EEEE 0x8003FCEE 0x80040AEE 0x800418EE 0x800426EE 0x800434EE 0x800442EE 0x800450EE 0x80045EEE 0x80046CEE 0x80047AEE 0x800488EE 0x800496EE 0x8004A4EE 0x8004B2EE 0x8004C0EE 0x8004CEEE 0x8004DCEE 0x8004EAEE /end VAR_ADDRESS
 /end VAR_CHARACTERISTIC
 /begin VAR_CHARACTERISTIC S8_ACC_CONT_B_STOP_P_GAIN EngCalVariantCriterion
  /begin VAR_ADDRESS 0x8003A8EF 0x8003B6EF 0x8003C4EF 0x8003D2EF 0x8003E0EF 0x8003EEEF 0x8003FCEF 0x80040AEF 0x800418EF 0x800426EF 0x800434EF 0x800442EF 0x800450EF 0x80045EEF 0x80046CEF 0x80047AEF 0x800488EF 0x800496EF 0x8004A4EF 0x8004B2EF 0x8004C0EF 0x8004CEEF 0x8004DCEF 0x8004EAEF /end VAR_ADDRESS
 /end VAR_CHARACTERISTIC
 /begin VAR_CHARACTERISTIC S8_ACC_CONT_E_D_GAIN EngCalVariantCriterion
  /begin VAR_ADDRESS 0x8003A8DD 0x8003B6DD 0x8003C4DD 0x8003D2DD 0x8003E0DD 0x8003EEDD 0x8003FCDD 0x80040ADD 0x800418DD 0x800426DD 0x800434DD 0x800442DD 0x800450DD 0x80045EDD 0x80046CDD 0x80047ADD 0x800488DD 0x800496DD 0x8004A4DD 0x8004B2DD 0x8004C0DD 0x8004CEDD 0x8004DCDD 0x8004EADD /end VAR_ADDRESS
 /end VAR_CHARACTERISTIC
 /begin VAR_CHARACTERISTIC S8_ACC_CONT_E_G1_D_GAIN EngCalVariantCriterion
  /begin VAR_ADDRESS 0x8003A8D5 0x8003B6D5 0x8003C4D5 0x8003D2D5 0x8003E0D5 0x8003EED5 0x8003FCD5 0x80040AD5 0x800418D5 0x800426D5 0x800434D5 0x800442D5 0x800450D5 0x80045ED5 0x80046CD5 0x80047AD5 0x800488D5 0x800496D5 0x8004A4D5 0x8004B2D5 0x8004C0D5 0x8004CED5 0x8004DCD5 0x8004EAD5 /end VAR_ADDRESS
 /end VAR_CHARACTERISTIC
 /begin VAR_CHARACTERISTIC S8_ACC_CONT_E_G1_I_GAIN EngCalVariantCriterion
  /begin VAR_ADDRESS 0x8003A8D6 0x8003B6D6 0x8003C4D6 0x8003D2D6 0x8003E0D6 0x8003EED6 0x8003FCD6 0x80040AD6 0x800418D6 0x800426D6 0x800434D6 0x800442D6 0x800450D6 0x80045ED6 0x80046CD6 0x80047AD6 0x800488D6 0x800496D6 0x8004A4D6 0x8004B2D6 0x8004C0D6 0x8004CED6 0x8004DCD6 0x8004EAD6 /end VAR_ADDRESS
 /end VAR_CHARACTERISTIC
 /begin VAR_CHARACTERISTIC S8_ACC_CONT_E_G1_P_GAIN EngCalVariantCriterion
  /begin VAR_ADDRESS 0x8003A8D7 0x8003B6D7 0x8003C4D7 0x8003D2D7 0x8003E0D7 0x8003EED7 0x8003FCD7 0x80040AD7 0x800418D7 0x800426D7 0x800434D7 0x800442D7 0x800450D7 0x80045ED7 0x80046CD7 0x80047AD7 0x800488D7 0x800496D7 0x8004A4D7 0x8004B2D7 0x8004C0D7 0x8004CED7 0x8004DCD7 0x8004EAD7 /end VAR_ADDRESS
 /end VAR_CHARACTERISTIC
 /begin VAR_CHARACTERISTIC S8_ACC_CONT_E_G1_P_GAIN_MINUS_G_ERR EngCalVariantCriterion
  /begin VAR_ADDRESS 0x8003A8D8 0x8003B6D8 0x8003C4D8 0x8003D2D8 0x8003E0D8 0x8003EED8 0x8003FCD8 0x80040AD8 0x800418D8 0x800426D8 0x800434D8 0x800442D8 0x800450D8 0x80045ED8 0x80046CD8 0x80047AD8 0x800488D8 0x800496D8 0x8004A4D8 0x8004B2D8 0x8004C0D8 0x8004CED8 0x8004DCD8 0x8004EAD8 /end VAR_ADDRESS
 /end VAR_CHARACTERISTIC
 /begin VAR_CHARACTERISTIC S8_ACC_CONT_E_G23_D_GAIN EngCalVariantCriterion
  /begin VAR_ADDRESS 0x8003A8D9 0x8003B6D9 0x8003C4D9 0x8003D2D9 0x8003E0D9 0x8003EED9 0x8003FCD9 0x80040AD9 0x800418D9 0x800426D9 0x800434D9 0x800442D9 0x800450D9 0x80045ED9 0x80046CD9 0x80047AD9 0x800488D9 0x800496D9 0x8004A4D9 0x8004B2D9 0x8004C0D9 0x8004CED9 0x8004DCD9 0x8004EAD9 /end VAR_ADDRESS
 /end VAR_CHARACTERISTIC
 /begin VAR_CHARACTERISTIC S8_ACC_CONT_E_G23_I_GAIN EngCalVariantCriterion
  /begin VAR_ADDRESS 0x8003A8DA 0x8003B6DA 0x8003C4DA 0x8003D2DA 0x8003E0DA 0x8003EEDA 0x8003FCDA 0x80040ADA 0x800418DA 0x800426DA 0x800434DA 0x800442DA 0x800450DA 0x80045EDA 0x80046CDA 0x80047ADA 0x800488DA 0x800496DA 0x8004A4DA 0x8004B2DA 0x8004C0DA 0x8004CEDA 0x8004DCDA 0x8004EADA /end VAR_ADDRESS
 /end VAR_CHARACTERISTIC
 /begin VAR_CHARACTERISTIC S8_ACC_CONT_E_G23_P_GAIN EngCalVariantCriterion
  /begin VAR_ADDRESS 0x8003A8DB 0x8003B6DB 0x8003C4DB 0x8003D2DB 0x8003E0DB 0x8003EEDB 0x8003FCDB 0x80040ADB 0x800418DB 0x800426DB 0x800434DB 0x800442DB 0x800450DB 0x80045EDB 0x80046CDB 0x80047ADB 0x800488DB 0x800496DB 0x8004A4DB 0x8004B2DB 0x8004C0DB 0x8004CEDB 0x8004DCDB 0x8004EADB /end VAR_ADDRESS
 /end VAR_CHARACTERISTIC
 /begin VAR_CHARACTERISTIC S8_ACC_CONT_E_G23_P_GAIN_MINUS_G_ERR EngCalVariantCriterion
  /begin VAR_ADDRESS 0x8003A8DC 0x8003B6DC 0x8003C4DC 0x8003D2DC 0x8003E0DC 0x8003EEDC 0x8003FCDC 0x80040ADC 0x800418DC 0x800426DC 0x800434DC 0x800442DC 0x800450DC 0x80045EDC 0x80046CDC 0x80047ADC 0x800488DC 0x800496DC 0x8004A4DC 0x8004B2DC 0x8004C0DC 0x8004CEDC 0x8004DCDC 0x8004EADC /end VAR_ADDRESS
 /end VAR_CHARACTERISTIC
 /begin VAR_CHARACTERISTIC S8_ACC_CONT_E_I_GAIN EngCalVariantCriterion
  /begin VAR_ADDRESS 0x8003A8DE 0x8003B6DE 0x8003C4DE 0x8003D2DE 0x8003E0DE 0x8003EEDE 0x8003FCDE 0x80040ADE 0x800418DE 0x800426DE 0x800434DE 0x800442DE 0x800450DE 0x80045EDE 0x80046CDE 0x80047ADE 0x800488DE 0x800496DE 0x8004A4DE 0x8004B2DE 0x8004C0DE 0x8004CEDE 0x8004DCDE 0x8004EADE /end VAR_ADDRESS
 /end VAR_CHARACTERISTIC
 /begin VAR_CHARACTERISTIC S8_ACC_CONT_E_P_GAIN EngCalVariantCriterion
  /begin VAR_ADDRESS 0x8003A8DF 0x8003B6DF 0x8003C4DF 0x8003D2DF 0x8003E0DF 0x8003EEDF 0x8003FCDF 0x80040ADF 0x800418DF 0x800426DF 0x800434DF 0x800442DF 0x800450DF 0x80045EDF 0x80046CDF 0x80047ADF 0x800488DF 0x800496DF 0x8004A4DF 0x8004B2DF 0x8004C0DF 0x8004CEDF 0x8004DCDF 0x8004EADF /end VAR_ADDRESS
 /end VAR_CHARACTERISTIC
 /begin VAR_CHARACTERISTIC S8_ACC_CONT_E_P_GAIN_MINUS_G_ERR EngCalVariantCriterion
  /begin VAR_ADDRESS 0x8003A8E0 0x8003B6E0 0x8003C4E0 0x8003D2E0 0x8003E0E0 0x8003EEE0 0x8003FCE0 0x80040AE0 0x800418E0 0x800426E0 0x800434E0 0x800442E0 0x800450E0 0x80045EE0 0x80046CE0 0x80047AE0 0x800488E0 0x800496E0 0x8004A4E0 0x8004B2E0 0x8004C0E0 0x8004CEE0 0x8004DCE0 0x8004EAE0 /end VAR_ADDRESS
 /end VAR_CHARACTERISTIC
 /begin VAR_CHARACTERISTIC SSM_EPB_lms16FS_Reserved1 EngCalVariantCriterion
  /begin VAR_ADDRESS 0x8003A886 0x8003B686 0x8003C486 0x8003D286 0x8003E086 0x8003EE86 0x8003FC86 0x80040A86 0x80041886 0x80042686 0x80043486 0x80044286 0x80045086 0x80045E86 0x80046C86 0x80047A86 0x80048886 0x80049686 0x8004A486 0x8004B286 0x8004C086 0x8004CE86 0x8004DC86 0x8004EA86 /end VAR_ADDRESS
 /end VAR_CHARACTERISTIC
 /begin VAR_CHARACTERISTIC SSM_EPB_lms16FS_Reserved2 EngCalVariantCriterion
  /begin VAR_ADDRESS 0x8003A888 0x8003B688 0x8003C488 0x8003D288 0x8003E088 0x8003EE88 0x8003FC88 0x80040A88 0x80041888 0x80042688 0x80043488 0x80044288 0x80045088 0x80045E88 0x80046C88 0x80047A88 0x80048888 0x80049688 0x8004A488 0x8004B288 0x8004C088 0x8004CE88 0x8004DC88 0x8004EA88 /end VAR_ADDRESS
 /end VAR_CHARACTERISTIC
 /begin VAR_CHARACTERISTIC SSM_EPB_lms16FS_Reserved3 EngCalVariantCriterion
  /begin VAR_ADDRESS 0x8003A88A 0x8003B68A 0x8003C48A 0x8003D28A 0x8003E08A 0x8003EE8A 0x8003FC8A 0x80040A8A 0x8004188A 0x8004268A 0x8004348A 0x8004428A 0x8004508A 0x80045E8A 0x80046C8A 0x80047A8A 0x8004888A 0x8004968A 0x8004A48A 0x8004B28A 0x8004C08A 0x8004CE8A 0x8004DC8A 0x8004EA8A /end VAR_ADDRESS
 /end VAR_CHARACTERISTIC
 /begin VAR_CHARACTERISTIC SSM_EPB_lms16FS_Reserved4 EngCalVariantCriterion
  /begin VAR_ADDRESS 0x8003A88C 0x8003B68C 0x8003C48C 0x8003D28C 0x8003E08C 0x8003EE8C 0x8003FC8C 0x80040A8C 0x8004188C 0x8004268C 0x8004348C 0x8004428C 0x8004508C 0x80045E8C 0x80046C8C 0x80047A8C 0x8004888C 0x8004968C 0x8004A48C 0x8004B28C 0x8004C08C 0x8004CE8C 0x8004DC8C 0x8004EA8C /end VAR_ADDRESS
 /end VAR_CHARACTERISTIC
 /begin VAR_CHARACTERISTIC SSM_EPB_lms16FS_Reserved5 EngCalVariantCriterion
  /begin VAR_ADDRESS 0x8003A88E 0x8003B68E 0x8003C48E 0x8003D28E 0x8003E08E 0x8003EE8E 0x8003FC8E 0x80040A8E 0x8004188E 0x8004268E 0x8004348E 0x8004428E 0x8004508E 0x80045E8E 0x80046C8E 0x80047A8E 0x8004888E 0x8004968E 0x8004A48E 0x8004B28E 0x8004C08E 0x8004CE8E 0x8004DC8E 0x8004EA8E /end VAR_ADDRESS
 /end VAR_CHARACTERISTIC
 /begin VAR_CHARACTERISTIC SSM_EPB_lmu8FS_Reserved1 EngCalVariantCriterion
  /begin VAR_ADDRESS 0x8003A890 0x8003B690 0x8003C490 0x8003D290 0x8003E090 0x8003EE90 0x8003FC90 0x80040A90 0x80041890 0x80042690 0x80043490 0x80044290 0x80045090 0x80045E90 0x80046C90 0x80047A90 0x80048890 0x80049690 0x8004A490 0x8004B290 0x8004C090 0x8004CE90 0x8004DC90 0x8004EA90 /end VAR_ADDRESS
 /end VAR_CHARACTERISTIC
 /begin VAR_CHARACTERISTIC SSM_EPB_lmu8FS_Reserved2 EngCalVariantCriterion
  /begin VAR_ADDRESS 0x8003A891 0x8003B691 0x8003C491 0x8003D291 0x8003E091 0x8003EE91 0x8003FC91 0x80040A91 0x80041891 0x80042691 0x80043491 0x80044291 0x80045091 0x80045E91 0x80046C91 0x80047A91 0x80048891 0x80049691 0x8004A491 0x8004B291 0x8004C091 0x8004CE91 0x8004DC91 0x8004EA91 /end VAR_ADDRESS
 /end VAR_CHARACTERISTIC
 /begin VAR_CHARACTERISTIC SSM_EPB_lmu8FS_Reserved3 EngCalVariantCriterion
  /begin VAR_ADDRESS 0x8003A892 0x8003B692 0x8003C492 0x8003D292 0x8003E092 0x8003EE92 0x8003FC92 0x80040A92 0x80041892 0x80042692 0x80043492 0x80044292 0x80045092 0x80045E92 0x80046C92 0x80047A92 0x80048892 0x80049692 0x8004A492 0x8004B292 0x8004C092 0x8004CE92 0x8004DC92 0x8004EA92 /end VAR_ADDRESS
 /end VAR_CHARACTERISTIC
 /begin VAR_CHARACTERISTIC SSM_EPB_lmu8FS_Reserved4 EngCalVariantCriterion
  /begin VAR_ADDRESS 0x8003A893 0x8003B693 0x8003C493 0x8003D293 0x8003E093 0x8003EE93 0x8003FC93 0x80040A93 0x80041893 0x80042693 0x80043493 0x80044293 0x80045093 0x80045E93 0x80046C93 0x80047A93 0x80048893 0x80049693 0x8004A493 0x8004B293 0x8004C093 0x8004CE93 0x8004DC93 0x8004EA93 /end VAR_ADDRESS
 /end VAR_CHARACTERISTIC
 /begin VAR_CHARACTERISTIC SSM_EPB_lmu8FS_Reserved5 EngCalVariantCriterion
  /begin VAR_ADDRESS 0x8003A894 0x8003B694 0x8003C494 0x8003D294 0x8003E094 0x8003EE94 0x8003FC94 0x80040A94 0x80041894 0x80042694 0x80043494 0x80044294 0x80045094 0x80045E94 0x80046C94 0x80047A94 0x80048894 0x80049694 0x8004A494 0x8004B294 0x8004C094 0x8004CE94 0x8004DC94 0x8004EA94 /end VAR_ADDRESS
 /end VAR_CHARACTERISTIC
 /begin VAR_CHARACTERISTIC SSM_K_AutoAdjust_Apply_Feature_En EngCalVariantCriterion
  /begin VAR_ADDRESS 0x8003A86C 0x8003B66C 0x8003C46C 0x8003D26C 0x8003E06C 0x8003EE6C 0x8003FC6C 0x80040A6C 0x8004186C 0x8004266C 0x8004346C 0x8004426C 0x8004506C 0x80045E6C 0x80046C6C 0x80047A6C 0x8004886C 0x8004966C 0x8004A46C 0x8004B26C 0x8004C06C 0x8004CE6C 0x8004DC6C 0x8004EA6C /end VAR_ADDRESS
 /end VAR_CHARACTERISTIC
 /begin VAR_CHARACTERISTIC SSM_K_AutoAdjust_Apply_OdoMeter EngCalVariantCriterion
  /begin VAR_ADDRESS 0x8003A86E 0x8003B66E 0x8003C46E 0x8003D26E 0x8003E06E 0x8003EE6E 0x8003FC6E 0x80040A6E 0x8004186E 0x8004266E 0x8004346E 0x8004426E 0x8004506E 0x80045E6E 0x80046C6E 0x80047A6E 0x8004886E 0x8004966E 0x8004A46E 0x8004B26E 0x8004C06E 0x8004CE6E 0x8004DC6E 0x8004EA6E /end VAR_ADDRESS
 /end VAR_CHARACTERISTIC
 /begin VAR_CHARACTERISTIC SSM_K_ClutchSwitch_From_ClutchSensor EngCalVariantCriterion
  /begin VAR_ADDRESS 0x8003A7FA 0x8003B5FA 0x8003C3FA 0x8003D1FA 0x8003DFFA 0x8003EDFA 0x8003FBFA 0x800409FA 0x800417FA 0x800425FA 0x800433FA 0x800441FA 0x80044FFA 0x80045DFA 0x80046BFA 0x800479FA 0x800487FA 0x800495FA 0x8004A3FA 0x8004B1FA 0x8004BFFA 0x8004CDFA 0x8004DBFA 0x8004E9FA /end VAR_ADDRESS
 /end VAR_CHARACTERISTIC
 /begin VAR_CHARACTERISTIC SSM_K_Clutch_Engage_LongG_Avr_Max EngCalVariantCriterion
  /begin VAR_ADDRESS 0x8003A7FC 0x8003B5FC 0x8003C3FC 0x8003D1FC 0x8003DFFC 0x8003EDFC 0x8003FBFC 0x800409FC 0x800417FC 0x800425FC 0x800433FC 0x800441FC 0x80044FFC 0x80045DFC 0x80046BFC 0x800479FC 0x800487FC 0x800495FC 0x8004A3FC 0x8004B1FC 0x8004BFFC 0x8004CDFC 0x8004DBFC 0x8004E9FC /end VAR_ADDRESS
 /end VAR_CHARACTERISTIC
 /begin VAR_CHARACTERISTIC SSM_K_Clutch_Engage_LongG_Avr_Min EngCalVariantCriterion
  /begin VAR_ADDRESS 0x8003A7FE 0x8003B5FE 0x8003C3FE 0x8003D1FE 0x8003DFFE 0x8003EDFE 0x8003FBFE 0x800409FE 0x800417FE 0x800425FE 0x800433FE 0x800441FE 0x80044FFE 0x80045DFE 0x80046BFE 0x800479FE 0x800487FE 0x800495FE 0x8004A3FE 0x8004B1FE 0x8004BFFE 0x8004CDFE 0x8004DBFE 0x8004E9FE /end VAR_ADDRESS
 /end VAR_CHARACTERISTIC
 /begin VAR_CHARACTERISTIC SSM_K_Clutch_Engage_Study_LongG_Th1 EngCalVariantCriterion
  /begin VAR_ADDRESS 0x8003A800 0x8003B600 0x8003C400 0x8003D200 0x8003E000 0x8003EE00 0x8003FC00 0x80040A00 0x80041800 0x80042600 0x80043400 0x80044200 0x80045000 0x80045E00 0x80046C00 0x80047A00 0x80048800 0x80049600 0x8004A400 0x8004B200 0x8004C000 0x8004CE00 0x8004DC00 0x8004EA00 /end VAR_ADDRESS
 /end VAR_CHARACTERISTIC
 /begin VAR_CHARACTERISTIC SSM_K_Clutch_Engage_Study_LongG_Th2 EngCalVariantCriterion
  /begin VAR_ADDRESS 0x8003A802 0x8003B602 0x8003C402 0x8003D202 0x8003E002 0x8003EE02 0x8003FC02 0x80040A02 0x80041802 0x80042602 0x80043402 0x80044202 0x80045002 0x80045E02 0x80046C02 0x80047A02 0x80048802 0x80049602 0x8004A402 0x8004B202 0x8004C002 0x8004CE02 0x8004DC02 0x8004EA02 /end VAR_ADDRESS
 /end VAR_CHARACTERISTIC
 /begin VAR_CHARACTERISTIC SSM_K_Clutch_Engage_Study_LongG_Th3 EngCalVariantCriterion
  /begin VAR_ADDRESS 0x8003A804 0x8003B604 0x8003C404 0x8003D204 0x8003E004 0x8003EE04 0x8003FC04 0x80040A04 0x80041804 0x80042604 0x80043404 0x80044204 0x80045004 0x80045E04 0x80046C04 0x80047A04 0x80048804 0x80049604 0x8004A404 0x8004B204 0x8004C004 0x8004CE04 0x8004DC04 0x8004EA04 /end VAR_ADDRESS
 /end VAR_CHARACTERISTIC
 /begin VAR_CHARACTERISTIC SSM_K_Clutch_Engage_Study_LongG_Th4 EngCalVariantCriterion
  /begin VAR_ADDRESS 0x8003A806 0x8003B606 0x8003C406 0x8003D206 0x8003E006 0x8003EE06 0x8003FC06 0x80040A06 0x80041806 0x80042606 0x80043406 0x80044206 0x80045006 0x80045E06 0x80046C06 0x80047A06 0x80048806 0x80049606 0x8004A406 0x8004B206 0x8004C006 0x8004CE06 0x8004DC06 0x8004EA06 /end VAR_ADDRESS
 /end VAR_CHARACTERISTIC
 /begin VAR_CHARACTERISTIC SSM_K_Current_Sensor_Offset EngCalVariantCriterion
  /begin VAR_ADDRESS 0x8003A7C9 0x8003B5C9 0x8003C3C9 0x8003D1C9 0x8003DFC9 0x8003EDC9 0x8003FBC9 0x800409C9 0x800417C9 0x800425C9 0x800433C9 0x800441C9 0x80044FC9 0x80045DC9 0x80046BC9 0x800479C9 0x800487C9 0x800495C9 0x8004A3C9 0x8004B1C9 0x8004BFC9 0x8004CDC9 0x8004DBC9 0x8004E9C9 /end VAR_ADDRESS
 /end VAR_CHARACTERISTIC
 /begin VAR_CHARACTERISTIC SSM_K_Current_Sensor_Offset_EEPROM EngCalVariantCriterion
  /begin VAR_ADDRESS 0x8003A7CA 0x8003B5CA 0x8003C3CA 0x8003D1CA 0x8003DFCA 0x8003EDCA 0x8003FBCA 0x800409CA 0x800417CA 0x800425CA 0x800433CA 0x800441CA 0x80044FCA 0x80045DCA 0x80046BCA 0x800479CA 0x800487CA 0x800495CA 0x8004A3CA 0x8004B1CA 0x8004BFCA 0x8004CDCA 0x8004DBCA 0x8004E9CA /end VAR_ADDRESS
 /end VAR_CHARACTERISTIC
 /begin VAR_CHARACTERISTIC SSM_K_EPB_AVH_TimeOut_Suspect_Time_Th EngCalVariantCriterion
  /begin VAR_ADDRESS 0x8003A84B 0x8003B64B 0x8003C44B 0x8003D24B 0x8003E04B 0x8003EE4B 0x8003FC4B 0x80040A4B 0x8004184B 0x8004264B 0x8004344B 0x8004424B 0x8004504B 0x80045E4B 0x80046C4B 0x80047A4B 0x8004884B 0x8004964B 0x8004A44B 0x8004B24B 0x8004C04B 0x8004CE4B 0x8004DC4B 0x8004EA4B /end VAR_ADDRESS
 /end VAR_CHARACTERISTIC
 /begin VAR_CHARACTERISTIC SSM_K_EPB_Auto_Apply_HillStop_Feature_En EngCalVariantCriterion
  /begin VAR_ADDRESS 0x8003A83B 0x8003B63B 0x8003C43B 0x8003D23B 0x8003E03B 0x8003EE3B 0x8003FC3B 0x80040A3B 0x8004183B 0x8004263B 0x8004343B 0x8004423B 0x8004503B 0x80045E3B 0x80046C3B 0x80047A3B 0x8004883B 0x8004963B 0x8004A43B 0x8004B23B 0x8004C03B 0x8004CE3B 0x8004DC3B 0x8004EA3B /end VAR_ADDRESS
 /end VAR_CHARACTERISTIC
 /begin VAR_CHARACTERISTIC SSM_K_EPB_Auto_Apply_SW_Fail_Feature_En EngCalVariantCriterion
  /begin VAR_ADDRESS 0x8003A83A 0x8003B63A 0x8003C43A 0x8003D23A 0x8003E03A 0x8003EE3A 0x8003FC3A 0x80040A3A 0x8004183A 0x8004263A 0x8004343A 0x8004423A 0x8004503A 0x80045E3A 0x80046C3A 0x80047A3A 0x8004883A 0x8004963A 0x8004A43A 0x8004B23A 0x8004C03A 0x8004CE3A 0x8004DC3A 0x8004EA3A /end VAR_ADDRESS
 /end VAR_CHARACTERISTIC
 /begin VAR_CHARACTERISTIC SSM_K_EPB_Auto_Release_Door_Close_Act EngCalVariantCriterion
  /begin VAR_ADDRESS 0x8003A844 0x8003B644 0x8003C444 0x8003D244 0x8003E044 0x8003EE44 0x8003FC44 0x80040A44 0x80041844 0x80042644 0x80043444 0x80044244 0x80045044 0x80045E44 0x80046C44 0x80047A44 0x80048844 0x80049644 0x8004A444 0x8004B244 0x8004C044 0x8004CE44 0x8004DC44 0x8004EA44 /end VAR_ADDRESS
 /end VAR_CHARACTERISTIC
 /begin VAR_CHARACTERISTIC SSM_K_EPB_Auto_Release_MT_IN_Gear_Act EngCalVariantCriterion
  /begin VAR_ADDRESS 0x8003A845 0x8003B645 0x8003C445 0x8003D245 0x8003E045 0x8003EE45 0x8003FC45 0x80040A45 0x80041845 0x80042645 0x80043445 0x80044245 0x80045045 0x80045E45 0x80046C45 0x80047A45 0x80048845 0x80049645 0x8004A445 0x8004B245 0x8004C045 0x8004CE45 0x8004DC45 0x8004EA45 /end VAR_ADDRESS
 /end VAR_CHARACTERISTIC
 /begin VAR_CHARACTERISTIC SSM_K_EPB_Automatic_Apply_AVH_On_Act EngCalVariantCriterion
  /begin VAR_ADDRESS 0x8003A831 0x8003B631 0x8003C431 0x8003D231 0x8003E031 0x8003EE31 0x8003FC31 0x80040A31 0x80041831 0x80042631 0x80043431 0x80044231 0x80045031 0x80045E31 0x80046C31 0x80047A31 0x80048831 0x80049631 0x8004A431 0x8004B231 0x8004C031 0x8004CE31 0x8004DC31 0x8004EA31 /end VAR_ADDRESS
 /end VAR_CHARACTERISTIC
 /begin VAR_CHARACTERISTIC SSM_K_EPB_Automatic_Apply_DoorBelt_Feature_En EngCalVariantCriterion
  /begin VAR_ADDRESS 0x8003A832 0x8003B632 0x8003C432 0x8003D232 0x8003E032 0x8003EE32 0x8003FC32 0x80040A32 0x80041832 0x80042632 0x80043432 0x80044232 0x80045032 0x80045E32 0x80046C32 0x80047A32 0x80048832 0x80049632 0x8004A432 0x8004B232 0x8004C032 0x8004CE32 0x8004DC32 0x8004EA32 /end VAR_ADDRESS
 /end VAR_CHARACTERISTIC
 /begin VAR_CHARACTERISTIC SSM_K_EPB_Automatic_Apply_Eng_Off_Act EngCalVariantCriterion
  /begin VAR_ADDRESS 0x8003A833 0x8003B633 0x8003C433 0x8003D233 0x8003E033 0x8003EE33 0x8003FC33 0x80040A33 0x80041833 0x80042633 0x80043433 0x80044233 0x80045033 0x80045E33 0x80046C33 0x80047A33 0x80048833 0x80049633 0x8004A433 0x8004B233 0x8004C033 0x8004CE33 0x8004DC33 0x8004EA33 /end VAR_ADDRESS
 /end VAR_CHARACTERISTIC
 /begin VAR_CHARACTERISTIC SSM_K_EPB_Automatic_Apply_Ign_Feature_En EngCalVariantCriterion
  /begin VAR_ADDRESS 0x8003A834 0x8003B634 0x8003C434 0x8003D234 0x8003E034 0x8003EE34 0x8003FC34 0x80040A34 0x80041834 0x80042634 0x80043434 0x80044234 0x80045034 0x80045E34 0x80046C34 0x80047A34 0x80048834 0x80049634 0x8004A434 0x8004B234 0x8004C034 0x8004CE34 0x8004DC34 0x8004EA34 /end VAR_ADDRESS
 /end VAR_CHARACTERISTIC
 /begin VAR_CHARACTERISTIC SSM_K_EPB_Automatic_Apply_Ign_Off_Act EngCalVariantCriterion
  /begin VAR_ADDRESS 0x8003A835 0x8003B635 0x8003C435 0x8003D235 0x8003E035 0x8003EE35 0x8003FC35 0x80040A35 0x80041835 0x80042635 0x80043435 0x80044235 0x80045035 0x80045E35 0x80046C35 0x80047A35 0x80048835 0x80049635 0x8004A435 0x8004B235 0x8004C035 0x8004CE35 0x8004DC35 0x8004EA35 /end VAR_ADDRESS
 /end VAR_CHARACTERISTIC
 /begin VAR_CHARACTERISTIC SSM_K_EPB_Automatic_Apply_Key_Out_Act EngCalVariantCriterion
  /begin VAR_ADDRESS 0x8003A836 0x8003B636 0x8003C436 0x8003D236 0x8003E036 0x8003EE36 0x8003FC36 0x80040A36 0x80041836 0x80042636 0x80043436 0x80044236 0x80045036 0x80045E36 0x80046C36 0x80047A36 0x80048836 0x80049636 0x8004A436 0x8004B236 0x8004C036 0x8004CE36 0x8004DC36 0x8004EA36 /end VAR_ADDRESS
 /end VAR_CHARACTERISTIC
 /begin VAR_CHARACTERISTIC SSM_K_EPB_Automatic_Apply_Key_Out_Inibit_Time EngCalVariantCriterion
  /begin VAR_ADDRESS 0x8003A838 0x8003B638 0x8003C438 0x8003D238 0x8003E038 0x8003EE38 0x8003FC38 0x80040A38 0x80041838 0x80042638 0x80043438 0x80044238 0x80045038 0x80045E38 0x80046C38 0x80047A38 0x80048838 0x80049638 0x8004A438 0x8004B238 0x8004C038 0x8004CE38 0x8004DC38 0x8004EA38 /end VAR_ADDRESS
 /end VAR_CHARACTERISTIC
 /begin VAR_CHARACTERISTIC SSM_K_EPB_Automatic_Release_Feature_En EngCalVariantCriterion
  /begin VAR_ADDRESS 0x8003A843 0x8003B643 0x8003C443 0x8003D243 0x8003E043 0x8003EE43 0x8003FC43 0x80040A43 0x80041843 0x80042643 0x80043443 0x80044243 0x80045043 0x80045E43 0x80046C43 0x80047A43 0x80048843 0x80049643 0x8004A443 0x8004B243 0x8004C043 0x8004CE43 0x8004DC43 0x8004EA43 /end VAR_ADDRESS
 /end VAR_CHARACTERISTIC
 /begin VAR_CHARACTERISTIC SSM_K_EPB_Automatic_Switch_Feature_En EngCalVariantCriterion
  /begin VAR_ADDRESS 0x8003A842 0x8003B642 0x8003C442 0x8003D242 0x8003E042 0x8003EE42 0x8003FC42 0x80040A42 0x80041842 0x80042642 0x80043442 0x80044242 0x80045042 0x80045E42 0x80046C42 0x80047A42 0x80048842 0x80049642 0x8004A442 0x8004B242 0x8004C042 0x8004CE42 0x8004DC42 0x8004EA42 /end VAR_ADDRESS
 /end VAR_CHARACTERISTIC
 /begin VAR_CHARACTERISTIC SSM_K_EPB_Autonomous_Apply_Driven_Spd_Th EngCalVariantCriterion
  /begin VAR_ADDRESS 0x8003A846 0x8003B646 0x8003C446 0x8003D246 0x8003E046 0x8003EE46 0x8003FC46 0x80040A46 0x80041846 0x80042646 0x80043446 0x80044246 0x80045046 0x80045E46 0x80046C46 0x80047A46 0x80048846 0x80049646 0x8004A446 0x8004B246 0x8004C046 0x8004CE46 0x8004DC46 0x8004EA46 /end VAR_ADDRESS
 /end VAR_CHARACTERISTIC
 /begin VAR_CHARACTERISTIC SSM_K_EPB_Autonomous_Apply_ESC_Feature_En EngCalVariantCriterion
  /begin VAR_ADDRESS 0x8003A848 0x8003B648 0x8003C448 0x8003D248 0x8003E048 0x8003EE48 0x8003FC48 0x80040A48 0x80041848 0x80042648 0x80043448 0x80044248 0x80045048 0x80045E48 0x80046C48 0x80047A48 0x80048848 0x80049648 0x8004A448 0x8004B248 0x8004C048 0x8004CE48 0x8004DC48 0x8004EA48 /end VAR_ADDRESS
 /end VAR_CHARACTERISTIC
 /begin VAR_CHARACTERISTIC SSM_K_EPB_Autonomous_Apply_ETRS_Feature_En EngCalVariantCriterion
  /begin VAR_ADDRESS 0x8003A849 0x8003B649 0x8003C449 0x8003D249 0x8003E049 0x8003EE49 0x8003FC49 0x80040A49 0x80041849 0x80042649 0x80043449 0x80044249 0x80045049 0x80045E49 0x80046C49 0x80047A49 0x80048849 0x80049649 0x8004A449 0x8004B249 0x8004C049 0x8004CE49 0x8004DC49 0x8004EA49 /end VAR_ADDRESS
 /end VAR_CHARACTERISTIC
 /begin VAR_CHARACTERISTIC SSM_K_EPB_Autonomous_Apply_VICM_Feature_En EngCalVariantCriterion
  /begin VAR_ADDRESS 0x8003A84A 0x8003B64A 0x8003C44A 0x8003D24A 0x8003E04A 0x8003EE4A 0x8003FC4A 0x80040A4A 0x8004184A 0x8004264A 0x8004344A 0x8004424A 0x8004504A 0x80045E4A 0x80046C4A 0x80047A4A 0x8004884A 0x8004964A 0x8004A44A 0x8004B24A 0x8004C04A 0x8004CE4A 0x8004DC4A 0x8004EA4A /end VAR_ADDRESS
 /end VAR_CHARACTERISTIC
 /begin VAR_CHARACTERISTIC SSM_K_EPB_ClutchEngageStudy_Feature_En EngCalVariantCriterion
  /begin VAR_ADDRESS 0x8003A808 0x8003B608 0x8003C408 0x8003D208 0x8003E008 0x8003EE08 0x8003FC08 0x80040A08 0x80041808 0x80042608 0x80043408 0x80044208 0x80045008 0x80045E08 0x80046C08 0x80047A08 0x80048808 0x80049608 0x8004A408 0x8004B208 0x8004C008 0x8004CE08 0x8004DC08 0x8004EA08 /end VAR_ADDRESS
 /end VAR_CHARACTERISTIC
 /begin VAR_CHARACTERISTIC SSM_K_EPB_Clutch_Engage_Detect_Speed EngCalVariantCriterion
  /begin VAR_ADDRESS 0x8003A809 0x8003B609 0x8003C409 0x8003D209 0x8003E009 0x8003EE09 0x8003FC09 0x80040A09 0x80041809 0x80042609 0x80043409 0x80044209 0x80045009 0x80045E09 0x80046C09 0x80047A09 0x80048809 0x80049609 0x8004A409 0x8004B209 0x8004C009 0x8004CE09 0x8004DC09 0x8004EA09 /end VAR_ADDRESS
 /end VAR_CHARACTERISTIC
 /begin VAR_CHARACTERISTIC SSM_K_EPB_Clutch_Engage_Rpm_Comp_Max EngCalVariantCriterion
  /begin VAR_ADDRESS 0x8003A80A 0x8003B60A 0x8003C40A 0x8003D20A 0x8003E00A 0x8003EE0A 0x8003FC0A 0x80040A0A 0x8004180A 0x8004260A 0x8004340A 0x8004420A 0x8004500A 0x80045E0A 0x80046C0A 0x80047A0A 0x8004880A 0x8004960A 0x8004A40A 0x8004B20A 0x8004C00A 0x8004CE0A 0x8004DC0A 0x8004EA0A /end VAR_ADDRESS
 /end VAR_CHARACTERISTIC
 /begin VAR_CHARACTERISTIC SSM_K_EPB_Clutch_Engage_Study_Comp EngCalVariantCriterion
  /begin VAR_ADDRESS 0x8003A80B 0x8003B60B 0x8003C40B 0x8003D20B 0x8003E00B 0x8003EE0B 0x8003FC0B 0x80040A0B 0x8004180B 0x8004260B 0x8004340B 0x8004420B 0x8004500B 0x80045E0B 0x80046C0B 0x80047A0B 0x8004880B 0x8004960B 0x8004A40B 0x8004B20B 0x8004C00B 0x8004CE0B 0x8004DC0B 0x8004EA0B /end VAR_ADDRESS
 /end VAR_CHARACTERISTIC
 /begin VAR_CHARACTERISTIC SSM_K_EPB_Clutch_Pedal_Back EngCalVariantCriterion
  /begin VAR_ADDRESS 0x8003A80C 0x8003B60C 0x8003C40C 0x8003D20C 0x8003E00C 0x8003EE0C 0x8003FC0C 0x80040A0C 0x8004180C 0x8004260C 0x8004340C 0x8004420C 0x8004500C 0x80045E0C 0x80046C0C 0x80047A0C 0x8004880C 0x8004960C 0x8004A40C 0x8004B20C 0x8004C00C 0x8004CE0C 0x8004DC0C 0x8004EA0C /end VAR_ADDRESS
 /end VAR_CHARACTERISTIC
 /begin VAR_CHARACTERISTIC SSM_K_EPB_Clutch_Pedal_Friction_Th EngCalVariantCriterion
  /begin VAR_ADDRESS 0x8003A80D 0x8003B60D 0x8003C40D 0x8003D20D 0x8003E00D 0x8003EE0D 0x8003FC0D 0x80040A0D 0x8004180D 0x8004260D 0x8004340D 0x8004420D 0x8004500D 0x80045E0D 0x80046C0D 0x80047A0D 0x8004880D 0x8004960D 0x8004A40D 0x8004B20D 0x8004C00D 0x8004CE0D 0x8004DC0D 0x8004EA0D /end VAR_ADDRESS
 /end VAR_CHARACTERISTIC
 /begin VAR_CHARACTERISTIC SSM_K_EPB_Clutch_Pedal_Max_Th EngCalVariantCriterion
  /begin VAR_ADDRESS 0x8003A80E 0x8003B60E 0x8003C40E 0x8003D20E 0x8003E00E 0x8003EE0E 0x8003FC0E 0x80040A0E 0x8004180E 0x8004260E 0x8004340E 0x8004420E 0x8004500E 0x80045E0E 0x80046C0E 0x80047A0E 0x8004880E 0x8004960E 0x8004A40E 0x8004B20E 0x8004C00E 0x8004CE0E 0x8004DC0E 0x8004EA0E /end VAR_ADDRESS
 /end VAR_CHARACTERISTIC
 /begin VAR_CHARACTERISTIC SSM_K_EPB_Clutch_Pedal_Min_Th EngCalVariantCriterion
  /begin VAR_ADDRESS 0x8003A80F 0x8003B60F 0x8003C40F 0x8003D20F 0x8003E00F 0x8003EE0F 0x8003FC0F 0x80040A0F 0x8004180F 0x8004260F 0x8004340F 0x8004420F 0x8004500F 0x80045E0F 0x80046C0F 0x80047A0F 0x8004880F 0x8004960F 0x8004A40F 0x8004B20F 0x8004C00F 0x8004CE0F 0x8004DC0F 0x8004EA0F /end VAR_ADDRESS
 /end VAR_CHARACTERISTIC
 /begin VAR_CHARACTERISTIC SSM_K_EPB_Clutch_Pedal_Z0_Th EngCalVariantCriterion
  /begin VAR_ADDRESS 0x8003A810 0x8003B610 0x8003C410 0x8003D210 0x8003E010 0x8003EE10 0x8003FC10 0x80040A10 0x80041810 0x80042610 0x80043410 0x80044210 0x80045010 0x80045E10 0x80046C10 0x80047A10 0x80048810 0x80049610 0x8004A410 0x8004B210 0x8004C010 0x8004CE10 0x8004DC10 0x8004EA10 /end VAR_ADDRESS
 /end VAR_CHARACTERISTIC
 /begin VAR_CHARACTERISTIC SSM_K_EPB_Clutch_Pedal_Z1_Th EngCalVariantCriterion
  /begin VAR_ADDRESS 0x8003A811 0x8003B611 0x8003C411 0x8003D211 0x8003E011 0x8003EE11 0x8003FC11 0x80040A11 0x80041811 0x80042611 0x80043411 0x80044211 0x80045011 0x80045E11 0x80046C11 0x80047A11 0x80048811 0x80049611 0x8004A411 0x8004B211 0x8004C011 0x8004CE11 0x8004DC11 0x8004EA11 /end VAR_ADDRESS
 /end VAR_CHARACTERISTIC
 /begin VAR_CHARACTERISTIC SSM_K_EPB_Clutch_Pedal_Z2_Th EngCalVariantCriterion
  /begin VAR_ADDRESS 0x8003A812 0x8003B612 0x8003C412 0x8003D212 0x8003E012 0x8003EE12 0x8003FC12 0x80040A12 0x80041812 0x80042612 0x80043412 0x80044212 0x80045012 0x80045E12 0x80046C12 0x80047A12 0x80048812 0x80049612 0x8004A412 0x8004B212 0x8004C012 0x8004CE12 0x8004DC12 0x8004EA12 /end VAR_ADDRESS
 /end VAR_CHARACTERISTIC
 /begin VAR_CHARACTERISTIC SSM_K_EPB_Clutch_Pedal_Z3_Th EngCalVariantCriterion
  /begin VAR_ADDRESS 0x8003A813 0x8003B613 0x8003C413 0x8003D213 0x8003E013 0x8003EE13 0x8003FC13 0x80040A13 0x80041813 0x80042613 0x80043413 0x80044213 0x80045013 0x80045E13 0x80046C13 0x80047A13 0x80048813 0x80049613 0x8004A413 0x8004B213 0x8004C013 0x8004CE13 0x8004DC13 0x8004EA13 /end VAR_ADDRESS
 /end VAR_CHARACTERISTIC
 /begin VAR_CHARACTERISTIC SSM_K_EPB_Clutch_Pedal_ZU_Th EngCalVariantCriterion
  /begin VAR_ADDRESS 0x8003A814 0x8003B614 0x8003C414 0x8003D214 0x8003E014 0x8003EE14 0x8003FC14 0x80040A14 0x80041814 0x80042614 0x80043414 0x80044214 0x80045014 0x80045E14 0x80046C14 0x80047A14 0x80048814 0x80049614 0x8004A414 0x8004B214 0x8004C014 0x8004CE14 0x8004DC14 0x8004EA14 /end VAR_ADDRESS
 /end VAR_CHARACTERISTIC
 /begin VAR_CHARACTERISTIC SSM_K_EPB_Crazy_Mode_Feature_En EngCalVariantCriterion
  /begin VAR_ADDRESS 0x8003A84C 0x8003B64C 0x8003C44C 0x8003D24C 0x8003E04C 0x8003EE4C 0x8003FC4C 0x80040A4C 0x8004184C 0x8004264C 0x8004344C 0x8004424C 0x8004504C 0x80045E4C 0x80046C4C 0x80047A4C 0x8004884C 0x8004964C 0x8004A44C 0x8004B24C 0x8004C04C 0x8004CE4C 0x8004DC4C 0x8004EA4C /end VAR_ADDRESS
 /end VAR_CHARACTERISTIC
 /begin VAR_CHARACTERISTIC SSM_K_EPB_Crazy_Mode_Hold_Time EngCalVariantCriterion
  /begin VAR_ADDRESS 0x8003A84E 0x8003B64E 0x8003C44E 0x8003D24E 0x8003E04E 0x8003EE4E 0x8003FC4E 0x80040A4E 0x8004184E 0x8004264E 0x8004344E 0x8004424E 0x8004504E 0x80045E4E 0x80046C4E 0x80047A4E 0x8004884E 0x8004964E 0x8004A44E 0x8004B24E 0x8004C04E 0x8004CE4E 0x8004DC4E 0x8004EA4E /end VAR_ADDRESS
 /end VAR_CHARACTERISTIC
 /begin VAR_CHARACTERISTIC SSM_K_EPB_Crazy_Mode_Max_Cnt EngCalVariantCriterion
  /begin VAR_ADDRESS 0x8003A850 0x8003B650 0x8003C450 0x8003D250 0x8003E050 0x8003EE50 0x8003FC50 0x80040A50 0x80041850 0x80042650 0x80043450 0x80044250 0x80045050 0x80045E50 0x80046C50 0x80047A50 0x80048850 0x80049650 0x8004A450 0x8004B250 0x8004C050 0x8004CE50 0x8004DC50 0x8004EA50 /end VAR_ADDRESS
 /end VAR_CHARACTERISTIC
 /begin VAR_CHARACTERISTIC SSM_K_EPB_DPB_REQ_OVERRIDE_TIME EngCalVariantCriterion
  /begin VAR_ADDRESS 0x8003A8A1 0x8003B6A1 0x8003C4A1 0x8003D2A1 0x8003E0A1 0x8003EEA1 0x8003FCA1 0x80040AA1 0x800418A1 0x800426A1 0x800434A1 0x800442A1 0x800450A1 0x80045EA1 0x80046CA1 0x80047AA1 0x800488A1 0x800496A1 0x8004A4A1 0x8004B2A1 0x8004C0A1 0x8004CEA1 0x8004DCA1 0x8004EAA1 /end VAR_ADDRESS
 /end VAR_CHARACTERISTIC
 /begin VAR_CHARACTERISTIC SSM_K_EPB_DectGear_D_Position_Th EngCalVariantCriterion
  /begin VAR_ADDRESS 0x8003A877 0x8003B677 0x8003C477 0x8003D277 0x8003E077 0x8003EE77 0x8003FC77 0x80040A77 0x80041877 0x80042677 0x80043477 0x80044277 0x80045077 0x80045E77 0x80046C77 0x80047A77 0x80048877 0x80049677 0x8004A477 0x8004B277 0x8004C077 0x8004CE77 0x8004DC77 0x8004EA77 /end VAR_ADDRESS
 /end VAR_CHARACTERISTIC
 /begin VAR_CHARACTERISTIC SSM_K_EPB_DectGear_N_Position_Th EngCalVariantCriterion
  /begin VAR_ADDRESS 0x8003A878 0x8003B678 0x8003C478 0x8003D278 0x8003E078 0x8003EE78 0x8003FC78 0x80040A78 0x80041878 0x80042678 0x80043478 0x80044278 0x80045078 0x80045E78 0x80046C78 0x80047A78 0x80048878 0x80049678 0x8004A478 0x8004B278 0x8004C078 0x8004CE78 0x8004DC78 0x8004EA78 /end VAR_ADDRESS
 /end VAR_CHARACTERISTIC
 /begin VAR_CHARACTERISTIC SSM_K_EPB_DectGear_P_Position_Th EngCalVariantCriterion
  /begin VAR_ADDRESS 0x8003A879 0x8003B679 0x8003C479 0x8003D279 0x8003E079 0x8003EE79 0x8003FC79 0x80040A79 0x80041879 0x80042679 0x80043479 0x80044279 0x80045079 0x80045E79 0x80046C79 0x80047A79 0x80048879 0x80049679 0x8004A479 0x8004B279 0x8004C079 0x8004CE79 0x8004DC79 0x8004EA79 /end VAR_ADDRESS
 /end VAR_CHARACTERISTIC
 /begin VAR_CHARACTERISTIC SSM_K_EPB_DectGear_R_Position_Th EngCalVariantCriterion
  /begin VAR_ADDRESS 0x8003A87A 0x8003B67A 0x8003C47A 0x8003D27A 0x8003E07A 0x8003EE7A 0x8003FC7A 0x80040A7A 0x8004187A 0x8004267A 0x8004347A 0x8004427A 0x8004507A 0x80045E7A 0x80046C7A 0x80047A7A 0x8004887A 0x8004967A 0x8004A47A 0x8004B27A 0x8004C07A 0x8004CE7A 0x8004DC7A 0x8004EA7A /end VAR_ADDRESS
 /end VAR_CHARACTERISTIC
 /begin VAR_CHARACTERISTIC SSM_K_EPB_Degrad_Release_SWOFF_Time_Th EngCalVariantCriterion
  /begin VAR_ADDRESS 0x8003A85C 0x8003B65C 0x8003C45C 0x8003D25C 0x8003E05C 0x8003EE5C 0x8003FC5C 0x80040A5C 0x8004185C 0x8004265C 0x8004345C 0x8004425C 0x8004505C 0x80045E5C 0x80046C5C 0x80047A5C 0x8004885C 0x8004965C 0x8004A45C 0x8004B25C 0x8004C05C 0x8004CE5C 0x8004DC5C 0x8004EA5C /end VAR_ADDRESS
 /end VAR_CHARACTERISTIC
 /begin VAR_CHARACTERISTIC SSM_K_EPB_Degraded_Apply_Feature_En EngCalVariantCriterion
  /begin VAR_ADDRESS 0x8003A852 0x8003B652 0x8003C452 0x8003D252 0x8003E052 0x8003EE52 0x8003FC52 0x80040A52 0x80041852 0x80042652 0x80043452 0x80044252 0x80045052 0x80045E52 0x80046C52 0x80047A52 0x80048852 0x80049652 0x8004A452 0x8004B252 0x8004C052 0x8004CE52 0x8004DC52 0x8004EA52 /end VAR_ADDRESS
 /end VAR_CHARACTERISTIC
 /begin VAR_CHARACTERISTIC SSM_K_EPB_Degraded_Apply_Time_Periode EngCalVariantCriterion
  /begin VAR_ADDRESS 0x8003A854 0x8003B654 0x8003C454 0x8003D254 0x8003E054 0x8003EE54 0x8003FC54 0x80040A54 0x80041854 0x80042654 0x80043454 0x80044254 0x80045054 0x80045E54 0x80046C54 0x80047A54 0x80048854 0x80049654 0x8004A454 0x8004B254 0x8004C054 0x8004CE54 0x8004DC54 0x8004EA54 /end VAR_ADDRESS
 /end VAR_CHARACTERISTIC
 /begin VAR_CHARACTERISTIC SSM_K_EPB_Degraded_Apply_Time_TH EngCalVariantCriterion
  /begin VAR_ADDRESS 0x8003A856 0x8003B656 0x8003C456 0x8003D256 0x8003E056 0x8003EE56 0x8003FC56 0x80040A56 0x80041856 0x80042656 0x80043456 0x80044256 0x80045056 0x80045E56 0x80046C56 0x80047A56 0x80048856 0x80049656 0x8004A456 0x8004B256 0x8004C056 0x8004CE56 0x8004DC56 0x8004EA56 /end VAR_ADDRESS
 /end VAR_CHARACTERISTIC
 /begin VAR_CHARACTERISTIC SSM_K_EPB_Degraded_Release_Feature_En EngCalVariantCriterion
  /begin VAR_ADDRESS 0x8003A858 0x8003B658 0x8003C458 0x8003D258 0x8003E058 0x8003EE58 0x8003FC58 0x80040A58 0x80041858 0x80042658 0x80043458 0x80044258 0x80045058 0x80045E58 0x80046C58 0x80047A58 0x80048858 0x80049658 0x8004A458 0x8004B258 0x8004C058 0x8004CE58 0x8004DC58 0x8004EA58 /end VAR_ADDRESS
 /end VAR_CHARACTERISTIC
 /begin VAR_CHARACTERISTIC SSM_K_EPB_Degraded_Release_Time_Th EngCalVariantCriterion
  /begin VAR_ADDRESS 0x8003A85A 0x8003B65A 0x8003C45A 0x8003D25A 0x8003E05A 0x8003EE5A 0x8003FC5A 0x80040A5A 0x8004185A 0x8004265A 0x8004345A 0x8004425A 0x8004505A 0x80045E5A 0x80046C5A 0x80047A5A 0x8004885A 0x8004965A 0x8004A45A 0x8004B25A 0x8004C05A 0x8004CE5A 0x8004DC5A 0x8004EA5A /end VAR_ADDRESS
 /end VAR_CHARACTERISTIC
 /begin VAR_CHARACTERISTIC SSM_K_EPB_Dynamic_Brake_Decel_Rate_ESC EngCalVariantCriterion
  /begin VAR_ADDRESS 0x8003A866 0x8003B666 0x8003C466 0x8003D266 0x8003E066 0x8003EE66 0x8003FC66 0x80040A66 0x80041866 0x80042666 0x80043466 0x80044266 0x80045066 0x80045E66 0x80046C66 0x80047A66 0x80048866 0x80049666 0x8004A466 0x8004B266 0x8004C066 0x8004CE66 0x8004DC66 0x8004EA66 /end VAR_ADDRESS
 /end VAR_CHARACTERISTIC
 /begin VAR_CHARACTERISTIC SSM_K_EPB_Dynamic_Brake_Decel_Rate_ESC_No_Brk EngCalVariantCriterion
  /begin VAR_ADDRESS 0x8003A868 0x8003B668 0x8003C468 0x8003D268 0x8003E068 0x8003EE68 0x8003FC68 0x80040A68 0x80041868 0x80042668 0x80043468 0x80044268 0x80045068 0x80045E68 0x80046C68 0x80047A68 0x80048868 0x80049668 0x8004A468 0x8004B268 0x8004C068 0x8004CE68 0x8004DC68 0x8004EA68 /end VAR_ADDRESS
 /end VAR_CHARACTERISTIC
 /begin VAR_CHARACTERISTIC SSM_K_EPB_Dynamic_Brake_EPB_Feature_En EngCalVariantCriterion
  /begin VAR_ADDRESS 0x8003A86A 0x8003B66A 0x8003C46A 0x8003D26A 0x8003E06A 0x8003EE6A 0x8003FC6A 0x80040A6A 0x8004186A 0x8004266A 0x8004346A 0x8004426A 0x8004506A 0x80045E6A 0x80046C6A 0x80047A6A 0x8004886A 0x8004966A 0x8004A46A 0x8004B26A 0x8004C06A 0x8004CE6A 0x8004DC6A 0x8004EA6A /end VAR_ADDRESS
 /end VAR_CHARACTERISTIC
 /begin VAR_CHARACTERISTIC SSM_K_EPB_Dynamic_Brake_ESC_Feature_En EngCalVariantCriterion
  /begin VAR_ADDRESS 0x8003A86B 0x8003B66B 0x8003C46B 0x8003D26B 0x8003E06B 0x8003EE6B 0x8003FC6B 0x80040A6B 0x8004186B 0x8004266B 0x8004346B 0x8004426B 0x8004506B 0x80045E6B 0x80046C6B 0x80047A6B 0x8004886B 0x8004966B 0x8004A46B 0x8004B26B 0x8004C06B 0x8004CE6B 0x8004DC6B 0x8004EA6B /end VAR_ADDRESS
 /end VAR_CHARACTERISTIC
 /begin VAR_CHARACTERISTIC SSM_K_EPB_ESC_system EngCalVariantCriterion
  /begin VAR_ADDRESS 0x8003A7CB 0x8003B5CB 0x8003C3CB 0x8003D1CB 0x8003DFCB 0x8003EDCB 0x8003FBCB 0x800409CB 0x800417CB 0x800425CB 0x800433CB 0x800441CB 0x80044FCB 0x80045DCB 0x80046BCB 0x800479CB 0x800487CB 0x800495CB 0x8004A3CB 0x8004B1CB 0x8004BFCB 0x8004CDCB 0x8004DBCB 0x8004E9CB /end VAR_ADDRESS
 /end VAR_CHARACTERISTIC
 /begin VAR_CHARACTERISTIC SSM_K_EPB_Engine_Run_rpm_Th_H EngCalVariantCriterion
  /begin VAR_ADDRESS 0x8003A7E8 0x8003B5E8 0x8003C3E8 0x8003D1E8 0x8003DFE8 0x8003EDE8 0x8003FBE8 0x800409E8 0x800417E8 0x800425E8 0x800433E8 0x800441E8 0x80044FE8 0x80045DE8 0x80046BE8 0x800479E8 0x800487E8 0x800495E8 0x8004A3E8 0x8004B1E8 0x8004BFE8 0x8004CDE8 0x8004DBE8 0x8004E9E8 /end VAR_ADDRESS
 /end VAR_CHARACTERISTIC
 /begin VAR_CHARACTERISTIC SSM_K_EPB_Engine_Run_rpm_Th_L EngCalVariantCriterion
  /begin VAR_ADDRESS 0x8003A7E6 0x8003B5E6 0x8003C3E6 0x8003D1E6 0x8003DFE6 0x8003EDE6 0x8003FBE6 0x800409E6 0x800417E6 0x800425E6 0x800433E6 0x800441E6 0x80044FE6 0x80045DE6 0x80046BE6 0x800479E6 0x800487E6 0x800495E6 0x8004A3E6 0x8004B1E6 0x8004BFE6 0x8004CDE6 0x8004DBE6 0x8004E9E6 /end VAR_ADDRESS
 /end VAR_CHARACTERISTIC
 /begin VAR_CHARACTERISTIC SSM_K_EPB_Grade_Decision_Z1_Th EngCalVariantCriterion
  /begin VAR_ADDRESS 0x8003A7D6 0x8003B5D6 0x8003C3D6 0x8003D1D6 0x8003DFD6 0x8003EDD6 0x8003FBD6 0x800409D6 0x800417D6 0x800425D6 0x800433D6 0x800441D6 0x80044FD6 0x80045DD6 0x80046BD6 0x800479D6 0x800487D6 0x800495D6 0x8004A3D6 0x8004B1D6 0x8004BFD6 0x8004CDD6 0x8004DBD6 0x8004E9D6 /end VAR_ADDRESS
 /end VAR_CHARACTERISTIC
 /begin VAR_CHARACTERISTIC SSM_K_EPB_Grade_Decision_Z2_Th EngCalVariantCriterion
  /begin VAR_ADDRESS 0x8003A7D8 0x8003B5D8 0x8003C3D8 0x8003D1D8 0x8003DFD8 0x8003EDD8 0x8003FBD8 0x800409D8 0x800417D8 0x800425D8 0x800433D8 0x800441D8 0x80044FD8 0x80045DD8 0x80046BD8 0x800479D8 0x800487D8 0x800495D8 0x8004A3D8 0x8004B1D8 0x8004BFD8 0x8004CDD8 0x8004DBD8 0x8004E9D8 /end VAR_ADDRESS
 /end VAR_CHARACTERISTIC
 /begin VAR_CHARACTERISTIC SSM_K_EPB_Grade_Decision_Z3_Th EngCalVariantCriterion
  /begin VAR_ADDRESS 0x8003A7DA 0x8003B5DA 0x8003C3DA 0x8003D1DA 0x8003DFDA 0x8003EDDA 0x8003FBDA 0x800409DA 0x800417DA 0x800425DA 0x800433DA 0x800441DA 0x80044FDA 0x80045DDA 0x80046BDA 0x800479DA 0x800487DA 0x800495DA 0x8004A3DA 0x8004B1DA 0x8004BFDA 0x8004CDDA 0x8004DBDA 0x8004E9DA /end VAR_ADDRESS
 /end VAR_CHARACTERISTIC
 /begin VAR_CHARACTERISTIC SSM_K_EPB_HillStop_Detecting_Time_Th EngCalVariantCriterion
  /begin VAR_ADDRESS 0x8003A83C 0x8003B63C 0x8003C43C 0x8003D23C 0x8003E03C 0x8003EE3C 0x8003FC3C 0x80040A3C 0x8004183C 0x8004263C 0x8004343C 0x8004423C 0x8004503C 0x80045E3C 0x80046C3C 0x80047A3C 0x8004883C 0x8004963C 0x8004A43C 0x8004B23C 0x8004C03C 0x8004CE3C 0x8004DC3C 0x8004EA3C /end VAR_ADDRESS
 /end VAR_CHARACTERISTIC
 /begin VAR_CHARACTERISTIC SSM_K_EPB_HillStop_Gear_Act EngCalVariantCriterion
  /begin VAR_ADDRESS 0x8003A83E 0x8003B63E 0x8003C43E 0x8003D23E 0x8003E03E 0x8003EE3E 0x8003FC3E 0x80040A3E 0x8004183E 0x8004263E 0x8004343E 0x8004423E 0x8004503E 0x80045E3E 0x80046C3E 0x80047A3E 0x8004883E 0x8004963E 0x8004A43E 0x8004B23E 0x8004C03E 0x8004CE3E 0x8004DC3E 0x8004EA3E /end VAR_ADDRESS
 /end VAR_CHARACTERISTIC
 /begin VAR_CHARACTERISTIC SSM_K_EPB_HillStop_Gradient_Th EngCalVariantCriterion
  /begin VAR_ADDRESS 0x8003A840 0x8003B640 0x8003C440 0x8003D240 0x8003E040 0x8003EE40 0x8003FC40 0x80040A40 0x80041840 0x80042640 0x80043440 0x80044240 0x80045040 0x80045E40 0x80046C40 0x80047A40 0x80048840 0x80049640 0x8004A440 0x8004B240 0x8004C040 0x8004CE40 0x8004DC40 0x8004EA40 /end VAR_ADDRESS
 /end VAR_CHARACTERISTIC
 /begin VAR_CHARACTERISTIC SSM_K_EPB_Intelligent_Apply_Belt_Feature_En EngCalVariantCriterion
  /begin VAR_ADDRESS 0x8003A85E 0x8003B65E 0x8003C45E 0x8003D25E 0x8003E05E 0x8003EE5E 0x8003FC5E 0x80040A5E 0x8004185E 0x8004265E 0x8004345E 0x8004425E 0x8004505E 0x80045E5E 0x80046C5E 0x80047A5E 0x8004885E 0x8004965E 0x8004A45E 0x8004B25E 0x8004C05E 0x8004CE5E 0x8004DC5E 0x8004EA5E /end VAR_ADDRESS
 /end VAR_CHARACTERISTIC
 /begin VAR_CHARACTERISTIC SSM_K_EPB_Intelligent_Apply_Feature_En EngCalVariantCriterion
  /begin VAR_ADDRESS 0x8003A85F 0x8003B65F 0x8003C45F 0x8003D25F 0x8003E05F 0x8003EE5F 0x8003FC5F 0x80040A5F 0x8004185F 0x8004265F 0x8004345F 0x8004425F 0x8004505F 0x80045E5F 0x80046C5F 0x80047A5F 0x8004885F 0x8004965F 0x8004A45F 0x8004B25F 0x8004C05F 0x8004CE5F 0x8004DC5F 0x8004EA5F /end VAR_ADDRESS
 /end VAR_CHARACTERISTIC
 /begin VAR_CHARACTERISTIC SSM_K_EPB_Intelligent_Apply_Switch_Feature_En EngCalVariantCriterion
  /begin VAR_ADDRESS 0x8003A860 0x8003B660 0x8003C460 0x8003D260 0x8003E060 0x8003EE60 0x8003FC60 0x80040A60 0x80041860 0x80042660 0x80043460 0x80044260 0x80045060 0x80045E60 0x80046C60 0x80047A60 0x80048860 0x80049660 0x8004A460 0x8004B260 0x8004C060 0x8004CE60 0x8004DC60 0x8004EA60 /end VAR_ADDRESS
 /end VAR_CHARACTERISTIC
 /begin VAR_CHARACTERISTIC SSM_K_EPB_Intelligent_Apply_Switch_Hold_On_Act EngCalVariantCriterion
  /begin VAR_ADDRESS 0x8003A861 0x8003B661 0x8003C461 0x8003D261 0x8003E061 0x8003EE61 0x8003FC61 0x80040A61 0x80041861 0x80042661 0x80043461 0x80044261 0x80045061 0x80045E61 0x80046C61 0x80047A61 0x80048861 0x80049661 0x8004A461 0x8004B261 0x8004C061 0x8004CE61 0x8004DC61 0x8004EA61 /end VAR_ADDRESS
 /end VAR_CHARACTERISTIC
 /begin VAR_CHARACTERISTIC SSM_K_EPB_Intelligent_Apply_Switch_Re_On_Act EngCalVariantCriterion
  /begin VAR_ADDRESS 0x8003A862 0x8003B662 0x8003C462 0x8003D262 0x8003E062 0x8003EE62 0x8003FC62 0x80040A62 0x80041862 0x80042662 0x80043462 0x80044262 0x80045062 0x80045E62 0x80046C62 0x80047A62 0x80048862 0x80049662 0x8004A462 0x8004B262 0x8004C062 0x8004CE62 0x8004DC62 0x8004EA62 /end VAR_ADDRESS
 /end VAR_CHARACTERISTIC
 /begin VAR_CHARACTERISTIC SSM_K_EPB_Intelligent_Apply_Switch_Time_Th EngCalVariantCriterion
  /begin VAR_ADDRESS 0x8003A864 0x8003B664 0x8003C464 0x8003D264 0x8003E064 0x8003EE64 0x8003FC64 0x80040A64 0x80041864 0x80042664 0x80043464 0x80044264 0x80045064 0x80045E64 0x80046C64 0x80047A64 0x80048864 0x80049664 0x8004A464 0x8004B264 0x8004C064 0x8004CE64 0x8004DC64 0x8004EA64 /end VAR_ADDRESS
 /end VAR_CHARACTERISTIC
 /begin VAR_CHARACTERISTIC SSM_K_EPB_Light_Apply_Threshold EngCalVariantCriterion
  /begin VAR_ADDRESS 0x8003A7DC 0x8003B5DC 0x8003C3DC 0x8003D1DC 0x8003DFDC 0x8003EDDC 0x8003FBDC 0x800409DC 0x800417DC 0x800425DC 0x800433DC 0x800441DC 0x80044FDC 0x80045DDC 0x80046BDC 0x800479DC 0x800487DC 0x800495DC 0x8004A3DC 0x8004B1DC 0x8004BFDC 0x8004CDDC 0x8004DBDC 0x8004E9DC /end VAR_ADDRESS
 /end VAR_CHARACTERISTIC
 /begin VAR_CHARACTERISTIC SSM_K_EPB_Longitudinal_G_Sensor EngCalVariantCriterion
  /begin VAR_ADDRESS 0x8003A7CC 0x8003B5CC 0x8003C3CC 0x8003D1CC 0x8003DFCC 0x8003EDCC 0x8003FBCC 0x800409CC 0x800417CC 0x800425CC 0x800433CC 0x800441CC 0x80044FCC 0x80045DCC 0x80046BCC 0x800479CC 0x800487CC 0x800495CC 0x8004A3CC 0x8004B1CC 0x8004BFCC 0x8004CDCC 0x8004DBCC 0x8004E9CC /end VAR_ADDRESS
 /end VAR_CHARACTERISTIC
 /begin VAR_CHARACTERISTIC SSM_K_EPB_Manual_Transmission EngCalVariantCriterion
  /begin VAR_ADDRESS 0x8003A7CD 0x8003B5CD 0x8003C3CD 0x8003D1CD 0x8003DFCD 0x8003EDCD 0x8003FBCD 0x800409CD 0x800417CD 0x800425CD 0x800433CD 0x800441CD 0x80044FCD 0x80045DCD 0x80046BCD 0x800479CD 0x800487CD 0x800495CD 0x8004A3CD 0x8004B1CD 0x8004BFCD 0x8004CDCD 0x8004DBCD 0x8004E9CD /end VAR_ADDRESS
 /end VAR_CHARACTERISTIC
 /begin VAR_CHARACTERISTIC SSM_K_EPB_Master_Pressure_Signal_Th EngCalVariantCriterion
  /begin VAR_ADDRESS 0x8003A7EA 0x8003B5EA 0x8003C3EA 0x8003D1EA 0x8003DFEA 0x8003EDEA 0x8003FBEA 0x800409EA 0x800417EA 0x800425EA 0x800433EA 0x800441EA 0x80044FEA 0x80045DEA 0x80046BEA 0x800479EA 0x800487EA 0x800495EA 0x8004A3EA 0x8004B1EA 0x8004BFEA 0x8004CDEA 0x8004DBEA 0x8004E9EA /end VAR_ADDRESS
 /end VAR_CHARACTERISTIC
 /begin VAR_CHARACTERISTIC SSM_K_EPB_Maunal_Apply_Feature_En EngCalVariantCriterion
  /begin VAR_ADDRESS 0x8003A82F 0x8003B62F 0x8003C42F 0x8003D22F 0x8003E02F 0x8003EE2F 0x8003FC2F 0x80040A2F 0x8004182F 0x8004262F 0x8004342F 0x8004422F 0x8004502F 0x80045E2F 0x80046C2F 0x80047A2F 0x8004882F 0x8004962F 0x8004A42F 0x8004B22F 0x8004C02F 0x8004CE2F 0x8004DC2F 0x8004EA2F /end VAR_ADDRESS
 /end VAR_CHARACTERISTIC
 /begin VAR_CHARACTERISTIC SSM_K_EPB_Maunal_Release_Feature_En EngCalVariantCriterion
  /begin VAR_ADDRESS 0x8003A830 0x8003B630 0x8003C430 0x8003D230 0x8003E030 0x8003EE30 0x8003FC30 0x80040A30 0x80041830 0x80042630 0x80043430 0x80044230 0x80045030 0x80045E30 0x80046C30 0x80047A30 0x80048830 0x80049630 0x8004A430 0x8004B230 0x8004C030 0x8004CE30 0x8004DC30 0x8004EA30 /end VAR_ADDRESS
 /end VAR_CHARACTERISTIC
 /begin VAR_CHARACTERISTIC SSM_K_EPB_Max_Apply_Threshold EngCalVariantCriterion
  /begin VAR_ADDRESS 0x8003A7DE 0x8003B5DE 0x8003C3DE 0x8003D1DE 0x8003DFDE 0x8003EDDE 0x8003FBDE 0x800409DE 0x800417DE 0x800425DE 0x800433DE 0x800441DE 0x80044FDE 0x80045DDE 0x80046BDE 0x800479DE 0x800487DE 0x800495DE 0x8004A3DE 0x8004B1DE 0x8004BFDE 0x8004CDDE 0x8004DBDE 0x8004E9DE /end VAR_ADDRESS
 /end VAR_CHARACTERISTIC
 /begin VAR_CHARACTERISTIC SSM_K_EPB_Output_Selection_Mode EngCalVariantCriterion
  /begin VAR_ADDRESS 0x8003A7C8 0x8003B5C8 0x8003C3C8 0x8003D1C8 0x8003DFC8 0x8003EDC8 0x8003FBC8 0x800409C8 0x800417C8 0x800425C8 0x800433C8 0x800441C8 0x80044FC8 0x80045DC8 0x80046BC8 0x800479C8 0x800487C8 0x800495C8 0x8004A3C8 0x8004B1C8 0x8004BFC8 0x8004CDC8 0x8004DBC8 0x8004E9C8 /end VAR_ADDRESS
 /end VAR_CHARACTERISTIC
 /begin VAR_CHARACTERISTIC SSM_K_EPB_P2X_Gear_Change_Time_Th EngCalVariantCriterion
  /begin VAR_ADDRESS 0x8003A87C 0x8003B67C 0x8003C47C 0x8003D27C 0x8003E07C 0x8003EE7C 0x8003FC7C 0x80040A7C 0x8004187C 0x8004267C 0x8004347C 0x8004427C 0x8004507C 0x80045E7C 0x80046C7C 0x80047A7C 0x8004887C 0x8004967C 0x8004A47C 0x8004B27C 0x8004C07C 0x8004CE7C 0x8004DC7C 0x8004EA7C /end VAR_ADDRESS
 /end VAR_CHARACTERISTIC
 /begin VAR_CHARACTERISTIC SSM_K_EPB_Parking_Brake_Type_DIH EngCalVariantCriterion
  /begin VAR_ADDRESS 0x8003A7CE 0x8003B5CE 0x8003C3CE 0x8003D1CE 0x8003DFCE 0x8003EDCE 0x8003FBCE 0x800409CE 0x800417CE 0x800425CE 0x800433CE 0x800441CE 0x80044FCE 0x80045DCE 0x80046BCE 0x800479CE 0x800487CE 0x800495CE 0x8004A3CE 0x8004B1CE 0x8004BFCE 0x8004CDCE 0x8004DBCE 0x8004E9CE /end VAR_ADDRESS
 /end VAR_CHARACTERISTIC
 /begin VAR_CHARACTERISTIC SSM_K_EPB_Pre_Release_Feature_En EngCalVariantCriterion
  /begin VAR_ADDRESS 0x8003A876 0x8003B676 0x8003C476 0x8003D276 0x8003E076 0x8003EE76 0x8003FC76 0x80040A76 0x80041876 0x80042676 0x80043476 0x80044276 0x80045076 0x80045E76 0x80046C76 0x80047A76 0x80048876 0x80049676 0x8004A476 0x8004B276 0x8004C076 0x8004CE76 0x8004DC76 0x8004EA76 /end VAR_ADDRESS
 /end VAR_CHARACTERISTIC
 /begin VAR_CHARACTERISTIC SSM_K_EPB_PropulsionSystActive_En EngCalVariantCriterion
  /begin VAR_ADDRESS 0x8003A7CF 0x8003B5CF 0x8003C3CF 0x8003D1CF 0x8003DFCF 0x8003EDCF 0x8003FBCF 0x800409CF 0x800417CF 0x800425CF 0x800433CF 0x800441CF 0x80044FCF 0x80045DCF 0x80046BCF 0x800479CF 0x800487CF 0x800495CF 0x8004A3CF 0x8004B1CF 0x8004BFCF 0x8004CDCF 0x8004DBCF 0x8004E9CF /end VAR_ADDRESS
 /end VAR_CHARACTERISTIC
 /begin VAR_CHARACTERISTIC SSM_K_EPB_PtoX_D_BrakeOnTime EngCalVariantCriterion
  /begin VAR_ADDRESS 0x8003A898 0x8003B698 0x8003C498 0x8003D298 0x8003E098 0x8003EE98 0x8003FC98 0x80040A98 0x80041898 0x80042698 0x80043498 0x80044298 0x80045098 0x80045E98 0x80046C98 0x80047A98 0x80048898 0x80049698 0x8004A498 0x8004B298 0x8004C098 0x8004CE98 0x8004DC98 0x8004EA98 /end VAR_ADDRESS
 /end VAR_CHARACTERISTIC
 /begin VAR_CHARACTERISTIC SSM_K_EPB_PtoX_N_BrakeOnTime EngCalVariantCriterion
  /begin VAR_ADDRESS 0x8003A896 0x8003B696 0x8003C496 0x8003D296 0x8003E096 0x8003EE96 0x8003FC96 0x80040A96 0x80041896 0x80042696 0x80043496 0x80044296 0x80045096 0x80045E96 0x80046C96 0x80047A96 0x80048896 0x80049696 0x8004A496 0x8004B296 0x8004C096 0x8004CE96 0x8004DC96 0x8004EA96 /end VAR_ADDRESS
 /end VAR_CHARACTERISTIC
 /begin VAR_CHARACTERISTIC SSM_K_EPB_PtoX_P_BrakeOnTime EngCalVariantCriterion
  /begin VAR_ADDRESS 0x8003A895 0x8003B695 0x8003C495 0x8003D295 0x8003E095 0x8003EE95 0x8003FC95 0x80040A95 0x80041895 0x80042695 0x80043495 0x80044295 0x80045095 0x80045E95 0x80046C95 0x80047A95 0x80048895 0x80049695 0x8004A495 0x8004B295 0x8004C095 0x8004CE95 0x8004DC95 0x8004EA95 /end VAR_ADDRESS
 /end VAR_CHARACTERISTIC
 /begin VAR_CHARACTERISTIC SSM_K_EPB_PtoX_R_BrakeOnTime EngCalVariantCriterion
  /begin VAR_ADDRESS 0x8003A897 0x8003B697 0x8003C497 0x8003D297 0x8003E097 0x8003EE97 0x8003FC97 0x80040A97 0x80041897 0x80042697 0x80043497 0x80044297 0x80045097 0x80045E97 0x80046C97 0x80047A97 0x80048897 0x80049697 0x8004A497 0x8004B297 0x8004C097 0x8004CE97 0x8004DC97 0x8004EA97 /end VAR_ADDRESS
 /end VAR_CHARACTERISTIC
 /begin VAR_CHARACTERISTIC SSM_K_EPB_PtoX_Release_DtoD_On_Act EngCalVariantCriterion
  /begin VAR_ADDRESS 0x8003A899 0x8003B699 0x8003C499 0x8003D299 0x8003E099 0x8003EE99 0x8003FC99 0x80040A99 0x80041899 0x80042699 0x80043499 0x80044299 0x80045099 0x80045E99 0x80046C99 0x80047A99 0x80048899 0x80049699 0x8004A499 0x8004B299 0x8004C099 0x8004CE99 0x8004DC99 0x8004EA99 /end VAR_ADDRESS
 /end VAR_CHARACTERISTIC
 /begin VAR_CHARACTERISTIC SSM_K_EPB_PtoX_Release_DtoX_On_Act EngCalVariantCriterion
  /begin VAR_ADDRESS 0x8003A87E 0x8003B67E 0x8003C47E 0x8003D27E 0x8003E07E 0x8003EE7E 0x8003FC7E 0x80040A7E 0x8004187E 0x8004267E 0x8004347E 0x8004427E 0x8004507E 0x80045E7E 0x80046C7E 0x80047A7E 0x8004887E 0x8004967E 0x8004A47E 0x8004B27E 0x8004C07E 0x8004CE7E 0x8004DC7E 0x8004EA7E /end VAR_ADDRESS
 /end VAR_CHARACTERISTIC
 /begin VAR_CHARACTERISTIC SSM_K_EPB_PtoX_Release_Feature_En EngCalVariantCriterion
  /begin VAR_ADDRESS 0x8003A87F 0x8003B67F 0x8003C47F 0x8003D27F 0x8003E07F 0x8003EE7F 0x8003FC7F 0x80040A7F 0x8004187F 0x8004267F 0x8004347F 0x8004427F 0x8004507F 0x80045E7F 0x80046C7F 0x80047A7F 0x8004887F 0x8004967F 0x8004A47F 0x8004B27F 0x8004C07F 0x8004CE7F 0x8004DC7F 0x8004EA7F /end VAR_ADDRESS
 /end VAR_CHARACTERISTIC
 /begin VAR_CHARACTERISTIC SSM_K_EPB_PtoX_Release_HillStop_Act EngCalVariantCriterion
  /begin VAR_ADDRESS 0x8003A880 0x8003B680 0x8003C480 0x8003D280 0x8003E080 0x8003EE80 0x8003FC80 0x80040A80 0x80041880 0x80042680 0x80043480 0x80044280 0x80045080 0x80045E80 0x80046C80 0x80047A80 0x80048880 0x80049680 0x8004A480 0x8004B280 0x8004C080 0x8004CE80 0x8004DC80 0x8004EA80 /end VAR_ADDRESS
 /end VAR_CHARACTERISTIC
 /begin VAR_CHARACTERISTIC SSM_K_EPB_PtoX_Release_NtoX_On_Act EngCalVariantCriterion
  /begin VAR_ADDRESS 0x8003A881 0x8003B681 0x8003C481 0x8003D281 0x8003E081 0x8003EE81 0x8003FC81 0x80040A81 0x80041881 0x80042681 0x80043481 0x80044281 0x80045081 0x80045E81 0x80046C81 0x80047A81 0x80048881 0x80049681 0x8004A481 0x8004B281 0x8004C081 0x8004CE81 0x8004DC81 0x8004EA81 /end VAR_ADDRESS
 /end VAR_CHARACTERISTIC
 /begin VAR_CHARACTERISTIC SSM_K_EPB_PtoX_Release_PtoX_On_Act EngCalVariantCriterion
  /begin VAR_ADDRESS 0x8003A882 0x8003B682 0x8003C482 0x8003D282 0x8003E082 0x8003EE82 0x8003FC82 0x80040A82 0x80041882 0x80042682 0x80043482 0x80044282 0x80045082 0x80045E82 0x80046C82 0x80047A82 0x80048882 0x80049682 0x8004A482 0x8004B282 0x8004C082 0x8004CE82 0x8004DC82 0x8004EA82 /end VAR_ADDRESS
 /end VAR_CHARACTERISTIC
 /begin VAR_CHARACTERISTIC SSM_K_EPB_PtoX_Release_RtoR_On_Act EngCalVariantCriterion
  /begin VAR_ADDRESS 0x8003A89A 0x8003B69A 0x8003C49A 0x8003D29A 0x8003E09A 0x8003EE9A 0x8003FC9A 0x80040A9A 0x8004189A 0x8004269A 0x8004349A 0x8004429A 0x8004509A 0x80045E9A 0x80046C9A 0x80047A9A 0x8004889A 0x8004969A 0x8004A49A 0x8004B29A 0x8004C09A 0x8004CE9A 0x8004DC9A 0x8004EA9A /end VAR_ADDRESS
 /end VAR_CHARACTERISTIC
 /begin VAR_CHARACTERISTIC SSM_K_EPB_PtoX_Release_RtoX_On_Act EngCalVariantCriterion
  /begin VAR_ADDRESS 0x8003A883 0x8003B683 0x8003C483 0x8003D283 0x8003E083 0x8003EE83 0x8003FC83 0x80040A83 0x80041883 0x80042683 0x80043483 0x80044283 0x80045083 0x80045E83 0x80046C83 0x80047A83 0x80048883 0x80049683 0x8004A483 0x8004B283 0x8004C083 0x8004CE83 0x8004DC83 0x8004EA83 /end VAR_ADDRESS
 /end VAR_CHARACTERISTIC
 /begin VAR_CHARACTERISTIC SSM_K_EPB_Push_Pull_Switch EngCalVariantCriterion
  /begin VAR_ADDRESS 0x8003A7D0 0x8003B5D0 0x8003C3D0 0x8003D1D0 0x8003DFD0 0x8003EDD0 0x8003FBD0 0x800409D0 0x800417D0 0x800425D0 0x800433D0 0x800441D0 0x80044FD0 0x80045DD0 0x80046BD0 0x800479D0 0x800487D0 0x800495D0 0x8004A3D0 0x8004B1D0 0x8004BFD0 0x8004CDD0 0x8004DBD0 0x8004E9D0 /end VAR_ADDRESS
 /end VAR_CHARACTERISTIC
 /begin VAR_CHARACTERISTIC SSM_K_EPB_Rear_Wheel_Drive EngCalVariantCriterion
  /begin VAR_ADDRESS 0x8003A7D1 0x8003B5D1 0x8003C3D1 0x8003D1D1 0x8003DFD1 0x8003EDD1 0x8003FBD1 0x800409D1 0x800417D1 0x800425D1 0x800433D1 0x800441D1 0x80044FD1 0x80045DD1 0x80046BD1 0x800479D1 0x800487D1 0x800495D1 0x8004A3D1 0x8004B1D1 0x8004BFD1 0x8004CDD1 0x8004DBD1 0x8004E9D1 /end VAR_ADDRESS
 /end VAR_CHARACTERISTIC
 /begin VAR_CHARACTERISTIC SSM_K_EPB_Release_Engine_RPM_Rate_Z1_Th EngCalVariantCriterion
  /begin VAR_ADDRESS 0x8003A816 0x8003B616 0x8003C416 0x8003D216 0x8003E016 0x8003EE16 0x8003FC16 0x80040A16 0x80041816 0x80042616 0x80043416 0x80044216 0x80045016 0x80045E16 0x80046C16 0x80047A16 0x80048816 0x80049616 0x8004A416 0x8004B216 0x8004C016 0x8004CE16 0x8004DC16 0x8004EA16 /end VAR_ADDRESS
 /end VAR_CHARACTERISTIC
 /begin VAR_CHARACTERISTIC SSM_K_EPB_Release_Engine_RPM_Rate_Z2_Th EngCalVariantCriterion
  /begin VAR_ADDRESS 0x8003A817 0x8003B617 0x8003C417 0x8003D217 0x8003E017 0x8003EE17 0x8003FC17 0x80040A17 0x80041817 0x80042617 0x80043417 0x80044217 0x80045017 0x80045E17 0x80046C17 0x80047A17 0x80048817 0x80049617 0x8004A417 0x8004B217 0x8004C017 0x8004CE17 0x8004DC17 0x8004EA17 /end VAR_ADDRESS
 /end VAR_CHARACTERISTIC
 /begin VAR_CHARACTERISTIC SSM_K_EPB_Release_Engine_RPM_Rate_Z3_Th EngCalVariantCriterion
  /begin VAR_ADDRESS 0x8003A818 0x8003B618 0x8003C418 0x8003D218 0x8003E018 0x8003EE18 0x8003FC18 0x80040A18 0x80041818 0x80042618 0x80043418 0x80044218 0x80045018 0x80045E18 0x80046C18 0x80047A18 0x80048818 0x80049618 0x8004A418 0x8004B218 0x8004C018 0x8004CE18 0x8004DC18 0x8004EA18 /end VAR_ADDRESS
 /end VAR_CHARACTERISTIC
 /begin VAR_CHARACTERISTIC SSM_K_EPB_Release_Engine_Rpm_Dot_LF_Gain EngCalVariantCriterion
  /begin VAR_ADDRESS 0x8003A815 0x8003B615 0x8003C415 0x8003D215 0x8003E015 0x8003EE15 0x8003FC15 0x80040A15 0x80041815 0x80042615 0x80043415 0x80044215 0x80045015 0x80045E15 0x80046C15 0x80047A15 0x80048815 0x80049615 0x8004A415 0x8004B215 0x8004C015 0x8004CE15 0x8004DC15 0x8004EA15 /end VAR_ADDRESS
 /end VAR_CHARACTERISTIC
 /begin VAR_CHARACTERISTIC SSM_K_EPB_Release_Engine_Torq_AT_Back EngCalVariantCriterion
  /begin VAR_ADDRESS 0x8003A819 0x8003B619 0x8003C419 0x8003D219 0x8003E019 0x8003EE19 0x8003FC19 0x80040A19 0x80041819 0x80042619 0x80043419 0x80044219 0x80045019 0x80045E19 0x80046C19 0x80047A19 0x80048819 0x80049619 0x8004A419 0x8004B219 0x8004C019 0x8004CE19 0x8004DC19 0x8004EA19 /end VAR_ADDRESS
 /end VAR_CHARACTERISTIC
 /begin VAR_CHARACTERISTIC SSM_K_EPB_Release_Engine_Torq_AT_Idle EngCalVariantCriterion
  /begin VAR_ADDRESS 0x8003A81A 0x8003B61A 0x8003C41A 0x8003D21A 0x8003E01A 0x8003EE1A 0x8003FC1A 0x80040A1A 0x8004181A 0x8004261A 0x8004341A 0x8004421A 0x8004501A 0x80045E1A 0x80046C1A 0x80047A1A 0x8004881A 0x8004961A 0x8004A41A 0x8004B21A 0x8004C01A 0x8004CE1A 0x8004DC1A 0x8004EA1A /end VAR_ADDRESS
 /end VAR_CHARACTERISTIC
 /begin VAR_CHARACTERISTIC SSM_K_EPB_Release_Engine_Torq_AT_Z1_Th EngCalVariantCriterion
  /begin VAR_ADDRESS 0x8003A81C 0x8003B61C 0x8003C41C 0x8003D21C 0x8003E01C 0x8003EE1C 0x8003FC1C 0x80040A1C 0x8004181C 0x8004261C 0x8004341C 0x8004421C 0x8004501C 0x80045E1C 0x80046C1C 0x80047A1C 0x8004881C 0x8004961C 0x8004A41C 0x8004B21C 0x8004C01C 0x8004CE1C 0x8004DC1C 0x8004EA1C /end VAR_ADDRESS
 /end VAR_CHARACTERISTIC
 /begin VAR_CHARACTERISTIC SSM_K_EPB_Release_Engine_Torq_AT_Z2_Th EngCalVariantCriterion
  /begin VAR_ADDRESS 0x8003A81D 0x8003B61D 0x8003C41D 0x8003D21D 0x8003E01D 0x8003EE1D 0x8003FC1D 0x80040A1D 0x8004181D 0x8004261D 0x8004341D 0x8004421D 0x8004501D 0x80045E1D 0x80046C1D 0x80047A1D 0x8004881D 0x8004961D 0x8004A41D 0x8004B21D 0x8004C01D 0x8004CE1D 0x8004DC1D 0x8004EA1D /end VAR_ADDRESS
 /end VAR_CHARACTERISTIC
 /begin VAR_CHARACTERISTIC SSM_K_EPB_Release_Engine_Torq_AT_Z3_Th EngCalVariantCriterion
  /begin VAR_ADDRESS 0x8003A81E 0x8003B61E 0x8003C41E 0x8003D21E 0x8003E01E 0x8003EE1E 0x8003FC1E 0x80040A1E 0x8004181E 0x8004261E 0x8004341E 0x8004421E 0x8004501E 0x80045E1E 0x80046C1E 0x80047A1E 0x8004881E 0x8004961E 0x8004A41E 0x8004B21E 0x8004C01E 0x8004CE1E 0x8004DC1E 0x8004EA1E /end VAR_ADDRESS
 /end VAR_CHARACTERISTIC
 /begin VAR_CHARACTERISTIC SSM_K_EPB_Release_Engine_Torq_AT_ZU_Th EngCalVariantCriterion
  /begin VAR_ADDRESS 0x8003A81F 0x8003B61F 0x8003C41F 0x8003D21F 0x8003E01F 0x8003EE1F 0x8003FC1F 0x80040A1F 0x8004181F 0x8004261F 0x8004341F 0x8004421F 0x8004501F 0x80045E1F 0x80046C1F 0x80047A1F 0x8004881F 0x8004961F 0x8004A41F 0x8004B21F 0x8004C01F 0x8004CE1F 0x8004DC1F 0x8004EA1F /end VAR_ADDRESS
 /end VAR_CHARACTERISTIC
 /begin VAR_CHARACTERISTIC SSM_K_EPB_Release_Engine_Torq_Delay_Z1_Th EngCalVariantCriterion
  /begin VAR_ADDRESS 0x8003A820 0x8003B620 0x8003C420 0x8003D220 0x8003E020 0x8003EE20 0x8003FC20 0x80040A20 0x80041820 0x80042620 0x80043420 0x80044220 0x80045020 0x80045E20 0x80046C20 0x80047A20 0x80048820 0x80049620 0x8004A420 0x8004B220 0x8004C020 0x8004CE20 0x8004DC20 0x8004EA20 /end VAR_ADDRESS
 /end VAR_CHARACTERISTIC
 /begin VAR_CHARACTERISTIC SSM_K_EPB_Release_Engine_Torq_Delay_Z2_Th EngCalVariantCriterion
  /begin VAR_ADDRESS 0x8003A821 0x8003B621 0x8003C421 0x8003D221 0x8003E021 0x8003EE21 0x8003FC21 0x80040A21 0x80041821 0x80042621 0x80043421 0x80044221 0x80045021 0x80045E21 0x80046C21 0x80047A21 0x80048821 0x80049621 0x8004A421 0x8004B221 0x8004C021 0x8004CE21 0x8004DC21 0x8004EA21 /end VAR_ADDRESS
 /end VAR_CHARACTERISTIC
 /begin VAR_CHARACTERISTIC SSM_K_EPB_Release_Engine_Torq_Delay_Z3_Th EngCalVariantCriterion
  /begin VAR_ADDRESS 0x8003A822 0x8003B622 0x8003C422 0x8003D222 0x8003E022 0x8003EE22 0x8003FC22 0x80040A22 0x80041822 0x80042622 0x80043422 0x80044222 0x80045022 0x80045E22 0x80046C22 0x80047A22 0x80048822 0x80049622 0x8004A422 0x8004B222 0x8004C022 0x8004CE22 0x8004DC22 0x8004EA22 /end VAR_ADDRESS
 /end VAR_CHARACTERISTIC
 /begin VAR_CHARACTERISTIC SSM_K_EPB_Release_Engine_Torq_Dot_LF_Gain1 EngCalVariantCriterion
  /begin VAR_ADDRESS 0x8003A823 0x8003B623 0x8003C423 0x8003D223 0x8003E023 0x8003EE23 0x8003FC23 0x80040A23 0x80041823 0x80042623 0x80043423 0x80044223 0x80045023 0x80045E23 0x80046C23 0x80047A23 0x80048823 0x80049623 0x8004A423 0x8004B223 0x8004C023 0x8004CE23 0x8004DC23 0x8004EA23 /end VAR_ADDRESS
 /end VAR_CHARACTERISTIC
 /begin VAR_CHARACTERISTIC SSM_K_EPB_Release_Engine_Torq_Dot_LF_Gain2 EngCalVariantCriterion
  /begin VAR_ADDRESS 0x8003A824 0x8003B624 0x8003C424 0x8003D224 0x8003E024 0x8003EE24 0x8003FC24 0x80040A24 0x80041824 0x80042624 0x80043424 0x80044224 0x80045024 0x80045E24 0x80046C24 0x80047A24 0x80048824 0x80049624 0x8004A424 0x8004B224 0x8004C024 0x8004CE24 0x8004DC24 0x8004EA24 /end VAR_ADDRESS
 /end VAR_CHARACTERISTIC
 /begin VAR_CHARACTERISTIC SSM_K_EPB_Release_Engine_Torq_MT_Back EngCalVariantCriterion
  /begin VAR_ADDRESS 0x8003A825 0x8003B625 0x8003C425 0x8003D225 0x8003E025 0x8003EE25 0x8003FC25 0x80040A25 0x80041825 0x80042625 0x80043425 0x80044225 0x80045025 0x80045E25 0x80046C25 0x80047A25 0x80048825 0x80049625 0x8004A425 0x8004B225 0x8004C025 0x8004CE25 0x8004DC25 0x8004EA25 /end VAR_ADDRESS
 /end VAR_CHARACTERISTIC
 /begin VAR_CHARACTERISTIC SSM_K_EPB_Release_Engine_Torq_MT_Idle EngCalVariantCriterion
  /begin VAR_ADDRESS 0x8003A826 0x8003B626 0x8003C426 0x8003D226 0x8003E026 0x8003EE26 0x8003FC26 0x80040A26 0x80041826 0x80042626 0x80043426 0x80044226 0x80045026 0x80045E26 0x80046C26 0x80047A26 0x80048826 0x80049626 0x8004A426 0x8004B226 0x8004C026 0x8004CE26 0x8004DC26 0x8004EA26 /end VAR_ADDRESS
 /end VAR_CHARACTERISTIC
 /begin VAR_CHARACTERISTIC SSM_K_EPB_Release_Engine_Torq_MT_Z1_Th EngCalVariantCriterion
  /begin VAR_ADDRESS 0x8003A828 0x8003B628 0x8003C428 0x8003D228 0x8003E028 0x8003EE28 0x8003FC28 0x80040A28 0x80041828 0x80042628 0x80043428 0x80044228 0x80045028 0x80045E28 0x80046C28 0x80047A28 0x80048828 0x80049628 0x8004A428 0x8004B228 0x8004C028 0x8004CE28 0x8004DC28 0x8004EA28 /end VAR_ADDRESS
 /end VAR_CHARACTERISTIC
 /begin VAR_CHARACTERISTIC SSM_K_EPB_Release_Engine_Torq_MT_Z2_Th EngCalVariantCriterion
  /begin VAR_ADDRESS 0x8003A829 0x8003B629 0x8003C429 0x8003D229 0x8003E029 0x8003EE29 0x8003FC29 0x80040A29 0x80041829 0x80042629 0x80043429 0x80044229 0x80045029 0x80045E29 0x80046C29 0x80047A29 0x80048829 0x80049629 0x8004A429 0x8004B229 0x8004C029 0x8004CE29 0x8004DC29 0x8004EA29 /end VAR_ADDRESS
 /end VAR_CHARACTERISTIC
 /begin VAR_CHARACTERISTIC SSM_K_EPB_Release_Engine_Torq_MT_Z3_Th EngCalVariantCriterion
  /begin VAR_ADDRESS 0x8003A82A 0x8003B62A 0x8003C42A 0x8003D22A 0x8003E02A 0x8003EE2A 0x8003FC2A 0x80040A2A 0x8004182A 0x8004262A 0x8004342A 0x8004422A 0x8004502A 0x80045E2A 0x80046C2A 0x80047A2A 0x8004882A 0x8004962A 0x8004A42A 0x8004B22A 0x8004C02A 0x8004CE2A 0x8004DC2A 0x8004EA2A /end VAR_ADDRESS
 /end VAR_CHARACTERISTIC
 /begin VAR_CHARACTERISTIC SSM_K_EPB_Release_Engine_Torq_MT_ZU_Th EngCalVariantCriterion
  /begin VAR_ADDRESS 0x8003A82B 0x8003B62B 0x8003C42B 0x8003D22B 0x8003E02B 0x8003EE2B 0x8003FC2B 0x80040A2B 0x8004182B 0x8004262B 0x8004342B 0x8004422B 0x8004502B 0x80045E2B 0x80046C2B 0x80047A2B 0x8004882B 0x8004962B 0x8004A42B 0x8004B22B 0x8004C02B 0x8004CE2B 0x8004DC2B 0x8004EA2B /end VAR_ADDRESS
 /end VAR_CHARACTERISTIC
 /begin VAR_CHARACTERISTIC SSM_K_EPB_Release_Engine_Torq_Rate_Z1_Th EngCalVariantCriterion
  /begin VAR_ADDRESS 0x8003A82C 0x8003B62C 0x8003C42C 0x8003D22C 0x8003E02C 0x8003EE2C 0x8003FC2C 0x80040A2C 0x8004182C 0x8004262C 0x8004342C 0x8004422C 0x8004502C 0x80045E2C 0x80046C2C 0x80047A2C 0x8004882C 0x8004962C 0x8004A42C 0x8004B22C 0x8004C02C 0x8004CE2C 0x8004DC2C 0x8004EA2C /end VAR_ADDRESS
 /end VAR_CHARACTERISTIC
 /begin VAR_CHARACTERISTIC SSM_K_EPB_Release_Engine_Torq_Rate_Z2_Th EngCalVariantCriterion
  /begin VAR_ADDRESS 0x8003A82D 0x8003B62D 0x8003C42D 0x8003D22D 0x8003E02D 0x8003EE2D 0x8003FC2D 0x80040A2D 0x8004182D 0x8004262D 0x8004342D 0x8004422D 0x8004502D 0x80045E2D 0x80046C2D 0x80047A2D 0x8004882D 0x8004962D 0x8004A42D 0x8004B22D 0x8004C02D 0x8004CE2D 0x8004DC2D 0x8004EA2D /end VAR_ADDRESS
 /end VAR_CHARACTERISTIC
 /begin VAR_CHARACTERISTIC SSM_K_EPB_Release_Engine_Torq_Rate_Z3_Th EngCalVariantCriterion
  /begin VAR_ADDRESS 0x8003A82E 0x8003B62E 0x8003C42E 0x8003D22E 0x8003E02E 0x8003EE2E 0x8003FC2E 0x80040A2E 0x8004182E 0x8004262E 0x8004342E 0x8004422E 0x8004502E 0x80045E2E 0x80046C2E 0x80047A2E 0x8004882E 0x8004962E 0x8004A42E 0x8004B22E 0x8004C02E 0x8004CE2E 0x8004DC2E 0x8004EA2E /end VAR_ADDRESS
 /end VAR_CHARACTERISTIC
 /begin VAR_CHARACTERISTIC SSM_K_EPB_Release_Throttle_Per_AT_Back EngCalVariantCriterion
  /begin VAR_ADDRESS 0x8003A7EC 0x8003B5EC 0x8003C3EC 0x8003D1EC 0x8003DFEC 0x8003EDEC 0x8003FBEC 0x800409EC 0x800417EC 0x800425EC 0x800433EC 0x800441EC 0x80044FEC 0x80045DEC 0x80046BEC 0x800479EC 0x800487EC 0x800495EC 0x8004A3EC 0x8004B1EC 0x8004BFEC 0x8004CDEC 0x8004DBEC 0x8004E9EC /end VAR_ADDRESS
 /end VAR_CHARACTERISTIC
 /begin VAR_CHARACTERISTIC SSM_K_EPB_Release_Throttle_Per_AT_Th_L EngCalVariantCriterion
  /begin VAR_ADDRESS 0x8003A7ED 0x8003B5ED 0x8003C3ED 0x8003D1ED 0x8003DFED 0x8003EDED 0x8003FBED 0x800409ED 0x800417ED 0x800425ED 0x800433ED 0x800441ED 0x80044FED 0x80045DED 0x80046BED 0x800479ED 0x800487ED 0x800495ED 0x8004A3ED 0x8004B1ED 0x8004BFED 0x8004CDED 0x8004DBED 0x8004E9ED /end VAR_ADDRESS
 /end VAR_CHARACTERISTIC
 /begin VAR_CHARACTERISTIC SSM_K_EPB_Release_Throttle_Per_AT_Z1_Th_H EngCalVariantCriterion
  /begin VAR_ADDRESS 0x8003A7EE 0x8003B5EE 0x8003C3EE 0x8003D1EE 0x8003DFEE 0x8003EDEE 0x8003FBEE 0x800409EE 0x800417EE 0x800425EE 0x800433EE 0x800441EE 0x80044FEE 0x80045DEE 0x80046BEE 0x800479EE 0x800487EE 0x800495EE 0x8004A3EE 0x8004B1EE 0x8004BFEE 0x8004CDEE 0x8004DBEE 0x8004E9EE /end VAR_ADDRESS
 /end VAR_CHARACTERISTIC
 /begin VAR_CHARACTERISTIC SSM_K_EPB_Release_Throttle_Per_AT_Z2_Th_H EngCalVariantCriterion
  /begin VAR_ADDRESS 0x8003A7EF 0x8003B5EF 0x8003C3EF 0x8003D1EF 0x8003DFEF 0x8003EDEF 0x8003FBEF 0x800409EF 0x800417EF 0x800425EF 0x800433EF 0x800441EF 0x80044FEF 0x80045DEF 0x80046BEF 0x800479EF 0x800487EF 0x800495EF 0x8004A3EF 0x8004B1EF 0x8004BFEF 0x8004CDEF 0x8004DBEF 0x8004E9EF /end VAR_ADDRESS
 /end VAR_CHARACTERISTIC
 /begin VAR_CHARACTERISTIC SSM_K_EPB_Release_Throttle_Per_AT_Z3_Th_H EngCalVariantCriterion
  /begin VAR_ADDRESS 0x8003A7F0 0x8003B5F0 0x8003C3F0 0x8003D1F0 0x8003DFF0 0x8003EDF0 0x8003FBF0 0x800409F0 0x800417F0 0x800425F0 0x800433F0 0x800441F0 0x80044FF0 0x80045DF0 0x80046BF0 0x800479F0 0x800487F0 0x800495F0 0x8004A3F0 0x8004B1F0 0x8004BFF0 0x8004CDF0 0x8004DBF0 0x8004E9F0 /end VAR_ADDRESS
 /end VAR_CHARACTERISTIC
 /begin VAR_CHARACTERISTIC SSM_K_EPB_Release_Throttle_Per_AT_ZU_Th EngCalVariantCriterion
  /begin VAR_ADDRESS 0x8003A7F1 0x8003B5F1 0x8003C3F1 0x8003D1F1 0x8003DFF1 0x8003EDF1 0x8003FBF1 0x800409F1 0x800417F1 0x800425F1 0x800433F1 0x800441F1 0x80044FF1 0x80045DF1 0x80046BF1 0x800479F1 0x800487F1 0x800495F1 0x8004A3F1 0x8004B1F1 0x8004BFF1 0x8004CDF1 0x8004DBF1 0x8004E9F1 /end VAR_ADDRESS
 /end VAR_CHARACTERISTIC
 /begin VAR_CHARACTERISTIC SSM_K_EPB_Release_Throttle_Per_MT_Back EngCalVariantCriterion
  /begin VAR_ADDRESS 0x8003A7F2 0x8003B5F2 0x8003C3F2 0x8003D1F2 0x8003DFF2 0x8003EDF2 0x8003FBF2 0x800409F2 0x800417F2 0x800425F2 0x800433F2 0x800441F2 0x80044FF2 0x80045DF2 0x80046BF2 0x800479F2 0x800487F2 0x800495F2 0x8004A3F2 0x8004B1F2 0x8004BFF2 0x8004CDF2 0x8004DBF2 0x8004E9F2 /end VAR_ADDRESS
 /end VAR_CHARACTERISTIC
 /begin VAR_CHARACTERISTIC SSM_K_EPB_Release_Throttle_Per_MT_Th_L EngCalVariantCriterion
  /begin VAR_ADDRESS 0x8003A7F3 0x8003B5F3 0x8003C3F3 0x8003D1F3 0x8003DFF3 0x8003EDF3 0x8003FBF3 0x800409F3 0x800417F3 0x800425F3 0x800433F3 0x800441F3 0x80044FF3 0x80045DF3 0x80046BF3 0x800479F3 0x800487F3 0x800495F3 0x8004A3F3 0x8004B1F3 0x8004BFF3 0x8004CDF3 0x8004DBF3 0x8004E9F3 /end VAR_ADDRESS
 /end VAR_CHARACTERISTIC
 /begin VAR_CHARACTERISTIC SSM_K_EPB_Release_Throttle_Per_MT_Z1_Th_H EngCalVariantCriterion
  /begin VAR_ADDRESS 0x8003A7F4 0x8003B5F4 0x8003C3F4 0x8003D1F4 0x8003DFF4 0x8003EDF4 0x8003FBF4 0x800409F4 0x800417F4 0x800425F4 0x800433F4 0x800441F4 0x80044FF4 0x80045DF4 0x80046BF4 0x800479F4 0x800487F4 0x800495F4 0x8004A3F4 0x8004B1F4 0x8004BFF4 0x8004CDF4 0x8004DBF4 0x8004E9F4 /end VAR_ADDRESS
 /end VAR_CHARACTERISTIC
 /begin VAR_CHARACTERISTIC SSM_K_EPB_Release_Throttle_Per_MT_Z2_Th_H EngCalVariantCriterion
  /begin VAR_ADDRESS 0x8003A7F5 0x8003B5F5 0x8003C3F5 0x8003D1F5 0x8003DFF5 0x8003EDF5 0x8003FBF5 0x800409F5 0x800417F5 0x800425F5 0x800433F5 0x800441F5 0x80044FF5 0x80045DF5 0x80046BF5 0x800479F5 0x800487F5 0x800495F5 0x8004A3F5 0x8004B1F5 0x8004BFF5 0x8004CDF5 0x8004DBF5 0x8004E9F5 /end VAR_ADDRESS
 /end VAR_CHARACTERISTIC
 /begin VAR_CHARACTERISTIC SSM_K_EPB_Release_Throttle_Per_MT_Z3_Th_H EngCalVariantCriterion
  /begin VAR_ADDRESS 0x8003A7F6 0x8003B5F6 0x8003C3F6 0x8003D1F6 0x8003DFF6 0x8003EDF6 0x8003FBF6 0x800409F6 0x800417F6 0x800425F6 0x800433F6 0x800441F6 0x80044FF6 0x80045DF6 0x80046BF6 0x800479F6 0x800487F6 0x800495F6 0x8004A3F6 0x8004B1F6 0x8004BFF6 0x8004CDF6 0x8004DBF6 0x8004E9F6 /end VAR_ADDRESS
 /end VAR_CHARACTERISTIC
 /begin VAR_CHARACTERISTIC SSM_K_EPB_Release_Throttle_Per_MT_ZU_Th EngCalVariantCriterion
  /begin VAR_ADDRESS 0x8003A7F7 0x8003B5F7 0x8003C3F7 0x8003D1F7 0x8003DFF7 0x8003EDF7 0x8003FBF7 0x800409F7 0x800417F7 0x800425F7 0x800433F7 0x800441F7 0x80044FF7 0x80045DF7 0x80046BF7 0x800479F7 0x800487F7 0x800495F7 0x8004A3F7 0x8004B1F7 0x8004BFF7 0x8004CDF7 0x8004DBF7 0x8004E9F7 /end VAR_ADDRESS
 /end VAR_CHARACTERISTIC
 /begin VAR_CHARACTERISTIC SSM_K_EPB_Rollbench_Front_SPD_TH_H EngCalVariantCriterion
  /begin VAR_ADDRESS 0x8003A8A2 0x8003B6A2 0x8003C4A2 0x8003D2A2 0x8003E0A2 0x8003EEA2 0x8003FCA2 0x80040AA2 0x800418A2 0x800426A2 0x800434A2 0x800442A2 0x800450A2 0x80045EA2 0x80046CA2 0x80047AA2 0x800488A2 0x800496A2 0x8004A4A2 0x8004B2A2 0x8004C0A2 0x8004CEA2 0x8004DCA2 0x8004EAA2 /end VAR_ADDRESS
 /end VAR_CHARACTERISTIC
 /begin VAR_CHARACTERISTIC SSM_K_EPB_Rollbench_Front_SPD_TH_L EngCalVariantCriterion
  /begin VAR_ADDRESS 0x8003A8A4 0x8003B6A4 0x8003C4A4 0x8003D2A4 0x8003E0A4 0x8003EEA4 0x8003FCA4 0x80040AA4 0x800418A4 0x800426A4 0x800434A4 0x800442A4 0x800450A4 0x80045EA4 0x80046CA4 0x80047AA4 0x800488A4 0x800496A4 0x8004A4A4 0x8004B2A4 0x8004C0A4 0x8004CEA4 0x8004DCA4 0x8004EAA4 /end VAR_ADDRESS
 /end VAR_CHARACTERISTIC
 /begin VAR_CHARACTERISTIC SSM_K_EPB_Rollbench_Rear_SPD_TH_H EngCalVariantCriterion
  /begin VAR_ADDRESS 0x8003A8A6 0x8003B6A6 0x8003C4A6 0x8003D2A6 0x8003E0A6 0x8003EEA6 0x8003FCA6 0x80040AA6 0x800418A6 0x800426A6 0x800434A6 0x800442A6 0x800450A6 0x80045EA6 0x80046CA6 0x80047AA6 0x800488A6 0x800496A6 0x8004A4A6 0x8004B2A6 0x8004C0A6 0x8004CEA6 0x8004DCA6 0x8004EAA6 /end VAR_ADDRESS
 /end VAR_CHARACTERISTIC
 /begin VAR_CHARACTERISTIC SSM_K_EPB_Rollbench_Rear_SPD_TH_L EngCalVariantCriterion
  /begin VAR_ADDRESS 0x8003A8A8 0x8003B6A8 0x8003C4A8 0x8003D2A8 0x8003E0A8 0x8003EEA8 0x8003FCA8 0x80040AA8 0x800418A8 0x800426A8 0x800434A8 0x800442A8 0x800450A8 0x80045EA8 0x80046CA8 0x80047AA8 0x800488A8 0x800496A8 0x8004A4A8 0x8004B2A8 0x8004C0A8 0x8004CEA8 0x8004DCA8 0x8004EAA8 /end VAR_ADDRESS
 /end VAR_CHARACTERISTIC
 /begin VAR_CHARACTERISTIC SSM_K_EPB_Service_Release_DectTime EngCalVariantCriterion
  /begin VAR_ADDRESS 0x8003A870 0x8003B670 0x8003C470 0x8003D270 0x8003E070 0x8003EE70 0x8003FC70 0x80040A70 0x80041870 0x80042670 0x80043470 0x80044270 0x80045070 0x80045E70 0x80046C70 0x80047A70 0x80048870 0x80049670 0x8004A470 0x8004B270 0x8004C070 0x8004CE70 0x8004DC70 0x8004EA70 /end VAR_ADDRESS
 /end VAR_CHARACTERISTIC
 /begin VAR_CHARACTERISTIC SSM_K_EPB_Service_Release_Feature_En EngCalVariantCriterion
  /begin VAR_ADDRESS 0x8003A872 0x8003B672 0x8003C472 0x8003D272 0x8003E072 0x8003EE72 0x8003FC72 0x80040A72 0x80041872 0x80042672 0x80043472 0x80044272 0x80045072 0x80045E72 0x80046C72 0x80047A72 0x80048872 0x80049672 0x8004A472 0x8004B272 0x8004C072 0x8004CE72 0x8004DC72 0x8004EA72 /end VAR_ADDRESS
 /end VAR_CHARACTERISTIC
 /begin VAR_CHARACTERISTIC SSM_K_EPB_Service_Release_Switch_On_Time EngCalVariantCriterion
  /begin VAR_ADDRESS 0x8003A874 0x8003B674 0x8003C474 0x8003D274 0x8003E074 0x8003EE74 0x8003FC74 0x80040A74 0x80041874 0x80042674 0x80043474 0x80044274 0x80045074 0x80045E74 0x80046C74 0x80047A74 0x80048874 0x80049674 0x8004A474 0x8004B274 0x8004C074 0x8004CE74 0x8004DC74 0x8004EA74 /end VAR_ADDRESS
 /end VAR_CHARACTERISTIC
 /begin VAR_CHARACTERISTIC SSM_K_EPB_Set_Variant_Code_En EngCalVariantCriterion
  /begin VAR_ADDRESS 0x8003A7D2 0x8003B5D2 0x8003C3D2 0x8003D1D2 0x8003DFD2 0x8003EDD2 0x8003FBD2 0x800409D2 0x800417D2 0x800425D2 0x800433D2 0x800441D2 0x80044FD2 0x80045DD2 0x80046BD2 0x800479D2 0x800487D2 0x800495D2 0x8004A3D2 0x8004B1D2 0x8004BFD2 0x8004CDD2 0x8004DBD2 0x8004E9D2 /end VAR_ADDRESS
 /end VAR_CHARACTERISTIC
 /begin VAR_CHARACTERISTIC SSM_K_EPB_Step_On_Brake_Message_En EngCalVariantCriterion
  /begin VAR_ADDRESS 0x8003A7D3 0x8003B5D3 0x8003C3D3 0x8003D1D3 0x8003DFD3 0x8003EDD3 0x8003FBD3 0x800409D3 0x800417D3 0x800425D3 0x800433D3 0x800441D3 0x80044FD3 0x80045DD3 0x80046BD3 0x800479D3 0x800487D3 0x800495D3 0x8004A3D3 0x8004B1D3 0x8004BFD3 0x8004CDD3 0x8004DBD3 0x8004E9D3 /end VAR_ADDRESS
 /end VAR_CHARACTERISTIC
 /begin VAR_CHARACTERISTIC SSM_K_EPB_Telltale_Ill_time_at_IGN_OFF EngCalVariantCriterion
  /begin VAR_ADDRESS 0x8003A7D4 0x8003B5D4 0x8003C3D4 0x8003D1D4 0x8003DFD4 0x8003EDD4 0x8003FBD4 0x800409D4 0x800417D4 0x800425D4 0x800433D4 0x800441D4 0x80044FD4 0x80045DD4 0x80046BD4 0x800479D4 0x800487D4 0x800495D4 0x8004A3D4 0x8004B1D4 0x8004BFD4 0x8004CDD4 0x8004DBD4 0x8004E9D4 /end VAR_ADDRESS
 /end VAR_CHARACTERISTIC
 /begin VAR_CHARACTERISTIC SSM_K_EPB_VICM_system EngCalVariantCriterion
  /begin VAR_ADDRESS 0x8003A7D5 0x8003B5D5 0x8003C3D5 0x8003D1D5 0x8003DFD5 0x8003EDD5 0x8003FBD5 0x800409D5 0x800417D5 0x800425D5 0x800433D5 0x800441D5 0x80044FD5 0x80045DD5 0x80046BD5 0x800479D5 0x800487D5 0x800495D5 0x8004A3D5 0x8004B1D5 0x8004BFD5 0x8004CDD5 0x8004DBD5 0x8004E9D5 /end VAR_ADDRESS
 /end VAR_CHARACTERISTIC
 /begin VAR_CHARACTERISTIC SSM_K_EPB_VehStopDecel_DynamicOn_Time_Th EngCalVariantCriterion
  /begin VAR_ADDRESS 0x8003A89E 0x8003B69E 0x8003C49E 0x8003D29E 0x8003E09E 0x8003EE9E 0x8003FC9E 0x80040A9E 0x8004189E 0x8004269E 0x8004349E 0x8004429E 0x8004509E 0x80045E9E 0x80046C9E 0x80047A9E 0x8004889E 0x8004969E 0x8004A49E 0x8004B29E 0x8004C09E 0x8004CE9E 0x8004DC9E 0x8004EA9E /end VAR_ADDRESS
 /end VAR_CHARACTERISTIC
 /begin VAR_CHARACTERISTIC SSM_K_EPB_VehStopDecel_En EngCalVariantCriterion
  /begin VAR_ADDRESS 0x8003A8A0 0x8003B6A0 0x8003C4A0 0x8003D2A0 0x8003E0A0 0x8003EEA0 0x8003FCA0 0x80040AA0 0x800418A0 0x800426A0 0x800434A0 0x800442A0 0x800450A0 0x80045EA0 0x80046CA0 0x80047AA0 0x800488A0 0x800496A0 0x8004A4A0 0x8004B2A0 0x8004C0A0 0x8004CEA0 0x8004DCA0 0x8004EAA0 /end VAR_ADDRESS
 /end VAR_CHARACTERISTIC
 /begin VAR_CHARACTERISTIC SSM_K_EPB_VehicleStopDecel_Th_H EngCalVariantCriterion
  /begin VAR_ADDRESS 0x8003A89C 0x8003B69C 0x8003C49C 0x8003D29C 0x8003E09C 0x8003EE9C 0x8003FC9C 0x80040A9C 0x8004189C 0x8004269C 0x8004349C 0x8004429C 0x8004509C 0x80045E9C 0x80046C9C 0x80047A9C 0x8004889C 0x8004969C 0x8004A49C 0x8004B29C 0x8004C09C 0x8004CE9C 0x8004DC9C 0x8004EA9C /end VAR_ADDRESS
 /end VAR_CHARACTERISTIC
 /begin VAR_CHARACTERISTIC SSM_K_EPB_VehicleStopDecel_Th_L EngCalVariantCriterion
  /begin VAR_ADDRESS 0x8003A89B 0x8003B69B 0x8003C49B 0x8003D29B 0x8003E09B 0x8003EE9B 0x8003FC9B 0x80040A9B 0x8004189B 0x8004269B 0x8004349B 0x8004429B 0x8004509B 0x80045E9B 0x80046C9B 0x80047A9B 0x8004889B 0x8004969B 0x8004A49B 0x8004B29B 0x8004C09B 0x8004CE9B 0x8004DC9B 0x8004EA9B /end VAR_ADDRESS
 /end VAR_CHARACTERISTIC
 /begin VAR_CHARACTERISTIC SSM_K_EPB_Vehicle_Speed_Apply_Slip_Comp_Th_L EngCalVariantCriterion
  /begin VAR_ADDRESS 0x8003A7E0 0x8003B5E0 0x8003C3E0 0x8003D1E0 0x8003DFE0 0x8003EDE0 0x8003FBE0 0x800409E0 0x800417E0 0x800425E0 0x800433E0 0x800441E0 0x80044FE0 0x80045DE0 0x80046BE0 0x800479E0 0x800487E0 0x800495E0 0x8004A3E0 0x8004B1E0 0x8004BFE0 0x8004CDE0 0x8004DBE0 0x8004E9E0 /end VAR_ADDRESS
 /end VAR_CHARACTERISTIC
 /begin VAR_CHARACTERISTIC SSM_K_EPB_Vehicle_Speed_Apply_Th_H EngCalVariantCriterion
  /begin VAR_ADDRESS 0x8003A7E2 0x8003B5E2 0x8003C3E2 0x8003D1E2 0x8003DFE2 0x8003EDE2 0x8003FBE2 0x800409E2 0x800417E2 0x800425E2 0x800433E2 0x800441E2 0x80044FE2 0x80045DE2 0x80046BE2 0x800479E2 0x800487E2 0x800495E2 0x8004A3E2 0x8004B1E2 0x8004BFE2 0x8004CDE2 0x8004DBE2 0x8004E9E2 /end VAR_ADDRESS
 /end VAR_CHARACTERISTIC
 /begin VAR_CHARACTERISTIC SSM_K_EPB_Vehicle_Speed_Apply_Th_L EngCalVariantCriterion
  /begin VAR_ADDRESS 0x8003A7E4 0x8003B5E4 0x8003C3E4 0x8003D1E4 0x8003DFE4 0x8003EDE4 0x8003FBE4 0x800409E4 0x800417E4 0x800425E4 0x800433E4 0x800441E4 0x80044FE4 0x80045DE4 0x80046BE4 0x800479E4 0x800487E4 0x800495E4 0x8004A3E4 0x8004B1E4 0x8004BFE4 0x8004CDE4 0x8004DBE4 0x8004E9E4 /end VAR_ADDRESS
 /end VAR_CHARACTERISTIC
/end VARIANT_CODING
/end MODULE
/end PROJECT
