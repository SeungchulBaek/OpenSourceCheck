ASAP2_VERSION 1 60
/begin PROJECT Master ""
/begin MODULE CPP ""
/begin MOD_COMMON "" BYTE_ORDER MSB_LAST ALIGNMENT_BYTE 1 ALIGNMENT_WORD 1 ALIGNMENT_LONG 1 ALIGNMENT_FLOAT32_IEEE 1 ALIGNMENT_FLOAT64_IEEE 1 ALIGNMENT_INT64 1 /end MOD_COMMON
/begin VARIANT_CODING
 /begin VAR_CHARACTERISTIC TP_U8ETCSCpBigEngSpdIgFac[0][1] EngCalVariantCriterion
  /begin VAR_ADDRESS 0x8003A4AE 0x8003B2AE 0x8003C0AE 0x8003CEAE 0x8003DCAE 0x8003EAAE 0x8003F8AE 0x800406AE 0x800414AE 0x800422AE 0x800430AE 0x80043EAE 0x80044CAE 0x80045AAE 0x800468AE 0x800476AE 0x800484AE 0x800492AE 0x8004A0AE 0x8004AEAE 0x8004BCAE 0x8004CAAE 0x8004D8AE 0x8004E6AE /end VAR_ADDRESS
 /end VAR_CHARACTERISTIC
 /begin VAR_CHARACTERISTIC TP_U8ETCSCpBigEngSpdIgFac[0][2] EngCalVariantCriterion
  /begin VAR_ADDRESS 0x8003A4AF 0x8003B2AF 0x8003C0AF 0x8003CEAF 0x8003DCAF 0x8003EAAF 0x8003F8AF 0x800406AF 0x800414AF 0x800422AF 0x800430AF 0x80043EAF 0x80044CAF 0x80045AAF 0x800468AF 0x800476AF 0x800484AF 0x800492AF 0x8004A0AF 0x8004AEAF 0x8004BCAF 0x8004CAAF 0x8004D8AF 0x8004E6AF /end VAR_ADDRESS
 /end VAR_CHARACTERISTIC
 /begin VAR_CHARACTERISTIC TP_U8ETCSCpBigEngSpdIgFac[1][0] EngCalVariantCriterion
  /begin VAR_ADDRESS 0x8003A4B0 0x8003B2B0 0x8003C0B0 0x8003CEB0 0x8003DCB0 0x8003EAB0 0x8003F8B0 0x800406B0 0x800414B0 0x800422B0 0x800430B0 0x80043EB0 0x80044CB0 0x80045AB0 0x800468B0 0x800476B0 0x800484B0 0x800492B0 0x8004A0B0 0x8004AEB0 0x8004BCB0 0x8004CAB0 0x8004D8B0 0x8004E6B0 /end VAR_ADDRESS
 /end VAR_CHARACTERISTIC
 /begin VAR_CHARACTERISTIC TP_U8ETCSCpBigEngSpdIgFac[1][1] EngCalVariantCriterion
  /begin VAR_ADDRESS 0x8003A4B1 0x8003B2B1 0x8003C0B1 0x8003CEB1 0x8003DCB1 0x8003EAB1 0x8003F8B1 0x800406B1 0x800414B1 0x800422B1 0x800430B1 0x80043EB1 0x80044CB1 0x80045AB1 0x800468B1 0x800476B1 0x800484B1 0x800492B1 0x8004A0B1 0x8004AEB1 0x8004BCB1 0x8004CAB1 0x8004D8B1 0x8004E6B1 /end VAR_ADDRESS
 /end VAR_CHARACTERISTIC
 /begin VAR_CHARACTERISTIC TP_U8ETCSCpBigEngSpdIgFac[1][2] EngCalVariantCriterion
  /begin VAR_ADDRESS 0x8003A4B2 0x8003B2B2 0x8003C0B2 0x8003CEB2 0x8003DCB2 0x8003EAB2 0x8003F8B2 0x800406B2 0x800414B2 0x800422B2 0x800430B2 0x80043EB2 0x80044CB2 0x80045AB2 0x800468B2 0x800476B2 0x800484B2 0x800492B2 0x8004A0B2 0x8004AEB2 0x8004BCB2 0x8004CAB2 0x8004D8B2 0x8004E6B2 /end VAR_ADDRESS
 /end VAR_CHARACTERISTIC
 /begin VAR_CHARACTERISTIC TP_U8ETCSCpBigEngSpdIgFac[2][0] EngCalVariantCriterion
  /begin VAR_ADDRESS 0x8003A4B3 0x8003B2B3 0x8003C0B3 0x8003CEB3 0x8003DCB3 0x8003EAB3 0x8003F8B3 0x800406B3 0x800414B3 0x800422B3 0x800430B3 0x80043EB3 0x80044CB3 0x80045AB3 0x800468B3 0x800476B3 0x800484B3 0x800492B3 0x8004A0B3 0x8004AEB3 0x8004BCB3 0x8004CAB3 0x8004D8B3 0x8004E6B3 /end VAR_ADDRESS
 /end VAR_CHARACTERISTIC
 /begin VAR_CHARACTERISTIC TP_U8ETCSCpBigEngSpdIgFac[2][1] EngCalVariantCriterion
  /begin VAR_ADDRESS 0x8003A4B4 0x8003B2B4 0x8003C0B4 0x8003CEB4 0x8003DCB4 0x8003EAB4 0x8003F8B4 0x800406B4 0x800414B4 0x800422B4 0x800430B4 0x80043EB4 0x80044CB4 0x80045AB4 0x800468B4 0x800476B4 0x800484B4 0x800492B4 0x8004A0B4 0x8004AEB4 0x8004BCB4 0x8004CAB4 0x8004D8B4 0x8004E6B4 /end VAR_ADDRESS
 /end VAR_CHARACTERISTIC
 /begin VAR_CHARACTERISTIC TP_U8ETCSCpBigEngSpdIgFac[2][2] EngCalVariantCriterion
  /begin VAR_ADDRESS 0x8003A4B5 0x8003B2B5 0x8003C0B5 0x8003CEB5 0x8003DCB5 0x8003EAB5 0x8003F8B5 0x800406B5 0x800414B5 0x800422B5 0x800430B5 0x80043EB5 0x80044CB5 0x80045AB5 0x800468B5 0x800476B5 0x800484B5 0x800492B5 0x8004A0B5 0x8004AEB5 0x8004BCB5 0x8004CAB5 0x8004D8B5 0x8004E6B5 /end VAR_ADDRESS
 /end VAR_CHARACTERISTIC
 /begin VAR_CHARACTERISTIC TP_U8ETCSCpBigSpnIgFac[0][0] EngCalVariantCriterion
  /begin VAR_ADDRESS 0x8003A4B6 0x8003B2B6 0x8003C0B6 0x8003CEB6 0x8003DCB6 0x8003EAB6 0x8003F8B6 0x800406B6 0x800414B6 0x800422B6 0x800430B6 0x80043EB6 0x80044CB6 0x80045AB6 0x800468B6 0x800476B6 0x800484B6 0x800492B6 0x8004A0B6 0x8004AEB6 0x8004BCB6 0x8004CAB6 0x8004D8B6 0x8004E6B6 /end VAR_ADDRESS
 /end VAR_CHARACTERISTIC
 /begin VAR_CHARACTERISTIC TP_U8ETCSCpBigSpnIgFac[0][1] EngCalVariantCriterion
  /begin VAR_ADDRESS 0x8003A4B7 0x8003B2B7 0x8003C0B7 0x8003CEB7 0x8003DCB7 0x8003EAB7 0x8003F8B7 0x800406B7 0x800414B7 0x800422B7 0x800430B7 0x80043EB7 0x80044CB7 0x80045AB7 0x800468B7 0x800476B7 0x800484B7 0x800492B7 0x8004A0B7 0x8004AEB7 0x8004BCB7 0x8004CAB7 0x8004D8B7 0x8004E6B7 /end VAR_ADDRESS
 /end VAR_CHARACTERISTIC
 /begin VAR_CHARACTERISTIC TP_U8ETCSCpBigSpnIgFac[0][2] EngCalVariantCriterion
  /begin VAR_ADDRESS 0x8003A4B8 0x8003B2B8 0x8003C0B8 0x8003CEB8 0x8003DCB8 0x8003EAB8 0x8003F8B8 0x800406B8 0x800414B8 0x800422B8 0x800430B8 0x80043EB8 0x80044CB8 0x80045AB8 0x800468B8 0x800476B8 0x800484B8 0x800492B8 0x8004A0B8 0x8004AEB8 0x8004BCB8 0x8004CAB8 0x8004D8B8 0x8004E6B8 /end VAR_ADDRESS
 /end VAR_CHARACTERISTIC
 /begin VAR_CHARACTERISTIC TP_U8ETCSCpBigSpnIgFac[1][0] EngCalVariantCriterion
  /begin VAR_ADDRESS 0x8003A4B9 0x8003B2B9 0x8003C0B9 0x8003CEB9 0x8003DCB9 0x8003EAB9 0x8003F8B9 0x800406B9 0x800414B9 0x800422B9 0x800430B9 0x80043EB9 0x80044CB9 0x80045AB9 0x800468B9 0x800476B9 0x800484B9 0x800492B9 0x8004A0B9 0x8004AEB9 0x8004BCB9 0x8004CAB9 0x8004D8B9 0x8004E6B9 /end VAR_ADDRESS
 /end VAR_CHARACTERISTIC
 /begin VAR_CHARACTERISTIC TP_U8ETCSCpBigSpnIgFac[1][1] EngCalVariantCriterion
  /begin VAR_ADDRESS 0x8003A4BA 0x8003B2BA 0x8003C0BA 0x8003CEBA 0x8003DCBA 0x8003EABA 0x8003F8BA 0x800406BA 0x800414BA 0x800422BA 0x800430BA 0x80043EBA 0x80044CBA 0x80045ABA 0x800468BA 0x800476BA 0x800484BA 0x800492BA 0x8004A0BA 0x8004AEBA 0x8004BCBA 0x8004CABA 0x8004D8BA 0x8004E6BA /end VAR_ADDRESS
 /end VAR_CHARACTERISTIC
 /begin VAR_CHARACTERISTIC TP_U8ETCSCpBigSpnIgFac[1][2] EngCalVariantCriterion
  /begin VAR_ADDRESS 0x8003A4BB 0x8003B2BB 0x8003C0BB 0x8003CEBB 0x8003DCBB 0x8003EABB 0x8003F8BB 0x800406BB 0x800414BB 0x800422BB 0x800430BB 0x80043EBB 0x80044CBB 0x80045ABB 0x800468BB 0x800476BB 0x800484BB 0x800492BB 0x8004A0BB 0x8004AEBB 0x8004BCBB 0x8004CABB 0x8004D8BB 0x8004E6BB /end VAR_ADDRESS
 /end VAR_CHARACTERISTIC
 /begin VAR_CHARACTERISTIC TP_U8ETCSCpCnt4Tar1stIncInTrn EngCalVariantCriterion
  /begin VAR_ADDRESS 0x8003A4BC 0x8003B2BC 0x8003C0BC 0x8003CEBC 0x8003DCBC 0x8003EABC 0x8003F8BC 0x800406BC 0x800414BC 0x800422BC 0x800430BC 0x80043EBC 0x80044CBC 0x80045ABC 0x800468BC 0x800476BC 0x800484BC 0x800492BC 0x8004A0BC 0x8004AEBC 0x8004BCBC 0x8004CABC 0x8004D8BC 0x8004E6BC /end VAR_ADDRESS
 /end VAR_CHARACTERISTIC
 /begin VAR_CHARACTERISTIC TP_U8ETCSCpCnt4TarMaxDecInTrn EngCalVariantCriterion
  /begin VAR_ADDRESS 0x8003A4BD 0x8003B2BD 0x8003C0BD 0x8003CEBD 0x8003DCBD 0x8003EABD 0x8003F8BD 0x800406BD 0x800414BD 0x800422BD 0x800430BD 0x80043EBD 0x80044CBD 0x80045ABD 0x800468BD 0x800476BD 0x800484BD 0x800492BD 0x8004A0BD 0x8004AEBD 0x8004BCBD 0x8004CABD 0x8004D8BD 0x8004E6BD /end VAR_ADDRESS
 /end VAR_CHARACTERISTIC
 /begin VAR_CHARACTERISTIC TP_U8ETCSCpCrnExDctCnt EngCalVariantCriterion
  /begin VAR_ADDRESS 0x8003A4BE 0x8003B2BE 0x8003C0BE 0x8003CEBE 0x8003DCBE 0x8003EABE 0x8003F8BE 0x800406BE 0x800414BE 0x800422BE 0x800430BE 0x80043EBE 0x80044CBE 0x80045ABE 0x800468BE 0x800476BE 0x800484BE 0x800492BE 0x8004A0BE 0x8004AEBE 0x8004BCBE 0x8004CABE 0x8004D8BE 0x8004E6BE /end VAR_ADDRESS
 /end VAR_CHARACTERISTIC
 /begin VAR_CHARACTERISTIC TP_U8ETCSCpCtlActCntThAtHiAxlAcc EngCalVariantCriterion
  /begin VAR_ADDRESS 0x8003A4BF 0x8003B2BF 0x8003C0BF 0x8003CEBF 0x8003DCBF 0x8003EABF 0x8003F8BF 0x800406BF 0x800414BF 0x800422BF 0x800430BF 0x80043EBF 0x80044CBF 0x80045ABF 0x800468BF 0x800476BF 0x800484BF 0x800492BF 0x8004A0BF 0x8004AEBF 0x8004BCBF 0x8004CABF 0x8004D8BF 0x8004E6BF /end VAR_ADDRESS
 /end VAR_CHARACTERISTIC
 /begin VAR_CHARACTERISTIC TP_U8ETCSCpCtlActCntThAtLwAxlAcc EngCalVariantCriterion
  /begin VAR_ADDRESS 0x8003A4C0 0x8003B2C0 0x8003C0C0 0x8003CEC0 0x8003DCC0 0x8003EAC0 0x8003F8C0 0x800406C0 0x800414C0 0x800422C0 0x800430C0 0x80043EC0 0x80044CC0 0x80045AC0 0x800468C0 0x800476C0 0x800484C0 0x800492C0 0x8004A0C0 0x8004AEC0 0x8004BCC0 0x8004CAC0 0x8004D8C0 0x8004E6C0 /end VAR_ADDRESS
 /end VAR_CHARACTERISTIC
 /begin VAR_CHARACTERISTIC TP_U8ETCSCpCtlActTmThInLmtCnrg EngCalVariantCriterion
  /begin VAR_ADDRESS 0x8003A4C1 0x8003B2C1 0x8003C0C1 0x8003CEC1 0x8003DCC1 0x8003EAC1 0x8003F8C1 0x800406C1 0x800414C1 0x800422C1 0x800430C1 0x80043EC1 0x80044CC1 0x80045AC1 0x800468C1 0x800476C1 0x800484C1 0x800492C1 0x8004A0C1 0x8004AEC1 0x8004BCC1 0x8004CAC1 0x8004D8C1 0x8004E6C1 /end VAR_ADDRESS
 /end VAR_CHARACTERISTIC
 /begin VAR_CHARACTERISTIC TP_U8ETCSCpCtlEnterAccPdlTh EngCalVariantCriterion
  /begin VAR_ADDRESS 0x8003A4C2 0x8003B2C2 0x8003C0C2 0x8003CEC2 0x8003DCC2 0x8003EAC2 0x8003F8C2 0x800406C2 0x800414C2 0x800422C2 0x800430C2 0x80043EC2 0x80044CC2 0x80045AC2 0x800468C2 0x800476C2 0x800484C2 0x800492C2 0x8004A0C2 0x8004AEC2 0x8004BCC2 0x8004CAC2 0x8004D8C2 0x8004E6C2 /end VAR_ADDRESS
 /end VAR_CHARACTERISTIC
 /begin VAR_CHARACTERISTIC TP_U8ETCSCpCtlExitAccPdlTh EngCalVariantCriterion
  /begin VAR_ADDRESS 0x8003A4C3 0x8003B2C3 0x8003C0C3 0x8003CEC3 0x8003DCC3 0x8003EAC3 0x8003F8C3 0x800406C3 0x800414C3 0x800422C3 0x800430C3 0x80043EC3 0x80044CC3 0x80045AC3 0x800468C3 0x800476C3 0x800484C3 0x800492C3 0x8004A0C3 0x8004AEC3 0x8004BCC3 0x8004CAC3 0x8004D8C3 0x8004E6C3 /end VAR_ADDRESS
 /end VAR_CHARACTERISTIC
 /begin VAR_CHARACTERISTIC TP_U8ETCSCpDelYawDivrgGain[0][0] EngCalVariantCriterion
  /begin VAR_ADDRESS 0x8003A4C4 0x8003B2C4 0x8003C0C4 0x8003CEC4 0x8003DCC4 0x8003EAC4 0x8003F8C4 0x800406C4 0x800414C4 0x800422C4 0x800430C4 0x80043EC4 0x80044CC4 0x80045AC4 0x800468C4 0x800476C4 0x800484C4 0x800492C4 0x8004A0C4 0x8004AEC4 0x8004BCC4 0x8004CAC4 0x8004D8C4 0x8004E6C4 /end VAR_ADDRESS
 /end VAR_CHARACTERISTIC
 /begin VAR_CHARACTERISTIC TP_U8ETCSCpDelYawDivrgGain[0][1] EngCalVariantCriterion
  /begin VAR_ADDRESS 0x8003A4C5 0x8003B2C5 0x8003C0C5 0x8003CEC5 0x8003DCC5 0x8003EAC5 0x8003F8C5 0x800406C5 0x800414C5 0x800422C5 0x800430C5 0x80043EC5 0x80044CC5 0x80045AC5 0x800468C5 0x800476C5 0x800484C5 0x800492C5 0x8004A0C5 0x8004AEC5 0x8004BCC5 0x8004CAC5 0x8004D8C5 0x8004E6C5 /end VAR_ADDRESS
 /end VAR_CHARACTERISTIC
 /begin VAR_CHARACTERISTIC TP_U8ETCSCpDelYawDivrgGain[0][2] EngCalVariantCriterion
  /begin VAR_ADDRESS 0x8003A4C6 0x8003B2C6 0x8003C0C6 0x8003CEC6 0x8003DCC6 0x8003EAC6 0x8003F8C6 0x800406C6 0x800414C6 0x800422C6 0x800430C6 0x80043EC6 0x80044CC6 0x80045AC6 0x800468C6 0x800476C6 0x800484C6 0x800492C6 0x8004A0C6 0x8004AEC6 0x8004BCC6 0x8004CAC6 0x8004D8C6 0x8004E6C6 /end VAR_ADDRESS
 /end VAR_CHARACTERISTIC
 /begin VAR_CHARACTERISTIC TP_U8ETCSCpDelYawDivrgGain[0][3] EngCalVariantCriterion
  /begin VAR_ADDRESS 0x8003A4C7 0x8003B2C7 0x8003C0C7 0x8003CEC7 0x8003DCC7 0x8003EAC7 0x8003F8C7 0x800406C7 0x800414C7 0x800422C7 0x800430C7 0x80043EC7 0x80044CC7 0x80045AC7 0x800468C7 0x800476C7 0x800484C7 0x800492C7 0x8004A0C7 0x8004AEC7 0x8004BCC7 0x8004CAC7 0x8004D8C7 0x8004E6C7 /end VAR_ADDRESS
 /end VAR_CHARACTERISTIC
 /begin VAR_CHARACTERISTIC TP_U8ETCSCpDelYawDivrgGain[0][4] EngCalVariantCriterion
  /begin VAR_ADDRESS 0x8003A4C8 0x8003B2C8 0x8003C0C8 0x8003CEC8 0x8003DCC8 0x8003EAC8 0x8003F8C8 0x800406C8 0x800414C8 0x800422C8 0x800430C8 0x80043EC8 0x80044CC8 0x80045AC8 0x800468C8 0x800476C8 0x800484C8 0x800492C8 0x8004A0C8 0x8004AEC8 0x8004BCC8 0x8004CAC8 0x8004D8C8 0x8004E6C8 /end VAR_ADDRESS
 /end VAR_CHARACTERISTIC
 /begin VAR_CHARACTERISTIC TP_U8ETCSCpDelYawDivrgGain[1][0] EngCalVariantCriterion
  /begin VAR_ADDRESS 0x8003A4C9 0x8003B2C9 0x8003C0C9 0x8003CEC9 0x8003DCC9 0x8003EAC9 0x8003F8C9 0x800406C9 0x800414C9 0x800422C9 0x800430C9 0x80043EC9 0x80044CC9 0x80045AC9 0x800468C9 0x800476C9 0x800484C9 0x800492C9 0x8004A0C9 0x8004AEC9 0x8004BCC9 0x8004CAC9 0x8004D8C9 0x8004E6C9 /end VAR_ADDRESS
 /end VAR_CHARACTERISTIC
 /begin VAR_CHARACTERISTIC TP_U8ETCSCpDelYawDivrgGain[1][1] EngCalVariantCriterion
  /begin VAR_ADDRESS 0x8003A4CA 0x8003B2CA 0x8003C0CA 0x8003CECA 0x8003DCCA 0x8003EACA 0x8003F8CA 0x800406CA 0x800414CA 0x800422CA 0x800430CA 0x80043ECA 0x80044CCA 0x80045ACA 0x800468CA 0x800476CA 0x800484CA 0x800492CA 0x8004A0CA 0x8004AECA 0x8004BCCA 0x8004CACA 0x8004D8CA 0x8004E6CA /end VAR_ADDRESS
 /end VAR_CHARACTERISTIC
 /begin VAR_CHARACTERISTIC TP_U8ETCSCpDelYawDivrgGain[1][2] EngCalVariantCriterion
  /begin VAR_ADDRESS 0x8003A4CB 0x8003B2CB 0x8003C0CB 0x8003CECB 0x8003DCCB 0x8003EACB 0x8003F8CB 0x800406CB 0x800414CB 0x800422CB 0x800430CB 0x80043ECB 0x80044CCB 0x80045ACB 0x800468CB 0x800476CB 0x800484CB 0x800492CB 0x8004A0CB 0x8004AECB 0x8004BCCB 0x8004CACB 0x8004D8CB 0x8004E6CB /end VAR_ADDRESS
 /end VAR_CHARACTERISTIC
 /begin VAR_CHARACTERISTIC TP_U8ETCSCpDelYawDivrgGain[1][3] EngCalVariantCriterion
  /begin VAR_ADDRESS 0x8003A4CC 0x8003B2CC 0x8003C0CC 0x8003CECC 0x8003DCCC 0x8003EACC 0x8003F8CC 0x800406CC 0x800414CC 0x800422CC 0x800430CC 0x80043ECC 0x80044CCC 0x80045ACC 0x800468CC 0x800476CC 0x800484CC 0x800492CC 0x8004A0CC 0x8004AECC 0x8004BCCC 0x8004CACC 0x8004D8CC 0x8004E6CC /end VAR_ADDRESS
 /end VAR_CHARACTERISTIC
 /begin VAR_CHARACTERISTIC TP_U8ETCSCpDelYawDivrgGain[1][4] EngCalVariantCriterion
  /begin VAR_ADDRESS 0x8003A4CD 0x8003B2CD 0x8003C0CD 0x8003CECD 0x8003DCCD 0x8003EACD 0x8003F8CD 0x800406CD 0x800414CD 0x800422CD 0x800430CD 0x80043ECD 0x80044CCD 0x80045ACD 0x800468CD 0x800476CD 0x800484CD 0x800492CD 0x8004A0CD 0x8004AECD 0x8004BCCD 0x8004CACD 0x8004D8CD 0x8004E6CD /end VAR_ADDRESS
 /end VAR_CHARACTERISTIC
 /begin VAR_CHARACTERISTIC TP_U8ETCSCpDelYawDivrgGain[2][0] EngCalVariantCriterion
  /begin VAR_ADDRESS 0x8003A4CE 0x8003B2CE 0x8003C0CE 0x8003CECE 0x8003DCCE 0x8003EACE 0x8003F8CE 0x800406CE 0x800414CE 0x800422CE 0x800430CE 0x80043ECE 0x80044CCE 0x80045ACE 0x800468CE 0x800476CE 0x800484CE 0x800492CE 0x8004A0CE 0x8004AECE 0x8004BCCE 0x8004CACE 0x8004D8CE 0x8004E6CE /end VAR_ADDRESS
 /end VAR_CHARACTERISTIC
 /begin VAR_CHARACTERISTIC TP_U8ETCSCpDelYawDivrgGain[2][1] EngCalVariantCriterion
  /begin VAR_ADDRESS 0x8003A4CF 0x8003B2CF 0x8003C0CF 0x8003CECF 0x8003DCCF 0x8003EACF 0x8003F8CF 0x800406CF 0x800414CF 0x800422CF 0x800430CF 0x80043ECF 0x80044CCF 0x80045ACF 0x800468CF 0x800476CF 0x800484CF 0x800492CF 0x8004A0CF 0x8004AECF 0x8004BCCF 0x8004CACF 0x8004D8CF 0x8004E6CF /end VAR_ADDRESS
 /end VAR_CHARACTERISTIC
 /begin VAR_CHARACTERISTIC TP_U8ETCSCpDelYawDivrgGain[2][2] EngCalVariantCriterion
  /begin VAR_ADDRESS 0x8003A4D0 0x8003B2D0 0x8003C0D0 0x8003CED0 0x8003DCD0 0x8003EAD0 0x8003F8D0 0x800406D0 0x800414D0 0x800422D0 0x800430D0 0x80043ED0 0x80044CD0 0x80045AD0 0x800468D0 0x800476D0 0x800484D0 0x800492D0 0x8004A0D0 0x8004AED0 0x8004BCD0 0x8004CAD0 0x8004D8D0 0x8004E6D0 /end VAR_ADDRESS
 /end VAR_CHARACTERISTIC
 /begin VAR_CHARACTERISTIC TP_U8ETCSCpDelYawDivrgGain[2][3] EngCalVariantCriterion
  /begin VAR_ADDRESS 0x8003A4D1 0x8003B2D1 0x8003C0D1 0x8003CED1 0x8003DCD1 0x8003EAD1 0x8003F8D1 0x800406D1 0x800414D1 0x800422D1 0x800430D1 0x80043ED1 0x80044CD1 0x80045AD1 0x800468D1 0x800476D1 0x800484D1 0x800492D1 0x8004A0D1 0x8004AED1 0x8004BCD1 0x8004CAD1 0x8004D8D1 0x8004E6D1 /end VAR_ADDRESS
 /end VAR_CHARACTERISTIC
 /begin VAR_CHARACTERISTIC TP_U8ETCSCpDelYawDivrgGain[2][4] EngCalVariantCriterion
  /begin VAR_ADDRESS 0x8003A4D2 0x8003B2D2 0x8003C0D2 0x8003CED2 0x8003DCD2 0x8003EAD2 0x8003F8D2 0x800406D2 0x800414D2 0x800422D2 0x800430D2 0x80043ED2 0x80044CD2 0x80045AD2 0x800468D2 0x800476D2 0x800484D2 0x800492D2 0x8004A0D2 0x8004AED2 0x8004BCD2 0x8004CAD2 0x8004D8D2 0x8004E6D2 /end VAR_ADDRESS
 /end VAR_CHARACTERISTIC
 /begin VAR_CHARACTERISTIC TP_U8ETCSCpDelYawFstIncGain[0][0] EngCalVariantCriterion
  /begin VAR_ADDRESS 0x8003A4D3 0x8003B2D3 0x8003C0D3 0x8003CED3 0x8003DCD3 0x8003EAD3 0x8003F8D3 0x800406D3 0x800414D3 0x800422D3 0x800430D3 0x80043ED3 0x80044CD3 0x80045AD3 0x800468D3 0x800476D3 0x800484D3 0x800492D3 0x8004A0D3 0x8004AED3 0x8004BCD3 0x8004CAD3 0x8004D8D3 0x8004E6D3 /end VAR_ADDRESS
 /end VAR_CHARACTERISTIC
 /begin VAR_CHARACTERISTIC TP_U8ETCSCpDelYawFstIncGain[0][1] EngCalVariantCriterion
  /begin VAR_ADDRESS 0x8003A4D4 0x8003B2D4 0x8003C0D4 0x8003CED4 0x8003DCD4 0x8003EAD4 0x8003F8D4 0x800406D4 0x800414D4 0x800422D4 0x800430D4 0x80043ED4 0x80044CD4 0x80045AD4 0x800468D4 0x800476D4 0x800484D4 0x800492D4 0x8004A0D4 0x8004AED4 0x8004BCD4 0x8004CAD4 0x8004D8D4 0x8004E6D4 /end VAR_ADDRESS
 /end VAR_CHARACTERISTIC
 /begin VAR_CHARACTERISTIC TP_U8ETCSCpDelYawFstIncGain[0][2] EngCalVariantCriterion
  /begin VAR_ADDRESS 0x8003A4D5 0x8003B2D5 0x8003C0D5 0x8003CED5 0x8003DCD5 0x8003EAD5 0x8003F8D5 0x800406D5 0x800414D5 0x800422D5 0x800430D5 0x80043ED5 0x80044CD5 0x80045AD5 0x800468D5 0x800476D5 0x800484D5 0x800492D5 0x8004A0D5 0x8004AED5 0x8004BCD5 0x8004CAD5 0x8004D8D5 0x8004E6D5 /end VAR_ADDRESS
 /end VAR_CHARACTERISTIC
 /begin VAR_CHARACTERISTIC TP_U8ETCSCpDelYawFstIncGain[0][3] EngCalVariantCriterion
  /begin VAR_ADDRESS 0x8003A4D6 0x8003B2D6 0x8003C0D6 0x8003CED6 0x8003DCD6 0x8003EAD6 0x8003F8D6 0x800406D6 0x800414D6 0x800422D6 0x800430D6 0x80043ED6 0x80044CD6 0x80045AD6 0x800468D6 0x800476D6 0x800484D6 0x800492D6 0x8004A0D6 0x8004AED6 0x8004BCD6 0x8004CAD6 0x8004D8D6 0x8004E6D6 /end VAR_ADDRESS
 /end VAR_CHARACTERISTIC
 /begin VAR_CHARACTERISTIC TP_U8ETCSCpDelYawFstIncGain[0][4] EngCalVariantCriterion
  /begin VAR_ADDRESS 0x8003A4D7 0x8003B2D7 0x8003C0D7 0x8003CED7 0x8003DCD7 0x8003EAD7 0x8003F8D7 0x800406D7 0x800414D7 0x800422D7 0x800430D7 0x80043ED7 0x80044CD7 0x80045AD7 0x800468D7 0x800476D7 0x800484D7 0x800492D7 0x8004A0D7 0x8004AED7 0x8004BCD7 0x8004CAD7 0x8004D8D7 0x8004E6D7 /end VAR_ADDRESS
 /end VAR_CHARACTERISTIC
 /begin VAR_CHARACTERISTIC TP_U8ETCSCpDelYawFstIncGain[1][0] EngCalVariantCriterion
  /begin VAR_ADDRESS 0x8003A4D8 0x8003B2D8 0x8003C0D8 0x8003CED8 0x8003DCD8 0x8003EAD8 0x8003F8D8 0x800406D8 0x800414D8 0x800422D8 0x800430D8 0x80043ED8 0x80044CD8 0x80045AD8 0x800468D8 0x800476D8 0x800484D8 0x800492D8 0x8004A0D8 0x8004AED8 0x8004BCD8 0x8004CAD8 0x8004D8D8 0x8004E6D8 /end VAR_ADDRESS
 /end VAR_CHARACTERISTIC
 /begin VAR_CHARACTERISTIC TP_U8ETCSCpDelYawFstIncGain[1][1] EngCalVariantCriterion
  /begin VAR_ADDRESS 0x8003A4D9 0x8003B2D9 0x8003C0D9 0x8003CED9 0x8003DCD9 0x8003EAD9 0x8003F8D9 0x800406D9 0x800414D9 0x800422D9 0x800430D9 0x80043ED9 0x80044CD9 0x80045AD9 0x800468D9 0x800476D9 0x800484D9 0x800492D9 0x8004A0D9 0x8004AED9 0x8004BCD9 0x8004CAD9 0x8004D8D9 0x8004E6D9 /end VAR_ADDRESS
 /end VAR_CHARACTERISTIC
 /begin VAR_CHARACTERISTIC TP_U8ETCSCpDelYawFstIncGain[1][2] EngCalVariantCriterion
  /begin VAR_ADDRESS 0x8003A4DA 0x8003B2DA 0x8003C0DA 0x8003CEDA 0x8003DCDA 0x8003EADA 0x8003F8DA 0x800406DA 0x800414DA 0x800422DA 0x800430DA 0x80043EDA 0x80044CDA 0x80045ADA 0x800468DA 0x800476DA 0x800484DA 0x800492DA 0x8004A0DA 0x8004AEDA 0x8004BCDA 0x8004CADA 0x8004D8DA 0x8004E6DA /end VAR_ADDRESS
 /end VAR_CHARACTERISTIC
 /begin VAR_CHARACTERISTIC TP_U8ETCSCpDelYawFstIncGain[1][3] EngCalVariantCriterion
  /begin VAR_ADDRESS 0x8003A4DB 0x8003B2DB 0x8003C0DB 0x8003CEDB 0x8003DCDB 0x8003EADB 0x8003F8DB 0x800406DB 0x800414DB 0x800422DB 0x800430DB 0x80043EDB 0x80044CDB 0x80045ADB 0x800468DB 0x800476DB 0x800484DB 0x800492DB 0x8004A0DB 0x8004AEDB 0x8004BCDB 0x8004CADB 0x8004D8DB 0x8004E6DB /end VAR_ADDRESS
 /end VAR_CHARACTERISTIC
 /begin VAR_CHARACTERISTIC TP_U8ETCSCpDelYawFstIncGain[1][4] EngCalVariantCriterion
  /begin VAR_ADDRESS 0x8003A4DC 0x8003B2DC 0x8003C0DC 0x8003CEDC 0x8003DCDC 0x8003EADC 0x8003F8DC 0x800406DC 0x800414DC 0x800422DC 0x800430DC 0x80043EDC 0x80044CDC 0x80045ADC 0x800468DC 0x800476DC 0x800484DC 0x800492DC 0x8004A0DC 0x8004AEDC 0x8004BCDC 0x8004CADC 0x8004D8DC 0x8004E6DC /end VAR_ADDRESS
 /end VAR_CHARACTERISTIC
 /begin VAR_CHARACTERISTIC TP_U8ETCSCpDelYawFstIncGain[2][0] EngCalVariantCriterion
  /begin VAR_ADDRESS 0x8003A4DD 0x8003B2DD 0x8003C0DD 0x8003CEDD 0x8003DCDD 0x8003EADD 0x8003F8DD 0x800406DD 0x800414DD 0x800422DD 0x800430DD 0x80043EDD 0x80044CDD 0x80045ADD 0x800468DD 0x800476DD 0x800484DD 0x800492DD 0x8004A0DD 0x8004AEDD 0x8004BCDD 0x8004CADD 0x8004D8DD 0x8004E6DD /end VAR_ADDRESS
 /end VAR_CHARACTERISTIC
 /begin VAR_CHARACTERISTIC TP_U8ETCSCpDelYawFstIncGain[2][1] EngCalVariantCriterion
  /begin VAR_ADDRESS 0x8003A4DE 0x8003B2DE 0x8003C0DE 0x8003CEDE 0x8003DCDE 0x8003EADE 0x8003F8DE 0x800406DE 0x800414DE 0x800422DE 0x800430DE 0x80043EDE 0x80044CDE 0x80045ADE 0x800468DE 0x800476DE 0x800484DE 0x800492DE 0x8004A0DE 0x8004AEDE 0x8004BCDE 0x8004CADE 0x8004D8DE 0x8004E6DE /end VAR_ADDRESS
 /end VAR_CHARACTERISTIC
 /begin VAR_CHARACTERISTIC TP_U8ETCSCpDelYawFstIncGain[2][2] EngCalVariantCriterion
  /begin VAR_ADDRESS 0x8003A4DF 0x8003B2DF 0x8003C0DF 0x8003CEDF 0x8003DCDF 0x8003EADF 0x8003F8DF 0x800406DF 0x800414DF 0x800422DF 0x800430DF 0x80043EDF 0x80044CDF 0x80045ADF 0x800468DF 0x800476DF 0x800484DF 0x800492DF 0x8004A0DF 0x8004AEDF 0x8004BCDF 0x8004CADF 0x8004D8DF 0x8004E6DF /end VAR_ADDRESS
 /end VAR_CHARACTERISTIC
 /begin VAR_CHARACTERISTIC TP_U8ETCSCpDelYawFstIncGain[2][3] EngCalVariantCriterion
  /begin VAR_ADDRESS 0x8003A4E0 0x8003B2E0 0x8003C0E0 0x8003CEE0 0x8003DCE0 0x8003EAE0 0x8003F8E0 0x800406E0 0x800414E0 0x800422E0 0x800430E0 0x80043EE0 0x80044CE0 0x80045AE0 0x800468E0 0x800476E0 0x800484E0 0x800492E0 0x8004A0E0 0x8004AEE0 0x8004BCE0 0x8004CAE0 0x8004D8E0 0x8004E6E0 /end VAR_ADDRESS
 /end VAR_CHARACTERISTIC
 /begin VAR_CHARACTERISTIC TP_U8ETCSCpDelYawFstIncGain[2][4] EngCalVariantCriterion
  /begin VAR_ADDRESS 0x8003A4E1 0x8003B2E1 0x8003C0E1 0x8003CEE1 0x8003DCE1 0x8003EAE1 0x8003F8E1 0x800406E1 0x800414E1 0x800422E1 0x800430E1 0x80043EE1 0x80044CE1 0x80045AE1 0x800468E1 0x800476E1 0x800484E1 0x800492E1 0x8004A0E1 0x8004AEE1 0x8004BCE1 0x8004CAE1 0x8004D8E1 0x8004E6E1 /end VAR_ADDRESS
 /end VAR_CHARACTERISTIC
 /begin VAR_CHARACTERISTIC TP_U8ETCSCpDelYawLowTrqGain[0] EngCalVariantCriterion
  /begin VAR_ADDRESS 0x8003A4E2 0x8003B2E2 0x8003C0E2 0x8003CEE2 0x8003DCE2 0x8003EAE2 0x8003F8E2 0x800406E2 0x800414E2 0x800422E2 0x800430E2 0x80043EE2 0x80044CE2 0x80045AE2 0x800468E2 0x800476E2 0x800484E2 0x800492E2 0x8004A0E2 0x8004AEE2 0x8004BCE2 0x8004CAE2 0x8004D8E2 0x8004E6E2 /end VAR_ADDRESS
 /end VAR_CHARACTERISTIC
 /begin VAR_CHARACTERISTIC TP_U8ETCSCpDelYawLowTrqGain[1] EngCalVariantCriterion
  /begin VAR_ADDRESS 0x8003A4E3 0x8003B2E3 0x8003C0E3 0x8003CEE3 0x8003DCE3 0x8003EAE3 0x8003F8E3 0x800406E3 0x800414E3 0x800422E3 0x800430E3 0x80043EE3 0x80044CE3 0x80045AE3 0x800468E3 0x800476E3 0x800484E3 0x800492E3 0x8004A0E3 0x8004AEE3 0x8004BCE3 0x8004CAE3 0x8004D8E3 0x8004E6E3 /end VAR_ADDRESS
 /end VAR_CHARACTERISTIC
 /begin VAR_CHARACTERISTIC TP_U8ETCSCpDelYawLowTrqGain[2] EngCalVariantCriterion
  /begin VAR_ADDRESS 0x8003A4E4 0x8003B2E4 0x8003C0E4 0x8003CEE4 0x8003DCE4 0x8003EAE4 0x8003F8E4 0x800406E4 0x800414E4 0x800422E4 0x800430E4 0x80043EE4 0x80044CE4 0x80045AE4 0x800468E4 0x800476E4 0x800484E4 0x800492E4 0x8004A0E4 0x8004AEE4 0x8004BCE4 0x8004CAE4 0x8004D8E4 0x8004E6E4 /end VAR_ADDRESS
 /end VAR_CHARACTERISTIC
 /begin VAR_CHARACTERISTIC TP_U8ETCSCpDelYawSlwIncGain[0][0] EngCalVariantCriterion
  /begin VAR_ADDRESS 0x8003A4E5 0x8003B2E5 0x8003C0E5 0x8003CEE5 0x8003DCE5 0x8003EAE5 0x8003F8E5 0x800406E5 0x800414E5 0x800422E5 0x800430E5 0x80043EE5 0x80044CE5 0x80045AE5 0x800468E5 0x800476E5 0x800484E5 0x800492E5 0x8004A0E5 0x8004AEE5 0x8004BCE5 0x8004CAE5 0x8004D8E5 0x8004E6E5 /end VAR_ADDRESS
 /end VAR_CHARACTERISTIC
 /begin VAR_CHARACTERISTIC TP_U8ETCSCpDelYawSlwIncGain[0][1] EngCalVariantCriterion
  /begin VAR_ADDRESS 0x8003A4E6 0x8003B2E6 0x8003C0E6 0x8003CEE6 0x8003DCE6 0x8003EAE6 0x8003F8E6 0x800406E6 0x800414E6 0x800422E6 0x800430E6 0x80043EE6 0x80044CE6 0x80045AE6 0x800468E6 0x800476E6 0x800484E6 0x800492E6 0x8004A0E6 0x8004AEE6 0x8004BCE6 0x8004CAE6 0x8004D8E6 0x8004E6E6 /end VAR_ADDRESS
 /end VAR_CHARACTERISTIC
 /begin VAR_CHARACTERISTIC TP_U8ETCSCpDelYawSlwIncGain[0][2] EngCalVariantCriterion
  /begin VAR_ADDRESS 0x8003A4E7 0x8003B2E7 0x8003C0E7 0x8003CEE7 0x8003DCE7 0x8003EAE7 0x8003F8E7 0x800406E7 0x800414E7 0x800422E7 0x800430E7 0x80043EE7 0x80044CE7 0x80045AE7 0x800468E7 0x800476E7 0x800484E7 0x800492E7 0x8004A0E7 0x8004AEE7 0x8004BCE7 0x8004CAE7 0x8004D8E7 0x8004E6E7 /end VAR_ADDRESS
 /end VAR_CHARACTERISTIC
 /begin VAR_CHARACTERISTIC TP_U8ETCSCpDelYawSlwIncGain[0][3] EngCalVariantCriterion
  /begin VAR_ADDRESS 0x8003A4E8 0x8003B2E8 0x8003C0E8 0x8003CEE8 0x8003DCE8 0x8003EAE8 0x8003F8E8 0x800406E8 0x800414E8 0x800422E8 0x800430E8 0x80043EE8 0x80044CE8 0x80045AE8 0x800468E8 0x800476E8 0x800484E8 0x800492E8 0x8004A0E8 0x8004AEE8 0x8004BCE8 0x8004CAE8 0x8004D8E8 0x8004E6E8 /end VAR_ADDRESS
 /end VAR_CHARACTERISTIC
 /begin VAR_CHARACTERISTIC TP_U8ETCSCpDelYawSlwIncGain[0][4] EngCalVariantCriterion
  /begin VAR_ADDRESS 0x8003A4E9 0x8003B2E9 0x8003C0E9 0x8003CEE9 0x8003DCE9 0x8003EAE9 0x8003F8E9 0x800406E9 0x800414E9 0x800422E9 0x800430E9 0x80043EE9 0x80044CE9 0x80045AE9 0x800468E9 0x800476E9 0x800484E9 0x800492E9 0x8004A0E9 0x8004AEE9 0x8004BCE9 0x8004CAE9 0x8004D8E9 0x8004E6E9 /end VAR_ADDRESS
 /end VAR_CHARACTERISTIC
 /begin VAR_CHARACTERISTIC TP_U8ETCSCpDelYawSlwIncGain[1][0] EngCalVariantCriterion
  /begin VAR_ADDRESS 0x8003A4EA 0x8003B2EA 0x8003C0EA 0x8003CEEA 0x8003DCEA 0x8003EAEA 0x8003F8EA 0x800406EA 0x800414EA 0x800422EA 0x800430EA 0x80043EEA 0x80044CEA 0x80045AEA 0x800468EA 0x800476EA 0x800484EA 0x800492EA 0x8004A0EA 0x8004AEEA 0x8004BCEA 0x8004CAEA 0x8004D8EA 0x8004E6EA /end VAR_ADDRESS
 /end VAR_CHARACTERISTIC
 /begin VAR_CHARACTERISTIC TP_U8ETCSCpDelYawSlwIncGain[1][1] EngCalVariantCriterion
  /begin VAR_ADDRESS 0x8003A4EB 0x8003B2EB 0x8003C0EB 0x8003CEEB 0x8003DCEB 0x8003EAEB 0x8003F8EB 0x800406EB 0x800414EB 0x800422EB 0x800430EB 0x80043EEB 0x80044CEB 0x80045AEB 0x800468EB 0x800476EB 0x800484EB 0x800492EB 0x8004A0EB 0x8004AEEB 0x8004BCEB 0x8004CAEB 0x8004D8EB 0x8004E6EB /end VAR_ADDRESS
 /end VAR_CHARACTERISTIC
 /begin VAR_CHARACTERISTIC TP_U8ETCSCpDelYawSlwIncGain[1][2] EngCalVariantCriterion
  /begin VAR_ADDRESS 0x8003A4EC 0x8003B2EC 0x8003C0EC 0x8003CEEC 0x8003DCEC 0x8003EAEC 0x8003F8EC 0x800406EC 0x800414EC 0x800422EC 0x800430EC 0x80043EEC 0x80044CEC 0x80045AEC 0x800468EC 0x800476EC 0x800484EC 0x800492EC 0x8004A0EC 0x8004AEEC 0x8004BCEC 0x8004CAEC 0x8004D8EC 0x8004E6EC /end VAR_ADDRESS
 /end VAR_CHARACTERISTIC
 /begin VAR_CHARACTERISTIC TP_U8ETCSCpDelYawSlwIncGain[1][3] EngCalVariantCriterion
  /begin VAR_ADDRESS 0x8003A4ED 0x8003B2ED 0x8003C0ED 0x8003CEED 0x8003DCED 0x8003EAED 0x8003F8ED 0x800406ED 0x800414ED 0x800422ED 0x800430ED 0x80043EED 0x80044CED 0x80045AED 0x800468ED 0x800476ED 0x800484ED 0x800492ED 0x8004A0ED 0x8004AEED 0x8004BCED 0x8004CAED 0x8004D8ED 0x8004E6ED /end VAR_ADDRESS
 /end VAR_CHARACTERISTIC
 /begin VAR_CHARACTERISTIC TP_U8ETCSCpDelYawSlwIncGain[1][4] EngCalVariantCriterion
  /begin VAR_ADDRESS 0x8003A4EE 0x8003B2EE 0x8003C0EE 0x8003CEEE 0x8003DCEE 0x8003EAEE 0x8003F8EE 0x800406EE 0x800414EE 0x800422EE 0x800430EE 0x80043EEE 0x80044CEE 0x80045AEE 0x800468EE 0x800476EE 0x800484EE 0x800492EE 0x8004A0EE 0x8004AEEE 0x8004BCEE 0x8004CAEE 0x8004D8EE 0x8004E6EE /end VAR_ADDRESS
 /end VAR_CHARACTERISTIC
 /begin VAR_CHARACTERISTIC TP_U8ETCSCpDelYawSlwIncGain[2][0] EngCalVariantCriterion
  /begin VAR_ADDRESS 0x8003A4EF 0x8003B2EF 0x8003C0EF 0x8003CEEF 0x8003DCEF 0x8003EAEF 0x8003F8EF 0x800406EF 0x800414EF 0x800422EF 0x800430EF 0x80043EEF 0x80044CEF 0x80045AEF 0x800468EF 0x800476EF 0x800484EF 0x800492EF 0x8004A0EF 0x8004AEEF 0x8004BCEF 0x8004CAEF 0x8004D8EF 0x8004E6EF /end VAR_ADDRESS
 /end VAR_CHARACTERISTIC
 /begin VAR_CHARACTERISTIC TP_U8ETCSCpDelYawSlwIncGain[2][1] EngCalVariantCriterion
  /begin VAR_ADDRESS 0x8003A4F0 0x8003B2F0 0x8003C0F0 0x8003CEF0 0x8003DCF0 0x8003EAF0 0x8003F8F0 0x800406F0 0x800414F0 0x800422F0 0x800430F0 0x80043EF0 0x80044CF0 0x80045AF0 0x800468F0 0x800476F0 0x800484F0 0x800492F0 0x8004A0F0 0x8004AEF0 0x8004BCF0 0x8004CAF0 0x8004D8F0 0x8004E6F0 /end VAR_ADDRESS
 /end VAR_CHARACTERISTIC
 /begin VAR_CHARACTERISTIC TP_U8ETCSCpDelYawSlwIncGain[2][2] EngCalVariantCriterion
  /begin VAR_ADDRESS 0x8003A4F1 0x8003B2F1 0x8003C0F1 0x8003CEF1 0x8003DCF1 0x8003EAF1 0x8003F8F1 0x800406F1 0x800414F1 0x800422F1 0x800430F1 0x80043EF1 0x80044CF1 0x80045AF1 0x800468F1 0x800476F1 0x800484F1 0x800492F1 0x8004A0F1 0x8004AEF1 0x8004BCF1 0x8004CAF1 0x8004D8F1 0x8004E6F1 /end VAR_ADDRESS
 /end VAR_CHARACTERISTIC
 /begin VAR_CHARACTERISTIC TP_U8ETCSCpDelYawSlwIncGain[2][3] EngCalVariantCriterion
  /begin VAR_ADDRESS 0x8003A4F2 0x8003B2F2 0x8003C0F2 0x8003CEF2 0x8003DCF2 0x8003EAF2 0x8003F8F2 0x800406F2 0x800414F2 0x800422F2 0x800430F2 0x80043EF2 0x80044CF2 0x80045AF2 0x800468F2 0x800476F2 0x800484F2 0x800492F2 0x8004A0F2 0x8004AEF2 0x8004BCF2 0x8004CAF2 0x8004D8F2 0x8004E6F2 /end VAR_ADDRESS
 /end VAR_CHARACTERISTIC
 /begin VAR_CHARACTERISTIC TP_U8ETCSCpDelYawSlwIncGain[2][4] EngCalVariantCriterion
  /begin VAR_ADDRESS 0x8003A4F3 0x8003B2F3 0x8003C0F3 0x8003CEF3 0x8003DCF3 0x8003EAF3 0x8003F8F3 0x800406F3 0x800414F3 0x800422F3 0x800430F3 0x80043EF3 0x80044CF3 0x80045AF3 0x800468F3 0x800476F3 0x800484F3 0x800492F3 0x8004A0F3 0x8004AEF3 0x8004BCF3 0x8004CAF3 0x8004D8F3 0x8004E6F3 /end VAR_ADDRESS
 /end VAR_CHARACTERISTIC
 /begin VAR_CHARACTERISTIC TP_U8ETCSCpDelYawTransVal EngCalVariantCriterion
  /begin VAR_ADDRESS 0x8003A4F4 0x8003B2F4 0x8003C0F4 0x8003CEF4 0x8003DCF4 0x8003EAF4 0x8003F8F4 0x800406F4 0x800414F4 0x800422F4 0x800430F4 0x80043EF4 0x80044CF4 0x80045AF4 0x800468F4 0x800476F4 0x800484F4 0x800492F4 0x8004A0F4 0x8004AEF4 0x8004BCF4 0x8004CAF4 0x8004D8F4 0x8004E6F4 /end VAR_ADDRESS
 /end VAR_CHARACTERISTIC
 /begin VAR_CHARACTERISTIC TP_U8ETCSCpDetDepSnwHilCnt EngCalVariantCriterion
  /begin VAR_ADDRESS 0x8003A4F5 0x8003B2F5 0x8003C0F5 0x8003CEF5 0x8003DCF5 0x8003EAF5 0x8003F8F5 0x800406F5 0x800414F5 0x800422F5 0x800430F5 0x80043EF5 0x80044CF5 0x80045AF5 0x800468F5 0x800476F5 0x800484F5 0x800492F5 0x8004A0F5 0x8004AEF5 0x8004BCF5 0x8004CAF5 0x8004D8F5 0x8004E6F5 /end VAR_ADDRESS
 /end VAR_CHARACTERISTIC
 /begin VAR_CHARACTERISTIC TP_U8ETCSCpDltYawOffset4MinTrgtSpn EngCalVariantCriterion
  /begin VAR_ADDRESS 0x8003A4F6 0x8003B2F6 0x8003C0F6 0x8003CEF6 0x8003DCF6 0x8003EAF6 0x8003F8F6 0x800406F6 0x800414F6 0x800422F6 0x800430F6 0x80043EF6 0x80044CF6 0x80045AF6 0x800468F6 0x800476F6 0x800484F6 0x800492F6 0x8004A0F6 0x8004AEF6 0x8004BCF6 0x8004CAF6 0x8004D8F6 0x8004E6F6 /end VAR_ADDRESS
 /end VAR_CHARACTERISTIC
 /begin VAR_CHARACTERISTIC TP_U8ETCSCpDltYawStbDctCnt EngCalVariantCriterion
  /begin VAR_ADDRESS 0x8003A4F7 0x8003B2F7 0x8003C0F7 0x8003CEF7 0x8003DCF7 0x8003EAF7 0x8003F8F7 0x800406F7 0x800414F7 0x800422F7 0x800430F7 0x80043EF7 0x80044CF7 0x80045AF7 0x800468F7 0x800476F7 0x800484F7 0x800492F7 0x8004A0F7 0x8004AEF7 0x8004BCF7 0x8004CAF7 0x8004D8F7 0x8004E6F7 /end VAR_ADDRESS
 /end VAR_CHARACTERISTIC
 /begin VAR_CHARACTERISTIC TP_U8ETCSCpEngAvail EngCalVariantCriterion
  /begin VAR_ADDRESS 0x8003A4F8 0x8003B2F8 0x8003C0F8 0x8003CEF8 0x8003DCF8 0x8003EAF8 0x8003F8F8 0x800406F8 0x800414F8 0x800422F8 0x800430F8 0x80043EF8 0x80044CF8 0x80045AF8 0x800468F8 0x800476F8 0x800484F8 0x800492F8 0x8004A0F8 0x8004AEF8 0x8004BCF8 0x8004CAF8 0x8004D8F8 0x8004E6F8 /end VAR_ADDRESS
 /end VAR_CHARACTERISTIC
 /begin VAR_CHARACTERISTIC TP_U8ETCSCpEngStallRpmOffset EngCalVariantCriterion
  /begin VAR_ADDRESS 0x8003A4F9 0x8003B2F9 0x8003C0F9 0x8003CEF9 0x8003DCF9 0x8003EAF9 0x8003F8F9 0x800406F9 0x800414F9 0x800422F9 0x800430F9 0x80043EF9 0x80044CF9 0x80045AF9 0x800468F9 0x800476F9 0x800484F9 0x800492F9 0x8004A0F9 0x8004AEF9 0x8004BCF9 0x8004CAF9 0x8004D8F9 0x8004E6F9 /end VAR_ADDRESS
 /end VAR_CHARACTERISTIC
 /begin VAR_CHARACTERISTIC TP_U8ETCSCpEngTrqFltGainCmdDec EngCalVariantCriterion
  /begin VAR_ADDRESS 0x8003A4FA 0x8003B2FA 0x8003C0FA 0x8003CEFA 0x8003DCFA 0x8003EAFA 0x8003F8FA 0x800406FA 0x800414FA 0x800422FA 0x800430FA 0x80043EFA 0x80044CFA 0x80045AFA 0x800468FA 0x800476FA 0x800484FA 0x800492FA 0x8004A0FA 0x8004AEFA 0x8004BCFA 0x8004CAFA 0x8004D8FA 0x8004E6FA /end VAR_ADDRESS
 /end VAR_CHARACTERISTIC
 /begin VAR_CHARACTERISTIC TP_U8ETCSCpEngTrqFltGainCmdInc EngCalVariantCriterion
  /begin VAR_ADDRESS 0x8003A4FB 0x8003B2FB 0x8003C0FB 0x8003CEFB 0x8003DCFB 0x8003EAFB 0x8003F8FB 0x800406FB 0x800414FB 0x800422FB 0x800430FB 0x80043EFB 0x80044CFB 0x80045AFB 0x800468FB 0x800476FB 0x800484FB 0x800492FB 0x8004A0FB 0x8004AEFB 0x8004BCFB 0x8004CAFB 0x8004D8FB 0x8004E6FB /end VAR_ADDRESS
 /end VAR_CHARACTERISTIC
 /begin VAR_CHARACTERISTIC TP_U8ETCSCpFtr4JmpDnMax EngCalVariantCriterion
  /begin VAR_ADDRESS 0x8003A4FC 0x8003B2FC 0x8003C0FC 0x8003CEFC 0x8003DCFC 0x8003EAFC 0x8003F8FC 0x800406FC 0x800414FC 0x800422FC 0x800430FC 0x80043EFC 0x80044CFC 0x80045AFC 0x800468FC 0x800476FC 0x800484FC 0x800492FC 0x8004A0FC 0x8004AEFC 0x8004BCFC 0x8004CAFC 0x8004D8FC 0x8004E6FC /end VAR_ADDRESS
 /end VAR_CHARACTERISTIC
 /begin VAR_CHARACTERISTIC TP_U8ETCSCpFtr4JmpDnMin EngCalVariantCriterion
  /begin VAR_ADDRESS 0x8003A4FD 0x8003B2FD 0x8003C0FD 0x8003CEFD 0x8003DCFD 0x8003EAFD 0x8003F8FD 0x800406FD 0x800414FD 0x800422FD 0x800430FD 0x80043EFD 0x80044CFD 0x80045AFD 0x800468FD 0x800476FD 0x800484FD 0x800492FD 0x8004A0FD 0x8004AEFD 0x8004BCFD 0x8004CAFD 0x8004D8FD 0x8004E6FD /end VAR_ADDRESS
 /end VAR_CHARACTERISTIC
 /begin VAR_CHARACTERISTIC TP_U8ETCSCpFtr4JmpUpMax EngCalVariantCriterion
  /begin VAR_ADDRESS 0x8003A4FE 0x8003B2FE 0x8003C0FE 0x8003CEFE 0x8003DCFE 0x8003EAFE 0x8003F8FE 0x800406FE 0x800414FE 0x800422FE 0x800430FE 0x80043EFE 0x80044CFE 0x80045AFE 0x800468FE 0x800476FE 0x800484FE 0x800492FE 0x8004A0FE 0x8004AEFE 0x8004BCFE 0x8004CAFE 0x8004D8FE 0x8004E6FE /end VAR_ADDRESS
 /end VAR_CHARACTERISTIC
 /begin VAR_CHARACTERISTIC TP_U8ETCSCpFtr4JmpUpMin EngCalVariantCriterion
  /begin VAR_ADDRESS 0x8003A4FF 0x8003B2FF 0x8003C0FF 0x8003CEFF 0x8003DCFF 0x8003EAFF 0x8003F8FF 0x800406FF 0x800414FF 0x800422FF 0x800430FF 0x80043EFF 0x80044CFF 0x80045AFF 0x800468FF 0x800476FF 0x800484FF 0x800492FF 0x8004A0FF 0x8004AEFF 0x8004BCFF 0x8004CAFF 0x8004D8FF 0x8004E6FF /end VAR_ADDRESS
 /end VAR_CHARACTERISTIC
 /begin VAR_CHARACTERISTIC TP_U8ETCSCpFtr4JmpUpSpnAcclMax EngCalVariantCriterion
  /begin VAR_ADDRESS 0x8003A500 0x8003B300 0x8003C100 0x8003CF00 0x8003DD00 0x8003EB00 0x8003F900 0x80040700 0x80041500 0x80042300 0x80043100 0x80043F00 0x80044D00 0x80045B00 0x80046900 0x80047700 0x80048500 0x80049300 0x8004A100 0x8004AF00 0x8004BD00 0x8004CB00 0x8004D900 0x8004E700 /end VAR_ADDRESS
 /end VAR_CHARACTERISTIC
 /begin VAR_CHARACTERISTIC TP_U8ETCSCpFtr4JmpUpSpnAcclMin EngCalVariantCriterion
  /begin VAR_ADDRESS 0x8003A501 0x8003B301 0x8003C101 0x8003CF01 0x8003DD01 0x8003EB01 0x8003F901 0x80040701 0x80041501 0x80042301 0x80043101 0x80043F01 0x80044D01 0x80045B01 0x80046901 0x80047701 0x80048501 0x80049301 0x8004A101 0x8004AF01 0x8004BD01 0x8004CB01 0x8004D901 0x8004E701 /end VAR_ADDRESS
 /end VAR_CHARACTERISTIC
 /begin VAR_CHARACTERISTIC TP_U8ETCSCpFtr4RefTrqAt2ndCylStrt EngCalVariantCriterion
  /begin VAR_ADDRESS 0x8003A502 0x8003B302 0x8003C102 0x8003CF02 0x8003DD02 0x8003EB02 0x8003F902 0x80040702 0x80041502 0x80042302 0x80043102 0x80043F02 0x80044D02 0x80045B02 0x80046902 0x80047702 0x80048502 0x80049302 0x8004A102 0x8004AF02 0x8004BD02 0x8004CB02 0x8004D902 0x8004E702 /end VAR_ADDRESS
 /end VAR_CHARACTERISTIC
 /begin VAR_CHARACTERISTIC TP_U8ETCSCpFtr4RefTrqAtVcaOfCtl EngCalVariantCriterion
  /begin VAR_ADDRESS 0x8003A504 0x8003B304 0x8003C104 0x8003CF04 0x8003DD04 0x8003EB04 0x8003F904 0x80040704 0x80041504 0x80042304 0x80043104 0x80043F04 0x80044D04 0x80045B04 0x80046904 0x80047704 0x80048504 0x80049304 0x8004A104 0x8004AF04 0x8004BD04 0x8004CB04 0x8004D904 0x8004E704 /end VAR_ADDRESS
 /end VAR_CHARACTERISTIC
 /begin VAR_CHARACTERISTIC TP_U8ETCSCpFtr4RefTrqLmg2ndCylStrt EngCalVariantCriterion
  /begin VAR_ADDRESS 0x8003A506 0x8003B306 0x8003C106 0x8003CF06 0x8003DD06 0x8003EB06 0x8003F906 0x80040706 0x80041506 0x80042306 0x80043106 0x80043F06 0x80044D06 0x80045B06 0x80046906 0x80047706 0x80048506 0x80049306 0x8004A106 0x8004AF06 0x8004BD06 0x8004CB06 0x8004D906 0x8004E706 /end VAR_ADDRESS
 /end VAR_CHARACTERISTIC
 /begin VAR_CHARACTERISTIC TP_U8ETCSCpFunLampOffCnt EngCalVariantCriterion
  /begin VAR_ADDRESS 0x8003A507 0x8003B307 0x8003C107 0x8003CF07 0x8003DD07 0x8003EB07 0x8003F907 0x80040707 0x80041507 0x80042307 0x80043107 0x80043F07 0x80044D07 0x80045B07 0x80046907 0x80047707 0x80048507 0x80049307 0x8004A107 0x8004AF07 0x8004BD07 0x8004CB07 0x8004D907 0x8004E707 /end VAR_ADDRESS
 /end VAR_CHARACTERISTIC
 /begin VAR_CHARACTERISTIC TP_U8ETCSCpGainFacTransTme EngCalVariantCriterion
  /begin VAR_ADDRESS 0x8003A508 0x8003B308 0x8003C108 0x8003CF08 0x8003DD08 0x8003EB08 0x8003F908 0x80040708 0x80041508 0x80042308 0x80043108 0x80043F08 0x80044D08 0x80045B08 0x80046908 0x80047708 0x80048508 0x80049308 0x8004A108 0x8004AF08 0x8004BD08 0x8004CB08 0x8004D908 0x8004E708 /end VAR_ADDRESS
 /end VAR_CHARACTERISTIC
 /begin VAR_CHARACTERISTIC TP_U8ETCSCpGrHoldingTme EngCalVariantCriterion
  /begin VAR_ADDRESS 0x8003A50D 0x8003B30D 0x8003C10D 0x8003CF0D 0x8003DD0D 0x8003EB0D 0x8003F90D 0x8004070D 0x8004150D 0x8004230D 0x8004310D 0x80043F0D 0x80044D0D 0x80045B0D 0x8004690D 0x8004770D 0x8004850D 0x8004930D 0x8004A10D 0x8004AF0D 0x8004BD0D 0x8004CB0D 0x8004D90D 0x8004E70D /end VAR_ADDRESS
 /end VAR_CHARACTERISTIC
 /begin VAR_CHARACTERISTIC TP_U8ETCSCpGrRtErrThr_ABS EngCalVariantCriterion
  /begin VAR_ADDRESS 0x8003A50E 0x8003B30E 0x8003C10E 0x8003CF0E 0x8003DD0E 0x8003EB0E 0x8003F90E 0x8004070E 0x8004150E 0x8004230E 0x8004310E 0x80043F0E 0x80044D0E 0x80045B0E 0x8004690E 0x8004770E 0x8004850E 0x8004930E 0x8004A10E 0x8004AF0E 0x8004BD0E 0x8004CB0E 0x8004D90E 0x8004E70E /end VAR_ADDRESS
 /end VAR_CHARACTERISTIC
 /begin VAR_CHARACTERISTIC TP_U8ETCSCpGrRtErrThr_Cstng EngCalVariantCriterion
  /begin VAR_ADDRESS 0x8003A50F 0x8003B30F 0x8003C10F 0x8003CF0F 0x8003DD0F 0x8003EB0F 0x8003F90F 0x8004070F 0x8004150F 0x8004230F 0x8004310F 0x80043F0F 0x80044D0F 0x80045B0F 0x8004690F 0x8004770F 0x8004850F 0x8004930F 0x8004A10F 0x8004AF0F 0x8004BD0F 0x8004CB0F 0x8004D90F 0x8004E70F /end VAR_ADDRESS
 /end VAR_CHARACTERISTIC
 /begin VAR_CHARACTERISTIC TP_U8ETCSCpGrRtErrThr_Shftng EngCalVariantCriterion
  /begin VAR_ADDRESS 0x8003A510 0x8003B310 0x8003C110 0x8003CF10 0x8003DD10 0x8003EB10 0x8003F910 0x80040710 0x80041510 0x80042310 0x80043110 0x80043F10 0x80044D10 0x80045B10 0x80046910 0x80047710 0x80048510 0x80049310 0x8004A110 0x8004AF10 0x8004BD10 0x8004CB10 0x8004D910 0x8004E710 /end VAR_ADDRESS
 /end VAR_CHARACTERISTIC
 /begin VAR_CHARACTERISTIC TP_U8ETCSCpGrRtErrThr_Smth EngCalVariantCriterion
  /begin VAR_ADDRESS 0x8003A511 0x8003B311 0x8003C111 0x8003CF11 0x8003DD11 0x8003EB11 0x8003F911 0x80040711 0x80041511 0x80042311 0x80043111 0x80043F11 0x80044D11 0x80045B11 0x80046911 0x80047711 0x80048511 0x80049311 0x8004A111 0x8004AF11 0x8004BD11 0x8004CB11 0x8004D911 0x8004E711 /end VAR_ADDRESS
 /end VAR_CHARACTERISTIC
 /begin VAR_CHARACTERISTIC TP_U8ETCSCpGrRtErrThr_Spin_HghLmt EngCalVariantCriterion
  /begin VAR_ADDRESS 0x8003A512 0x8003B312 0x8003C112 0x8003CF12 0x8003DD12 0x8003EB12 0x8003F912 0x80040712 0x80041512 0x80042312 0x80043112 0x80043F12 0x80044D12 0x80045B12 0x80046912 0x80047712 0x80048512 0x80049312 0x8004A112 0x8004AF12 0x8004BD12 0x8004CB12 0x8004D912 0x8004E712 /end VAR_ADDRESS
 /end VAR_CHARACTERISTIC
 /begin VAR_CHARACTERISTIC TP_U8ETCSCpGrRtErrThr_Spin_LowLmt EngCalVariantCriterion
  /begin VAR_ADDRESS 0x8003A513 0x8003B313 0x8003C113 0x8003CF13 0x8003DD13 0x8003EB13 0x8003F913 0x80040713 0x80041513 0x80042313 0x80043113 0x80043F13 0x80044D13 0x80045B13 0x80046913 0x80047713 0x80048513 0x80049313 0x8004A113 0x8004AF13 0x8004BD13 0x8004CB13 0x8004D913 0x8004E713 /end VAR_ADDRESS
 /end VAR_CHARACTERISTIC
 /begin VAR_CHARACTERISTIC TP_U8ETCSCpGrRtErrThr_Trctn EngCalVariantCriterion
  /begin VAR_ADDRESS 0x8003A514 0x8003B314 0x8003C114 0x8003CF14 0x8003DD14 0x8003EB14 0x8003F914 0x80040714 0x80041514 0x80042314 0x80043114 0x80043F14 0x80044D14 0x80045B14 0x80046914 0x80047714 0x80048514 0x80049314 0x8004A114 0x8004AF14 0x8004BD14 0x8004CB14 0x8004D914 0x8004E714 /end VAR_ADDRESS
 /end VAR_CHARACTERISTIC
 /begin VAR_CHARACTERISTIC TP_U8ETCSCpGrTransTme EngCalVariantCriterion
  /begin VAR_ADDRESS 0x8003A515 0x8003B315 0x8003C115 0x8003CF15 0x8003DD15 0x8003EB15 0x8003F915 0x80040715 0x80041515 0x80042315 0x80043115 0x80043F15 0x80044D15 0x80045B15 0x80046915 0x80047715 0x80048515 0x80049315 0x8004A115 0x8004AF15 0x8004BD15 0x8004CB15 0x8004D915 0x8004E715 /end VAR_ADDRESS
 /end VAR_CHARACTERISTIC
 /begin VAR_CHARACTERISTIC TP_U8ETCSCpGradientTrstCplCnt EngCalVariantCriterion
  /begin VAR_ADDRESS 0x8003A509 0x8003B309 0x8003C109 0x8003CF09 0x8003DD09 0x8003EB09 0x8003F909 0x80040709 0x80041509 0x80042309 0x80043109 0x80043F09 0x80044D09 0x80045B09 0x80046909 0x80047709 0x80048509 0x80049309 0x8004A109 0x8004AF09 0x8004BD09 0x8004CB09 0x8004D909 0x8004E709 /end VAR_ADDRESS
 /end VAR_CHARACTERISTIC
 /begin VAR_CHARACTERISTIC TP_U8ETCSCpGradientTrstStCnt EngCalVariantCriterion
  /begin VAR_ADDRESS 0x8003A50A 0x8003B30A 0x8003C10A 0x8003CF0A 0x8003DD0A 0x8003EB0A 0x8003F90A 0x8004070A 0x8004150A 0x8004230A 0x8004310A 0x80043F0A 0x80044D0A 0x80045B0A 0x8004690A 0x8004770A 0x8004850A 0x8004930A 0x8004A10A 0x8004AF0A 0x8004BD0A 0x8004CB0A 0x8004D90A 0x8004E70A /end VAR_ADDRESS
 /end VAR_CHARACTERISTIC
 /begin VAR_CHARACTERISTIC TP_U8ETCSCpGrdLdTrqChngFac EngCalVariantCriterion
  /begin VAR_ADDRESS 0x8003A50B 0x8003B30B 0x8003C10B 0x8003CF0B 0x8003DD0B 0x8003EB0B 0x8003F90B 0x8004070B 0x8004150B 0x8004230B 0x8004310B 0x80043F0B 0x80044D0B 0x80045B0B 0x8004690B 0x8004770B 0x8004850B 0x8004930B 0x8004A10B 0x8004AF0B 0x8004BD0B 0x8004CB0B 0x8004D90B 0x8004E70B /end VAR_ADDRESS
 /end VAR_CHARACTERISTIC
 /begin VAR_CHARACTERISTIC TP_U8ETCSCpGrdTransTme EngCalVariantCriterion
  /begin VAR_ADDRESS 0x8003A50C 0x8003B30C 0x8003C10C 0x8003CF0C 0x8003DD0C 0x8003EB0C 0x8003F90C 0x8004070C 0x8004150C 0x8004230C 0x8004310C 0x80043F0C 0x80044D0C 0x80045B0C 0x8004690C 0x8004770C 0x8004850C 0x8004930C 0x8004A10C 0x8004AF0C 0x8004BD0C 0x8004CB0C 0x8004D90C 0x8004E70C /end VAR_ADDRESS
 /end VAR_CHARACTERISTIC
 /begin VAR_CHARACTERISTIC TP_U8ETCSCpH2LDctHldTm EngCalVariantCriterion
  /begin VAR_ADDRESS 0x8003A516 0x8003B316 0x8003C116 0x8003CF16 0x8003DD16 0x8003EB16 0x8003F916 0x80040716 0x80041516 0x80042316 0x80043116 0x80043F16 0x80044D16 0x80045B16 0x80046916 0x80047716 0x80048516 0x80049316 0x8004A116 0x8004AF16 0x8004BD16 0x8004CB16 0x8004D916 0x8004E716 /end VAR_ADDRESS
 /end VAR_CHARACTERISTIC
 /begin VAR_CHARACTERISTIC TP_U8ETCSCpH2LDctSpnTh EngCalVariantCriterion
  /begin VAR_ADDRESS 0x8003A517 0x8003B317 0x8003C117 0x8003CF17 0x8003DD17 0x8003EB17 0x8003F917 0x80040717 0x80041517 0x80042317 0x80043117 0x80043F17 0x80044D17 0x80045B17 0x80046917 0x80047717 0x80048517 0x80049317 0x8004A117 0x8004AF17 0x8004BD17 0x8004CB17 0x8004D917 0x8004E717 /end VAR_ADDRESS
 /end VAR_CHARACTERISTIC
 /begin VAR_CHARACTERISTIC TP_U8ETCSCpHiAxlAccTh EngCalVariantCriterion
  /begin VAR_ADDRESS 0x8003A518 0x8003B318 0x8003C118 0x8003CF18 0x8003DD18 0x8003EB18 0x8003F918 0x80040718 0x80041518 0x80042318 0x80043118 0x80043F18 0x80044D18 0x80045B18 0x80046918 0x80047718 0x80048518 0x80049318 0x8004A118 0x8004AF18 0x8004BD18 0x8004CB18 0x8004D918 0x8004E718 /end VAR_ADDRESS
 /end VAR_CHARACTERISTIC
 /begin VAR_CHARACTERISTIC TP_U8ETCSCpHighBigSpnL2SpltTh EngCalVariantCriterion
  /begin VAR_ADDRESS 0x8003A519 0x8003B319 0x8003C119 0x8003CF19 0x8003DD19 0x8003EB19 0x8003F919 0x80040719 0x80041519 0x80042319 0x80043119 0x80043F19 0x80044D19 0x80045B19 0x80046919 0x80047719 0x80048519 0x80049319 0x8004A119 0x8004AF19 0x8004BD19 0x8004CB19 0x8004D919 0x8004E719 /end VAR_ADDRESS
 /end VAR_CHARACTERISTIC
 /begin VAR_CHARACTERISTIC TP_U8ETCSCpHighBigSpnTh EngCalVariantCriterion
  /begin VAR_ADDRESS 0x8003A51A 0x8003B31A 0x8003C11A 0x8003CF1A 0x8003DD1A 0x8003EB1A 0x8003F91A 0x8004071A 0x8004151A 0x8004231A 0x8004311A 0x80043F1A 0x80044D1A 0x80045B1A 0x8004691A 0x8004771A 0x8004851A 0x8004931A 0x8004A11A 0x8004AF1A 0x8004BD1A 0x8004CB1A 0x8004D91A 0x8004E71A /end VAR_ADDRESS
 /end VAR_CHARACTERISTIC
 /begin VAR_CHARACTERISTIC TP_U8ETCSCpHighSpnL2SpltTh EngCalVariantCriterion
  /begin VAR_ADDRESS 0x8003A51B 0x8003B31B 0x8003C11B 0x8003CF1B 0x8003DD1B 0x8003EB1B 0x8003F91B 0x8004071B 0x8004151B 0x8004231B 0x8004311B 0x80043F1B 0x80044D1B 0x80045B1B 0x8004691B 0x8004771B 0x8004851B 0x8004931B 0x8004A11B 0x8004AF1B 0x8004BD1B 0x8004CB1B 0x8004D91B 0x8004E71B /end VAR_ADDRESS
 /end VAR_CHARACTERISTIC
 /begin VAR_CHARACTERISTIC TP_U8ETCSCpHighSpnTh EngCalVariantCriterion
  /begin VAR_ADDRESS 0x8003A51C 0x8003B31C 0x8003C11C 0x8003CF1C 0x8003DD1C 0x8003EB1C 0x8003F91C 0x8004071C 0x8004151C 0x8004231C 0x8004311C 0x80043F1C 0x80044D1C 0x80045B1C 0x8004691C 0x8004771C 0x8004851C 0x8004931C 0x8004A11C 0x8004AF1C 0x8004BD1C 0x8004CB1C 0x8004D91C 0x8004E71C /end VAR_ADDRESS
 /end VAR_CHARACTERISTIC
 /begin VAR_CHARACTERISTIC TP_U8ETCSCpHillClrTime EngCalVariantCriterion
  /begin VAR_ADDRESS 0x8003A51D 0x8003B31D 0x8003C11D 0x8003CF1D 0x8003DD1D 0x8003EB1D 0x8003F91D 0x8004071D 0x8004151D 0x8004231D 0x8004311D 0x80043F1D 0x80044D1D 0x80045B1D 0x8004691D 0x8004771D 0x8004851D 0x8004931D 0x8004A11D 0x8004AF1D 0x8004BD1D 0x8004CB1D 0x8004D91D 0x8004E71D /end VAR_ADDRESS
 /end VAR_CHARACTERISTIC
 /begin VAR_CHARACTERISTIC TP_U8ETCSCpHillDctAlongTh EngCalVariantCriterion
  /begin VAR_ADDRESS 0x8003A51E 0x8003B31E 0x8003C11E 0x8003CF1E 0x8003DD1E 0x8003EB1E 0x8003F91E 0x8004071E 0x8004151E 0x8004231E 0x8004311E 0x80043F1E 0x80044D1E 0x80045B1E 0x8004691E 0x8004771E 0x8004851E 0x8004931E 0x8004A11E 0x8004AF1E 0x8004BD1E 0x8004CB1E 0x8004D91E 0x8004E71E /end VAR_ADDRESS
 /end VAR_CHARACTERISTIC
 /begin VAR_CHARACTERISTIC TP_U8ETCSCpHillDctTime EngCalVariantCriterion
  /begin VAR_ADDRESS 0x8003A51F 0x8003B31F 0x8003C11F 0x8003CF1F 0x8003DD1F 0x8003EB1F 0x8003F91F 0x8004071F 0x8004151F 0x8004231F 0x8004311F 0x80043F1F 0x80044D1F 0x80045B1F 0x8004691F 0x8004771F 0x8004851F 0x8004931F 0x8004A11F 0x8004AF1F 0x8004BD1F 0x8004CB1F 0x8004D91F 0x8004E71F /end VAR_ADDRESS
 /end VAR_CHARACTERISTIC
 /begin VAR_CHARACTERISTIC TP_U8ETCSCpHillDctTimeAx EngCalVariantCriterion
  /begin VAR_ADDRESS 0x8003A520 0x8003B320 0x8003C120 0x8003CF20 0x8003DD20 0x8003EB20 0x8003F920 0x80040720 0x80041520 0x80042320 0x80043120 0x80043F20 0x80044D20 0x80045B20 0x80046920 0x80047720 0x80048520 0x80049320 0x8004A120 0x8004AF20 0x8004BD20 0x8004CB20 0x8004D920 0x8004E720 /end VAR_ADDRESS
 /end VAR_CHARACTERISTIC
 /begin VAR_CHARACTERISTIC TP_U8ETCSCpHillDiffAx EngCalVariantCriterion
  /begin VAR_ADDRESS 0x8003A521 0x8003B321 0x8003C121 0x8003CF21 0x8003DD21 0x8003EB21 0x8003F921 0x80040721 0x80041521 0x80042321 0x80043121 0x80043F21 0x80044D21 0x80045B21 0x80046921 0x80047721 0x80048521 0x80049321 0x8004A121 0x8004AF21 0x8004BD21 0x8004CB21 0x8004D921 0x8004E721 /end VAR_ADDRESS
 /end VAR_CHARACTERISTIC
 /begin VAR_CHARACTERISTIC TP_U8ETCSCpHillTransTme EngCalVariantCriterion
  /begin VAR_ADDRESS 0x8003A522 0x8003B322 0x8003C122 0x8003CF22 0x8003DD22 0x8003EB22 0x8003F922 0x80040722 0x80041522 0x80042322 0x80043122 0x80043F22 0x80044D22 0x80045B22 0x80046922 0x80047722 0x80048522 0x80049322 0x8004A122 0x8004AF22 0x8004BD22 0x8004CB22 0x8004D922 0x8004E722 /end VAR_ADDRESS
 /end VAR_CHARACTERISTIC
 /begin VAR_CHARACTERISTIC TP_U8ETCSCpHsaHillTime EngCalVariantCriterion
  /begin VAR_ADDRESS 0x8003A523 0x8003B323 0x8003C123 0x8003CF23 0x8003DD23 0x8003EB23 0x8003F923 0x80040723 0x80041523 0x80042323 0x80043123 0x80043F23 0x80044D23 0x80045B23 0x80046923 0x80047723 0x80048523 0x80049323 0x8004A123 0x8004AF23 0x8004BD23 0x8004CB23 0x8004D923 0x8004E723 /end VAR_ADDRESS
 /end VAR_CHARACTERISTIC
 /begin VAR_CHARACTERISTIC TP_U8ETCSCpHysDeltAcc EngCalVariantCriterion
  /begin VAR_ADDRESS 0x8003A524 0x8003B324 0x8003C124 0x8003CF24 0x8003DD24 0x8003EB24 0x8003F924 0x80040724 0x80041524 0x80042324 0x80043124 0x80043F24 0x80044D24 0x80045B24 0x80046924 0x80047724 0x80048524 0x80049324 0x8004A124 0x8004AF24 0x8004BD24 0x8004CB24 0x8004D924 0x8004E724 /end VAR_ADDRESS
 /end VAR_CHARACTERISTIC
 /begin VAR_CHARACTERISTIC TP_U8ETCSCpHysDepSnwHilCnt EngCalVariantCriterion
  /begin VAR_ADDRESS 0x8003A525 0x8003B325 0x8003C125 0x8003CF25 0x8003DD25 0x8003EB25 0x8003F925 0x80040725 0x80041525 0x80042325 0x80043125 0x80043F25 0x80044D25 0x80045B25 0x80046925 0x80047725 0x80048525 0x80049325 0x8004A125 0x8004AF25 0x8004BD25 0x8004CB25 0x8004D925 0x8004E725 /end VAR_ADDRESS
 /end VAR_CHARACTERISTIC
 /begin VAR_CHARACTERISTIC TP_U8ETCSCpIGainIncFacAsymVib EngCalVariantCriterion
  /begin VAR_ADDRESS 0x8003A535 0x8003B335 0x8003C135 0x8003CF35 0x8003DD35 0x8003EB35 0x8003F935 0x80040735 0x80041535 0x80042335 0x80043135 0x80043F35 0x80044D35 0x80045B35 0x80046935 0x80047735 0x80048535 0x80049335 0x8004A135 0x8004AF35 0x8004BD35 0x8004CB35 0x8004D935 0x8004E735 /end VAR_ADDRESS
 /end VAR_CHARACTERISTIC
 /begin VAR_CHARACTERISTIC TP_U8ETCSCpIGainIncFacHldVib EngCalVariantCriterion
  /begin VAR_ADDRESS 0x8003A536 0x8003B336 0x8003C136 0x8003CF36 0x8003DD36 0x8003EB36 0x8003F936 0x80040736 0x80041536 0x80042336 0x80043136 0x80043F36 0x80044D36 0x80045B36 0x80046936 0x80047736 0x80048536 0x80049336 0x8004A136 0x8004AF36 0x8004BD36 0x8004CB36 0x8004D936 0x8004E736 /end VAR_ADDRESS
 /end VAR_CHARACTERISTIC
 /begin VAR_CHARACTERISTIC TP_U8ETCSCpIGainIncFacVib EngCalVariantCriterion
  /begin VAR_ADDRESS 0x8003A537 0x8003B337 0x8003C137 0x8003CF37 0x8003DD37 0x8003EB37 0x8003F937 0x80040737 0x80041537 0x80042337 0x80043137 0x80043F37 0x80044D37 0x80045B37 0x80046937 0x80047737 0x80048537 0x80049337 0x8004A137 0x8004AF37 0x8004BD37 0x8004CB37 0x8004D937 0x8004E737 /end VAR_ADDRESS
 /end VAR_CHARACTERISTIC
 /begin VAR_CHARACTERISTIC TP_U8ETCSCpIGainLmtFac[0][0] EngCalVariantCriterion
  /begin VAR_ADDRESS 0x8003A538 0x8003B338 0x8003C138 0x8003CF38 0x8003DD38 0x8003EB38 0x8003F938 0x80040738 0x80041538 0x80042338 0x80043138 0x80043F38 0x80044D38 0x80045B38 0x80046938 0x80047738 0x80048538 0x80049338 0x8004A138 0x8004AF38 0x8004BD38 0x8004CB38 0x8004D938 0x8004E738 /end VAR_ADDRESS
 /end VAR_CHARACTERISTIC
 /begin VAR_CHARACTERISTIC TP_U8ETCSCpIGainLmtFac[0][1] EngCalVariantCriterion
  /begin VAR_ADDRESS 0x8003A539 0x8003B339 0x8003C139 0x8003CF39 0x8003DD39 0x8003EB39 0x8003F939 0x80040739 0x80041539 0x80042339 0x80043139 0x80043F39 0x80044D39 0x80045B39 0x80046939 0x80047739 0x80048539 0x80049339 0x8004A139 0x8004AF39 0x8004BD39 0x8004CB39 0x8004D939 0x8004E739 /end VAR_ADDRESS
 /end VAR_CHARACTERISTIC
 /begin VAR_CHARACTERISTIC TP_U8ETCSCpIGainLmtFac[0][2] EngCalVariantCriterion
  /begin VAR_ADDRESS 0x8003A53A 0x8003B33A 0x8003C13A 0x8003CF3A 0x8003DD3A 0x8003EB3A 0x8003F93A 0x8004073A 0x8004153A 0x8004233A 0x8004313A 0x80043F3A 0x80044D3A 0x80045B3A 0x8004693A 0x8004773A 0x8004853A 0x8004933A 0x8004A13A 0x8004AF3A 0x8004BD3A 0x8004CB3A 0x8004D93A 0x8004E73A /end VAR_ADDRESS
 /end VAR_CHARACTERISTIC
 /begin VAR_CHARACTERISTIC TP_U8ETCSCpIGainLmtFac[1][0] EngCalVariantCriterion
  /begin VAR_ADDRESS 0x8003A53B 0x8003B33B 0x8003C13B 0x8003CF3B 0x8003DD3B 0x8003EB3B 0x8003F93B 0x8004073B 0x8004153B 0x8004233B 0x8004313B 0x80043F3B 0x80044D3B 0x80045B3B 0x8004693B 0x8004773B 0x8004853B 0x8004933B 0x8004A13B 0x8004AF3B 0x8004BD3B 0x8004CB3B 0x8004D93B 0x8004E73B /end VAR_ADDRESS
 /end VAR_CHARACTERISTIC
 /begin VAR_CHARACTERISTIC TP_U8ETCSCpIGainLmtFac[1][1] EngCalVariantCriterion
  /begin VAR_ADDRESS 0x8003A53C 0x8003B33C 0x8003C13C 0x8003CF3C 0x8003DD3C 0x8003EB3C 0x8003F93C 0x8004073C 0x8004153C 0x8004233C 0x8004313C 0x80043F3C 0x80044D3C 0x80045B3C 0x8004693C 0x8004773C 0x8004853C 0x8004933C 0x8004A13C 0x8004AF3C 0x8004BD3C 0x8004CB3C 0x8004D93C 0x8004E73C /end VAR_ADDRESS
 /end VAR_CHARACTERISTIC
 /begin VAR_CHARACTERISTIC TP_U8ETCSCpIGainLmtFac[1][2] EngCalVariantCriterion
  /begin VAR_ADDRESS 0x8003A53D 0x8003B33D 0x8003C13D 0x8003CF3D 0x8003DD3D 0x8003EB3D 0x8003F93D 0x8004073D 0x8004153D 0x8004233D 0x8004313D 0x80043F3D 0x80044D3D 0x80045B3D 0x8004693D 0x8004773D 0x8004853D 0x8004933D 0x8004A13D 0x8004AF3D 0x8004BD3D 0x8004CB3D 0x8004D93D 0x8004E73D /end VAR_ADDRESS
 /end VAR_CHARACTERISTIC
 /begin VAR_CHARACTERISTIC TP_U8ETCSCpIGainLmtFac[2][0] EngCalVariantCriterion
  /begin VAR_ADDRESS 0x8003A53E 0x8003B33E 0x8003C13E 0x8003CF3E 0x8003DD3E 0x8003EB3E 0x8003F93E 0x8004073E 0x8004153E 0x8004233E 0x8004313E 0x80043F3E 0x80044D3E 0x80045B3E 0x8004693E 0x8004773E 0x8004853E 0x8004933E 0x8004A13E 0x8004AF3E 0x8004BD3E 0x8004CB3E 0x8004D93E 0x8004E73E /end VAR_ADDRESS
 /end VAR_CHARACTERISTIC
 /begin VAR_CHARACTERISTIC TP_U8ETCSCpIGainLmtFac[2][1] EngCalVariantCriterion
  /begin VAR_ADDRESS 0x8003A53F 0x8003B33F 0x8003C13F 0x8003CF3F 0x8003DD3F 0x8003EB3F 0x8003F93F 0x8004073F 0x8004153F 0x8004233F 0x8004313F 0x80043F3F 0x80044D3F 0x80045B3F 0x8004693F 0x8004773F 0x8004853F 0x8004933F 0x8004A13F 0x8004AF3F 0x8004BD3F 0x8004CB3F 0x8004D93F 0x8004E73F /end VAR_ADDRESS
 /end VAR_CHARACTERISTIC
 /begin VAR_CHARACTERISTIC TP_U8ETCSCpIGainLmtFac[2][2] EngCalVariantCriterion
  /begin VAR_ADDRESS 0x8003A540 0x8003B340 0x8003C140 0x8003CF40 0x8003DD40 0x8003EB40 0x8003F940 0x80040740 0x80041540 0x80042340 0x80043140 0x80043F40 0x80044D40 0x80045B40 0x80046940 0x80047740 0x80048540 0x80049340 0x8004A140 0x8004AF40 0x8004BD40 0x8004CB40 0x8004D940 0x8004E740 /end VAR_ADDRESS
 /end VAR_CHARACTERISTIC
 /begin VAR_CHARACTERISTIC TP_U8ETCSCpIgFacGrChgErrNeg[0] EngCalVariantCriterion
  /begin VAR_ADDRESS 0x8003A541 0x8003B341 0x8003C141 0x8003CF41 0x8003DD41 0x8003EB41 0x8003F941 0x80040741 0x80041541 0x80042341 0x80043141 0x80043F41 0x80044D41 0x80045B41 0x80046941 0x80047741 0x80048541 0x80049341 0x8004A141 0x8004AF41 0x8004BD41 0x8004CB41 0x8004D941 0x8004E741 /end VAR_ADDRESS
 /end VAR_CHARACTERISTIC
 /begin VAR_CHARACTERISTIC TP_U8ETCSCpIgFacGrChgErrNeg[1] EngCalVariantCriterion
  /begin VAR_ADDRESS 0x8003A542 0x8003B342 0x8003C142 0x8003CF42 0x8003DD42 0x8003EB42 0x8003F942 0x80040742 0x80041542 0x80042342 0x80043142 0x80043F42 0x80044D42 0x80045B42 0x80046942 0x80047742 0x80048542 0x80049342 0x8004A142 0x8004AF42 0x8004BD42 0x8004CB42 0x8004D942 0x8004E742 /end VAR_ADDRESS
 /end VAR_CHARACTERISTIC
 /begin VAR_CHARACTERISTIC TP_U8ETCSCpIgFacGrChgErrNeg[2] EngCalVariantCriterion
  /begin VAR_ADDRESS 0x8003A543 0x8003B343 0x8003C143 0x8003CF43 0x8003DD43 0x8003EB43 0x8003F943 0x80040743 0x80041543 0x80042343 0x80043143 0x80043F43 0x80044D43 0x80045B43 0x80046943 0x80047743 0x80048543 0x80049343 0x8004A143 0x8004AF43 0x8004BD43 0x8004CB43 0x8004D943 0x8004E743 /end VAR_ADDRESS
 /end VAR_CHARACTERISTIC
 /begin VAR_CHARACTERISTIC TP_U8ETCSCpIgFacGrChgErrNeg[3] EngCalVariantCriterion
  /begin VAR_ADDRESS 0x8003A544 0x8003B344 0x8003C144 0x8003CF44 0x8003DD44 0x8003EB44 0x8003F944 0x80040744 0x80041544 0x80042344 0x80043144 0x80043F44 0x80044D44 0x80045B44 0x80046944 0x80047744 0x80048544 0x80049344 0x8004A144 0x8004AF44 0x8004BD44 0x8004CB44 0x8004D944 0x8004E744 /end VAR_ADDRESS
 /end VAR_CHARACTERISTIC
 /begin VAR_CHARACTERISTIC TP_U8ETCSCpIgFacGrChgErrNeg[4] EngCalVariantCriterion
  /begin VAR_ADDRESS 0x8003A545 0x8003B345 0x8003C145 0x8003CF45 0x8003DD45 0x8003EB45 0x8003F945 0x80040745 0x80041545 0x80042345 0x80043145 0x80043F45 0x80044D45 0x80045B45 0x80046945 0x80047745 0x80048545 0x80049345 0x8004A145 0x8004AF45 0x8004BD45 0x8004CB45 0x8004D945 0x8004E745 /end VAR_ADDRESS
 /end VAR_CHARACTERISTIC
 /begin VAR_CHARACTERISTIC TP_U8ETCSCpIgFacGrChgErrPos[0] EngCalVariantCriterion
  /begin VAR_ADDRESS 0x8003A546 0x8003B346 0x8003C146 0x8003CF46 0x8003DD46 0x8003EB46 0x8003F946 0x80040746 0x80041546 0x80042346 0x80043146 0x80043F46 0x80044D46 0x80045B46 0x80046946 0x80047746 0x80048546 0x80049346 0x8004A146 0x8004AF46 0x8004BD46 0x8004CB46 0x8004D946 0x8004E746 /end VAR_ADDRESS
 /end VAR_CHARACTERISTIC
 /begin VAR_CHARACTERISTIC TP_U8ETCSCpIgFacGrChgErrPos[1] EngCalVariantCriterion
  /begin VAR_ADDRESS 0x8003A547 0x8003B347 0x8003C147 0x8003CF47 0x8003DD47 0x8003EB47 0x8003F947 0x80040747 0x80041547 0x80042347 0x80043147 0x80043F47 0x80044D47 0x80045B47 0x80046947 0x80047747 0x80048547 0x80049347 0x8004A147 0x8004AF47 0x8004BD47 0x8004CB47 0x8004D947 0x8004E747 /end VAR_ADDRESS
 /end VAR_CHARACTERISTIC
 /begin VAR_CHARACTERISTIC TP_U8ETCSCpIgFacGrChgErrPos[2] EngCalVariantCriterion
  /begin VAR_ADDRESS 0x8003A548 0x8003B348 0x8003C148 0x8003CF48 0x8003DD48 0x8003EB48 0x8003F948 0x80040748 0x80041548 0x80042348 0x80043148 0x80043F48 0x80044D48 0x80045B48 0x80046948 0x80047748 0x80048548 0x80049348 0x8004A148 0x8004AF48 0x8004BD48 0x8004CB48 0x8004D948 0x8004E748 /end VAR_ADDRESS
 /end VAR_CHARACTERISTIC
 /begin VAR_CHARACTERISTIC TP_U8ETCSCpIgFacGrChgErrPos[3] EngCalVariantCriterion
  /begin VAR_ADDRESS 0x8003A549 0x8003B349 0x8003C149 0x8003CF49 0x8003DD49 0x8003EB49 0x8003F949 0x80040749 0x80041549 0x80042349 0x80043149 0x80043F49 0x80044D49 0x80045B49 0x80046949 0x80047749 0x80048549 0x80049349 0x8004A149 0x8004AF49 0x8004BD49 0x8004CB49 0x8004D949 0x8004E749 /end VAR_ADDRESS
 /end VAR_CHARACTERISTIC
 /begin VAR_CHARACTERISTIC TP_U8ETCSCpIgFacGrChgErrPos[4] EngCalVariantCriterion
  /begin VAR_ADDRESS 0x8003A54A 0x8003B34A 0x8003C14A 0x8003CF4A 0x8003DD4A 0x8003EB4A 0x8003F94A 0x8004074A 0x8004154A 0x8004234A 0x8004314A 0x80043F4A 0x80044D4A 0x80045B4A 0x8004694A 0x8004774A 0x8004854A 0x8004934A 0x8004A14A 0x8004AF4A 0x8004BD4A 0x8004CB4A 0x8004D94A 0x8004E74A /end VAR_ADDRESS
 /end VAR_CHARACTERISTIC
 /begin VAR_CHARACTERISTIC TP_U8ETCSCpIgFacInTrn[0][0] EngCalVariantCriterion
  /begin VAR_ADDRESS 0x8003A54B 0x8003B34B 0x8003C14B 0x8003CF4B 0x8003DD4B 0x8003EB4B 0x8003F94B 0x8004074B 0x8004154B 0x8004234B 0x8004314B 0x80043F4B 0x80044D4B 0x80045B4B 0x8004694B 0x8004774B 0x8004854B 0x8004934B 0x8004A14B 0x8004AF4B 0x8004BD4B 0x8004CB4B 0x8004D94B 0x8004E74B /end VAR_ADDRESS
 /end VAR_CHARACTERISTIC
 /begin VAR_CHARACTERISTIC TP_U8ETCSCpIgFacInTrn[0][1] EngCalVariantCriterion
  /begin VAR_ADDRESS 0x8003A54C 0x8003B34C 0x8003C14C 0x8003CF4C 0x8003DD4C 0x8003EB4C 0x8003F94C 0x8004074C 0x8004154C 0x8004234C 0x8004314C 0x80043F4C 0x80044D4C 0x80045B4C 0x8004694C 0x8004774C 0x8004854C 0x8004934C 0x8004A14C 0x8004AF4C 0x8004BD4C 0x8004CB4C 0x8004D94C 0x8004E74C /end VAR_ADDRESS
 /end VAR_CHARACTERISTIC
 /begin VAR_CHARACTERISTIC TP_U8ETCSCpIgFacInTrn[0][2] EngCalVariantCriterion
  /begin VAR_ADDRESS 0x8003A54D 0x8003B34D 0x8003C14D 0x8003CF4D 0x8003DD4D 0x8003EB4D 0x8003F94D 0x8004074D 0x8004154D 0x8004234D 0x8004314D 0x80043F4D 0x80044D4D 0x80045B4D 0x8004694D 0x8004774D 0x8004854D 0x8004934D 0x8004A14D 0x8004AF4D 0x8004BD4D 0x8004CB4D 0x8004D94D 0x8004E74D /end VAR_ADDRESS
 /end VAR_CHARACTERISTIC
 /begin VAR_CHARACTERISTIC TP_U8ETCSCpIgFacInTrn[0][3] EngCalVariantCriterion
  /begin VAR_ADDRESS 0x8003A54E 0x8003B34E 0x8003C14E 0x8003CF4E 0x8003DD4E 0x8003EB4E 0x8003F94E 0x8004074E 0x8004154E 0x8004234E 0x8004314E 0x80043F4E 0x80044D4E 0x80045B4E 0x8004694E 0x8004774E 0x8004854E 0x8004934E 0x8004A14E 0x8004AF4E 0x8004BD4E 0x8004CB4E 0x8004D94E 0x8004E74E /end VAR_ADDRESS
 /end VAR_CHARACTERISTIC
 /begin VAR_CHARACTERISTIC TP_U8ETCSCpIgFacInTrn[0][4] EngCalVariantCriterion
  /begin VAR_ADDRESS 0x8003A54F 0x8003B34F 0x8003C14F 0x8003CF4F 0x8003DD4F 0x8003EB4F 0x8003F94F 0x8004074F 0x8004154F 0x8004234F 0x8004314F 0x80043F4F 0x80044D4F 0x80045B4F 0x8004694F 0x8004774F 0x8004854F 0x8004934F 0x8004A14F 0x8004AF4F 0x8004BD4F 0x8004CB4F 0x8004D94F 0x8004E74F /end VAR_ADDRESS
 /end VAR_CHARACTERISTIC
 /begin VAR_CHARACTERISTIC TP_U8ETCSCpIgFacInTrn[1][0] EngCalVariantCriterion
  /begin VAR_ADDRESS 0x8003A550 0x8003B350 0x8003C150 0x8003CF50 0x8003DD50 0x8003EB50 0x8003F950 0x80040750 0x80041550 0x80042350 0x80043150 0x80043F50 0x80044D50 0x80045B50 0x80046950 0x80047750 0x80048550 0x80049350 0x8004A150 0x8004AF50 0x8004BD50 0x8004CB50 0x8004D950 0x8004E750 /end VAR_ADDRESS
 /end VAR_CHARACTERISTIC
 /begin VAR_CHARACTERISTIC TP_U8ETCSCpIgFacInTrn[1][1] EngCalVariantCriterion
  /begin VAR_ADDRESS 0x8003A551 0x8003B351 0x8003C151 0x8003CF51 0x8003DD51 0x8003EB51 0x8003F951 0x80040751 0x80041551 0x80042351 0x80043151 0x80043F51 0x80044D51 0x80045B51 0x80046951 0x80047751 0x80048551 0x80049351 0x8004A151 0x8004AF51 0x8004BD51 0x8004CB51 0x8004D951 0x8004E751 /end VAR_ADDRESS
 /end VAR_CHARACTERISTIC
 /begin VAR_CHARACTERISTIC TP_U8ETCSCpIgFacInTrn[1][2] EngCalVariantCriterion
  /begin VAR_ADDRESS 0x8003A552 0x8003B352 0x8003C152 0x8003CF52 0x8003DD52 0x8003EB52 0x8003F952 0x80040752 0x80041552 0x80042352 0x80043152 0x80043F52 0x80044D52 0x80045B52 0x80046952 0x80047752 0x80048552 0x80049352 0x8004A152 0x8004AF52 0x8004BD52 0x8004CB52 0x8004D952 0x8004E752 /end VAR_ADDRESS
 /end VAR_CHARACTERISTIC
 /begin VAR_CHARACTERISTIC TP_U8ETCSCpIgFacInTrn[1][3] EngCalVariantCriterion
  /begin VAR_ADDRESS 0x8003A553 0x8003B353 0x8003C153 0x8003CF53 0x8003DD53 0x8003EB53 0x8003F953 0x80040753 0x80041553 0x80042353 0x80043153 0x80043F53 0x80044D53 0x80045B53 0x80046953 0x80047753 0x80048553 0x80049353 0x8004A153 0x8004AF53 0x8004BD53 0x8004CB53 0x8004D953 0x8004E753 /end VAR_ADDRESS
 /end VAR_CHARACTERISTIC
 /begin VAR_CHARACTERISTIC TP_U8ETCSCpIgFacInTrn[1][4] EngCalVariantCriterion
  /begin VAR_ADDRESS 0x8003A554 0x8003B354 0x8003C154 0x8003CF54 0x8003DD54 0x8003EB54 0x8003F954 0x80040754 0x80041554 0x80042354 0x80043154 0x80043F54 0x80044D54 0x80045B54 0x80046954 0x80047754 0x80048554 0x80049354 0x8004A154 0x8004AF54 0x8004BD54 0x8004CB54 0x8004D954 0x8004E754 /end VAR_ADDRESS
 /end VAR_CHARACTERISTIC
 /begin VAR_CHARACTERISTIC TP_U8ETCSCpIgFacInTrn[2][0] EngCalVariantCriterion
  /begin VAR_ADDRESS 0x8003A555 0x8003B355 0x8003C155 0x8003CF55 0x8003DD55 0x8003EB55 0x8003F955 0x80040755 0x80041555 0x80042355 0x80043155 0x80043F55 0x80044D55 0x80045B55 0x80046955 0x80047755 0x80048555 0x80049355 0x8004A155 0x8004AF55 0x8004BD55 0x8004CB55 0x8004D955 0x8004E755 /end VAR_ADDRESS
 /end VAR_CHARACTERISTIC
 /begin VAR_CHARACTERISTIC TP_U8ETCSCpIgFacInTrn[2][1] EngCalVariantCriterion
  /begin VAR_ADDRESS 0x8003A556 0x8003B356 0x8003C156 0x8003CF56 0x8003DD56 0x8003EB56 0x8003F956 0x80040756 0x80041556 0x80042356 0x80043156 0x80043F56 0x80044D56 0x80045B56 0x80046956 0x80047756 0x80048556 0x80049356 0x8004A156 0x8004AF56 0x8004BD56 0x8004CB56 0x8004D956 0x8004E756 /end VAR_ADDRESS
 /end VAR_CHARACTERISTIC
 /begin VAR_CHARACTERISTIC TP_U8ETCSCpIgFacInTrn[2][2] EngCalVariantCriterion
  /begin VAR_ADDRESS 0x8003A557 0x8003B357 0x8003C157 0x8003CF57 0x8003DD57 0x8003EB57 0x8003F957 0x80040757 0x80041557 0x80042357 0x80043157 0x80043F57 0x80044D57 0x80045B57 0x80046957 0x80047757 0x80048557 0x80049357 0x8004A157 0x8004AF57 0x8004BD57 0x8004CB57 0x8004D957 0x8004E757 /end VAR_ADDRESS
 /end VAR_CHARACTERISTIC
 /begin VAR_CHARACTERISTIC TP_U8ETCSCpIgFacInTrn[2][3] EngCalVariantCriterion
  /begin VAR_ADDRESS 0x8003A558 0x8003B358 0x8003C158 0x8003CF58 0x8003DD58 0x8003EB58 0x8003F958 0x80040758 0x80041558 0x80042358 0x80043158 0x80043F58 0x80044D58 0x80045B58 0x80046958 0x80047758 0x80048558 0x80049358 0x8004A158 0x8004AF58 0x8004BD58 0x8004CB58 0x8004D958 0x8004E758 /end VAR_ADDRESS
 /end VAR_CHARACTERISTIC
 /begin VAR_CHARACTERISTIC TP_U8ETCSCpIgFacInTrn[2][4] EngCalVariantCriterion
  /begin VAR_ADDRESS 0x8003A559 0x8003B359 0x8003C159 0x8003CF59 0x8003DD59 0x8003EB59 0x8003F959 0x80040759 0x80041559 0x80042359 0x80043159 0x80043F59 0x80044D59 0x80045B59 0x80046959 0x80047759 0x80048559 0x80049359 0x8004A159 0x8004AF59 0x8004BD59 0x8004CB59 0x8004D959 0x8004E759 /end VAR_ADDRESS
 /end VAR_CHARACTERISTIC
 /begin VAR_CHARACTERISTIC TP_U8ETCSCpIgainFacAftrTrn[0][0] EngCalVariantCriterion
  /begin VAR_ADDRESS 0x8003A526 0x8003B326 0x8003C126 0x8003CF26 0x8003DD26 0x8003EB26 0x8003F926 0x80040726 0x80041526 0x80042326 0x80043126 0x80043F26 0x80044D26 0x80045B26 0x80046926 0x80047726 0x80048526 0x80049326 0x8004A126 0x8004AF26 0x8004BD26 0x8004CB26 0x8004D926 0x8004E726 /end VAR_ADDRESS
 /end VAR_CHARACTERISTIC
 /begin VAR_CHARACTERISTIC TP_U8ETCSCpIgainFacAftrTrn[0][1] EngCalVariantCriterion
  /begin VAR_ADDRESS 0x8003A527 0x8003B327 0x8003C127 0x8003CF27 0x8003DD27 0x8003EB27 0x8003F927 0x80040727 0x80041527 0x80042327 0x80043127 0x80043F27 0x80044D27 0x80045B27 0x80046927 0x80047727 0x80048527 0x80049327 0x8004A127 0x8004AF27 0x8004BD27 0x8004CB27 0x8004D927 0x8004E727 /end VAR_ADDRESS
 /end VAR_CHARACTERISTIC
 /begin VAR_CHARACTERISTIC TP_U8ETCSCpIgainFacAftrTrn[0][2] EngCalVariantCriterion
  /begin VAR_ADDRESS 0x8003A528 0x8003B328 0x8003C128 0x8003CF28 0x8003DD28 0x8003EB28 0x8003F928 0x80040728 0x80041528 0x80042328 0x80043128 0x80043F28 0x80044D28 0x80045B28 0x80046928 0x80047728 0x80048528 0x80049328 0x8004A128 0x8004AF28 0x8004BD28 0x8004CB28 0x8004D928 0x8004E728 /end VAR_ADDRESS
 /end VAR_CHARACTERISTIC
 /begin VAR_CHARACTERISTIC TP_U8ETCSCpIgainFacAftrTrn[0][3] EngCalVariantCriterion
  /begin VAR_ADDRESS 0x8003A529 0x8003B329 0x8003C129 0x8003CF29 0x8003DD29 0x8003EB29 0x8003F929 0x80040729 0x80041529 0x80042329 0x80043129 0x80043F29 0x80044D29 0x80045B29 0x80046929 0x80047729 0x80048529 0x80049329 0x8004A129 0x8004AF29 0x8004BD29 0x8004CB29 0x8004D929 0x8004E729 /end VAR_ADDRESS
 /end VAR_CHARACTERISTIC
 /begin VAR_CHARACTERISTIC TP_U8ETCSCpIgainFacAftrTrn[0][4] EngCalVariantCriterion
  /begin VAR_ADDRESS 0x8003A52A 0x8003B32A 0x8003C12A 0x8003CF2A 0x8003DD2A 0x8003EB2A 0x8003F92A 0x8004072A 0x8004152A 0x8004232A 0x8004312A 0x80043F2A 0x80044D2A 0x80045B2A 0x8004692A 0x8004772A 0x8004852A 0x8004932A 0x8004A12A 0x8004AF2A 0x8004BD2A 0x8004CB2A 0x8004D92A 0x8004E72A /end VAR_ADDRESS
 /end VAR_CHARACTERISTIC
 /begin VAR_CHARACTERISTIC TP_U8ETCSCpIgainFacAftrTrn[1][0] EngCalVariantCriterion
  /begin VAR_ADDRESS 0x8003A52B 0x8003B32B 0x8003C12B 0x8003CF2B 0x8003DD2B 0x8003EB2B 0x8003F92B 0x8004072B 0x8004152B 0x8004232B 0x8004312B 0x80043F2B 0x80044D2B 0x80045B2B 0x8004692B 0x8004772B 0x8004852B 0x8004932B 0x8004A12B 0x8004AF2B 0x8004BD2B 0x8004CB2B 0x8004D92B 0x8004E72B /end VAR_ADDRESS
 /end VAR_CHARACTERISTIC
 /begin VAR_CHARACTERISTIC TP_U8ETCSCpIgainFacAftrTrn[1][1] EngCalVariantCriterion
  /begin VAR_ADDRESS 0x8003A52C 0x8003B32C 0x8003C12C 0x8003CF2C 0x8003DD2C 0x8003EB2C 0x8003F92C 0x8004072C 0x8004152C 0x8004232C 0x8004312C 0x80043F2C 0x80044D2C 0x80045B2C 0x8004692C 0x8004772C 0x8004852C 0x8004932C 0x8004A12C 0x8004AF2C 0x8004BD2C 0x8004CB2C 0x8004D92C 0x8004E72C /end VAR_ADDRESS
 /end VAR_CHARACTERISTIC
 /begin VAR_CHARACTERISTIC TP_U8ETCSCpIgainFacAftrTrn[1][2] EngCalVariantCriterion
  /begin VAR_ADDRESS 0x8003A52D 0x8003B32D 0x8003C12D 0x8003CF2D 0x8003DD2D 0x8003EB2D 0x8003F92D 0x8004072D 0x8004152D 0x8004232D 0x8004312D 0x80043F2D 0x80044D2D 0x80045B2D 0x8004692D 0x8004772D 0x8004852D 0x8004932D 0x8004A12D 0x8004AF2D 0x8004BD2D 0x8004CB2D 0x8004D92D 0x8004E72D /end VAR_ADDRESS
 /end VAR_CHARACTERISTIC
 /begin VAR_CHARACTERISTIC TP_U8ETCSCpIgainFacAftrTrn[1][3] EngCalVariantCriterion
  /begin VAR_ADDRESS 0x8003A52E 0x8003B32E 0x8003C12E 0x8003CF2E 0x8003DD2E 0x8003EB2E 0x8003F92E 0x8004072E 0x8004152E 0x8004232E 0x8004312E 0x80043F2E 0x80044D2E 0x80045B2E 0x8004692E 0x8004772E 0x8004852E 0x8004932E 0x8004A12E 0x8004AF2E 0x8004BD2E 0x8004CB2E 0x8004D92E 0x8004E72E /end VAR_ADDRESS
 /end VAR_CHARACTERISTIC
 /begin VAR_CHARACTERISTIC TP_U8ETCSCpIgainFacAftrTrn[1][4] EngCalVariantCriterion
  /begin VAR_ADDRESS 0x8003A52F 0x8003B32F 0x8003C12F 0x8003CF2F 0x8003DD2F 0x8003EB2F 0x8003F92F 0x8004072F 0x8004152F 0x8004232F 0x8004312F 0x80043F2F 0x80044D2F 0x80045B2F 0x8004692F 0x8004772F 0x8004852F 0x8004932F 0x8004A12F 0x8004AF2F 0x8004BD2F 0x8004CB2F 0x8004D92F 0x8004E72F /end VAR_ADDRESS
 /end VAR_CHARACTERISTIC
 /begin VAR_CHARACTERISTIC TP_U8ETCSCpIgainFacAftrTrn[2][0] EngCalVariantCriterion
  /begin VAR_ADDRESS 0x8003A530 0x8003B330 0x8003C130 0x8003CF30 0x8003DD30 0x8003EB30 0x8003F930 0x80040730 0x80041530 0x80042330 0x80043130 0x80043F30 0x80044D30 0x80045B30 0x80046930 0x80047730 0x80048530 0x80049330 0x8004A130 0x8004AF30 0x8004BD30 0x8004CB30 0x8004D930 0x8004E730 /end VAR_ADDRESS
 /end VAR_CHARACTERISTIC
 /begin VAR_CHARACTERISTIC TP_U8ETCSCpIgainFacAftrTrn[2][1] EngCalVariantCriterion
  /begin VAR_ADDRESS 0x8003A531 0x8003B331 0x8003C131 0x8003CF31 0x8003DD31 0x8003EB31 0x8003F931 0x80040731 0x80041531 0x80042331 0x80043131 0x80043F31 0x80044D31 0x80045B31 0x80046931 0x80047731 0x80048531 0x80049331 0x8004A131 0x8004AF31 0x8004BD31 0x8004CB31 0x8004D931 0x8004E731 /end VAR_ADDRESS
 /end VAR_CHARACTERISTIC
 /begin VAR_CHARACTERISTIC TP_U8ETCSCpIgainFacAftrTrn[2][2] EngCalVariantCriterion
  /begin VAR_ADDRESS 0x8003A532 0x8003B332 0x8003C132 0x8003CF32 0x8003DD32 0x8003EB32 0x8003F932 0x80040732 0x80041532 0x80042332 0x80043132 0x80043F32 0x80044D32 0x80045B32 0x80046932 0x80047732 0x80048532 0x80049332 0x8004A132 0x8004AF32 0x8004BD32 0x8004CB32 0x8004D932 0x8004E732 /end VAR_ADDRESS
 /end VAR_CHARACTERISTIC
 /begin VAR_CHARACTERISTIC TP_U8ETCSCpIgainFacAftrTrn[2][3] EngCalVariantCriterion
  /begin VAR_ADDRESS 0x8003A533 0x8003B333 0x8003C133 0x8003CF33 0x8003DD33 0x8003EB33 0x8003F933 0x80040733 0x80041533 0x80042333 0x80043133 0x80043F33 0x80044D33 0x80045B33 0x80046933 0x80047733 0x80048533 0x80049333 0x8004A133 0x8004AF33 0x8004BD33 0x8004CB33 0x8004D933 0x8004E733 /end VAR_ADDRESS
 /end VAR_CHARACTERISTIC
 /begin VAR_CHARACTERISTIC TP_U8ETCSCpIgainFacAftrTrn[2][4] EngCalVariantCriterion
  /begin VAR_ADDRESS 0x8003A534 0x8003B334 0x8003C134 0x8003CF34 0x8003DD34 0x8003EB34 0x8003F934 0x80040734 0x80041534 0x80042334 0x80043134 0x80043F34 0x80044D34 0x80045B34 0x80046934 0x80047734 0x80048534 0x80049334 0x8004A134 0x8004AF34 0x8004BD34 0x8004CB34 0x8004D934 0x8004E734 /end VAR_ADDRESS
 /end VAR_CHARACTERISTIC
 /begin VAR_CHARACTERISTIC TP_U8ETCSCpInGrCntThr4MultShft4TCS EngCalVariantCriterion
  /begin VAR_ADDRESS 0x8003A55A 0x8003B35A 0x8003C15A 0x8003CF5A 0x8003DD5A 0x8003EB5A 0x8003F95A 0x8004075A 0x8004155A 0x8004235A 0x8004315A 0x80043F5A 0x80044D5A 0x80045B5A 0x8004695A 0x8004775A 0x8004855A 0x8004935A 0x8004A15A 0x8004AF5A 0x8004BD5A 0x8004CB5A 0x8004D95A 0x8004E75A /end VAR_ADDRESS
 /end VAR_CHARACTERISTIC
 /begin VAR_CHARACTERISTIC TP_U8ETCSCpInGrCntThr4SnglShft4TCS EngCalVariantCriterion
  /begin VAR_ADDRESS 0x8003A55B 0x8003B35B 0x8003C15B 0x8003CF5B 0x8003DD5B 0x8003EB5B 0x8003F95B 0x8004075B 0x8004155B 0x8004235B 0x8004315B 0x80043F5B 0x80044D5B 0x80045B5B 0x8004695B 0x8004775B 0x8004855B 0x8004935B 0x8004A15B 0x8004AF5B 0x8004BD5B 0x8004CB5B 0x8004D95B 0x8004E75B /end VAR_ADDRESS
 /end VAR_CHARACTERISTIC
 /begin VAR_CHARACTERISTIC TP_U8ETCSCpLatStabCntTh[0] EngCalVariantCriterion
  /begin VAR_ADDRESS 0x8003A55C 0x8003B35C 0x8003C15C 0x8003CF5C 0x8003DD5C 0x8003EB5C 0x8003F95C 0x8004075C 0x8004155C 0x8004235C 0x8004315C 0x80043F5C 0x80044D5C 0x80045B5C 0x8004695C 0x8004775C 0x8004855C 0x8004935C 0x8004A15C 0x8004AF5C 0x8004BD5C 0x8004CB5C 0x8004D95C 0x8004E75C /end VAR_ADDRESS
 /end VAR_CHARACTERISTIC
 /begin VAR_CHARACTERISTIC TP_U8ETCSCpLatStabCntTh[1] EngCalVariantCriterion
  /begin VAR_ADDRESS 0x8003A55D 0x8003B35D 0x8003C15D 0x8003CF5D 0x8003DD5D 0x8003EB5D 0x8003F95D 0x8004075D 0x8004155D 0x8004235D 0x8004315D 0x80043F5D 0x80044D5D 0x80045B5D 0x8004695D 0x8004775D 0x8004855D 0x8004935D 0x8004A15D 0x8004AF5D 0x8004BD5D 0x8004CB5D 0x8004D95D 0x8004E75D /end VAR_ADDRESS
 /end VAR_CHARACTERISTIC
 /begin VAR_CHARACTERISTIC TP_U8ETCSCpLatStabCntTh[2] EngCalVariantCriterion
  /begin VAR_ADDRESS 0x8003A55E 0x8003B35E 0x8003C15E 0x8003CF5E 0x8003DD5E 0x8003EB5E 0x8003F95E 0x8004075E 0x8004155E 0x8004235E 0x8004315E 0x80043F5E 0x80044D5E 0x80045B5E 0x8004695E 0x8004775E 0x8004855E 0x8004935E 0x8004A15E 0x8004AF5E 0x8004BD5E 0x8004CB5E 0x8004D95E 0x8004E75E /end VAR_ADDRESS
 /end VAR_CHARACTERISTIC
 /begin VAR_CHARACTERISTIC TP_U8ETCSCpLatStabStrTh[0] EngCalVariantCriterion
  /begin VAR_ADDRESS 0x8003A55F 0x8003B35F 0x8003C15F 0x8003CF5F 0x8003DD5F 0x8003EB5F 0x8003F95F 0x8004075F 0x8004155F 0x8004235F 0x8004315F 0x80043F5F 0x80044D5F 0x80045B5F 0x8004695F 0x8004775F 0x8004855F 0x8004935F 0x8004A15F 0x8004AF5F 0x8004BD5F 0x8004CB5F 0x8004D95F 0x8004E75F /end VAR_ADDRESS
 /end VAR_CHARACTERISTIC
 /begin VAR_CHARACTERISTIC TP_U8ETCSCpLatStabStrTh[1] EngCalVariantCriterion
  /begin VAR_ADDRESS 0x8003A560 0x8003B360 0x8003C160 0x8003CF60 0x8003DD60 0x8003EB60 0x8003F960 0x80040760 0x80041560 0x80042360 0x80043160 0x80043F60 0x80044D60 0x80045B60 0x80046960 0x80047760 0x80048560 0x80049360 0x8004A160 0x8004AF60 0x8004BD60 0x8004CB60 0x8004D960 0x8004E760 /end VAR_ADDRESS
 /end VAR_CHARACTERISTIC
 /begin VAR_CHARACTERISTIC TP_U8ETCSCpLatStabStrTh[2] EngCalVariantCriterion
  /begin VAR_ADDRESS 0x8003A561 0x8003B361 0x8003C161 0x8003CF61 0x8003DD61 0x8003EB61 0x8003F961 0x80040761 0x80041561 0x80042361 0x80043161 0x80043F61 0x80044D61 0x80045B61 0x80046961 0x80047761 0x80048561 0x80049361 0x8004A161 0x8004AF61 0x8004BD61 0x8004CB61 0x8004D961 0x8004E761 /end VAR_ADDRESS
 /end VAR_CHARACTERISTIC
 /begin VAR_CHARACTERISTIC TP_U8ETCSCpLdTrqAsymSpinFac EngCalVariantCriterion
  /begin VAR_ADDRESS 0x8003A562 0x8003B362 0x8003C162 0x8003CF62 0x8003DD62 0x8003EB62 0x8003F962 0x80040762 0x80041562 0x80042362 0x80043162 0x80043F62 0x80044D62 0x80045B62 0x80046962 0x80047762 0x80048562 0x80049362 0x8004A162 0x8004AF62 0x8004BD62 0x8004CB62 0x8004D962 0x8004E762 /end VAR_ADDRESS
 /end VAR_CHARACTERISTIC
 /begin VAR_CHARACTERISTIC TP_U8ETCSCpLdTrqByAsymTransTme EngCalVariantCriterion
  /begin VAR_ADDRESS 0x8003A563 0x8003B363 0x8003C163 0x8003CF63 0x8003DD63 0x8003EB63 0x8003F963 0x80040763 0x80041563 0x80042363 0x80043163 0x80043F63 0x80044D63 0x80045B63 0x80046963 0x80047763 0x80048563 0x80049363 0x8004A163 0x8004AF63 0x8004BD63 0x8004CB63 0x8004D963 0x8004E763 /end VAR_ADDRESS
 /end VAR_CHARACTERISTIC
 /begin VAR_CHARACTERISTIC TP_U8ETCSCpLdTrqByGrdTransTme EngCalVariantCriterion
  /begin VAR_ADDRESS 0x8003A564 0x8003B364 0x8003C164 0x8003CF64 0x8003DD64 0x8003EB64 0x8003F964 0x80040764 0x80041564 0x80042364 0x80043164 0x80043F64 0x80044D64 0x80045B64 0x80046964 0x80047764 0x80048564 0x80049364 0x8004A164 0x8004AF64 0x8004BD64 0x8004CB64 0x8004D964 0x8004E764 /end VAR_ADDRESS
 /end VAR_CHARACTERISTIC
 /begin VAR_CHARACTERISTIC TP_U8ETCSCpLdTrqChngFac EngCalVariantCriterion
  /begin VAR_ADDRESS 0x8003A565 0x8003B365 0x8003C165 0x8003CF65 0x8003DD65 0x8003EB65 0x8003F965 0x80040765 0x80041565 0x80042365 0x80043165 0x80043F65 0x80044D65 0x80045B65 0x80046965 0x80047765 0x80048565 0x80049365 0x8004A165 0x8004AF65 0x8004BD65 0x8004CB65 0x8004D965 0x8004E765 /end VAR_ADDRESS
 /end VAR_CHARACTERISTIC
 /begin VAR_CHARACTERISTIC TP_U8ETCSCpLmtStrDepSnwHil EngCalVariantCriterion
  /begin VAR_ADDRESS 0x8003A566 0x8003B366 0x8003C166 0x8003CF66 0x8003DD66 0x8003EB66 0x8003F966 0x80040766 0x80041566 0x80042366 0x80043166 0x80043F66 0x80044D66 0x80045B66 0x80046966 0x80047766 0x80048566 0x80049366 0x8004A166 0x8004AF66 0x8004BD66 0x8004CB66 0x8004D966 0x8004E766 /end VAR_ADDRESS
 /end VAR_CHARACTERISTIC
 /begin VAR_CHARACTERISTIC TP_U8ETCSCpLowSpnL2SpltTh EngCalVariantCriterion
  /begin VAR_ADDRESS 0x8003A567 0x8003B367 0x8003C167 0x8003CF67 0x8003DD67 0x8003EB67 0x8003F967 0x80040767 0x80041567 0x80042367 0x80043167 0x80043F67 0x80044D67 0x80045B67 0x80046967 0x80047767 0x80048567 0x80049367 0x8004A167 0x8004AF67 0x8004BD67 0x8004CB67 0x8004D967 0x8004E767 /end VAR_ADDRESS
 /end VAR_CHARACTERISTIC
 /begin VAR_CHARACTERISTIC TP_U8ETCSCpLowSpnTh EngCalVariantCriterion
  /begin VAR_ADDRESS 0x8003A568 0x8003B368 0x8003C168 0x8003CF68 0x8003DD68 0x8003EB68 0x8003F968 0x80040768 0x80041568 0x80042368 0x80043168 0x80043F68 0x80044D68 0x80045B68 0x80046968 0x80047768 0x80048568 0x80049368 0x8004A168 0x8004AF68 0x8004BD68 0x8004CB68 0x8004D968 0x8004E768 /end VAR_ADDRESS
 /end VAR_CHARACTERISTIC
 /begin VAR_CHARACTERISTIC TP_U8ETCSCpLowWhlSpnCntDnTh EngCalVariantCriterion
  /begin VAR_ADDRESS 0x8003A569 0x8003B369 0x8003C169 0x8003CF69 0x8003DD69 0x8003EB69 0x8003F969 0x80040769 0x80041569 0x80042369 0x80043169 0x80043F69 0x80044D69 0x80045B69 0x80046969 0x80047769 0x80048569 0x80049369 0x8004A169 0x8004AF69 0x8004BD69 0x8004CB69 0x8004D969 0x8004E769 /end VAR_ADDRESS
 /end VAR_CHARACTERISTIC
 /begin VAR_CHARACTERISTIC TP_U8ETCSCpLowWhlSpnCntUpTh EngCalVariantCriterion
  /begin VAR_ADDRESS 0x8003A56A 0x8003B36A 0x8003C16A 0x8003CF6A 0x8003DD6A 0x8003EB6A 0x8003F96A 0x8004076A 0x8004156A 0x8004236A 0x8004316A 0x80043F6A 0x80044D6A 0x80045B6A 0x8004696A 0x8004776A 0x8004856A 0x8004936A 0x8004A16A 0x8004AF6A 0x8004BD6A 0x8004CB6A 0x8004D96A 0x8004E76A /end VAR_ADDRESS
 /end VAR_CHARACTERISTIC
 /begin VAR_CHARACTERISTIC TP_U8ETCSCpLwAxlAccTh EngCalVariantCriterion
  /begin VAR_ADDRESS 0x8003A56B 0x8003B36B 0x8003C16B 0x8003CF6B 0x8003DD6B 0x8003EB6B 0x8003F96B 0x8004076B 0x8004156B 0x8004236B 0x8004316B 0x80043F6B 0x80044D6B 0x80045B6B 0x8004696B 0x8004776B 0x8004856B 0x8004936B 0x8004A16B 0x8004AF6B 0x8004BD6B 0x8004CB6B 0x8004D96B 0x8004E76B /end VAR_ADDRESS
 /end VAR_CHARACTERISTIC
 /begin VAR_CHARACTERISTIC TP_U8ETCSCpLwSpnHldCntTh[0] EngCalVariantCriterion
  /begin VAR_ADDRESS 0x8003A56C 0x8003B36C 0x8003C16C 0x8003CF6C 0x8003DD6C 0x8003EB6C 0x8003F96C 0x8004076C 0x8004156C 0x8004236C 0x8004316C 0x80043F6C 0x80044D6C 0x80045B6C 0x8004696C 0x8004776C 0x8004856C 0x8004936C 0x8004A16C 0x8004AF6C 0x8004BD6C 0x8004CB6C 0x8004D96C 0x8004E76C /end VAR_ADDRESS
 /end VAR_CHARACTERISTIC
 /begin VAR_CHARACTERISTIC TP_U8ETCSCpLwSpnHldCntTh[1] EngCalVariantCriterion
  /begin VAR_ADDRESS 0x8003A56D 0x8003B36D 0x8003C16D 0x8003CF6D 0x8003DD6D 0x8003EB6D 0x8003F96D 0x8004076D 0x8004156D 0x8004236D 0x8004316D 0x80043F6D 0x80044D6D 0x80045B6D 0x8004696D 0x8004776D 0x8004856D 0x8004936D 0x8004A16D 0x8004AF6D 0x8004BD6D 0x8004CB6D 0x8004D96D 0x8004E76D /end VAR_ADDRESS
 /end VAR_CHARACTERISTIC
 /begin VAR_CHARACTERISTIC TP_U8ETCSCpLwSpnHldCntTh[2] EngCalVariantCriterion
  /begin VAR_ADDRESS 0x8003A56E 0x8003B36E 0x8003C16E 0x8003CF6E 0x8003DD6E 0x8003EB6E 0x8003F96E 0x8004076E 0x8004156E 0x8004236E 0x8004316E 0x80043F6E 0x80044D6E 0x80045B6E 0x8004696E 0x8004776E 0x8004856E 0x8004936E 0x8004A16E 0x8004AF6E 0x8004BD6E 0x8004CB6E 0x8004D96E 0x8004E76E /end VAR_ADDRESS
 /end VAR_CHARACTERISTIC
 /begin VAR_CHARACTERISTIC TP_U8ETCSCpLwToHiDetAreaCnt EngCalVariantCriterion
  /begin VAR_ADDRESS 0x8003A56F 0x8003B36F 0x8003C16F 0x8003CF6F 0x8003DD6F 0x8003EB6F 0x8003F96F 0x8004076F 0x8004156F 0x8004236F 0x8004316F 0x80043F6F 0x80044D6F 0x80045B6F 0x8004696F 0x8004776F 0x8004856F 0x8004936F 0x8004A16F 0x8004AF6F 0x8004BD6F 0x8004CB6F 0x8004D96F 0x8004E76F /end VAR_ADDRESS
 /end VAR_CHARACTERISTIC
 /begin VAR_CHARACTERISTIC TP_U8ETCSCpLwToHiDetCnt EngCalVariantCriterion
  /begin VAR_ADDRESS 0x8003A570 0x8003B370 0x8003C170 0x8003CF70 0x8003DD70 0x8003EB70 0x8003F970 0x80040770 0x80041570 0x80042370 0x80043170 0x80043F70 0x80044D70 0x80045B70 0x80046970 0x80047770 0x80048570 0x80049370 0x8004A170 0x8004AF70 0x8004BD70 0x8004CB70 0x8004D970 0x8004E770 /end VAR_ADDRESS
 /end VAR_CHARACTERISTIC
 /begin VAR_CHARACTERISTIC TP_U8ETCSCpLwWhlSpnTh2ClrCyl1st EngCalVariantCriterion
  /begin VAR_ADDRESS 0x8003A571 0x8003B371 0x8003C171 0x8003CF71 0x8003DD71 0x8003EB71 0x8003F971 0x80040771 0x80041571 0x80042371 0x80043171 0x80043F71 0x80044D71 0x80045B71 0x80046971 0x80047771 0x80048571 0x80049371 0x8004A171 0x8004AF71 0x8004BD71 0x8004CB71 0x8004D971 0x8004E771 /end VAR_ADDRESS
 /end VAR_CHARACTERISTIC
 /begin VAR_CHARACTERISTIC TP_U8ETCSCpMaxTrqFct4FunLamp EngCalVariantCriterion
  /begin VAR_ADDRESS 0x8003A572 0x8003B372 0x8003C172 0x8003CF72 0x8003DD72 0x8003EB72 0x8003F972 0x80040772 0x80041572 0x80042372 0x80043172 0x80043F72 0x80044D72 0x80045B72 0x80046972 0x80047772 0x80048572 0x80049372 0x8004A172 0x8004AF72 0x8004BD72 0x8004CB72 0x8004D972 0x8004E772 /end VAR_ADDRESS
 /end VAR_CHARACTERISTIC
 /begin VAR_CHARACTERISTIC TP_U8ETCSCpMinTarSpn EngCalVariantCriterion
  /begin VAR_ADDRESS 0x8003A573 0x8003B373 0x8003C173 0x8003CF73 0x8003DD73 0x8003EB73 0x8003F973 0x80040773 0x80041573 0x80042373 0x80043173 0x80043F73 0x80044D73 0x80045B73 0x80046973 0x80047773 0x80048573 0x80049373 0x8004A173 0x8004AF73 0x8004BD73 0x8004CB73 0x8004D973 0x8004E773 /end VAR_ADDRESS
 /end VAR_CHARACTERISTIC
 /begin VAR_CHARACTERISTIC TP_U8ETCSCpMovWinLen EngCalVariantCriterion
  /begin VAR_ADDRESS 0x8003A574 0x8003B374 0x8003C174 0x8003CF74 0x8003DD74 0x8003EB74 0x8003F974 0x80040774 0x80041574 0x80042374 0x80043174 0x80043F74 0x80044D74 0x80045B74 0x80046974 0x80047774 0x80048574 0x80049374 0x8004A174 0x8004AF74 0x8004BD74 0x8004CB74 0x8004D974 0x8004E774 /end VAR_ADDRESS
 /end VAR_CHARACTERISTIC
 /begin VAR_CHARACTERISTIC TP_U8ETCSCpNAlwAddTar4DepSnwSpd EngCalVariantCriterion
  /begin VAR_ADDRESS 0x8003A575 0x8003B375 0x8003C175 0x8003CF75 0x8003DD75 0x8003EB75 0x8003F975 0x80040775 0x80041575 0x80042375 0x80043175 0x80043F75 0x80044D75 0x80045B75 0x80046975 0x80047775 0x80048575 0x80049375 0x8004A175 0x8004AF75 0x8004BD75 0x8004CB75 0x8004D975 0x8004E775 /end VAR_ADDRESS
 /end VAR_CHARACTERISTIC
 /begin VAR_CHARACTERISTIC TP_U8ETCSCpNegErrIgainSplt[0] EngCalVariantCriterion
  /begin VAR_ADDRESS 0x8003A586 0x8003B386 0x8003C186 0x8003CF86 0x8003DD86 0x8003EB86 0x8003F986 0x80040786 0x80041586 0x80042386 0x80043186 0x80043F86 0x80044D86 0x80045B86 0x80046986 0x80047786 0x80048586 0x80049386 0x8004A186 0x8004AF86 0x8004BD86 0x8004CB86 0x8004D986 0x8004E786 /end VAR_ADDRESS
 /end VAR_CHARACTERISTIC
 /begin VAR_CHARACTERISTIC TP_U8ETCSCpNegErrIgainSplt[1] EngCalVariantCriterion
  /begin VAR_ADDRESS 0x8003A587 0x8003B387 0x8003C187 0x8003CF87 0x8003DD87 0x8003EB87 0x8003F987 0x80040787 0x80041587 0x80042387 0x80043187 0x80043F87 0x80044D87 0x80045B87 0x80046987 0x80047787 0x80048587 0x80049387 0x8004A187 0x8004AF87 0x8004BD87 0x8004CB87 0x8004D987 0x8004E787 /end VAR_ADDRESS
 /end VAR_CHARACTERISTIC
 /begin VAR_CHARACTERISTIC TP_U8ETCSCpNegErrIgainSplt[2] EngCalVariantCriterion
  /begin VAR_ADDRESS 0x8003A588 0x8003B388 0x8003C188 0x8003CF88 0x8003DD88 0x8003EB88 0x8003F988 0x80040788 0x80041588 0x80042388 0x80043188 0x80043F88 0x80044D88 0x80045B88 0x80046988 0x80047788 0x80048588 0x80049388 0x8004A188 0x8004AF88 0x8004BD88 0x8004CB88 0x8004D988 0x8004E788 /end VAR_ADDRESS
 /end VAR_CHARACTERISTIC
 /begin VAR_CHARACTERISTIC TP_U8ETCSCpNegErrIgainSplt[3] EngCalVariantCriterion
  /begin VAR_ADDRESS 0x8003A589 0x8003B389 0x8003C189 0x8003CF89 0x8003DD89 0x8003EB89 0x8003F989 0x80040789 0x80041589 0x80042389 0x80043189 0x80043F89 0x80044D89 0x80045B89 0x80046989 0x80047789 0x80048589 0x80049389 0x8004A189 0x8004AF89 0x8004BD89 0x8004CB89 0x8004D989 0x8004E789 /end VAR_ADDRESS
 /end VAR_CHARACTERISTIC
 /begin VAR_CHARACTERISTIC TP_U8ETCSCpNegErrIgainSplt[4] EngCalVariantCriterion
  /begin VAR_ADDRESS 0x8003A58A 0x8003B38A 0x8003C18A 0x8003CF8A 0x8003DD8A 0x8003EB8A 0x8003F98A 0x8004078A 0x8004158A 0x8004238A 0x8004318A 0x80043F8A 0x80044D8A 0x80045B8A 0x8004698A 0x8004778A 0x8004858A 0x8004938A 0x8004A18A 0x8004AF8A 0x8004BD8A 0x8004CB8A 0x8004D98A 0x8004E78A /end VAR_ADDRESS
 /end VAR_CHARACTERISTIC
 /begin VAR_CHARACTERISTIC TP_U8ETCSCpNegErrIgain[0][0] EngCalVariantCriterion
  /begin VAR_ADDRESS 0x8003A576 0x8003B376 0x8003C176 0x8003CF76 0x8003DD76 0x8003EB76 0x8003F976 0x80040776 0x80041576 0x80042376 0x80043176 0x80043F76 0x80044D76 0x80045B76 0x80046976 0x80047776 0x80048576 0x80049376 0x8004A176 0x8004AF76 0x8004BD76 0x8004CB76 0x8004D976 0x8004E776 /end VAR_ADDRESS
 /end VAR_CHARACTERISTIC
 /begin VAR_CHARACTERISTIC TP_U8ETCSCpNegErrIgain[0][1] EngCalVariantCriterion
  /begin VAR_ADDRESS 0x8003A577 0x8003B377 0x8003C177 0x8003CF77 0x8003DD77 0x8003EB77 0x8003F977 0x80040777 0x80041577 0x80042377 0x80043177 0x80043F77 0x80044D77 0x80045B77 0x80046977 0x80047777 0x80048577 0x80049377 0x8004A177 0x8004AF77 0x8004BD77 0x8004CB77 0x8004D977 0x8004E777 /end VAR_ADDRESS
 /end VAR_CHARACTERISTIC
 /begin VAR_CHARACTERISTIC TP_U8ETCSCpNegErrIgain[0][2] EngCalVariantCriterion
  /begin VAR_ADDRESS 0x8003A578 0x8003B378 0x8003C178 0x8003CF78 0x8003DD78 0x8003EB78 0x8003F978 0x80040778 0x80041578 0x80042378 0x80043178 0x80043F78 0x80044D78 0x80045B78 0x80046978 0x80047778 0x80048578 0x80049378 0x8004A178 0x8004AF78 0x8004BD78 0x8004CB78 0x8004D978 0x8004E778 /end VAR_ADDRESS
 /end VAR_CHARACTERISTIC
 /begin VAR_CHARACTERISTIC TP_U8ETCSCpNegErrIgain[0][3] EngCalVariantCriterion
  /begin VAR_ADDRESS 0x8003A579 0x8003B379 0x8003C179 0x8003CF79 0x8003DD79 0x8003EB79 0x8003F979 0x80040779 0x80041579 0x80042379 0x80043179 0x80043F79 0x80044D79 0x80045B79 0x80046979 0x80047779 0x80048579 0x80049379 0x8004A179 0x8004AF79 0x8004BD79 0x8004CB79 0x8004D979 0x8004E779 /end VAR_ADDRESS
 /end VAR_CHARACTERISTIC
 /begin VAR_CHARACTERISTIC TP_U8ETCSCpNegErrIgain[0][4] EngCalVariantCriterion
  /begin VAR_ADDRESS 0x8003A57A 0x8003B37A 0x8003C17A 0x8003CF7A 0x8003DD7A 0x8003EB7A 0x8003F97A 0x8004077A 0x8004157A 0x8004237A 0x8004317A 0x80043F7A 0x80044D7A 0x80045B7A 0x8004697A 0x8004777A 0x8004857A 0x8004937A 0x8004A17A 0x8004AF7A 0x8004BD7A 0x8004CB7A 0x8004D97A 0x8004E77A /end VAR_ADDRESS
 /end VAR_CHARACTERISTIC
 /begin VAR_CHARACTERISTIC TP_U8ETCSCpNegErrIgain[1][0] EngCalVariantCriterion
  /begin VAR_ADDRESS 0x8003A57B 0x8003B37B 0x8003C17B 0x8003CF7B 0x8003DD7B 0x8003EB7B 0x8003F97B 0x8004077B 0x8004157B 0x8004237B 0x8004317B 0x80043F7B 0x80044D7B 0x80045B7B 0x8004697B 0x8004777B 0x8004857B 0x8004937B 0x8004A17B 0x8004AF7B 0x8004BD7B 0x8004CB7B 0x8004D97B 0x8004E77B /end VAR_ADDRESS
 /end VAR_CHARACTERISTIC
 /begin VAR_CHARACTERISTIC TP_U8ETCSCpNegErrIgain[1][1] EngCalVariantCriterion
  /begin VAR_ADDRESS 0x8003A57C 0x8003B37C 0x8003C17C 0x8003CF7C 0x8003DD7C 0x8003EB7C 0x8003F97C 0x8004077C 0x8004157C 0x8004237C 0x8004317C 0x80043F7C 0x80044D7C 0x80045B7C 0x8004697C 0x8004777C 0x8004857C 0x8004937C 0x8004A17C 0x8004AF7C 0x8004BD7C 0x8004CB7C 0x8004D97C 0x8004E77C /end VAR_ADDRESS
 /end VAR_CHARACTERISTIC
 /begin VAR_CHARACTERISTIC TP_U8ETCSCpNegErrIgain[1][2] EngCalVariantCriterion
  /begin VAR_ADDRESS 0x8003A57D 0x8003B37D 0x8003C17D 0x8003CF7D 0x8003DD7D 0x8003EB7D 0x8003F97D 0x8004077D 0x8004157D 0x8004237D 0x8004317D 0x80043F7D 0x80044D7D 0x80045B7D 0x8004697D 0x8004777D 0x8004857D 0x8004937D 0x8004A17D 0x8004AF7D 0x8004BD7D 0x8004CB7D 0x8004D97D 0x8004E77D /end VAR_ADDRESS
 /end VAR_CHARACTERISTIC
 /begin VAR_CHARACTERISTIC TP_U8ETCSCpNegErrIgain[1][3] EngCalVariantCriterion
  /begin VAR_ADDRESS 0x8003A57E 0x8003B37E 0x8003C17E 0x8003CF7E 0x8003DD7E 0x8003EB7E 0x8003F97E 0x8004077E 0x8004157E 0x8004237E 0x8004317E 0x80043F7E 0x80044D7E 0x80045B7E 0x8004697E 0x8004777E 0x8004857E 0x8004937E 0x8004A17E 0x8004AF7E 0x8004BD7E 0x8004CB7E 0x8004D97E 0x8004E77E /end VAR_ADDRESS
 /end VAR_CHARACTERISTIC
 /begin VAR_CHARACTERISTIC TP_U8ETCSCpNegErrIgain[1][4] EngCalVariantCriterion
  /begin VAR_ADDRESS 0x8003A57F 0x8003B37F 0x8003C17F 0x8003CF7F 0x8003DD7F 0x8003EB7F 0x8003F97F 0x8004077F 0x8004157F 0x8004237F 0x8004317F 0x80043F7F 0x80044D7F 0x80045B7F 0x8004697F 0x8004777F 0x8004857F 0x8004937F 0x8004A17F 0x8004AF7F 0x8004BD7F 0x8004CB7F 0x8004D97F 0x8004E77F /end VAR_ADDRESS
 /end VAR_CHARACTERISTIC
 /begin VAR_CHARACTERISTIC TP_U8ETCSCpNegErrIgain[2][0] EngCalVariantCriterion
  /begin VAR_ADDRESS 0x8003A580 0x8003B380 0x8003C180 0x8003CF80 0x8003DD80 0x8003EB80 0x8003F980 0x80040780 0x80041580 0x80042380 0x80043180 0x80043F80 0x80044D80 0x80045B80 0x80046980 0x80047780 0x80048580 0x80049380 0x8004A180 0x8004AF80 0x8004BD80 0x8004CB80 0x8004D980 0x8004E780 /end VAR_ADDRESS
 /end VAR_CHARACTERISTIC
 /begin VAR_CHARACTERISTIC TP_U8ETCSCpNegErrIgain[2][1] EngCalVariantCriterion
  /begin VAR_ADDRESS 0x8003A581 0x8003B381 0x8003C181 0x8003CF81 0x8003DD81 0x8003EB81 0x8003F981 0x80040781 0x80041581 0x80042381 0x80043181 0x80043F81 0x80044D81 0x80045B81 0x80046981 0x80047781 0x80048581 0x80049381 0x8004A181 0x8004AF81 0x8004BD81 0x8004CB81 0x8004D981 0x8004E781 /end VAR_ADDRESS
 /end VAR_CHARACTERISTIC
 /begin VAR_CHARACTERISTIC TP_U8ETCSCpNegErrIgain[2][2] EngCalVariantCriterion
  /begin VAR_ADDRESS 0x8003A582 0x8003B382 0x8003C182 0x8003CF82 0x8003DD82 0x8003EB82 0x8003F982 0x80040782 0x80041582 0x80042382 0x80043182 0x80043F82 0x80044D82 0x80045B82 0x80046982 0x80047782 0x80048582 0x80049382 0x8004A182 0x8004AF82 0x8004BD82 0x8004CB82 0x8004D982 0x8004E782 /end VAR_ADDRESS
 /end VAR_CHARACTERISTIC
 /begin VAR_CHARACTERISTIC TP_U8ETCSCpNegErrIgain[2][3] EngCalVariantCriterion
  /begin VAR_ADDRESS 0x8003A583 0x8003B383 0x8003C183 0x8003CF83 0x8003DD83 0x8003EB83 0x8003F983 0x80040783 0x80041583 0x80042383 0x80043183 0x80043F83 0x80044D83 0x80045B83 0x80046983 0x80047783 0x80048583 0x80049383 0x8004A183 0x8004AF83 0x8004BD83 0x8004CB83 0x8004D983 0x8004E783 /end VAR_ADDRESS
 /end VAR_CHARACTERISTIC
 /begin VAR_CHARACTERISTIC TP_U8ETCSCpNegErrIgain[2][4] EngCalVariantCriterion
  /begin VAR_ADDRESS 0x8003A584 0x8003B384 0x8003C184 0x8003CF84 0x8003DD84 0x8003EB84 0x8003F984 0x80040784 0x80041584 0x80042384 0x80043184 0x80043F84 0x80044D84 0x80045B84 0x80046984 0x80047784 0x80048584 0x80049384 0x8004A184 0x8004AF84 0x8004BD84 0x8004CB84 0x8004D984 0x8004E784 /end VAR_ADDRESS
 /end VAR_CHARACTERISTIC
 /begin VAR_CHARACTERISTIC TP_U8ETCSCpNegErrIgain_R EngCalVariantCriterion
  /begin VAR_ADDRESS 0x8003A585 0x8003B385 0x8003C185 0x8003CF85 0x8003DD85 0x8003EB85 0x8003F985 0x80040785 0x80041585 0x80042385 0x80043185 0x80043F85 0x80044D85 0x80045B85 0x80046985 0x80047785 0x80048585 0x80049385 0x8004A185 0x8004AF85 0x8004BD85 0x8004CB85 0x8004D985 0x8004E785 /end VAR_ADDRESS
 /end VAR_CHARACTERISTIC
 /begin VAR_CHARACTERISTIC TP_U8ETCSCpNegErrPgainSplt[0] EngCalVariantCriterion
  /begin VAR_ADDRESS 0x8003A59B 0x8003B39B 0x8003C19B 0x8003CF9B 0x8003DD9B 0x8003EB9B 0x8003F99B 0x8004079B 0x8004159B 0x8004239B 0x8004319B 0x80043F9B 0x80044D9B 0x80045B9B 0x8004699B 0x8004779B 0x8004859B 0x8004939B 0x8004A19B 0x8004AF9B 0x8004BD9B 0x8004CB9B 0x8004D99B 0x8004E79B /end VAR_ADDRESS
 /end VAR_CHARACTERISTIC
 /begin VAR_CHARACTERISTIC TP_U8ETCSCpNegErrPgainSplt[1] EngCalVariantCriterion
  /begin VAR_ADDRESS 0x8003A59C 0x8003B39C 0x8003C19C 0x8003CF9C 0x8003DD9C 0x8003EB9C 0x8003F99C 0x8004079C 0x8004159C 0x8004239C 0x8004319C 0x80043F9C 0x80044D9C 0x80045B9C 0x8004699C 0x8004779C 0x8004859C 0x8004939C 0x8004A19C 0x8004AF9C 0x8004BD9C 0x8004CB9C 0x8004D99C 0x8004E79C /end VAR_ADDRESS
 /end VAR_CHARACTERISTIC
 /begin VAR_CHARACTERISTIC TP_U8ETCSCpNegErrPgainSplt[2] EngCalVariantCriterion
  /begin VAR_ADDRESS 0x8003A59D 0x8003B39D 0x8003C19D 0x8003CF9D 0x8003DD9D 0x8003EB9D 0x8003F99D 0x8004079D 0x8004159D 0x8004239D 0x8004319D 0x80043F9D 0x80044D9D 0x80045B9D 0x8004699D 0x8004779D 0x8004859D 0x8004939D 0x8004A19D 0x8004AF9D 0x8004BD9D 0x8004CB9D 0x8004D99D 0x8004E79D /end VAR_ADDRESS
 /end VAR_CHARACTERISTIC
 /begin VAR_CHARACTERISTIC TP_U8ETCSCpNegErrPgainSplt[3] EngCalVariantCriterion
  /begin VAR_ADDRESS 0x8003A59E 0x8003B39E 0x8003C19E 0x8003CF9E 0x8003DD9E 0x8003EB9E 0x8003F99E 0x8004079E 0x8004159E 0x8004239E 0x8004319E 0x80043F9E 0x80044D9E 0x80045B9E 0x8004699E 0x8004779E 0x8004859E 0x8004939E 0x8004A19E 0x8004AF9E 0x8004BD9E 0x8004CB9E 0x8004D99E 0x8004E79E /end VAR_ADDRESS
 /end VAR_CHARACTERISTIC
 /begin VAR_CHARACTERISTIC TP_U8ETCSCpNegErrPgainSplt[4] EngCalVariantCriterion
  /begin VAR_ADDRESS 0x8003A59F 0x8003B39F 0x8003C19F 0x8003CF9F 0x8003DD9F 0x8003EB9F 0x8003F99F 0x8004079F 0x8004159F 0x8004239F 0x8004319F 0x80043F9F 0x80044D9F 0x80045B9F 0x8004699F 0x8004779F 0x8004859F 0x8004939F 0x8004A19F 0x8004AF9F 0x8004BD9F 0x8004CB9F 0x8004D99F 0x8004E79F /end VAR_ADDRESS
 /end VAR_CHARACTERISTIC
 /begin VAR_CHARACTERISTIC TP_U8ETCSCpNegErrPgain[0][0] EngCalVariantCriterion
  /begin VAR_ADDRESS 0x8003A58B 0x8003B38B 0x8003C18B 0x8003CF8B 0x8003DD8B 0x8003EB8B 0x8003F98B 0x8004078B 0x8004158B 0x8004238B 0x8004318B 0x80043F8B 0x80044D8B 0x80045B8B 0x8004698B 0x8004778B 0x8004858B 0x8004938B 0x8004A18B 0x8004AF8B 0x8004BD8B 0x8004CB8B 0x8004D98B 0x8004E78B /end VAR_ADDRESS
 /end VAR_CHARACTERISTIC
 /begin VAR_CHARACTERISTIC TP_U8ETCSCpNegErrPgain[0][1] EngCalVariantCriterion
  /begin VAR_ADDRESS 0x8003A58C 0x8003B38C 0x8003C18C 0x8003CF8C 0x8003DD8C 0x8003EB8C 0x8003F98C 0x8004078C 0x8004158C 0x8004238C 0x8004318C 0x80043F8C 0x80044D8C 0x80045B8C 0x8004698C 0x8004778C 0x8004858C 0x8004938C 0x8004A18C 0x8004AF8C 0x8004BD8C 0x8004CB8C 0x8004D98C 0x8004E78C /end VAR_ADDRESS
 /end VAR_CHARACTERISTIC
 /begin VAR_CHARACTERISTIC TP_U8ETCSCpNegErrPgain[0][2] EngCalVariantCriterion
  /begin VAR_ADDRESS 0x8003A58D 0x8003B38D 0x8003C18D 0x8003CF8D 0x8003DD8D 0x8003EB8D 0x8003F98D 0x8004078D 0x8004158D 0x8004238D 0x8004318D 0x80043F8D 0x80044D8D 0x80045B8D 0x8004698D 0x8004778D 0x8004858D 0x8004938D 0x8004A18D 0x8004AF8D 0x8004BD8D 0x8004CB8D 0x8004D98D 0x8004E78D /end VAR_ADDRESS
 /end VAR_CHARACTERISTIC
 /begin VAR_CHARACTERISTIC TP_U8ETCSCpNegErrPgain[0][3] EngCalVariantCriterion
  /begin VAR_ADDRESS 0x8003A58E 0x8003B38E 0x8003C18E 0x8003CF8E 0x8003DD8E 0x8003EB8E 0x8003F98E 0x8004078E 0x8004158E 0x8004238E 0x8004318E 0x80043F8E 0x80044D8E 0x80045B8E 0x8004698E 0x8004778E 0x8004858E 0x8004938E 0x8004A18E 0x8004AF8E 0x8004BD8E 0x8004CB8E 0x8004D98E 0x8004E78E /end VAR_ADDRESS
 /end VAR_CHARACTERISTIC
 /begin VAR_CHARACTERISTIC TP_U8ETCSCpNegErrPgain[0][4] EngCalVariantCriterion
  /begin VAR_ADDRESS 0x8003A58F 0x8003B38F 0x8003C18F 0x8003CF8F 0x8003DD8F 0x8003EB8F 0x8003F98F 0x8004078F 0x8004158F 0x8004238F 0x8004318F 0x80043F8F 0x80044D8F 0x80045B8F 0x8004698F 0x8004778F 0x8004858F 0x8004938F 0x8004A18F 0x8004AF8F 0x8004BD8F 0x8004CB8F 0x8004D98F 0x8004E78F /end VAR_ADDRESS
 /end VAR_CHARACTERISTIC
 /begin VAR_CHARACTERISTIC TP_U8ETCSCpNegErrPgain[1][0] EngCalVariantCriterion
  /begin VAR_ADDRESS 0x8003A590 0x8003B390 0x8003C190 0x8003CF90 0x8003DD90 0x8003EB90 0x8003F990 0x80040790 0x80041590 0x80042390 0x80043190 0x80043F90 0x80044D90 0x80045B90 0x80046990 0x80047790 0x80048590 0x80049390 0x8004A190 0x8004AF90 0x8004BD90 0x8004CB90 0x8004D990 0x8004E790 /end VAR_ADDRESS
 /end VAR_CHARACTERISTIC
 /begin VAR_CHARACTERISTIC TP_U8ETCSCpNegErrPgain[1][1] EngCalVariantCriterion
  /begin VAR_ADDRESS 0x8003A591 0x8003B391 0x8003C191 0x8003CF91 0x8003DD91 0x8003EB91 0x8003F991 0x80040791 0x80041591 0x80042391 0x80043191 0x80043F91 0x80044D91 0x80045B91 0x80046991 0x80047791 0x80048591 0x80049391 0x8004A191 0x8004AF91 0x8004BD91 0x8004CB91 0x8004D991 0x8004E791 /end VAR_ADDRESS
 /end VAR_CHARACTERISTIC
 /begin VAR_CHARACTERISTIC TP_U8ETCSCpNegErrPgain[1][2] EngCalVariantCriterion
  /begin VAR_ADDRESS 0x8003A592 0x8003B392 0x8003C192 0x8003CF92 0x8003DD92 0x8003EB92 0x8003F992 0x80040792 0x80041592 0x80042392 0x80043192 0x80043F92 0x80044D92 0x80045B92 0x80046992 0x80047792 0x80048592 0x80049392 0x8004A192 0x8004AF92 0x8004BD92 0x8004CB92 0x8004D992 0x8004E792 /end VAR_ADDRESS
 /end VAR_CHARACTERISTIC
 /begin VAR_CHARACTERISTIC TP_U8ETCSCpNegErrPgain[1][3] EngCalVariantCriterion
  /begin VAR_ADDRESS 0x8003A593 0x8003B393 0x8003C193 0x8003CF93 0x8003DD93 0x8003EB93 0x8003F993 0x80040793 0x80041593 0x80042393 0x80043193 0x80043F93 0x80044D93 0x80045B93 0x80046993 0x80047793 0x80048593 0x80049393 0x8004A193 0x8004AF93 0x8004BD93 0x8004CB93 0x8004D993 0x8004E793 /end VAR_ADDRESS
 /end VAR_CHARACTERISTIC
 /begin VAR_CHARACTERISTIC TP_U8ETCSCpNegErrPgain[1][4] EngCalVariantCriterion
  /begin VAR_ADDRESS 0x8003A594 0x8003B394 0x8003C194 0x8003CF94 0x8003DD94 0x8003EB94 0x8003F994 0x80040794 0x80041594 0x80042394 0x80043194 0x80043F94 0x80044D94 0x80045B94 0x80046994 0x80047794 0x80048594 0x80049394 0x8004A194 0x8004AF94 0x8004BD94 0x8004CB94 0x8004D994 0x8004E794 /end VAR_ADDRESS
 /end VAR_CHARACTERISTIC
 /begin VAR_CHARACTERISTIC TP_U8ETCSCpNegErrPgain[2][0] EngCalVariantCriterion
  /begin VAR_ADDRESS 0x8003A595 0x8003B395 0x8003C195 0x8003CF95 0x8003DD95 0x8003EB95 0x8003F995 0x80040795 0x80041595 0x80042395 0x80043195 0x80043F95 0x80044D95 0x80045B95 0x80046995 0x80047795 0x80048595 0x80049395 0x8004A195 0x8004AF95 0x8004BD95 0x8004CB95 0x8004D995 0x8004E795 /end VAR_ADDRESS
 /end VAR_CHARACTERISTIC
 /begin VAR_CHARACTERISTIC TP_U8ETCSCpNegErrPgain[2][1] EngCalVariantCriterion
  /begin VAR_ADDRESS 0x8003A596 0x8003B396 0x8003C196 0x8003CF96 0x8003DD96 0x8003EB96 0x8003F996 0x80040796 0x80041596 0x80042396 0x80043196 0x80043F96 0x80044D96 0x80045B96 0x80046996 0x80047796 0x80048596 0x80049396 0x8004A196 0x8004AF96 0x8004BD96 0x8004CB96 0x8004D996 0x8004E796 /end VAR_ADDRESS
 /end VAR_CHARACTERISTIC
 /begin VAR_CHARACTERISTIC TP_U8ETCSCpNegErrPgain[2][2] EngCalVariantCriterion
  /begin VAR_ADDRESS 0x8003A597 0x8003B397 0x8003C197 0x8003CF97 0x8003DD97 0x8003EB97 0x8003F997 0x80040797 0x80041597 0x80042397 0x80043197 0x80043F97 0x80044D97 0x80045B97 0x80046997 0x80047797 0x80048597 0x80049397 0x8004A197 0x8004AF97 0x8004BD97 0x8004CB97 0x8004D997 0x8004E797 /end VAR_ADDRESS
 /end VAR_CHARACTERISTIC
 /begin VAR_CHARACTERISTIC TP_U8ETCSCpNegErrPgain[2][3] EngCalVariantCriterion
  /begin VAR_ADDRESS 0x8003A598 0x8003B398 0x8003C198 0x8003CF98 0x8003DD98 0x8003EB98 0x8003F998 0x80040798 0x80041598 0x80042398 0x80043198 0x80043F98 0x80044D98 0x80045B98 0x80046998 0x80047798 0x80048598 0x80049398 0x8004A198 0x8004AF98 0x8004BD98 0x8004CB98 0x8004D998 0x8004E798 /end VAR_ADDRESS
 /end VAR_CHARACTERISTIC
 /begin VAR_CHARACTERISTIC TP_U8ETCSCpNegErrPgain[2][4] EngCalVariantCriterion
  /begin VAR_ADDRESS 0x8003A599 0x8003B399 0x8003C199 0x8003CF99 0x8003DD99 0x8003EB99 0x8003F999 0x80040799 0x80041599 0x80042399 0x80043199 0x80043F99 0x80044D99 0x80045B99 0x80046999 0x80047799 0x80048599 0x80049399 0x8004A199 0x8004AF99 0x8004BD99 0x8004CB99 0x8004D999 0x8004E799 /end VAR_ADDRESS
 /end VAR_CHARACTERISTIC
 /begin VAR_CHARACTERISTIC TP_U8ETCSCpNegErrPgain_R EngCalVariantCriterion
  /begin VAR_ADDRESS 0x8003A59A 0x8003B39A 0x8003C19A 0x8003CF9A 0x8003DD9A 0x8003EB9A 0x8003F99A 0x8004079A 0x8004159A 0x8004239A 0x8004319A 0x80043F9A 0x80044D9A 0x80045B9A 0x8004699A 0x8004779A 0x8004859A 0x8004939A 0x8004A19A 0x8004AF9A 0x8004BD9A 0x8004CB9A 0x8004D99A 0x8004E79A /end VAR_ADDRESS
 /end VAR_CHARACTERISTIC
 /begin VAR_CHARACTERISTIC TP_U8ETCSCpNoSpnTh EngCalVariantCriterion
  /begin VAR_ADDRESS 0x8003A5A0 0x8003B3A0 0x8003C1A0 0x8003CFA0 0x8003DDA0 0x8003EBA0 0x8003F9A0 0x800407A0 0x800415A0 0x800423A0 0x800431A0 0x80043FA0 0x80044DA0 0x80045BA0 0x800469A0 0x800477A0 0x800485A0 0x800493A0 0x8004A1A0 0x8004AFA0 0x8004BDA0 0x8004CBA0 0x8004D9A0 0x8004E7A0 /end VAR_ADDRESS
 /end VAR_CHARACTERISTIC
 /begin VAR_CHARACTERISTIC TP_U8ETCSCpOffsetFct4FunLamp EngCalVariantCriterion
  /begin VAR_ADDRESS 0x8003A5A1 0x8003B3A1 0x8003C1A1 0x8003CFA1 0x8003DDA1 0x8003EBA1 0x8003F9A1 0x800407A1 0x800415A1 0x800423A1 0x800431A1 0x80043FA1 0x80044DA1 0x80045BA1 0x800469A1 0x800477A1 0x800485A1 0x800493A1 0x8004A1A1 0x8004AFA1 0x8004BDA1 0x8004CBA1 0x8004D9A1 0x8004E7A1 /end VAR_ADDRESS
 /end VAR_CHARACTERISTIC
 /begin VAR_CHARACTERISTIC TP_U8ETCSCpOvrStrLmtCrngEnbl EngCalVariantCriterion
  /begin VAR_ADDRESS 0x8003A5A2 0x8003B3A2 0x8003C1A2 0x8003CFA2 0x8003DDA2 0x8003EBA2 0x8003F9A2 0x800407A2 0x800415A2 0x800423A2 0x800431A2 0x80043FA2 0x80044DA2 0x80045BA2 0x800469A2 0x800477A2 0x800485A2 0x800493A2 0x8004A1A2 0x8004AFA2 0x8004BDA2 0x8004CBA2 0x8004D9A2 0x8004E7A2 /end VAR_ADDRESS
 /end VAR_CHARACTERISTIC
 /begin VAR_CHARACTERISTIC TP_U8ETCSCpOvrStrTrgSpnDecEnbl EngCalVariantCriterion
  /begin VAR_ADDRESS 0x8003A5A3 0x8003B3A3 0x8003C1A3 0x8003CFA3 0x8003DDA3 0x8003EBA3 0x8003F9A3 0x800407A3 0x800415A3 0x800423A3 0x800431A3 0x80043FA3 0x80044DA3 0x80045BA3 0x800469A3 0x800477A3 0x800485A3 0x800493A3 0x8004A1A3 0x8004AFA3 0x8004BDA3 0x8004CBA3 0x8004D9A3 0x8004E7A3 /end VAR_ADDRESS
 /end VAR_CHARACTERISTIC
 /begin VAR_CHARACTERISTIC TP_U8ETCSCpPGainIncFacH2L EngCalVariantCriterion
  /begin VAR_ADDRESS 0x8003A5A4 0x8003B3A4 0x8003C1A4 0x8003CFA4 0x8003DDA4 0x8003EBA4 0x8003F9A4 0x800407A4 0x800415A4 0x800423A4 0x800431A4 0x80043FA4 0x80044DA4 0x80045BA4 0x800469A4 0x800477A4 0x800485A4 0x800493A4 0x8004A1A4 0x8004AFA4 0x8004BDA4 0x8004CBA4 0x8004D9A4 0x8004E7A4 /end VAR_ADDRESS
 /end VAR_CHARACTERISTIC
 /begin VAR_CHARACTERISTIC TP_U8ETCSCpPgFacGrChgErrNeg[0] EngCalVariantCriterion
  /begin VAR_ADDRESS 0x8003A5A5 0x8003B3A5 0x8003C1A5 0x8003CFA5 0x8003DDA5 0x8003EBA5 0x8003F9A5 0x800407A5 0x800415A5 0x800423A5 0x800431A5 0x80043FA5 0x80044DA5 0x80045BA5 0x800469A5 0x800477A5 0x800485A5 0x800493A5 0x8004A1A5 0x8004AFA5 0x8004BDA5 0x8004CBA5 0x8004D9A5 0x8004E7A5 /end VAR_ADDRESS
 /end VAR_CHARACTERISTIC
 /begin VAR_CHARACTERISTIC TP_U8ETCSCpPgFacGrChgErrNeg[1] EngCalVariantCriterion
  /begin VAR_ADDRESS 0x8003A5A6 0x8003B3A6 0x8003C1A6 0x8003CFA6 0x8003DDA6 0x8003EBA6 0x8003F9A6 0x800407A6 0x800415A6 0x800423A6 0x800431A6 0x80043FA6 0x80044DA6 0x80045BA6 0x800469A6 0x800477A6 0x800485A6 0x800493A6 0x8004A1A6 0x8004AFA6 0x8004BDA6 0x8004CBA6 0x8004D9A6 0x8004E7A6 /end VAR_ADDRESS
 /end VAR_CHARACTERISTIC
 /begin VAR_CHARACTERISTIC TP_U8ETCSCpPgFacGrChgErrNeg[2] EngCalVariantCriterion
  /begin VAR_ADDRESS 0x8003A5A7 0x8003B3A7 0x8003C1A7 0x8003CFA7 0x8003DDA7 0x8003EBA7 0x8003F9A7 0x800407A7 0x800415A7 0x800423A7 0x800431A7 0x80043FA7 0x80044DA7 0x80045BA7 0x800469A7 0x800477A7 0x800485A7 0x800493A7 0x8004A1A7 0x8004AFA7 0x8004BDA7 0x8004CBA7 0x8004D9A7 0x8004E7A7 /end VAR_ADDRESS
 /end VAR_CHARACTERISTIC
 /begin VAR_CHARACTERISTIC TP_U8ETCSCpPgFacGrChgErrNeg[3] EngCalVariantCriterion
  /begin VAR_ADDRESS 0x8003A5A8 0x8003B3A8 0x8003C1A8 0x8003CFA8 0x8003DDA8 0x8003EBA8 0x8003F9A8 0x800407A8 0x800415A8 0x800423A8 0x800431A8 0x80043FA8 0x80044DA8 0x80045BA8 0x800469A8 0x800477A8 0x800485A8 0x800493A8 0x8004A1A8 0x8004AFA8 0x8004BDA8 0x8004CBA8 0x8004D9A8 0x8004E7A8 /end VAR_ADDRESS
 /end VAR_CHARACTERISTIC
 /begin VAR_CHARACTERISTIC TP_U8ETCSCpPgFacGrChgErrNeg[4] EngCalVariantCriterion
  /begin VAR_ADDRESS 0x8003A5A9 0x8003B3A9 0x8003C1A9 0x8003CFA9 0x8003DDA9 0x8003EBA9 0x8003F9A9 0x800407A9 0x800415A9 0x800423A9 0x800431A9 0x80043FA9 0x80044DA9 0x80045BA9 0x800469A9 0x800477A9 0x800485A9 0x800493A9 0x8004A1A9 0x8004AFA9 0x8004BDA9 0x8004CBA9 0x8004D9A9 0x8004E7A9 /end VAR_ADDRESS
 /end VAR_CHARACTERISTIC
 /begin VAR_CHARACTERISTIC TP_U8ETCSCpPgFacGrChgErrPos[0] EngCalVariantCriterion
  /begin VAR_ADDRESS 0x8003A5AA 0x8003B3AA 0x8003C1AA 0x8003CFAA 0x8003DDAA 0x8003EBAA 0x8003F9AA 0x800407AA 0x800415AA 0x800423AA 0x800431AA 0x80043FAA 0x80044DAA 0x80045BAA 0x800469AA 0x800477AA 0x800485AA 0x800493AA 0x8004A1AA 0x8004AFAA 0x8004BDAA 0x8004CBAA 0x8004D9AA 0x8004E7AA /end VAR_ADDRESS
 /end VAR_CHARACTERISTIC
 /begin VAR_CHARACTERISTIC TP_U8ETCSCpPgFacGrChgErrPos[1] EngCalVariantCriterion
  /begin VAR_ADDRESS 0x8003A5AB 0x8003B3AB 0x8003C1AB 0x8003CFAB 0x8003DDAB 0x8003EBAB 0x8003F9AB 0x800407AB 0x800415AB 0x800423AB 0x800431AB 0x80043FAB 0x80044DAB 0x80045BAB 0x800469AB 0x800477AB 0x800485AB 0x800493AB 0x8004A1AB 0x8004AFAB 0x8004BDAB 0x8004CBAB 0x8004D9AB 0x8004E7AB /end VAR_ADDRESS
 /end VAR_CHARACTERISTIC
 /begin VAR_CHARACTERISTIC TP_U8ETCSCpPgFacGrChgErrPos[2] EngCalVariantCriterion
  /begin VAR_ADDRESS 0x8003A5AC 0x8003B3AC 0x8003C1AC 0x8003CFAC 0x8003DDAC 0x8003EBAC 0x8003F9AC 0x800407AC 0x800415AC 0x800423AC 0x800431AC 0x80043FAC 0x80044DAC 0x80045BAC 0x800469AC 0x800477AC 0x800485AC 0x800493AC 0x8004A1AC 0x8004AFAC 0x8004BDAC 0x8004CBAC 0x8004D9AC 0x8004E7AC /end VAR_ADDRESS
 /end VAR_CHARACTERISTIC
 /begin VAR_CHARACTERISTIC TP_U8ETCSCpPgFacGrChgErrPos[3] EngCalVariantCriterion
  /begin VAR_ADDRESS 0x8003A5AD 0x8003B3AD 0x8003C1AD 0x8003CFAD 0x8003DDAD 0x8003EBAD 0x8003F9AD 0x800407AD 0x800415AD 0x800423AD 0x800431AD 0x80043FAD 0x80044DAD 0x80045BAD 0x800469AD 0x800477AD 0x800485AD 0x800493AD 0x8004A1AD 0x8004AFAD 0x8004BDAD 0x8004CBAD 0x8004D9AD 0x8004E7AD /end VAR_ADDRESS
 /end VAR_CHARACTERISTIC
 /begin VAR_CHARACTERISTIC TP_U8ETCSCpPgFacGrChgErrPos[4] EngCalVariantCriterion
  /begin VAR_ADDRESS 0x8003A5AE 0x8003B3AE 0x8003C1AE 0x8003CFAE 0x8003DDAE 0x8003EBAE 0x8003F9AE 0x800407AE 0x800415AE 0x800423AE 0x800431AE 0x80043FAE 0x80044DAE 0x80045BAE 0x800469AE 0x800477AE 0x800485AE 0x800493AE 0x8004A1AE 0x8004AFAE 0x8004BDAE 0x8004CBAE 0x8004D9AE 0x8004E7AE /end VAR_ADDRESS
 /end VAR_CHARACTERISTIC
 /begin VAR_CHARACTERISTIC TP_U8ETCSCpPgFacInTrn[0][0] EngCalVariantCriterion
  /begin VAR_ADDRESS 0x8003A5AF 0x8003B3AF 0x8003C1AF 0x8003CFAF 0x8003DDAF 0x8003EBAF 0x8003F9AF 0x800407AF 0x800415AF 0x800423AF 0x800431AF 0x80043FAF 0x80044DAF 0x80045BAF 0x800469AF 0x800477AF 0x800485AF 0x800493AF 0x8004A1AF 0x8004AFAF 0x8004BDAF 0x8004CBAF 0x8004D9AF 0x8004E7AF /end VAR_ADDRESS
 /end VAR_CHARACTERISTIC
 /begin VAR_CHARACTERISTIC TP_U8ETCSCpPgFacInTrn[0][1] EngCalVariantCriterion
  /begin VAR_ADDRESS 0x8003A5B0 0x8003B3B0 0x8003C1B0 0x8003CFB0 0x8003DDB0 0x8003EBB0 0x8003F9B0 0x800407B0 0x800415B0 0x800423B0 0x800431B0 0x80043FB0 0x80044DB0 0x80045BB0 0x800469B0 0x800477B0 0x800485B0 0x800493B0 0x8004A1B0 0x8004AFB0 0x8004BDB0 0x8004CBB0 0x8004D9B0 0x8004E7B0 /end VAR_ADDRESS
 /end VAR_CHARACTERISTIC
 /begin VAR_CHARACTERISTIC TP_U8ETCSCpPgFacInTrn[0][2] EngCalVariantCriterion
  /begin VAR_ADDRESS 0x8003A5B1 0x8003B3B1 0x8003C1B1 0x8003CFB1 0x8003DDB1 0x8003EBB1 0x8003F9B1 0x800407B1 0x800415B1 0x800423B1 0x800431B1 0x80043FB1 0x80044DB1 0x80045BB1 0x800469B1 0x800477B1 0x800485B1 0x800493B1 0x8004A1B1 0x8004AFB1 0x8004BDB1 0x8004CBB1 0x8004D9B1 0x8004E7B1 /end VAR_ADDRESS
 /end VAR_CHARACTERISTIC
 /begin VAR_CHARACTERISTIC TP_U8ETCSCpPgFacInTrn[0][3] EngCalVariantCriterion
  /begin VAR_ADDRESS 0x8003A5B2 0x8003B3B2 0x8003C1B2 0x8003CFB2 0x8003DDB2 0x8003EBB2 0x8003F9B2 0x800407B2 0x800415B2 0x800423B2 0x800431B2 0x80043FB2 0x80044DB2 0x80045BB2 0x800469B2 0x800477B2 0x800485B2 0x800493B2 0x8004A1B2 0x8004AFB2 0x8004BDB2 0x8004CBB2 0x8004D9B2 0x8004E7B2 /end VAR_ADDRESS
 /end VAR_CHARACTERISTIC
 /begin VAR_CHARACTERISTIC TP_U8ETCSCpPgFacInTrn[0][4] EngCalVariantCriterion
  /begin VAR_ADDRESS 0x8003A5B3 0x8003B3B3 0x8003C1B3 0x8003CFB3 0x8003DDB3 0x8003EBB3 0x8003F9B3 0x800407B3 0x800415B3 0x800423B3 0x800431B3 0x80043FB3 0x80044DB3 0x80045BB3 0x800469B3 0x800477B3 0x800485B3 0x800493B3 0x8004A1B3 0x8004AFB3 0x8004BDB3 0x8004CBB3 0x8004D9B3 0x8004E7B3 /end VAR_ADDRESS
 /end VAR_CHARACTERISTIC
 /begin VAR_CHARACTERISTIC TP_U8ETCSCpPgFacInTrn[1][0] EngCalVariantCriterion
  /begin VAR_ADDRESS 0x8003A5B4 0x8003B3B4 0x8003C1B4 0x8003CFB4 0x8003DDB4 0x8003EBB4 0x8003F9B4 0x800407B4 0x800415B4 0x800423B4 0x800431B4 0x80043FB4 0x80044DB4 0x80045BB4 0x800469B4 0x800477B4 0x800485B4 0x800493B4 0x8004A1B4 0x8004AFB4 0x8004BDB4 0x8004CBB4 0x8004D9B4 0x8004E7B4 /end VAR_ADDRESS
 /end VAR_CHARACTERISTIC
 /begin VAR_CHARACTERISTIC TP_U8ETCSCpPgFacInTrn[1][1] EngCalVariantCriterion
  /begin VAR_ADDRESS 0x8003A5B5 0x8003B3B5 0x8003C1B5 0x8003CFB5 0x8003DDB5 0x8003EBB5 0x8003F9B5 0x800407B5 0x800415B5 0x800423B5 0x800431B5 0x80043FB5 0x80044DB5 0x80045BB5 0x800469B5 0x800477B5 0x800485B5 0x800493B5 0x8004A1B5 0x8004AFB5 0x8004BDB5 0x8004CBB5 0x8004D9B5 0x8004E7B5 /end VAR_ADDRESS
 /end VAR_CHARACTERISTIC
 /begin VAR_CHARACTERISTIC TP_U8ETCSCpPgFacInTrn[1][2] EngCalVariantCriterion
  /begin VAR_ADDRESS 0x8003A5B6 0x8003B3B6 0x8003C1B6 0x8003CFB6 0x8003DDB6 0x8003EBB6 0x8003F9B6 0x800407B6 0x800415B6 0x800423B6 0x800431B6 0x80043FB6 0x80044DB6 0x80045BB6 0x800469B6 0x800477B6 0x800485B6 0x800493B6 0x8004A1B6 0x8004AFB6 0x8004BDB6 0x8004CBB6 0x8004D9B6 0x8004E7B6 /end VAR_ADDRESS
 /end VAR_CHARACTERISTIC
 /begin VAR_CHARACTERISTIC TP_U8ETCSCpPgFacInTrn[1][3] EngCalVariantCriterion
  /begin VAR_ADDRESS 0x8003A5B7 0x8003B3B7 0x8003C1B7 0x8003CFB7 0x8003DDB7 0x8003EBB7 0x8003F9B7 0x800407B7 0x800415B7 0x800423B7 0x800431B7 0x80043FB7 0x80044DB7 0x80045BB7 0x800469B7 0x800477B7 0x800485B7 0x800493B7 0x8004A1B7 0x8004AFB7 0x8004BDB7 0x8004CBB7 0x8004D9B7 0x8004E7B7 /end VAR_ADDRESS
 /end VAR_CHARACTERISTIC
 /begin VAR_CHARACTERISTIC TP_U8ETCSCpPgFacInTrn[1][4] EngCalVariantCriterion
  /begin VAR_ADDRESS 0x8003A5B8 0x8003B3B8 0x8003C1B8 0x8003CFB8 0x8003DDB8 0x8003EBB8 0x8003F9B8 0x800407B8 0x800415B8 0x800423B8 0x800431B8 0x80043FB8 0x80044DB8 0x80045BB8 0x800469B8 0x800477B8 0x800485B8 0x800493B8 0x8004A1B8 0x8004AFB8 0x8004BDB8 0x8004CBB8 0x8004D9B8 0x8004E7B8 /end VAR_ADDRESS
 /end VAR_CHARACTERISTIC
 /begin VAR_CHARACTERISTIC TP_U8ETCSCpPgFacInTrn[2][0] EngCalVariantCriterion
  /begin VAR_ADDRESS 0x8003A5B9 0x8003B3B9 0x8003C1B9 0x8003CFB9 0x8003DDB9 0x8003EBB9 0x8003F9B9 0x800407B9 0x800415B9 0x800423B9 0x800431B9 0x80043FB9 0x80044DB9 0x80045BB9 0x800469B9 0x800477B9 0x800485B9 0x800493B9 0x8004A1B9 0x8004AFB9 0x8004BDB9 0x8004CBB9 0x8004D9B9 0x8004E7B9 /end VAR_ADDRESS
 /end VAR_CHARACTERISTIC
 /begin VAR_CHARACTERISTIC TP_U8ETCSCpPgFacInTrn[2][1] EngCalVariantCriterion
  /begin VAR_ADDRESS 0x8003A5BA 0x8003B3BA 0x8003C1BA 0x8003CFBA 0x8003DDBA 0x8003EBBA 0x8003F9BA 0x800407BA 0x800415BA 0x800423BA 0x800431BA 0x80043FBA 0x80044DBA 0x80045BBA 0x800469BA 0x800477BA 0x800485BA 0x800493BA 0x8004A1BA 0x8004AFBA 0x8004BDBA 0x8004CBBA 0x8004D9BA 0x8004E7BA /end VAR_ADDRESS
 /end VAR_CHARACTERISTIC
 /begin VAR_CHARACTERISTIC TP_U8ETCSCpPgFacInTrn[2][2] EngCalVariantCriterion
  /begin VAR_ADDRESS 0x8003A5BB 0x8003B3BB 0x8003C1BB 0x8003CFBB 0x8003DDBB 0x8003EBBB 0x8003F9BB 0x800407BB 0x800415BB 0x800423BB 0x800431BB 0x80043FBB 0x80044DBB 0x80045BBB 0x800469BB 0x800477BB 0x800485BB 0x800493BB 0x8004A1BB 0x8004AFBB 0x8004BDBB 0x8004CBBB 0x8004D9BB 0x8004E7BB /end VAR_ADDRESS
 /end VAR_CHARACTERISTIC
 /begin VAR_CHARACTERISTIC TP_U8ETCSCpPgFacInTrn[2][3] EngCalVariantCriterion
  /begin VAR_ADDRESS 0x8003A5BC 0x8003B3BC 0x8003C1BC 0x8003CFBC 0x8003DDBC 0x8003EBBC 0x8003F9BC 0x800407BC 0x800415BC 0x800423BC 0x800431BC 0x80043FBC 0x80044DBC 0x80045BBC 0x800469BC 0x800477BC 0x800485BC 0x800493BC 0x8004A1BC 0x8004AFBC 0x8004BDBC 0x8004CBBC 0x8004D9BC 0x8004E7BC /end VAR_ADDRESS
 /end VAR_CHARACTERISTIC
 /begin VAR_CHARACTERISTIC TP_U8ETCSCpPgFacInTrn[2][4] EngCalVariantCriterion
  /begin VAR_ADDRESS 0x8003A5BD 0x8003B3BD 0x8003C1BD 0x8003CFBD 0x8003DDBD 0x8003EBBD 0x8003F9BD 0x800407BD 0x800415BD 0x800423BD 0x800431BD 0x80043FBD 0x80044DBD 0x80045BBD 0x800469BD 0x800477BD 0x800485BD 0x800493BD 0x8004A1BD 0x8004AFBD 0x8004BDBD 0x8004CBBD 0x8004D9BD 0x8004E7BD /end VAR_ADDRESS
 /end VAR_CHARACTERISTIC
 /begin VAR_CHARACTERISTIC TP_U8ETCSCpPosErrIgainSplt[0] EngCalVariantCriterion
  /begin VAR_ADDRESS 0x8003A5CE 0x8003B3CE 0x8003C1CE 0x8003CFCE 0x8003DDCE 0x8003EBCE 0x8003F9CE 0x800407CE 0x800415CE 0x800423CE 0x800431CE 0x80043FCE 0x80044DCE 0x80045BCE 0x800469CE 0x800477CE 0x800485CE 0x800493CE 0x8004A1CE 0x8004AFCE 0x8004BDCE 0x8004CBCE 0x8004D9CE 0x8004E7CE /end VAR_ADDRESS
 /end VAR_CHARACTERISTIC
 /begin VAR_CHARACTERISTIC TP_U8ETCSCpPosErrIgainSplt[1] EngCalVariantCriterion
  /begin VAR_ADDRESS 0x8003A5CF 0x8003B3CF 0x8003C1CF 0x8003CFCF 0x8003DDCF 0x8003EBCF 0x8003F9CF 0x800407CF 0x800415CF 0x800423CF 0x800431CF 0x80043FCF 0x80044DCF 0x80045BCF 0x800469CF 0x800477CF 0x800485CF 0x800493CF 0x8004A1CF 0x8004AFCF 0x8004BDCF 0x8004CBCF 0x8004D9CF 0x8004E7CF /end VAR_ADDRESS
 /end VAR_CHARACTERISTIC
 /begin VAR_CHARACTERISTIC TP_U8ETCSCpPosErrIgainSplt[2] EngCalVariantCriterion
  /begin VAR_ADDRESS 0x8003A5D0 0x8003B3D0 0x8003C1D0 0x8003CFD0 0x8003DDD0 0x8003EBD0 0x8003F9D0 0x800407D0 0x800415D0 0x800423D0 0x800431D0 0x80043FD0 0x80044DD0 0x80045BD0 0x800469D0 0x800477D0 0x800485D0 0x800493D0 0x8004A1D0 0x8004AFD0 0x8004BDD0 0x8004CBD0 0x8004D9D0 0x8004E7D0 /end VAR_ADDRESS
 /end VAR_CHARACTERISTIC
 /begin VAR_CHARACTERISTIC TP_U8ETCSCpPosErrIgainSplt[3] EngCalVariantCriterion
  /begin VAR_ADDRESS 0x8003A5D1 0x8003B3D1 0x8003C1D1 0x8003CFD1 0x8003DDD1 0x8003EBD1 0x8003F9D1 0x800407D1 0x800415D1 0x800423D1 0x800431D1 0x80043FD1 0x80044DD1 0x80045BD1 0x800469D1 0x800477D1 0x800485D1 0x800493D1 0x8004A1D1 0x8004AFD1 0x8004BDD1 0x8004CBD1 0x8004D9D1 0x8004E7D1 /end VAR_ADDRESS
 /end VAR_CHARACTERISTIC
 /begin VAR_CHARACTERISTIC TP_U8ETCSCpPosErrIgainSplt[4] EngCalVariantCriterion
  /begin VAR_ADDRESS 0x8003A5D2 0x8003B3D2 0x8003C1D2 0x8003CFD2 0x8003DDD2 0x8003EBD2 0x8003F9D2 0x800407D2 0x800415D2 0x800423D2 0x800431D2 0x80043FD2 0x80044DD2 0x80045BD2 0x800469D2 0x800477D2 0x800485D2 0x800493D2 0x8004A1D2 0x8004AFD2 0x8004BDD2 0x8004CBD2 0x8004D9D2 0x8004E7D2 /end VAR_ADDRESS
 /end VAR_CHARACTERISTIC
 /begin VAR_CHARACTERISTIC TP_U8ETCSCpPosErrIgain[0][0] EngCalVariantCriterion
  /begin VAR_ADDRESS 0x8003A5BE 0x8003B3BE 0x8003C1BE 0x8003CFBE 0x8003DDBE 0x8003EBBE 0x8003F9BE 0x800407BE 0x800415BE 0x800423BE 0x800431BE 0x80043FBE 0x80044DBE 0x80045BBE 0x800469BE 0x800477BE 0x800485BE 0x800493BE 0x8004A1BE 0x8004AFBE 0x8004BDBE 0x8004CBBE 0x8004D9BE 0x8004E7BE /end VAR_ADDRESS
 /end VAR_CHARACTERISTIC
 /begin VAR_CHARACTERISTIC TP_U8ETCSCpPosErrIgain[0][1] EngCalVariantCriterion
  /begin VAR_ADDRESS 0x8003A5BF 0x8003B3BF 0x8003C1BF 0x8003CFBF 0x8003DDBF 0x8003EBBF 0x8003F9BF 0x800407BF 0x800415BF 0x800423BF 0x800431BF 0x80043FBF 0x80044DBF 0x80045BBF 0x800469BF 0x800477BF 0x800485BF 0x800493BF 0x8004A1BF 0x8004AFBF 0x8004BDBF 0x8004CBBF 0x8004D9BF 0x8004E7BF /end VAR_ADDRESS
 /end VAR_CHARACTERISTIC
 /begin VAR_CHARACTERISTIC TP_U8ETCSCpPosErrIgain[0][2] EngCalVariantCriterion
  /begin VAR_ADDRESS 0x8003A5C0 0x8003B3C0 0x8003C1C0 0x8003CFC0 0x8003DDC0 0x8003EBC0 0x8003F9C0 0x800407C0 0x800415C0 0x800423C0 0x800431C0 0x80043FC0 0x80044DC0 0x80045BC0 0x800469C0 0x800477C0 0x800485C0 0x800493C0 0x8004A1C0 0x8004AFC0 0x8004BDC0 0x8004CBC0 0x8004D9C0 0x8004E7C0 /end VAR_ADDRESS
 /end VAR_CHARACTERISTIC
 /begin VAR_CHARACTERISTIC TP_U8ETCSCpPosErrIgain[0][3] EngCalVariantCriterion
  /begin VAR_ADDRESS 0x8003A5C1 0x8003B3C1 0x8003C1C1 0x8003CFC1 0x8003DDC1 0x8003EBC1 0x8003F9C1 0x800407C1 0x800415C1 0x800423C1 0x800431C1 0x80043FC1 0x80044DC1 0x80045BC1 0x800469C1 0x800477C1 0x800485C1 0x800493C1 0x8004A1C1 0x8004AFC1 0x8004BDC1 0x8004CBC1 0x8004D9C1 0x8004E7C1 /end VAR_ADDRESS
 /end VAR_CHARACTERISTIC
 /begin VAR_CHARACTERISTIC TP_U8ETCSCpPosErrIgain[0][4] EngCalVariantCriterion
  /begin VAR_ADDRESS 0x8003A5C2 0x8003B3C2 0x8003C1C2 0x8003CFC2 0x8003DDC2 0x8003EBC2 0x8003F9C2 0x800407C2 0x800415C2 0x800423C2 0x800431C2 0x80043FC2 0x80044DC2 0x80045BC2 0x800469C2 0x800477C2 0x800485C2 0x800493C2 0x8004A1C2 0x8004AFC2 0x8004BDC2 0x8004CBC2 0x8004D9C2 0x8004E7C2 /end VAR_ADDRESS
 /end VAR_CHARACTERISTIC
 /begin VAR_CHARACTERISTIC TP_U8ETCSCpPosErrIgain[1][0] EngCalVariantCriterion
  /begin VAR_ADDRESS 0x8003A5C3 0x8003B3C3 0x8003C1C3 0x8003CFC3 0x8003DDC3 0x8003EBC3 0x8003F9C3 0x800407C3 0x800415C3 0x800423C3 0x800431C3 0x80043FC3 0x80044DC3 0x80045BC3 0x800469C3 0x800477C3 0x800485C3 0x800493C3 0x8004A1C3 0x8004AFC3 0x8004BDC3 0x8004CBC3 0x8004D9C3 0x8004E7C3 /end VAR_ADDRESS
 /end VAR_CHARACTERISTIC
 /begin VAR_CHARACTERISTIC TP_U8ETCSCpPosErrIgain[1][1] EngCalVariantCriterion
  /begin VAR_ADDRESS 0x8003A5C4 0x8003B3C4 0x8003C1C4 0x8003CFC4 0x8003DDC4 0x8003EBC4 0x8003F9C4 0x800407C4 0x800415C4 0x800423C4 0x800431C4 0x80043FC4 0x80044DC4 0x80045BC4 0x800469C4 0x800477C4 0x800485C4 0x800493C4 0x8004A1C4 0x8004AFC4 0x8004BDC4 0x8004CBC4 0x8004D9C4 0x8004E7C4 /end VAR_ADDRESS
 /end VAR_CHARACTERISTIC
 /begin VAR_CHARACTERISTIC TP_U8ETCSCpPosErrIgain[1][2] EngCalVariantCriterion
  /begin VAR_ADDRESS 0x8003A5C5 0x8003B3C5 0x8003C1C5 0x8003CFC5 0x8003DDC5 0x8003EBC5 0x8003F9C5 0x800407C5 0x800415C5 0x800423C5 0x800431C5 0x80043FC5 0x80044DC5 0x80045BC5 0x800469C5 0x800477C5 0x800485C5 0x800493C5 0x8004A1C5 0x8004AFC5 0x8004BDC5 0x8004CBC5 0x8004D9C5 0x8004E7C5 /end VAR_ADDRESS
 /end VAR_CHARACTERISTIC
 /begin VAR_CHARACTERISTIC TP_U8ETCSCpPosErrIgain[1][3] EngCalVariantCriterion
  /begin VAR_ADDRESS 0x8003A5C6 0x8003B3C6 0x8003C1C6 0x8003CFC6 0x8003DDC6 0x8003EBC6 0x8003F9C6 0x800407C6 0x800415C6 0x800423C6 0x800431C6 0x80043FC6 0x80044DC6 0x80045BC6 0x800469C6 0x800477C6 0x800485C6 0x800493C6 0x8004A1C6 0x8004AFC6 0x8004BDC6 0x8004CBC6 0x8004D9C6 0x8004E7C6 /end VAR_ADDRESS
 /end VAR_CHARACTERISTIC
 /begin VAR_CHARACTERISTIC TP_U8ETCSCpPosErrIgain[1][4] EngCalVariantCriterion
  /begin VAR_ADDRESS 0x8003A5C7 0x8003B3C7 0x8003C1C7 0x8003CFC7 0x8003DDC7 0x8003EBC7 0x8003F9C7 0x800407C7 0x800415C7 0x800423C7 0x800431C7 0x80043FC7 0x80044DC7 0x80045BC7 0x800469C7 0x800477C7 0x800485C7 0x800493C7 0x8004A1C7 0x8004AFC7 0x8004BDC7 0x8004CBC7 0x8004D9C7 0x8004E7C7 /end VAR_ADDRESS
 /end VAR_CHARACTERISTIC
 /begin VAR_CHARACTERISTIC TP_U8ETCSCpPosErrIgain[2][0] EngCalVariantCriterion
  /begin VAR_ADDRESS 0x8003A5C8 0x8003B3C8 0x8003C1C8 0x8003CFC8 0x8003DDC8 0x8003EBC8 0x8003F9C8 0x800407C8 0x800415C8 0x800423C8 0x800431C8 0x80043FC8 0x80044DC8 0x80045BC8 0x800469C8 0x800477C8 0x800485C8 0x800493C8 0x8004A1C8 0x8004AFC8 0x8004BDC8 0x8004CBC8 0x8004D9C8 0x8004E7C8 /end VAR_ADDRESS
 /end VAR_CHARACTERISTIC
 /begin VAR_CHARACTERISTIC TP_U8ETCSCpPosErrIgain[2][1] EngCalVariantCriterion
  /begin VAR_ADDRESS 0x8003A5C9 0x8003B3C9 0x8003C1C9 0x8003CFC9 0x8003DDC9 0x8003EBC9 0x8003F9C9 0x800407C9 0x800415C9 0x800423C9 0x800431C9 0x80043FC9 0x80044DC9 0x80045BC9 0x800469C9 0x800477C9 0x800485C9 0x800493C9 0x8004A1C9 0x8004AFC9 0x8004BDC9 0x8004CBC9 0x8004D9C9 0x8004E7C9 /end VAR_ADDRESS
 /end VAR_CHARACTERISTIC
 /begin VAR_CHARACTERISTIC TP_U8ETCSCpPosErrIgain[2][2] EngCalVariantCriterion
  /begin VAR_ADDRESS 0x8003A5CA 0x8003B3CA 0x8003C1CA 0x8003CFCA 0x8003DDCA 0x8003EBCA 0x8003F9CA 0x800407CA 0x800415CA 0x800423CA 0x800431CA 0x80043FCA 0x80044DCA 0x80045BCA 0x800469CA 0x800477CA 0x800485CA 0x800493CA 0x8004A1CA 0x8004AFCA 0x8004BDCA 0x8004CBCA 0x8004D9CA 0x8004E7CA /end VAR_ADDRESS
 /end VAR_CHARACTERISTIC
 /begin VAR_CHARACTERISTIC TP_U8ETCSCpPosErrIgain[2][3] EngCalVariantCriterion
  /begin VAR_ADDRESS 0x8003A5CB 0x8003B3CB 0x8003C1CB 0x8003CFCB 0x8003DDCB 0x8003EBCB 0x8003F9CB 0x800407CB 0x800415CB 0x800423CB 0x800431CB 0x80043FCB 0x80044DCB 0x80045BCB 0x800469CB 0x800477CB 0x800485CB 0x800493CB 0x8004A1CB 0x8004AFCB 0x8004BDCB 0x8004CBCB 0x8004D9CB 0x8004E7CB /end VAR_ADDRESS
 /end VAR_CHARACTERISTIC
 /begin VAR_CHARACTERISTIC TP_U8ETCSCpPosErrIgain[2][4] EngCalVariantCriterion
  /begin VAR_ADDRESS 0x8003A5CC 0x8003B3CC 0x8003C1CC 0x8003CFCC 0x8003DDCC 0x8003EBCC 0x8003F9CC 0x800407CC 0x800415CC 0x800423CC 0x800431CC 0x80043FCC 0x80044DCC 0x80045BCC 0x800469CC 0x800477CC 0x800485CC 0x800493CC 0x8004A1CC 0x8004AFCC 0x8004BDCC 0x8004CBCC 0x8004D9CC 0x8004E7CC /end VAR_ADDRESS
 /end VAR_CHARACTERISTIC
 /begin VAR_CHARACTERISTIC TP_U8ETCSCpPosErrIgain_R EngCalVariantCriterion
  /begin VAR_ADDRESS 0x8003A5CD 0x8003B3CD 0x8003C1CD 0x8003CFCD 0x8003DDCD 0x8003EBCD 0x8003F9CD 0x800407CD 0x800415CD 0x800423CD 0x800431CD 0x80043FCD 0x80044DCD 0x80045BCD 0x800469CD 0x800477CD 0x800485CD 0x800493CD 0x8004A1CD 0x8004AFCD 0x8004BDCD 0x8004CBCD 0x8004D9CD 0x8004E7CD /end VAR_ADDRESS
 /end VAR_CHARACTERISTIC
 /begin VAR_CHARACTERISTIC TP_U8ETCSCpPosErrPgainSplt[0] EngCalVariantCriterion
  /begin VAR_ADDRESS 0x8003A5E3 0x8003B3E3 0x8003C1E3 0x8003CFE3 0x8003DDE3 0x8003EBE3 0x8003F9E3 0x800407E3 0x800415E3 0x800423E3 0x800431E3 0x80043FE3 0x80044DE3 0x80045BE3 0x800469E3 0x800477E3 0x800485E3 0x800493E3 0x8004A1E3 0x8004AFE3 0x8004BDE3 0x8004CBE3 0x8004D9E3 0x8004E7E3 /end VAR_ADDRESS
 /end VAR_CHARACTERISTIC
 /begin VAR_CHARACTERISTIC TP_U8ETCSCpPosErrPgainSplt[1] EngCalVariantCriterion
  /begin VAR_ADDRESS 0x8003A5E4 0x8003B3E4 0x8003C1E4 0x8003CFE4 0x8003DDE4 0x8003EBE4 0x8003F9E4 0x800407E4 0x800415E4 0x800423E4 0x800431E4 0x80043FE4 0x80044DE4 0x80045BE4 0x800469E4 0x800477E4 0x800485E4 0x800493E4 0x8004A1E4 0x8004AFE4 0x8004BDE4 0x8004CBE4 0x8004D9E4 0x8004E7E4 /end VAR_ADDRESS
 /end VAR_CHARACTERISTIC
 /begin VAR_CHARACTERISTIC TP_U8ETCSCpPosErrPgainSplt[2] EngCalVariantCriterion
  /begin VAR_ADDRESS 0x8003A5E5 0x8003B3E5 0x8003C1E5 0x8003CFE5 0x8003DDE5 0x8003EBE5 0x8003F9E5 0x800407E5 0x800415E5 0x800423E5 0x800431E5 0x80043FE5 0x80044DE5 0x80045BE5 0x800469E5 0x800477E5 0x800485E5 0x800493E5 0x8004A1E5 0x8004AFE5 0x8004BDE5 0x8004CBE5 0x8004D9E5 0x8004E7E5 /end VAR_ADDRESS
 /end VAR_CHARACTERISTIC
 /begin VAR_CHARACTERISTIC TP_U8ETCSCpPosErrPgainSplt[3] EngCalVariantCriterion
  /begin VAR_ADDRESS 0x8003A5E6 0x8003B3E6 0x8003C1E6 0x8003CFE6 0x8003DDE6 0x8003EBE6 0x8003F9E6 0x800407E6 0x800415E6 0x800423E6 0x800431E6 0x80043FE6 0x80044DE6 0x80045BE6 0x800469E6 0x800477E6 0x800485E6 0x800493E6 0x8004A1E6 0x8004AFE6 0x8004BDE6 0x8004CBE6 0x8004D9E6 0x8004E7E6 /end VAR_ADDRESS
 /end VAR_CHARACTERISTIC
 /begin VAR_CHARACTERISTIC TP_U8ETCSCpPosErrPgainSplt[4] EngCalVariantCriterion
  /begin VAR_ADDRESS 0x8003A5E7 0x8003B3E7 0x8003C1E7 0x8003CFE7 0x8003DDE7 0x8003EBE7 0x8003F9E7 0x800407E7 0x800415E7 0x800423E7 0x800431E7 0x80043FE7 0x80044DE7 0x80045BE7 0x800469E7 0x800477E7 0x800485E7 0x800493E7 0x8004A1E7 0x8004AFE7 0x8004BDE7 0x8004CBE7 0x8004D9E7 0x8004E7E7 /end VAR_ADDRESS
 /end VAR_CHARACTERISTIC
 /begin VAR_CHARACTERISTIC TP_U8ETCSCpPosErrPgain[0][0] EngCalVariantCriterion
  /begin VAR_ADDRESS 0x8003A5D3 0x8003B3D3 0x8003C1D3 0x8003CFD3 0x8003DDD3 0x8003EBD3 0x8003F9D3 0x800407D3 0x800415D3 0x800423D3 0x800431D3 0x80043FD3 0x80044DD3 0x80045BD3 0x800469D3 0x800477D3 0x800485D3 0x800493D3 0x8004A1D3 0x8004AFD3 0x8004BDD3 0x8004CBD3 0x8004D9D3 0x8004E7D3 /end VAR_ADDRESS
 /end VAR_CHARACTERISTIC
 /begin VAR_CHARACTERISTIC TP_U8ETCSCpPosErrPgain[0][1] EngCalVariantCriterion
  /begin VAR_ADDRESS 0x8003A5D4 0x8003B3D4 0x8003C1D4 0x8003CFD4 0x8003DDD4 0x8003EBD4 0x8003F9D4 0x800407D4 0x800415D4 0x800423D4 0x800431D4 0x80043FD4 0x80044DD4 0x80045BD4 0x800469D4 0x800477D4 0x800485D4 0x800493D4 0x8004A1D4 0x8004AFD4 0x8004BDD4 0x8004CBD4 0x8004D9D4 0x8004E7D4 /end VAR_ADDRESS
 /end VAR_CHARACTERISTIC
 /begin VAR_CHARACTERISTIC TP_U8ETCSCpPosErrPgain[0][2] EngCalVariantCriterion
  /begin VAR_ADDRESS 0x8003A5D5 0x8003B3D5 0x8003C1D5 0x8003CFD5 0x8003DDD5 0x8003EBD5 0x8003F9D5 0x800407D5 0x800415D5 0x800423D5 0x800431D5 0x80043FD5 0x80044DD5 0x80045BD5 0x800469D5 0x800477D5 0x800485D5 0x800493D5 0x8004A1D5 0x8004AFD5 0x8004BDD5 0x8004CBD5 0x8004D9D5 0x8004E7D5 /end VAR_ADDRESS
 /end VAR_CHARACTERISTIC
 /begin VAR_CHARACTERISTIC TP_U8ETCSCpPosErrPgain[0][3] EngCalVariantCriterion
  /begin VAR_ADDRESS 0x8003A5D6 0x8003B3D6 0x8003C1D6 0x8003CFD6 0x8003DDD6 0x8003EBD6 0x8003F9D6 0x800407D6 0x800415D6 0x800423D6 0x800431D6 0x80043FD6 0x80044DD6 0x80045BD6 0x800469D6 0x800477D6 0x800485D6 0x800493D6 0x8004A1D6 0x8004AFD6 0x8004BDD6 0x8004CBD6 0x8004D9D6 0x8004E7D6 /end VAR_ADDRESS
 /end VAR_CHARACTERISTIC
 /begin VAR_CHARACTERISTIC TP_U8ETCSCpPosErrPgain[0][4] EngCalVariantCriterion
  /begin VAR_ADDRESS 0x8003A5D7 0x8003B3D7 0x8003C1D7 0x8003CFD7 0x8003DDD7 0x8003EBD7 0x8003F9D7 0x800407D7 0x800415D7 0x800423D7 0x800431D7 0x80043FD7 0x80044DD7 0x80045BD7 0x800469D7 0x800477D7 0x800485D7 0x800493D7 0x8004A1D7 0x8004AFD7 0x8004BDD7 0x8004CBD7 0x8004D9D7 0x8004E7D7 /end VAR_ADDRESS
 /end VAR_CHARACTERISTIC
 /begin VAR_CHARACTERISTIC TP_U8ETCSCpPosErrPgain[1][0] EngCalVariantCriterion
  /begin VAR_ADDRESS 0x8003A5D8 0x8003B3D8 0x8003C1D8 0x8003CFD8 0x8003DDD8 0x8003EBD8 0x8003F9D8 0x800407D8 0x800415D8 0x800423D8 0x800431D8 0x80043FD8 0x80044DD8 0x80045BD8 0x800469D8 0x800477D8 0x800485D8 0x800493D8 0x8004A1D8 0x8004AFD8 0x8004BDD8 0x8004CBD8 0x8004D9D8 0x8004E7D8 /end VAR_ADDRESS
 /end VAR_CHARACTERISTIC
 /begin VAR_CHARACTERISTIC TP_U8ETCSCpPosErrPgain[1][1] EngCalVariantCriterion
  /begin VAR_ADDRESS 0x8003A5D9 0x8003B3D9 0x8003C1D9 0x8003CFD9 0x8003DDD9 0x8003EBD9 0x8003F9D9 0x800407D9 0x800415D9 0x800423D9 0x800431D9 0x80043FD9 0x80044DD9 0x80045BD9 0x800469D9 0x800477D9 0x800485D9 0x800493D9 0x8004A1D9 0x8004AFD9 0x8004BDD9 0x8004CBD9 0x8004D9D9 0x8004E7D9 /end VAR_ADDRESS
 /end VAR_CHARACTERISTIC
 /begin VAR_CHARACTERISTIC TP_U8ETCSCpPosErrPgain[1][2] EngCalVariantCriterion
  /begin VAR_ADDRESS 0x8003A5DA 0x8003B3DA 0x8003C1DA 0x8003CFDA 0x8003DDDA 0x8003EBDA 0x8003F9DA 0x800407DA 0x800415DA 0x800423DA 0x800431DA 0x80043FDA 0x80044DDA 0x80045BDA 0x800469DA 0x800477DA 0x800485DA 0x800493DA 0x8004A1DA 0x8004AFDA 0x8004BDDA 0x8004CBDA 0x8004D9DA 0x8004E7DA /end VAR_ADDRESS
 /end VAR_CHARACTERISTIC
 /begin VAR_CHARACTERISTIC TP_U8ETCSCpPosErrPgain[1][3] EngCalVariantCriterion
  /begin VAR_ADDRESS 0x8003A5DB 0x8003B3DB 0x8003C1DB 0x8003CFDB 0x8003DDDB 0x8003EBDB 0x8003F9DB 0x800407DB 0x800415DB 0x800423DB 0x800431DB 0x80043FDB 0x80044DDB 0x80045BDB 0x800469DB 0x800477DB 0x800485DB 0x800493DB 0x8004A1DB 0x8004AFDB 0x8004BDDB 0x8004CBDB 0x8004D9DB 0x8004E7DB /end VAR_ADDRESS
 /end VAR_CHARACTERISTIC
 /begin VAR_CHARACTERISTIC TP_U8ETCSCpPosErrPgain[1][4] EngCalVariantCriterion
  /begin VAR_ADDRESS 0x8003A5DC 0x8003B3DC 0x8003C1DC 0x8003CFDC 0x8003DDDC 0x8003EBDC 0x8003F9DC 0x800407DC 0x800415DC 0x800423DC 0x800431DC 0x80043FDC 0x80044DDC 0x80045BDC 0x800469DC 0x800477DC 0x800485DC 0x800493DC 0x8004A1DC 0x8004AFDC 0x8004BDDC 0x8004CBDC 0x8004D9DC 0x8004E7DC /end VAR_ADDRESS
 /end VAR_CHARACTERISTIC
 /begin VAR_CHARACTERISTIC TP_U8ETCSCpPosErrPgain[2][0] EngCalVariantCriterion
  /begin VAR_ADDRESS 0x8003A5DD 0x8003B3DD 0x8003C1DD 0x8003CFDD 0x8003DDDD 0x8003EBDD 0x8003F9DD 0x800407DD 0x800415DD 0x800423DD 0x800431DD 0x80043FDD 0x80044DDD 0x80045BDD 0x800469DD 0x800477DD 0x800485DD 0x800493DD 0x8004A1DD 0x8004AFDD 0x8004BDDD 0x8004CBDD 0x8004D9DD 0x8004E7DD /end VAR_ADDRESS
 /end VAR_CHARACTERISTIC
 /begin VAR_CHARACTERISTIC TP_U8ETCSCpPosErrPgain[2][1] EngCalVariantCriterion
  /begin VAR_ADDRESS 0x8003A5DE 0x8003B3DE 0x8003C1DE 0x8003CFDE 0x8003DDDE 0x8003EBDE 0x8003F9DE 0x800407DE 0x800415DE 0x800423DE 0x800431DE 0x80043FDE 0x80044DDE 0x80045BDE 0x800469DE 0x800477DE 0x800485DE 0x800493DE 0x8004A1DE 0x8004AFDE 0x8004BDDE 0x8004CBDE 0x8004D9DE 0x8004E7DE /end VAR_ADDRESS
 /end VAR_CHARACTERISTIC
 /begin VAR_CHARACTERISTIC TP_U8ETCSCpPosErrPgain[2][2] EngCalVariantCriterion
  /begin VAR_ADDRESS 0x8003A5DF 0x8003B3DF 0x8003C1DF 0x8003CFDF 0x8003DDDF 0x8003EBDF 0x8003F9DF 0x800407DF 0x800415DF 0x800423DF 0x800431DF 0x80043FDF 0x80044DDF 0x80045BDF 0x800469DF 0x800477DF 0x800485DF 0x800493DF 0x8004A1DF 0x8004AFDF 0x8004BDDF 0x8004CBDF 0x8004D9DF 0x8004E7DF /end VAR_ADDRESS
 /end VAR_CHARACTERISTIC
 /begin VAR_CHARACTERISTIC TP_U8ETCSCpPosErrPgain[2][3] EngCalVariantCriterion
  /begin VAR_ADDRESS 0x8003A5E0 0x8003B3E0 0x8003C1E0 0x8003CFE0 0x8003DDE0 0x8003EBE0 0x8003F9E0 0x800407E0 0x800415E0 0x800423E0 0x800431E0 0x80043FE0 0x80044DE0 0x80045BE0 0x800469E0 0x800477E0 0x800485E0 0x800493E0 0x8004A1E0 0x8004AFE0 0x8004BDE0 0x8004CBE0 0x8004D9E0 0x8004E7E0 /end VAR_ADDRESS
 /end VAR_CHARACTERISTIC
 /begin VAR_CHARACTERISTIC TP_U8ETCSCpPosErrPgain[2][4] EngCalVariantCriterion
  /begin VAR_ADDRESS 0x8003A5E1 0x8003B3E1 0x8003C1E1 0x8003CFE1 0x8003DDE1 0x8003EBE1 0x8003F9E1 0x800407E1 0x800415E1 0x800423E1 0x800431E1 0x80043FE1 0x80044DE1 0x80045BE1 0x800469E1 0x800477E1 0x800485E1 0x800493E1 0x8004A1E1 0x8004AFE1 0x8004BDE1 0x8004CBE1 0x8004D9E1 0x8004E7E1 /end VAR_ADDRESS
 /end VAR_CHARACTERISTIC
 /begin VAR_CHARACTERISTIC TP_U8ETCSCpPosErrPgain_R EngCalVariantCriterion
  /begin VAR_ADDRESS 0x8003A5E2 0x8003B3E2 0x8003C1E2 0x8003CFE2 0x8003DDE2 0x8003EBE2 0x8003F9E2 0x800407E2 0x800415E2 0x800423E2 0x800431E2 0x80043FE2 0x80044DE2 0x80045BE2 0x800469E2 0x800477E2 0x800485E2 0x800493E2 0x8004A1E2 0x8004AFE2 0x8004BDE2 0x8004CBE2 0x8004D9E2 0x8004E7E2 /end VAR_ADDRESS
 /end VAR_CHARACTERISTIC
 /begin VAR_CHARACTERISTIC TP_U8ETCSCpRdMemTqDecGainFac EngCalVariantCriterion
  /begin VAR_ADDRESS 0x8003A5E8 0x8003B3E8 0x8003C1E8 0x8003CFE8 0x8003DDE8 0x8003EBE8 0x8003F9E8 0x800407E8 0x800415E8 0x800423E8 0x800431E8 0x80043FE8 0x80044DE8 0x80045BE8 0x800469E8 0x800477E8 0x800485E8 0x800493E8 0x8004A1E8 0x8004AFE8 0x8004BDE8 0x8004CBE8 0x8004D9E8 0x8004E7E8 /end VAR_ADDRESS
 /end VAR_CHARACTERISTIC
 /begin VAR_CHARACTERISTIC TP_U8ETCSCpRecTrqFacInBump EngCalVariantCriterion
  /begin VAR_ADDRESS 0x8003A5E9 0x8003B3E9 0x8003C1E9 0x8003CFE9 0x8003DDE9 0x8003EBE9 0x8003F9E9 0x800407E9 0x800415E9 0x800423E9 0x800431E9 0x80043FE9 0x80044DE9 0x80045BE9 0x800469E9 0x800477E9 0x800485E9 0x800493E9 0x8004A1E9 0x8004AFE9 0x8004BDE9 0x8004CBE9 0x8004D9E9 0x8004E7E9 /end VAR_ADDRESS
 /end VAR_CHARACTERISTIC
 /begin VAR_CHARACTERISTIC TP_U8ETCSCpRefTrqNvldTm EngCalVariantCriterion
  /begin VAR_ADDRESS 0x8003A5EA 0x8003B3EA 0x8003C1EA 0x8003CFEA 0x8003DDEA 0x8003EBEA 0x8003F9EA 0x800407EA 0x800415EA 0x800423EA 0x800431EA 0x80043FEA 0x80044DEA 0x80045BEA 0x800469EA 0x800477EA 0x800485EA 0x800493EA 0x8004A1EA 0x8004AFEA 0x8004BDEA 0x8004CBEA 0x8004D9EA 0x8004E7EA /end VAR_ADDRESS
 /end VAR_CHARACTERISTIC
 /begin VAR_CHARACTERISTIC TP_U8ETCSCpRefTrqVldTm EngCalVariantCriterion
  /begin VAR_ADDRESS 0x8003A5EB 0x8003B3EB 0x8003C1EB 0x8003CFEB 0x8003DDEB 0x8003EBEB 0x8003F9EB 0x800407EB 0x800415EB 0x800423EB 0x800431EB 0x80043FEB 0x80044DEB 0x80045BEB 0x800469EB 0x800477EB 0x800485EB 0x800493EB 0x8004A1EB 0x8004AFEB 0x8004BDEB 0x8004CBEB 0x8004D9EB 0x8004E7EB /end VAR_ADDRESS
 /end VAR_CHARACTERISTIC
 /begin VAR_CHARACTERISTIC TP_U8ETCSCpSplitHillClrAccel EngCalVariantCriterion
  /begin VAR_ADDRESS 0x8003A5EC 0x8003B3EC 0x8003C1EC 0x8003CFEC 0x8003DDEC 0x8003EBEC 0x8003F9EC 0x800407EC 0x800415EC 0x800423EC 0x800431EC 0x80043FEC 0x80044DEC 0x80045BEC 0x800469EC 0x800477EC 0x800485EC 0x800493EC 0x8004A1EC 0x8004AFEC 0x8004BDEC 0x8004CBEC 0x8004D9EC 0x8004E7EC /end VAR_ADDRESS
 /end VAR_CHARACTERISTIC
 /begin VAR_CHARACTERISTIC TP_U8ETCSCpSplitHillClrVehSpd EngCalVariantCriterion
  /begin VAR_ADDRESS 0x8003A5ED 0x8003B3ED 0x8003C1ED 0x8003CFED 0x8003DDED 0x8003EBED 0x8003F9ED 0x800407ED 0x800415ED 0x800423ED 0x800431ED 0x80043FED 0x80044DED 0x80045BED 0x800469ED 0x800477ED 0x800485ED 0x800493ED 0x8004A1ED 0x8004AFED 0x8004BDED 0x8004CBED 0x8004D9ED 0x8004E7ED /end VAR_ADDRESS
 /end VAR_CHARACTERISTIC
 /begin VAR_CHARACTERISTIC TP_U8ETCSCpSplitHillDctAccel EngCalVariantCriterion
  /begin VAR_ADDRESS 0x8003A5EE 0x8003B3EE 0x8003C1EE 0x8003CFEE 0x8003DDEE 0x8003EBEE 0x8003F9EE 0x800407EE 0x800415EE 0x800423EE 0x800431EE 0x80043FEE 0x80044DEE 0x80045BEE 0x800469EE 0x800477EE 0x800485EE 0x800493EE 0x8004A1EE 0x8004AFEE 0x8004BDEE 0x8004CBEE 0x8004D9EE 0x8004E7EE /end VAR_ADDRESS
 /end VAR_CHARACTERISTIC
 /begin VAR_CHARACTERISTIC TP_U8ETCSCpSplitHillDctMinAx EngCalVariantCriterion
  /begin VAR_ADDRESS 0x8003A5EF 0x8003B3EF 0x8003C1EF 0x8003CFEF 0x8003DDEF 0x8003EBEF 0x8003F9EF 0x800407EF 0x800415EF 0x800423EF 0x800431EF 0x80043FEF 0x80044DEF 0x80045BEF 0x800469EF 0x800477EF 0x800485EF 0x800493EF 0x8004A1EF 0x8004AFEF 0x8004BDEF 0x8004CBEF 0x8004D9EF 0x8004E7EF /end VAR_ADDRESS
 /end VAR_CHARACTERISTIC
 /begin VAR_CHARACTERISTIC TP_U8ETCSCpSplitHillDctVehSpd EngCalVariantCriterion
  /begin VAR_ADDRESS 0x8003A5F0 0x8003B3F0 0x8003C1F0 0x8003CFF0 0x8003DDF0 0x8003EBF0 0x8003F9F0 0x800407F0 0x800415F0 0x800423F0 0x800431F0 0x80043FF0 0x80044DF0 0x80045BF0 0x800469F0 0x800477F0 0x800485F0 0x800493F0 0x8004A1F0 0x8004AFF0 0x8004BDF0 0x8004CBF0 0x8004D9F0 0x8004E7F0 /end VAR_ADDRESS
 /end VAR_CHARACTERISTIC
 /begin VAR_CHARACTERISTIC TP_U8ETCSCpSpltDctBrkTrqCnt EngCalVariantCriterion
  /begin VAR_ADDRESS 0x8003A5F1 0x8003B3F1 0x8003C1F1 0x8003CFF1 0x8003DDF1 0x8003EBF1 0x8003F9F1 0x800407F1 0x800415F1 0x800423F1 0x800431F1 0x80043FF1 0x80044DF1 0x80045BF1 0x800469F1 0x800477F1 0x800485F1 0x800493F1 0x8004A1F1 0x8004AFF1 0x8004BDF1 0x8004CBF1 0x8004D9F1 0x8004E7F1 /end VAR_ADDRESS
 /end VAR_CHARACTERISTIC
 /begin VAR_CHARACTERISTIC TP_U8ETCSCpStDeltAcc EngCalVariantCriterion
  /begin VAR_ADDRESS 0x8003A5F3 0x8003B3F3 0x8003C1F3 0x8003CFF3 0x8003DDF3 0x8003EBF3 0x8003F9F3 0x800407F3 0x800415F3 0x800423F3 0x800431F3 0x80043FF3 0x80044DF3 0x80045BF3 0x800469F3 0x800477F3 0x800485F3 0x800493F3 0x8004A1F3 0x8004AFF3 0x8004BDF3 0x8004CBF3 0x8004D9F3 0x8004E7F3 /end VAR_ADDRESS
 /end VAR_CHARACTERISTIC
 /begin VAR_CHARACTERISTIC TP_U8ETCSCpStabCrngTime EngCalVariantCriterion
  /begin VAR_ADDRESS 0x8003A5F2 0x8003B3F2 0x8003C1F2 0x8003CFF2 0x8003DDF2 0x8003EBF2 0x8003F9F2 0x800407F2 0x800415F2 0x800423F2 0x800431F2 0x80043FF2 0x80044DF2 0x80045BF2 0x800469F2 0x800477F2 0x800485F2 0x800493F2 0x8004A1F2 0x8004AFF2 0x8004BDF2 0x8004CBF2 0x8004D9F2 0x8004E7F2 /end VAR_ADDRESS
 /end VAR_CHARACTERISTIC
 /begin VAR_CHARACTERISTIC TP_U8ETCSCpSymBrkCtlGain EngCalVariantCriterion
  /begin VAR_ADDRESS 0x8003A5F4 0x8003B3F4 0x8003C1F4 0x8003CFF4 0x8003DDF4 0x8003EBF4 0x8003F9F4 0x800407F4 0x800415F4 0x800423F4 0x800431F4 0x80043FF4 0x80044DF4 0x80045BF4 0x800469F4 0x800477F4 0x800485F4 0x800493F4 0x8004A1F4 0x8004AFF4 0x8004BDF4 0x8004CBF4 0x8004D9F4 0x8004E7F4 /end VAR_ADDRESS
 /end VAR_CHARACTERISTIC
 /begin VAR_CHARACTERISTIC TP_U8ETCSCpSymBrkCtlIhbAxTh EngCalVariantCriterion
  /begin VAR_ADDRESS 0x8003A5F5 0x8003B3F5 0x8003C1F5 0x8003CFF5 0x8003DDF5 0x8003EBF5 0x8003F9F5 0x800407F5 0x800415F5 0x800423F5 0x800431F5 0x80043FF5 0x80044DF5 0x80045BF5 0x800469F5 0x800477F5 0x800485F5 0x800493F5 0x8004A1F5 0x8004AFF5 0x8004BDF5 0x8004CBF5 0x8004D9F5 0x8004E7F5 /end VAR_ADDRESS
 /end VAR_CHARACTERISTIC
 /begin VAR_CHARACTERISTIC TP_U8ETCSCpSymBrkCtlTh[0][0] EngCalVariantCriterion
  /begin VAR_ADDRESS 0x8003A5F6 0x8003B3F6 0x8003C1F6 0x8003CFF6 0x8003DDF6 0x8003EBF6 0x8003F9F6 0x800407F6 0x800415F6 0x800423F6 0x800431F6 0x80043FF6 0x80044DF6 0x80045BF6 0x800469F6 0x800477F6 0x800485F6 0x800493F6 0x8004A1F6 0x8004AFF6 0x8004BDF6 0x8004CBF6 0x8004D9F6 0x8004E7F6 /end VAR_ADDRESS
 /end VAR_CHARACTERISTIC
 /begin VAR_CHARACTERISTIC TP_U8ETCSCpSymBrkCtlTh[0][1] EngCalVariantCriterion
  /begin VAR_ADDRESS 0x8003A5F7 0x8003B3F7 0x8003C1F7 0x8003CFF7 0x8003DDF7 0x8003EBF7 0x8003F9F7 0x800407F7 0x800415F7 0x800423F7 0x800431F7 0x80043FF7 0x80044DF7 0x80045BF7 0x800469F7 0x800477F7 0x800485F7 0x800493F7 0x8004A1F7 0x8004AFF7 0x8004BDF7 0x8004CBF7 0x8004D9F7 0x8004E7F7 /end VAR_ADDRESS
 /end VAR_CHARACTERISTIC
 /begin VAR_CHARACTERISTIC TP_U8ETCSCpSymBrkCtlTh[0][2] EngCalVariantCriterion
  /begin VAR_ADDRESS 0x8003A5F8 0x8003B3F8 0x8003C1F8 0x8003CFF8 0x8003DDF8 0x8003EBF8 0x8003F9F8 0x800407F8 0x800415F8 0x800423F8 0x800431F8 0x80043FF8 0x80044DF8 0x80045BF8 0x800469F8 0x800477F8 0x800485F8 0x800493F8 0x8004A1F8 0x8004AFF8 0x8004BDF8 0x8004CBF8 0x8004D9F8 0x8004E7F8 /end VAR_ADDRESS
 /end VAR_CHARACTERISTIC
 /begin VAR_CHARACTERISTIC TP_U8ETCSCpSymBrkCtlTh[0][3] EngCalVariantCriterion
  /begin VAR_ADDRESS 0x8003A5F9 0x8003B3F9 0x8003C1F9 0x8003CFF9 0x8003DDF9 0x8003EBF9 0x8003F9F9 0x800407F9 0x800415F9 0x800423F9 0x800431F9 0x80043FF9 0x80044DF9 0x80045BF9 0x800469F9 0x800477F9 0x800485F9 0x800493F9 0x8004A1F9 0x8004AFF9 0x8004BDF9 0x8004CBF9 0x8004D9F9 0x8004E7F9 /end VAR_ADDRESS
 /end VAR_CHARACTERISTIC
 /begin VAR_CHARACTERISTIC TP_U8ETCSCpSymBrkCtlTh[0][4] EngCalVariantCriterion
  /begin VAR_ADDRESS 0x8003A5FA 0x8003B3FA 0x8003C1FA 0x8003CFFA 0x8003DDFA 0x8003EBFA 0x8003F9FA 0x800407FA 0x800415FA 0x800423FA 0x800431FA 0x80043FFA 0x80044DFA 0x80045BFA 0x800469FA 0x800477FA 0x800485FA 0x800493FA 0x8004A1FA 0x8004AFFA 0x8004BDFA 0x8004CBFA 0x8004D9FA 0x8004E7FA /end VAR_ADDRESS
 /end VAR_CHARACTERISTIC
 /begin VAR_CHARACTERISTIC TP_U8ETCSCpSymBrkCtlTh[1][0] EngCalVariantCriterion
  /begin VAR_ADDRESS 0x8003A5FB 0x8003B3FB 0x8003C1FB 0x8003CFFB 0x8003DDFB 0x8003EBFB 0x8003F9FB 0x800407FB 0x800415FB 0x800423FB 0x800431FB 0x80043FFB 0x80044DFB 0x80045BFB 0x800469FB 0x800477FB 0x800485FB 0x800493FB 0x8004A1FB 0x8004AFFB 0x8004BDFB 0x8004CBFB 0x8004D9FB 0x8004E7FB /end VAR_ADDRESS
 /end VAR_CHARACTERISTIC
 /begin VAR_CHARACTERISTIC TP_U8ETCSCpSymBrkCtlTh[1][1] EngCalVariantCriterion
  /begin VAR_ADDRESS 0x8003A5FC 0x8003B3FC 0x8003C1FC 0x8003CFFC 0x8003DDFC 0x8003EBFC 0x8003F9FC 0x800407FC 0x800415FC 0x800423FC 0x800431FC 0x80043FFC 0x80044DFC 0x80045BFC 0x800469FC 0x800477FC 0x800485FC 0x800493FC 0x8004A1FC 0x8004AFFC 0x8004BDFC 0x8004CBFC 0x8004D9FC 0x8004E7FC /end VAR_ADDRESS
 /end VAR_CHARACTERISTIC
 /begin VAR_CHARACTERISTIC TP_U8ETCSCpSymBrkCtlTh[1][2] EngCalVariantCriterion
  /begin VAR_ADDRESS 0x8003A5FD 0x8003B3FD 0x8003C1FD 0x8003CFFD 0x8003DDFD 0x8003EBFD 0x8003F9FD 0x800407FD 0x800415FD 0x800423FD 0x800431FD 0x80043FFD 0x80044DFD 0x80045BFD 0x800469FD 0x800477FD 0x800485FD 0x800493FD 0x8004A1FD 0x8004AFFD 0x8004BDFD 0x8004CBFD 0x8004D9FD 0x8004E7FD /end VAR_ADDRESS
 /end VAR_CHARACTERISTIC
 /begin VAR_CHARACTERISTIC TP_U8ETCSCpSymBrkCtlTh[1][3] EngCalVariantCriterion
  /begin VAR_ADDRESS 0x8003A5FE 0x8003B3FE 0x8003C1FE 0x8003CFFE 0x8003DDFE 0x8003EBFE 0x8003F9FE 0x800407FE 0x800415FE 0x800423FE 0x800431FE 0x80043FFE 0x80044DFE 0x80045BFE 0x800469FE 0x800477FE 0x800485FE 0x800493FE 0x8004A1FE 0x8004AFFE 0x8004BDFE 0x8004CBFE 0x8004D9FE 0x8004E7FE /end VAR_ADDRESS
 /end VAR_CHARACTERISTIC
 /begin VAR_CHARACTERISTIC TP_U8ETCSCpSymBrkCtlTh[1][4] EngCalVariantCriterion
  /begin VAR_ADDRESS 0x8003A5FF 0x8003B3FF 0x8003C1FF 0x8003CFFF 0x8003DDFF 0x8003EBFF 0x8003F9FF 0x800407FF 0x800415FF 0x800423FF 0x800431FF 0x80043FFF 0x80044DFF 0x80045BFF 0x800469FF 0x800477FF 0x800485FF 0x800493FF 0x8004A1FF 0x8004AFFF 0x8004BDFF 0x8004CBFF 0x8004D9FF 0x8004E7FF /end VAR_ADDRESS
 /end VAR_CHARACTERISTIC
 /begin VAR_CHARACTERISTIC TP_U8ETCSCpSymBrkTrqMax[0] EngCalVariantCriterion
  /begin VAR_ADDRESS 0x8003A600 0x8003B400 0x8003C200 0x8003D000 0x8003DE00 0x8003EC00 0x8003FA00 0x80040800 0x80041600 0x80042400 0x80043200 0x80044000 0x80044E00 0x80045C00 0x80046A00 0x80047800 0x80048600 0x80049400 0x8004A200 0x8004B000 0x8004BE00 0x8004CC00 0x8004DA00 0x8004E800 /end VAR_ADDRESS
 /end VAR_CHARACTERISTIC
 /begin VAR_CHARACTERISTIC TP_U8ETCSCpSymBrkTrqMax[1] EngCalVariantCriterion
  /begin VAR_ADDRESS 0x8003A602 0x8003B402 0x8003C202 0x8003D002 0x8003DE02 0x8003EC02 0x8003FA02 0x80040802 0x80041602 0x80042402 0x80043202 0x80044002 0x80044E02 0x80045C02 0x80046A02 0x80047802 0x80048602 0x80049402 0x8004A202 0x8004B002 0x8004BE02 0x8004CC02 0x8004DA02 0x8004E802 /end VAR_ADDRESS
 /end VAR_CHARACTERISTIC
 /begin VAR_CHARACTERISTIC TP_U8ETCSCpSymBrkTrqMax[2] EngCalVariantCriterion
  /begin VAR_ADDRESS 0x8003A604 0x8003B404 0x8003C204 0x8003D004 0x8003DE04 0x8003EC04 0x8003FA04 0x80040804 0x80041604 0x80042404 0x80043204 0x80044004 0x80044E04 0x80045C04 0x80046A04 0x80047804 0x80048604 0x80049404 0x8004A204 0x8004B004 0x8004BE04 0x8004CC04 0x8004DA04 0x8004E804 /end VAR_ADDRESS
 /end VAR_CHARACTERISTIC
 /begin VAR_CHARACTERISTIC TP_U8ETCSCpSymBrkTrqMax[3] EngCalVariantCriterion
  /begin VAR_ADDRESS 0x8003A606 0x8003B406 0x8003C206 0x8003D006 0x8003DE06 0x8003EC06 0x8003FA06 0x80040806 0x80041606 0x80042406 0x80043206 0x80044006 0x80044E06 0x80045C06 0x80046A06 0x80047806 0x80048606 0x80049406 0x8004A206 0x8004B006 0x8004BE06 0x8004CC06 0x8004DA06 0x8004E806 /end VAR_ADDRESS
 /end VAR_CHARACTERISTIC
 /begin VAR_CHARACTERISTIC TP_U8ETCSCpSymBrkTrqMax[4] EngCalVariantCriterion
  /begin VAR_ADDRESS 0x8003A608 0x8003B408 0x8003C208 0x8003D008 0x8003DE08 0x8003EC08 0x8003FA08 0x80040808 0x80041608 0x80042408 0x80043208 0x80044008 0x80044E08 0x80045C08 0x80046A08 0x80047808 0x80048608 0x80049408 0x8004A208 0x8004B008 0x8004BE08 0x8004CC08 0x8004DA08 0x8004E808 /end VAR_ADDRESS
 /end VAR_CHARACTERISTIC
 /begin VAR_CHARACTERISTIC TP_U8ETCSCpSymSpnDifL2SpltTh EngCalVariantCriterion
  /begin VAR_ADDRESS 0x8003A60A 0x8003B40A 0x8003C20A 0x8003D00A 0x8003DE0A 0x8003EC0A 0x8003FA0A 0x8004080A 0x8004160A 0x8004240A 0x8004320A 0x8004400A 0x80044E0A 0x80045C0A 0x80046A0A 0x8004780A 0x8004860A 0x8004940A 0x8004A20A 0x8004B00A 0x8004BE0A 0x8004CC0A 0x8004DA0A 0x8004E80A /end VAR_ADDRESS
 /end VAR_CHARACTERISTIC
 /begin VAR_CHARACTERISTIC TP_U8ETCSCpSymSpnDifTh EngCalVariantCriterion
  /begin VAR_ADDRESS 0x8003A60B 0x8003B40B 0x8003C20B 0x8003D00B 0x8003DE0B 0x8003EC0B 0x8003FA0B 0x8004080B 0x8004160B 0x8004240B 0x8004320B 0x8004400B 0x80044E0B 0x80045C0B 0x80046A0B 0x8004780B 0x8004860B 0x8004940B 0x8004A20B 0x8004B00B 0x8004BE0B 0x8004CC0B 0x8004DA0B 0x8004E80B /end VAR_ADDRESS
 /end VAR_CHARACTERISTIC
 /begin VAR_CHARACTERISTIC TP_U8ETCSCpTEGInGrCntThr4ErSgnChng EngCalVariantCriterion
  /begin VAR_ADDRESS 0x8003A629 0x8003B429 0x8003C229 0x8003D029 0x8003DE29 0x8003EC29 0x8003FA29 0x80040829 0x80041629 0x80042429 0x80043229 0x80044029 0x80044E29 0x80045C29 0x80046A29 0x80047829 0x80048629 0x80049429 0x8004A229 0x8004B029 0x8004BE29 0x8004CC29 0x8004DA29 0x8004E829 /end VAR_ADDRESS
 /end VAR_CHARACTERISTIC
 /begin VAR_CHARACTERISTIC TP_U8ETCSCpTEGInGrCntThr4MultShft EngCalVariantCriterion
  /begin VAR_ADDRESS 0x8003A62A 0x8003B42A 0x8003C22A 0x8003D02A 0x8003DE2A 0x8003EC2A 0x8003FA2A 0x8004082A 0x8004162A 0x8004242A 0x8004322A 0x8004402A 0x80044E2A 0x80045C2A 0x80046A2A 0x8004782A 0x8004862A 0x8004942A 0x8004A22A 0x8004B02A 0x8004BE2A 0x8004CC2A 0x8004DA2A 0x8004E82A /end VAR_ADDRESS
 /end VAR_CHARACTERISTIC
 /begin VAR_CHARACTERISTIC TP_U8ETCSCpTEGInGrCntThr4SlpChng EngCalVariantCriterion
  /begin VAR_ADDRESS 0x8003A62B 0x8003B42B 0x8003C22B 0x8003D02B 0x8003DE2B 0x8003EC2B 0x8003FA2B 0x8004082B 0x8004162B 0x8004242B 0x8004322B 0x8004402B 0x80044E2B 0x80045C2B 0x80046A2B 0x8004782B 0x8004862B 0x8004942B 0x8004A22B 0x8004B02B 0x8004BE2B 0x8004CC2B 0x8004DA2B 0x8004E82B /end VAR_ADDRESS
 /end VAR_CHARACTERISTIC
 /begin VAR_CHARACTERISTIC TP_U8ETCSCpTEGInGrCntThr4SnglShft EngCalVariantCriterion
  /begin VAR_ADDRESS 0x8003A62C 0x8003B42C 0x8003C22C 0x8003D02C 0x8003DE2C 0x8003EC2C 0x8003FA2C 0x8004082C 0x8004162C 0x8004242C 0x8004322C 0x8004402C 0x80044E2C 0x80045C2C 0x80046A2C 0x8004782C 0x8004862C 0x8004942C 0x8004A22C 0x8004B02C 0x8004BE2C 0x8004CC2C 0x8004DA2C 0x8004E82C /end VAR_ADDRESS
 /end VAR_CHARACTERISTIC
 /begin VAR_CHARACTERISTIC TP_U8ETCSCpTEGOutGrCntThr EngCalVariantCriterion
  /begin VAR_ADDRESS 0x8003A62D 0x8003B42D 0x8003C22D 0x8003D02D 0x8003DE2D 0x8003EC2D 0x8003FA2D 0x8004082D 0x8004162D 0x8004242D 0x8004322D 0x8004402D 0x80044E2D 0x80045C2D 0x80046A2D 0x8004782D 0x8004862D 0x8004942D 0x8004A22D 0x8004B02D 0x8004BE2D 0x8004CC2D 0x8004DA2D 0x8004E82D /end VAR_ADDRESS
 /end VAR_CHARACTERISTIC
 /begin VAR_CHARACTERISTIC TP_U8ETCSCpTEGOutGrCntThr4Spin EngCalVariantCriterion
  /begin VAR_ADDRESS 0x8003A62E 0x8003B42E 0x8003C22E 0x8003D02E 0x8003DE2E 0x8003EC2E 0x8003FA2E 0x8004082E 0x8004162E 0x8004242E 0x8004322E 0x8004402E 0x80044E2E 0x80045C2E 0x80046A2E 0x8004782E 0x8004862E 0x8004942E 0x8004A22E 0x8004B02E 0x8004BE2E 0x8004CC2E 0x8004DA2E 0x8004E82E /end VAR_ADDRESS
 /end VAR_CHARACTERISTIC
 /begin VAR_CHARACTERISTIC TP_U8ETCSCpTEGSpdThrGr1st EngCalVariantCriterion
  /begin VAR_ADDRESS 0x8003A62F 0x8003B42F 0x8003C22F 0x8003D02F 0x8003DE2F 0x8003EC2F 0x8003FA2F 0x8004082F 0x8004162F 0x8004242F 0x8004322F 0x8004402F 0x80044E2F 0x80045C2F 0x80046A2F 0x8004782F 0x8004862F 0x8004942F 0x8004A22F 0x8004B02F 0x8004BE2F 0x8004CC2F 0x8004DA2F 0x8004E82F /end VAR_ADDRESS
 /end VAR_CHARACTERISTIC
 /begin VAR_CHARACTERISTIC TP_U8ETCSCpTarAddAcc EngCalVariantCriterion
  /begin VAR_ADDRESS 0x8003A60C 0x8003B40C 0x8003C20C 0x8003D00C 0x8003DE0C 0x8003EC0C 0x8003FA0C 0x8004080C 0x8004160C 0x8004240C 0x8004320C 0x8004400C 0x80044E0C 0x80045C0C 0x80046A0C 0x8004780C 0x8004860C 0x8004940C 0x8004A20C 0x8004B00C 0x8004BE0C 0x8004CC0C 0x8004DA0C 0x8004E80C /end VAR_ADDRESS
 /end VAR_CHARACTERISTIC
 /begin VAR_CHARACTERISTIC TP_U8ETCSCpTarNChngDltYawFac EngCalVariantCriterion
  /begin VAR_ADDRESS 0x8003A60D 0x8003B40D 0x8003C20D 0x8003D00D 0x8003DE0D 0x8003EC0D 0x8003FA0D 0x8004080D 0x8004160D 0x8004240D 0x8004320D 0x8004400D 0x80044E0D 0x80045C0D 0x80046A0D 0x8004780D 0x8004860D 0x8004940D 0x8004A20D 0x8004B00D 0x8004BE0D 0x8004CC0D 0x8004DA0D 0x8004E80D /end VAR_ADDRESS
 /end VAR_CHARACTERISTIC
 /begin VAR_CHARACTERISTIC TP_U8ETCSCpTarNChngDltYawHiBrkTrq EngCalVariantCriterion
  /begin VAR_ADDRESS 0x8003A60E 0x8003B40E 0x8003C20E 0x8003D00E 0x8003DE0E 0x8003EC0E 0x8003FA0E 0x8004080E 0x8004160E 0x8004240E 0x8004320E 0x8004400E 0x80044E0E 0x80045C0E 0x80046A0E 0x8004780E 0x8004860E 0x8004940E 0x8004A20E 0x8004B00E 0x8004BE0E 0x8004CC0E 0x8004DA0E 0x8004E80E /end VAR_ADDRESS
 /end VAR_CHARACTERISTIC
 /begin VAR_CHARACTERISTIC TP_U8ETCSCpTarNChngDltYawLwBrkTrq EngCalVariantCriterion
  /begin VAR_ADDRESS 0x8003A60F 0x8003B40F 0x8003C20F 0x8003D00F 0x8003DE0F 0x8003EC0F 0x8003FA0F 0x8004080F 0x8004160F 0x8004240F 0x8004320F 0x8004400F 0x80044E0F 0x80045C0F 0x80046A0F 0x8004780F 0x8004860F 0x8004940F 0x8004A20F 0x8004B00F 0x8004BE0F 0x8004CC0F 0x8004DA0F 0x8004E80F /end VAR_ADDRESS
 /end VAR_CHARACTERISTIC
 /begin VAR_CHARACTERISTIC TP_U8ETCSCpTarSpnAdd1stCycle[0] EngCalVariantCriterion
  /begin VAR_ADDRESS 0x8003A610 0x8003B410 0x8003C210 0x8003D010 0x8003DE10 0x8003EC10 0x8003FA10 0x80040810 0x80041610 0x80042410 0x80043210 0x80044010 0x80044E10 0x80045C10 0x80046A10 0x80047810 0x80048610 0x80049410 0x8004A210 0x8004B010 0x8004BE10 0x8004CC10 0x8004DA10 0x8004E810 /end VAR_ADDRESS
 /end VAR_CHARACTERISTIC
 /begin VAR_CHARACTERISTIC TP_U8ETCSCpTarSpnAdd1stCycle[1] EngCalVariantCriterion
  /begin VAR_ADDRESS 0x8003A611 0x8003B411 0x8003C211 0x8003D011 0x8003DE11 0x8003EC11 0x8003FA11 0x80040811 0x80041611 0x80042411 0x80043211 0x80044011 0x80044E11 0x80045C11 0x80046A11 0x80047811 0x80048611 0x80049411 0x8004A211 0x8004B011 0x8004BE11 0x8004CC11 0x8004DA11 0x8004E811 /end VAR_ADDRESS
 /end VAR_CHARACTERISTIC
 /begin VAR_CHARACTERISTIC TP_U8ETCSCpTarSpnAdd1stCycle[2] EngCalVariantCriterion
  /begin VAR_ADDRESS 0x8003A612 0x8003B412 0x8003C212 0x8003D012 0x8003DE12 0x8003EC12 0x8003FA12 0x80040812 0x80041612 0x80042412 0x80043212 0x80044012 0x80044E12 0x80045C12 0x80046A12 0x80047812 0x80048612 0x80049412 0x8004A212 0x8004B012 0x8004BE12 0x8004CC12 0x8004DA12 0x8004E812 /end VAR_ADDRESS
 /end VAR_CHARACTERISTIC
 /begin VAR_CHARACTERISTIC TP_U8ETCSCpTarSpnAdd1stCycle[3] EngCalVariantCriterion
  /begin VAR_ADDRESS 0x8003A613 0x8003B413 0x8003C213 0x8003D013 0x8003DE13 0x8003EC13 0x8003FA13 0x80040813 0x80041613 0x80042413 0x80043213 0x80044013 0x80044E13 0x80045C13 0x80046A13 0x80047813 0x80048613 0x80049413 0x8004A213 0x8004B013 0x8004BE13 0x8004CC13 0x8004DA13 0x8004E813 /end VAR_ADDRESS
 /end VAR_CHARACTERISTIC
 /begin VAR_CHARACTERISTIC TP_U8ETCSCpTarSpnAdd1stCycle[4] EngCalVariantCriterion
  /begin VAR_ADDRESS 0x8003A614 0x8003B414 0x8003C214 0x8003D014 0x8003DE14 0x8003EC14 0x8003FA14 0x80040814 0x80041614 0x80042414 0x80043214 0x80044014 0x80044E14 0x80045C14 0x80046A14 0x80047814 0x80048614 0x80049414 0x8004A214 0x8004B014 0x8004BE14 0x8004CC14 0x8004DA14 0x8004E814 /end VAR_ADDRESS
 /end VAR_CHARACTERISTIC
 /begin VAR_CHARACTERISTIC TP_U8ETCSCpTarSpnAdd4AbnmSizTire EngCalVariantCriterion
  /begin VAR_ADDRESS 0x8003A615 0x8003B415 0x8003C215 0x8003D015 0x8003DE15 0x8003EC15 0x8003FA15 0x80040815 0x80041615 0x80042415 0x80043215 0x80044015 0x80044E15 0x80045C15 0x80046A15 0x80047815 0x80048615 0x80049415 0x8004A215 0x8004B015 0x8004BE15 0x8004CC15 0x8004DA15 0x8004E815 /end VAR_ADDRESS
 /end VAR_CHARACTERISTIC
 /begin VAR_CHARACTERISTIC TP_U8ETCSCpTarSpnAdd4AdHiRd EngCalVariantCriterion
  /begin VAR_ADDRESS 0x8003A616 0x8003B416 0x8003C216 0x8003D016 0x8003DE16 0x8003EC16 0x8003FA16 0x80040816 0x80041616 0x80042416 0x80043216 0x80044016 0x80044E16 0x80045C16 0x80046A16 0x80047816 0x80048616 0x80049416 0x8004A216 0x8004B016 0x8004BE16 0x8004CC16 0x8004DA16 0x8004E816 /end VAR_ADDRESS
 /end VAR_CHARACTERISTIC
 /begin VAR_CHARACTERISTIC TP_U8ETCSCpTarSpnAdd4DepSnwHil EngCalVariantCriterion
  /begin VAR_ADDRESS 0x8003A617 0x8003B417 0x8003C217 0x8003D017 0x8003DE17 0x8003EC17 0x8003FA17 0x80040817 0x80041617 0x80042417 0x80043217 0x80044017 0x80044E17 0x80045C17 0x80046A17 0x80047817 0x80048617 0x80049417 0x8004A217 0x8004B017 0x8004BE17 0x8004CC17 0x8004DA17 0x8004E817 /end VAR_ADDRESS
 /end VAR_CHARACTERISTIC
 /begin VAR_CHARACTERISTIC TP_U8ETCSCpTarSpnAdd4DrvPrtnMd EngCalVariantCriterion
  /begin VAR_ADDRESS 0x8003A618 0x8003B418 0x8003C218 0x8003D018 0x8003DE18 0x8003EC18 0x8003FA18 0x80040818 0x80041618 0x80042418 0x80043218 0x80044018 0x80044E18 0x80045C18 0x80046A18 0x80047818 0x80048618 0x80049418 0x8004A218 0x8004B018 0x8004BE18 0x8004CC18 0x8004DA18 0x8004E818 /end VAR_ADDRESS
 /end VAR_CHARACTERISTIC
 /begin VAR_CHARACTERISTIC TP_U8ETCSCpTarSpnAdd4Hill EngCalVariantCriterion
  /begin VAR_ADDRESS 0x8003A619 0x8003B419 0x8003C219 0x8003D019 0x8003DE19 0x8003EC19 0x8003FA19 0x80040819 0x80041619 0x80042419 0x80043219 0x80044019 0x80044E19 0x80045C19 0x80046A19 0x80047819 0x80048619 0x80049419 0x8004A219 0x8004B019 0x8004BE19 0x8004CC19 0x8004DA19 0x8004E819 /end VAR_ADDRESS
 /end VAR_CHARACTERISTIC
 /begin VAR_CHARACTERISTIC TP_U8ETCSCpTarSpnAdd4LwWhlSpn EngCalVariantCriterion
  /begin VAR_ADDRESS 0x8003A61A 0x8003B41A 0x8003C21A 0x8003D01A 0x8003DE1A 0x8003EC1A 0x8003FA1A 0x8004081A 0x8004161A 0x8004241A 0x8004321A 0x8004401A 0x80044E1A 0x80045C1A 0x80046A1A 0x8004781A 0x8004861A 0x8004941A 0x8004A21A 0x8004B01A 0x8004BE1A 0x8004CC1A 0x8004DA1A 0x8004E81A /end VAR_ADDRESS
 /end VAR_CHARACTERISTIC
 /begin VAR_CHARACTERISTIC TP_U8ETCSCpTarSpnAdd4PreHiRd EngCalVariantCriterion
  /begin VAR_ADDRESS 0x8003A61B 0x8003B41B 0x8003C21B 0x8003D01B 0x8003DE1B 0x8003EC1B 0x8003FA1B 0x8004081B 0x8004161B 0x8004241B 0x8004321B 0x8004401B 0x80044E1B 0x80045C1B 0x80046A1B 0x8004781B 0x8004861B 0x8004941B 0x8004A21B 0x8004B01B 0x8004BE1B 0x8004CC1B 0x8004DA1B 0x8004E81B /end VAR_ADDRESS
 /end VAR_CHARACTERISTIC
 /begin VAR_CHARACTERISTIC TP_U8ETCSCpTarSpnAdd4Sp EngCalVariantCriterion
  /begin VAR_ADDRESS 0x8003A61C 0x8003B41C 0x8003C21C 0x8003D01C 0x8003DE1C 0x8003EC1C 0x8003FA1C 0x8004081C 0x8004161C 0x8004241C 0x8004321C 0x8004401C 0x80044E1C 0x80045C1C 0x80046A1C 0x8004781C 0x8004861C 0x8004941C 0x8004A21C 0x8004B01C 0x8004BE1C 0x8004CC1C 0x8004DA1C 0x8004E81C /end VAR_ADDRESS
 /end VAR_CHARACTERISTIC
 /begin VAR_CHARACTERISTIC TP_U8ETCSCpTarSpnAdd4Track EngCalVariantCriterion
  /begin VAR_ADDRESS 0x8003A61D 0x8003B41D 0x8003C21D 0x8003D01D 0x8003DE1D 0x8003EC1D 0x8003FA1D 0x8004081D 0x8004161D 0x8004241D 0x8004321D 0x8004401D 0x80044E1D 0x80045C1D 0x80046A1D 0x8004781D 0x8004861D 0x8004941D 0x8004A21D 0x8004B01D 0x8004BE1D 0x8004CC1D 0x8004DA1D 0x8004E81D /end VAR_ADDRESS
 /end VAR_CHARACTERISTIC
 /begin VAR_CHARACTERISTIC TP_U8ETCSCpTarSpnAddLwSpd EngCalVariantCriterion
  /begin VAR_ADDRESS 0x8003A61E 0x8003B41E 0x8003C21E 0x8003D01E 0x8003DE1E 0x8003EC1E 0x8003FA1E 0x8004081E 0x8004161E 0x8004241E 0x8004321E 0x8004401E 0x80044E1E 0x80045C1E 0x80046A1E 0x8004781E 0x8004861E 0x8004941E 0x8004A21E 0x8004B01E 0x8004BE1E 0x8004CC1E 0x8004DA1E 0x8004E81E /end VAR_ADDRESS
 /end VAR_CHARACTERISTIC
 /begin VAR_CHARACTERISTIC TP_U8ETCSCpTarSpnTransTme EngCalVariantCriterion
  /begin VAR_ADDRESS 0x8003A61F 0x8003B41F 0x8003C21F 0x8003D01F 0x8003DE1F 0x8003EC1F 0x8003FA1F 0x8004081F 0x8004161F 0x8004241F 0x8004321F 0x8004401F 0x80044E1F 0x80045C1F 0x80046A1F 0x8004781F 0x8004861F 0x8004941F 0x8004A21F 0x8004B01F 0x8004BE1F 0x8004CC1F 0x8004DA1F 0x8004E81F /end VAR_ADDRESS
 /end VAR_CHARACTERISTIC
 /begin VAR_CHARACTERISTIC TP_U8ETCSCpTarTransCplBrkTrq2Sp EngCalVariantCriterion
  /begin VAR_ADDRESS 0x8003A620 0x8003B420 0x8003C220 0x8003D020 0x8003DE20 0x8003EC20 0x8003FA20 0x80040820 0x80041620 0x80042420 0x80043220 0x80044020 0x80044E20 0x80045C20 0x80046A20 0x80047820 0x80048620 0x80049420 0x8004A220 0x8004B020 0x8004BE20 0x8004CC20 0x8004DA20 0x8004E820 /end VAR_ADDRESS
 /end VAR_CHARACTERISTIC
 /begin VAR_CHARACTERISTIC TP_U8ETCSCpTarTransCplReBrkTrq2Sp EngCalVariantCriterion
  /begin VAR_ADDRESS 0x8003A621 0x8003B421 0x8003C221 0x8003D021 0x8003DE21 0x8003EC21 0x8003FA21 0x80040821 0x80041621 0x80042421 0x80043221 0x80044021 0x80044E21 0x80045C21 0x80046A21 0x80047821 0x80048621 0x80049421 0x8004A221 0x8004B021 0x8004BE21 0x8004CC21 0x8004DA21 0x8004E821 /end VAR_ADDRESS
 /end VAR_CHARACTERISTIC
 /begin VAR_CHARACTERISTIC TP_U8ETCSCpTarTransStBrkTrq2Sp EngCalVariantCriterion
  /begin VAR_ADDRESS 0x8003A622 0x8003B422 0x8003C222 0x8003D022 0x8003DE22 0x8003EC22 0x8003FA22 0x80040822 0x80041622 0x80042422 0x80043222 0x80044022 0x80044E22 0x80045C22 0x80046A22 0x80047822 0x80048622 0x80049422 0x8004A222 0x8004B022 0x8004BE22 0x8004CC22 0x8004DA22 0x8004E822 /end VAR_ADDRESS
 /end VAR_CHARACTERISTIC
 /begin VAR_CHARACTERISTIC TP_U8ETCSCpTarTransStReBrkTrq2Sp EngCalVariantCriterion
  /begin VAR_ADDRESS 0x8003A623 0x8003B423 0x8003C223 0x8003D023 0x8003DE23 0x8003EC23 0x8003FA23 0x80040823 0x80041623 0x80042423 0x80043223 0x80044023 0x80044E23 0x80045C23 0x80046A23 0x80047823 0x80048623 0x80049423 0x8004A223 0x8004B023 0x8004BE23 0x8004CC23 0x8004DA23 0x8004E823 /end VAR_ADDRESS
 /end VAR_CHARACTERISTIC
 /begin VAR_CHARACTERISTIC TP_U8ETCSCpTarWhlSpin[0] EngCalVariantCriterion
  /begin VAR_ADDRESS 0x8003A624 0x8003B424 0x8003C224 0x8003D024 0x8003DE24 0x8003EC24 0x8003FA24 0x80040824 0x80041624 0x80042424 0x80043224 0x80044024 0x80044E24 0x80045C24 0x80046A24 0x80047824 0x80048624 0x80049424 0x8004A224 0x8004B024 0x8004BE24 0x8004CC24 0x8004DA24 0x8004E824 /end VAR_ADDRESS
 /end VAR_CHARACTERISTIC
 /begin VAR_CHARACTERISTIC TP_U8ETCSCpTarWhlSpin[1] EngCalVariantCriterion
  /begin VAR_ADDRESS 0x8003A625 0x8003B425 0x8003C225 0x8003D025 0x8003DE25 0x8003EC25 0x8003FA25 0x80040825 0x80041625 0x80042425 0x80043225 0x80044025 0x80044E25 0x80045C25 0x80046A25 0x80047825 0x80048625 0x80049425 0x8004A225 0x8004B025 0x8004BE25 0x8004CC25 0x8004DA25 0x8004E825 /end VAR_ADDRESS
 /end VAR_CHARACTERISTIC
 /begin VAR_CHARACTERISTIC TP_U8ETCSCpTarWhlSpin[2] EngCalVariantCriterion
  /begin VAR_ADDRESS 0x8003A626 0x8003B426 0x8003C226 0x8003D026 0x8003DE26 0x8003EC26 0x8003FA26 0x80040826 0x80041626 0x80042426 0x80043226 0x80044026 0x80044E26 0x80045C26 0x80046A26 0x80047826 0x80048626 0x80049426 0x8004A226 0x8004B026 0x8004BE26 0x8004CC26 0x8004DA26 0x8004E826 /end VAR_ADDRESS
 /end VAR_CHARACTERISTIC
 /begin VAR_CHARACTERISTIC TP_U8ETCSCpTarWhlSpin[3] EngCalVariantCriterion
  /begin VAR_ADDRESS 0x8003A627 0x8003B427 0x8003C227 0x8003D027 0x8003DE27 0x8003EC27 0x8003FA27 0x80040827 0x80041627 0x80042427 0x80043227 0x80044027 0x80044E27 0x80045C27 0x80046A27 0x80047827 0x80048627 0x80049427 0x8004A227 0x8004B027 0x8004BE27 0x8004CC27 0x8004DA27 0x8004E827 /end VAR_ADDRESS
 /end VAR_CHARACTERISTIC
 /begin VAR_CHARACTERISTIC TP_U8ETCSCpTarWhlSpin[4] EngCalVariantCriterion
  /begin VAR_ADDRESS 0x8003A628 0x8003B428 0x8003C228 0x8003D028 0x8003DE28 0x8003EC28 0x8003FA28 0x80040828 0x80041628 0x80042428 0x80043228 0x80044028 0x80044E28 0x80045C28 0x80046A28 0x80047828 0x80048628 0x80049428 0x8004A228 0x8004B028 0x8004BE28 0x8004CC28 0x8004DA28 0x8004E828 /end VAR_ADDRESS
 /end VAR_CHARACTERISTIC
 /begin VAR_CHARACTERISTIC TP_U8ETCSCpTimeTh2ClrCyl1st EngCalVariantCriterion
  /begin VAR_ADDRESS 0x8003A630 0x8003B430 0x8003C230 0x8003D030 0x8003DE30 0x8003EC30 0x8003FA30 0x80040830 0x80041630 0x80042430 0x80043230 0x80044030 0x80044E30 0x80045C30 0x80046A30 0x80047830 0x80048630 0x80049430 0x8004A230 0x8004B030 0x8004BE30 0x8004CC30 0x8004DA30 0x8004E830 /end VAR_ADDRESS
 /end VAR_CHARACTERISTIC
 /begin VAR_CHARACTERISTIC TP_U8ETCSCpTrackHiRdCplCnt EngCalVariantCriterion
  /begin VAR_ADDRESS 0x8003A631 0x8003B431 0x8003C231 0x8003D031 0x8003DE31 0x8003EC31 0x8003FA31 0x80040831 0x80041631 0x80042431 0x80043231 0x80044031 0x80044E31 0x80045C31 0x80046A31 0x80047831 0x80048631 0x80049431 0x8004A231 0x8004B031 0x8004BE31 0x8004CC31 0x8004DA31 0x8004E831 /end VAR_ADDRESS
 /end VAR_CHARACTERISTIC
 /begin VAR_CHARACTERISTIC TP_U8ETCSCpTrackHiRdStCnt EngCalVariantCriterion
  /begin VAR_ADDRESS 0x8003A632 0x8003B432 0x8003C232 0x8003D032 0x8003DE32 0x8003EC32 0x8003FA32 0x80040832 0x80041632 0x80042432 0x80043232 0x80044032 0x80044E32 0x80045C32 0x80046A32 0x80047832 0x80048632 0x80049432 0x8004A232 0x8004B032 0x8004BE32 0x8004CC32 0x8004DA32 0x8004E832 /end VAR_ADDRESS
 /end VAR_CHARACTERISTIC
 /begin VAR_CHARACTERISTIC TP_U8ETCSCpTrqDel[0] EngCalVariantCriterion
  /begin VAR_ADDRESS 0x8003A633 0x8003B433 0x8003C233 0x8003D033 0x8003DE33 0x8003EC33 0x8003FA33 0x80040833 0x80041633 0x80042433 0x80043233 0x80044033 0x80044E33 0x80045C33 0x80046A33 0x80047833 0x80048633 0x80049433 0x8004A233 0x8004B033 0x8004BE33 0x8004CC33 0x8004DA33 0x8004E833 /end VAR_ADDRESS
 /end VAR_CHARACTERISTIC
 /begin VAR_CHARACTERISTIC TP_U8ETCSCpTrqDel[1] EngCalVariantCriterion
  /begin VAR_ADDRESS 0x8003A634 0x8003B434 0x8003C234 0x8003D034 0x8003DE34 0x8003EC34 0x8003FA34 0x80040834 0x80041634 0x80042434 0x80043234 0x80044034 0x80044E34 0x80045C34 0x80046A34 0x80047834 0x80048634 0x80049434 0x8004A234 0x8004B034 0x8004BE34 0x8004CC34 0x8004DA34 0x8004E834 /end VAR_ADDRESS
 /end VAR_CHARACTERISTIC
 /begin VAR_CHARACTERISTIC TP_U8ETCSCpTrqDel[2] EngCalVariantCriterion
  /begin VAR_ADDRESS 0x8003A635 0x8003B435 0x8003C235 0x8003D035 0x8003DE35 0x8003EC35 0x8003FA35 0x80040835 0x80041635 0x80042435 0x80043235 0x80044035 0x80044E35 0x80045C35 0x80046A35 0x80047835 0x80048635 0x80049435 0x8004A235 0x8004B035 0x8004BE35 0x8004CC35 0x8004DA35 0x8004E835 /end VAR_ADDRESS
 /end VAR_CHARACTERISTIC
 /begin VAR_CHARACTERISTIC TP_U8ETCSCpTrqDel[3] EngCalVariantCriterion
  /begin VAR_ADDRESS 0x8003A636 0x8003B436 0x8003C236 0x8003D036 0x8003DE36 0x8003EC36 0x8003FA36 0x80040836 0x80041636 0x80042436 0x80043236 0x80044036 0x80044E36 0x80045C36 0x80046A36 0x80047836 0x80048636 0x80049436 0x8004A236 0x8004B036 0x8004BE36 0x8004CC36 0x8004DA36 0x8004E836 /end VAR_ADDRESS
 /end VAR_CHARACTERISTIC
 /begin VAR_CHARACTERISTIC TP_U8ETCSCpTrqDel[4] EngCalVariantCriterion
  /begin VAR_ADDRESS 0x8003A637 0x8003B437 0x8003C237 0x8003D037 0x8003DE37 0x8003EC37 0x8003FA37 0x80040837 0x80041637 0x80042437 0x80043237 0x80044037 0x80044E37 0x80045C37 0x80046A37 0x80047837 0x80048637 0x80049437 0x8004A237 0x8004B037 0x8004BE37 0x8004CC37 0x8004DA37 0x8004E837 /end VAR_ADDRESS
 /end VAR_CHARACTERISTIC
 /begin VAR_CHARACTERISTIC TP_U8ETCSCpWhlSpnTransVal EngCalVariantCriterion
  /begin VAR_ADDRESS 0x8003A638 0x8003B438 0x8003C238 0x8003D038 0x8003DE38 0x8003EC38 0x8003FA38 0x80040838 0x80041638 0x80042438 0x80043238 0x80044038 0x80044E38 0x80045C38 0x80046A38 0x80047838 0x80048638 0x80049438 0x8004A238 0x8004B038 0x8004BE38 0x8004CC38 0x8004DA38 0x8004E838 /end VAR_ADDRESS
 /end VAR_CHARACTERISTIC
 /begin VAR_CHARACTERISTIC TP_U8ETCSCpYawCtlFacInDepSnw EngCalVariantCriterion
  /begin VAR_ADDRESS 0x8003A639 0x8003B439 0x8003C239 0x8003D039 0x8003DE39 0x8003EC39 0x8003FA39 0x80040839 0x80041639 0x80042439 0x80043239 0x80044039 0x80044E39 0x80045C39 0x80046A39 0x80047839 0x80048639 0x80049439 0x8004A239 0x8004B039 0x8004BE39 0x8004CC39 0x8004DA39 0x8004E839 /end VAR_ADDRESS
 /end VAR_CHARACTERISTIC
 /begin VAR_CHARACTERISTIC TP_U8ETCSCpYawStabCntTh[0] EngCalVariantCriterion
  /begin VAR_ADDRESS 0x8003A63A 0x8003B43A 0x8003C23A 0x8003D03A 0x8003DE3A 0x8003EC3A 0x8003FA3A 0x8004083A 0x8004163A 0x8004243A 0x8004323A 0x8004403A 0x80044E3A 0x80045C3A 0x80046A3A 0x8004783A 0x8004863A 0x8004943A 0x8004A23A 0x8004B03A 0x8004BE3A 0x8004CC3A 0x8004DA3A 0x8004E83A /end VAR_ADDRESS
 /end VAR_CHARACTERISTIC
 /begin VAR_CHARACTERISTIC TP_U8ETCSCpYawStabCntTh[1] EngCalVariantCriterion
  /begin VAR_ADDRESS 0x8003A63B 0x8003B43B 0x8003C23B 0x8003D03B 0x8003DE3B 0x8003EC3B 0x8003FA3B 0x8004083B 0x8004163B 0x8004243B 0x8004323B 0x8004403B 0x80044E3B 0x80045C3B 0x80046A3B 0x8004783B 0x8004863B 0x8004943B 0x8004A23B 0x8004B03B 0x8004BE3B 0x8004CC3B 0x8004DA3B 0x8004E83B /end VAR_ADDRESS
 /end VAR_CHARACTERISTIC
 /begin VAR_CHARACTERISTIC TP_U8ETCSCpYawStabCntTh[2] EngCalVariantCriterion
  /begin VAR_ADDRESS 0x8003A63C 0x8003B43C 0x8003C23C 0x8003D03C 0x8003DE3C 0x8003EC3C 0x8003FA3C 0x8004083C 0x8004163C 0x8004243C 0x8004323C 0x8004403C 0x80044E3C 0x80045C3C 0x80046A3C 0x8004783C 0x8004863C 0x8004943C 0x8004A23C 0x8004B03C 0x8004BE3C 0x8004CC3C 0x8004DA3C 0x8004E83C /end VAR_ADDRESS
 /end VAR_CHARACTERISTIC
 /begin VAR_CHARACTERISTIC TP_U8ETCSCpYawStabCnvrgThFac EngCalVariantCriterion
  /begin VAR_ADDRESS 0x8003A63D 0x8003B43D 0x8003C23D 0x8003D03D 0x8003DE3D 0x8003EC3D 0x8003FA3D 0x8004083D 0x8004163D 0x8004243D 0x8004323D 0x8004403D 0x80044E3D 0x80045C3D 0x80046A3D 0x8004783D 0x8004863D 0x8004943D 0x8004A23D 0x8004B03D 0x8004BE3D 0x8004CC3D 0x8004DA3D 0x8004E83D /end VAR_ADDRESS
 /end VAR_CHARACTERISTIC
 /begin VAR_CHARACTERISTIC TP_U8ETCSCpYawThFacInDepSnw EngCalVariantCriterion
  /begin VAR_ADDRESS 0x8003A64D 0x8003B44D 0x8003C24D 0x8003D04D 0x8003DE4D 0x8003EC4D 0x8003FA4D 0x8004084D 0x8004164D 0x8004244D 0x8004324D 0x8004404D 0x80044E4D 0x80045C4D 0x80046A4D 0x8004784D 0x8004864D 0x8004944D 0x8004A24D 0x8004B04D 0x8004BE4D 0x8004CC4D 0x8004DA4D 0x8004E84D /end VAR_ADDRESS
 /end VAR_CHARACTERISTIC
 /begin VAR_CHARACTERISTIC TP_U8ETCSCpYawThFac[0][0] EngCalVariantCriterion
  /begin VAR_ADDRESS 0x8003A63E 0x8003B43E 0x8003C23E 0x8003D03E 0x8003DE3E 0x8003EC3E 0x8003FA3E 0x8004083E 0x8004163E 0x8004243E 0x8004323E 0x8004403E 0x80044E3E 0x80045C3E 0x80046A3E 0x8004783E 0x8004863E 0x8004943E 0x8004A23E 0x8004B03E 0x8004BE3E 0x8004CC3E 0x8004DA3E 0x8004E83E /end VAR_ADDRESS
 /end VAR_CHARACTERISTIC
 /begin VAR_CHARACTERISTIC TP_U8ETCSCpYawThFac[0][1] EngCalVariantCriterion
  /begin VAR_ADDRESS 0x8003A63F 0x8003B43F 0x8003C23F 0x8003D03F 0x8003DE3F 0x8003EC3F 0x8003FA3F 0x8004083F 0x8004163F 0x8004243F 0x8004323F 0x8004403F 0x80044E3F 0x80045C3F 0x80046A3F 0x8004783F 0x8004863F 0x8004943F 0x8004A23F 0x8004B03F 0x8004BE3F 0x8004CC3F 0x8004DA3F 0x8004E83F /end VAR_ADDRESS
 /end VAR_CHARACTERISTIC
 /begin VAR_CHARACTERISTIC TP_U8ETCSCpYawThFac[0][2] EngCalVariantCriterion
  /begin VAR_ADDRESS 0x8003A640 0x8003B440 0x8003C240 0x8003D040 0x8003DE40 0x8003EC40 0x8003FA40 0x80040840 0x80041640 0x80042440 0x80043240 0x80044040 0x80044E40 0x80045C40 0x80046A40 0x80047840 0x80048640 0x80049440 0x8004A240 0x8004B040 0x8004BE40 0x8004CC40 0x8004DA40 0x8004E840 /end VAR_ADDRESS
 /end VAR_CHARACTERISTIC
 /begin VAR_CHARACTERISTIC TP_U8ETCSCpYawThFac[0][3] EngCalVariantCriterion
  /begin VAR_ADDRESS 0x8003A641 0x8003B441 0x8003C241 0x8003D041 0x8003DE41 0x8003EC41 0x8003FA41 0x80040841 0x80041641 0x80042441 0x80043241 0x80044041 0x80044E41 0x80045C41 0x80046A41 0x80047841 0x80048641 0x80049441 0x8004A241 0x8004B041 0x8004BE41 0x8004CC41 0x8004DA41 0x8004E841 /end VAR_ADDRESS
 /end VAR_CHARACTERISTIC
 /begin VAR_CHARACTERISTIC TP_U8ETCSCpYawThFac[0][4] EngCalVariantCriterion
  /begin VAR_ADDRESS 0x8003A642 0x8003B442 0x8003C242 0x8003D042 0x8003DE42 0x8003EC42 0x8003FA42 0x80040842 0x80041642 0x80042442 0x80043242 0x80044042 0x80044E42 0x80045C42 0x80046A42 0x80047842 0x80048642 0x80049442 0x8004A242 0x8004B042 0x8004BE42 0x8004CC42 0x8004DA42 0x8004E842 /end VAR_ADDRESS
 /end VAR_CHARACTERISTIC
 /begin VAR_CHARACTERISTIC TP_U8ETCSCpYawThFac[1][0] EngCalVariantCriterion
  /begin VAR_ADDRESS 0x8003A643 0x8003B443 0x8003C243 0x8003D043 0x8003DE43 0x8003EC43 0x8003FA43 0x80040843 0x80041643 0x80042443 0x80043243 0x80044043 0x80044E43 0x80045C43 0x80046A43 0x80047843 0x80048643 0x80049443 0x8004A243 0x8004B043 0x8004BE43 0x8004CC43 0x8004DA43 0x8004E843 /end VAR_ADDRESS
 /end VAR_CHARACTERISTIC
 /begin VAR_CHARACTERISTIC TP_U8ETCSCpYawThFac[1][1] EngCalVariantCriterion
  /begin VAR_ADDRESS 0x8003A644 0x8003B444 0x8003C244 0x8003D044 0x8003DE44 0x8003EC44 0x8003FA44 0x80040844 0x80041644 0x80042444 0x80043244 0x80044044 0x80044E44 0x80045C44 0x80046A44 0x80047844 0x80048644 0x80049444 0x8004A244 0x8004B044 0x8004BE44 0x8004CC44 0x8004DA44 0x8004E844 /end VAR_ADDRESS
 /end VAR_CHARACTERISTIC
 /begin VAR_CHARACTERISTIC TP_U8ETCSCpYawThFac[1][2] EngCalVariantCriterion
  /begin VAR_ADDRESS 0x8003A645 0x8003B445 0x8003C245 0x8003D045 0x8003DE45 0x8003EC45 0x8003FA45 0x80040845 0x80041645 0x80042445 0x80043245 0x80044045 0x80044E45 0x80045C45 0x80046A45 0x80047845 0x80048645 0x80049445 0x8004A245 0x8004B045 0x8004BE45 0x8004CC45 0x8004DA45 0x8004E845 /end VAR_ADDRESS
 /end VAR_CHARACTERISTIC
 /begin VAR_CHARACTERISTIC TP_U8ETCSCpYawThFac[1][3] EngCalVariantCriterion
  /begin VAR_ADDRESS 0x8003A646 0x8003B446 0x8003C246 0x8003D046 0x8003DE46 0x8003EC46 0x8003FA46 0x80040846 0x80041646 0x80042446 0x80043246 0x80044046 0x80044E46 0x80045C46 0x80046A46 0x80047846 0x80048646 0x80049446 0x8004A246 0x8004B046 0x8004BE46 0x8004CC46 0x8004DA46 0x8004E846 /end VAR_ADDRESS
 /end VAR_CHARACTERISTIC
 /begin VAR_CHARACTERISTIC TP_U8ETCSCpYawThFac[1][4] EngCalVariantCriterion
  /begin VAR_ADDRESS 0x8003A647 0x8003B447 0x8003C247 0x8003D047 0x8003DE47 0x8003EC47 0x8003FA47 0x80040847 0x80041647 0x80042447 0x80043247 0x80044047 0x80044E47 0x80045C47 0x80046A47 0x80047847 0x80048647 0x80049447 0x8004A247 0x8004B047 0x8004BE47 0x8004CC47 0x8004DA47 0x8004E847 /end VAR_ADDRESS
 /end VAR_CHARACTERISTIC
 /begin VAR_CHARACTERISTIC TP_U8ETCSCpYawThFac[2][0] EngCalVariantCriterion
  /begin VAR_ADDRESS 0x8003A648 0x8003B448 0x8003C248 0x8003D048 0x8003DE48 0x8003EC48 0x8003FA48 0x80040848 0x80041648 0x80042448 0x80043248 0x80044048 0x80044E48 0x80045C48 0x80046A48 0x80047848 0x80048648 0x80049448 0x8004A248 0x8004B048 0x8004BE48 0x8004CC48 0x8004DA48 0x8004E848 /end VAR_ADDRESS
 /end VAR_CHARACTERISTIC
 /begin VAR_CHARACTERISTIC TP_U8ETCSCpYawThFac[2][1] EngCalVariantCriterion
  /begin VAR_ADDRESS 0x8003A649 0x8003B449 0x8003C249 0x8003D049 0x8003DE49 0x8003EC49 0x8003FA49 0x80040849 0x80041649 0x80042449 0x80043249 0x80044049 0x80044E49 0x80045C49 0x80046A49 0x80047849 0x80048649 0x80049449 0x8004A249 0x8004B049 0x8004BE49 0x8004CC49 0x8004DA49 0x8004E849 /end VAR_ADDRESS
 /end VAR_CHARACTERISTIC
 /begin VAR_CHARACTERISTIC TP_U8ETCSCpYawThFac[2][2] EngCalVariantCriterion
  /begin VAR_ADDRESS 0x8003A64A 0x8003B44A 0x8003C24A 0x8003D04A 0x8003DE4A 0x8003EC4A 0x8003FA4A 0x8004084A 0x8004164A 0x8004244A 0x8004324A 0x8004404A 0x80044E4A 0x80045C4A 0x80046A4A 0x8004784A 0x8004864A 0x8004944A 0x8004A24A 0x8004B04A 0x8004BE4A 0x8004CC4A 0x8004DA4A 0x8004E84A /end VAR_ADDRESS
 /end VAR_CHARACTERISTIC
 /begin VAR_CHARACTERISTIC TP_U8ETCSCpYawThFac[2][3] EngCalVariantCriterion
  /begin VAR_ADDRESS 0x8003A64B 0x8003B44B 0x8003C24B 0x8003D04B 0x8003DE4B 0x8003EC4B 0x8003FA4B 0x8004084B 0x8004164B 0x8004244B 0x8004324B 0x8004404B 0x80044E4B 0x80045C4B 0x80046A4B 0x8004784B 0x8004864B 0x8004944B 0x8004A24B 0x8004B04B 0x8004BE4B 0x8004CC4B 0x8004DA4B 0x8004E84B /end VAR_ADDRESS
 /end VAR_CHARACTERISTIC
 /begin VAR_CHARACTERISTIC TP_U8ETCSCpYawThFac[2][4] EngCalVariantCriterion
  /begin VAR_ADDRESS 0x8003A64C 0x8003B44C 0x8003C24C 0x8003D04C 0x8003DE4C 0x8003EC4C 0x8003FA4C 0x8004084C 0x8004164C 0x8004244C 0x8004324C 0x8004404C 0x80044E4C 0x80045C4C 0x80046A4C 0x8004784C 0x8004864C 0x8004944C 0x8004A24C 0x8004B04C 0x8004BE4C 0x8004CC4C 0x8004DA4C 0x8004E84C /end VAR_ADDRESS
 /end VAR_CHARACTERISTIC
 /begin VAR_CHARACTERISTIC TP_U8TCSCpAfterIIntActScan EngCalVariantCriterion
  /begin VAR_ADDRESS 0x8003A26B 0x8003B06B 0x8003BE6B 0x8003CC6B 0x8003DA6B 0x8003E86B 0x8003F66B 0x8004046B 0x8004126B 0x8004206B 0x80042E6B 0x80043C6B 0x80044A6B 0x8004586B 0x8004666B 0x8004746B 0x8004826B 0x8004906B 0x80049E6B 0x8004AC6B 0x8004BA6B 0x8004C86B 0x8004D66B 0x8004E46B /end VAR_ADDRESS
 /end VAR_CHARACTERISTIC
 /begin VAR_CHARACTERISTIC TP_U8TCSCpAsmdMuDiff4SplitMuDct EngCalVariantCriterion
  /begin VAR_ADDRESS 0x8003A26C 0x8003B06C 0x8003BE6C 0x8003CC6C 0x8003DA6C 0x8003E86C 0x8003F66C 0x8004046C 0x8004126C 0x8004206C 0x80042E6C 0x80043C6C 0x80044A6C 0x8004586C 0x8004666C 0x8004746C 0x8004826C 0x8004906C 0x80049E6C 0x8004AC6C 0x8004BA6C 0x8004C86C 0x8004D66C 0x8004E46C /end VAR_ADDRESS
 /end VAR_CHARACTERISTIC
 /begin VAR_CHARACTERISTIC TP_U8TCSCpAsymSpnCtlFFmodeTimeUp EngCalVariantCriterion
  /begin VAR_ADDRESS 0x8003A26D 0x8003B06D 0x8003BE6D 0x8003CC6D 0x8003DA6D 0x8003E86D 0x8003F66D 0x8004046D 0x8004126D 0x8004206D 0x80042E6D 0x80043C6D 0x80044A6D 0x8004586D 0x8004666D 0x8004746D 0x8004826D 0x8004906D 0x80049E6D 0x8004AC6D 0x8004BA6D 0x8004C86D 0x8004D66D 0x8004E46D /end VAR_ADDRESS
 /end VAR_CHARACTERISTIC
 /begin VAR_CHARACTERISTIC TP_U8TCSCpAveWhlAcc_1 EngCalVariantCriterion
  /begin VAR_ADDRESS 0x8003A26E 0x8003B06E 0x8003BE6E 0x8003CC6E 0x8003DA6E 0x8003E86E 0x8003F66E 0x8004046E 0x8004126E 0x8004206E 0x80042E6E 0x80043C6E 0x80044A6E 0x8004586E 0x8004666E 0x8004746E 0x8004826E 0x8004906E 0x80049E6E 0x8004AC6E 0x8004BA6E 0x8004C86E 0x8004D66E 0x8004E46E /end VAR_ADDRESS
 /end VAR_CHARACTERISTIC
 /begin VAR_CHARACTERISTIC TP_U8TCSCpAveWhlAcc_2 EngCalVariantCriterion
  /begin VAR_ADDRESS 0x8003A26F 0x8003B06F 0x8003BE6F 0x8003CC6F 0x8003DA6F 0x8003E86F 0x8003F66F 0x8004046F 0x8004126F 0x8004206F 0x80042E6F 0x80043C6F 0x80044A6F 0x8004586F 0x8004666F 0x8004746F 0x8004826F 0x8004906F 0x80049E6F 0x8004AC6F 0x8004BA6F 0x8004C86F 0x8004D66F 0x8004E46F /end VAR_ADDRESS
 /end VAR_CHARACTERISTIC
 /begin VAR_CHARACTERISTIC TP_U8TCSCpBaseTarWhlSpinDiff[0] EngCalVariantCriterion
  /begin VAR_ADDRESS 0x8003A270 0x8003B070 0x8003BE70 0x8003CC70 0x8003DA70 0x8003E870 0x8003F670 0x80040470 0x80041270 0x80042070 0x80042E70 0x80043C70 0x80044A70 0x80045870 0x80046670 0x80047470 0x80048270 0x80049070 0x80049E70 0x8004AC70 0x8004BA70 0x8004C870 0x8004D670 0x8004E470 /end VAR_ADDRESS
 /end VAR_CHARACTERISTIC
 /begin VAR_CHARACTERISTIC TP_U8TCSCpBaseTarWhlSpinDiff[1] EngCalVariantCriterion
  /begin VAR_ADDRESS 0x8003A271 0x8003B071 0x8003BE71 0x8003CC71 0x8003DA71 0x8003E871 0x8003F671 0x80040471 0x80041271 0x80042071 0x80042E71 0x80043C71 0x80044A71 0x80045871 0x80046671 0x80047471 0x80048271 0x80049071 0x80049E71 0x8004AC71 0x8004BA71 0x8004C871 0x8004D671 0x8004E471 /end VAR_ADDRESS
 /end VAR_CHARACTERISTIC
 /begin VAR_CHARACTERISTIC TP_U8TCSCpBaseTarWhlSpinDiff[2] EngCalVariantCriterion
  /begin VAR_ADDRESS 0x8003A272 0x8003B072 0x8003BE72 0x8003CC72 0x8003DA72 0x8003E872 0x8003F672 0x80040472 0x80041272 0x80042072 0x80042E72 0x80043C72 0x80044A72 0x80045872 0x80046672 0x80047472 0x80048272 0x80049072 0x80049E72 0x8004AC72 0x8004BA72 0x8004C872 0x8004D672 0x8004E472 /end VAR_ADDRESS
 /end VAR_CHARACTERISTIC
 /begin VAR_CHARACTERISTIC TP_U8TCSCpBaseTarWhlSpinDiff[3] EngCalVariantCriterion
  /begin VAR_ADDRESS 0x8003A273 0x8003B073 0x8003BE73 0x8003CC73 0x8003DA73 0x8003E873 0x8003F673 0x80040473 0x80041273 0x80042073 0x80042E73 0x80043C73 0x80044A73 0x80045873 0x80046673 0x80047473 0x80048273 0x80049073 0x80049E73 0x8004AC73 0x8004BA73 0x8004C873 0x8004D673 0x8004E473 /end VAR_ADDRESS
 /end VAR_CHARACTERISTIC
 /begin VAR_CHARACTERISTIC TP_U8TCSCpBaseTarWhlSpinDiff[4] EngCalVariantCriterion
  /begin VAR_ADDRESS 0x8003A274 0x8003B074 0x8003BE74 0x8003CC74 0x8003DA74 0x8003E874 0x8003F674 0x80040474 0x80041274 0x80042074 0x80042E74 0x80043C74 0x80044A74 0x80045874 0x80046674 0x80047474 0x80048274 0x80049074 0x80049E74 0x8004AC74 0x8004BA74 0x8004C874 0x8004D674 0x8004E474 /end VAR_ADDRESS
 /end VAR_CHARACTERISTIC
 /begin VAR_CHARACTERISTIC TP_U8TCSCpBrkTorqDecPcntOfEngStl EngCalVariantCriterion
  /begin VAR_ADDRESS 0x8003A275 0x8003B075 0x8003BE75 0x8003CC75 0x8003DA75 0x8003E875 0x8003F675 0x80040475 0x80041275 0x80042075 0x80042E75 0x80043C75 0x80044A75 0x80045875 0x80046675 0x80047475 0x80048275 0x80049075 0x80049E75 0x8004AC75 0x8004BA75 0x8004C875 0x8004D675 0x8004E475 /end VAR_ADDRESS
 /end VAR_CHARACTERISTIC
 /begin VAR_CHARACTERISTIC TP_U8TCSCpBrkTorqDecPcntOfOvBrk EngCalVariantCriterion
  /begin VAR_ADDRESS 0x8003A276 0x8003B076 0x8003BE76 0x8003CC76 0x8003DA76 0x8003E876 0x8003F676 0x80040476 0x80041276 0x80042076 0x80042E76 0x80043C76 0x80044A76 0x80045876 0x80046676 0x80047476 0x80048276 0x80049076 0x80049E76 0x8004AC76 0x8004BA76 0x8004C876 0x8004D676 0x8004E476 /end VAR_ADDRESS
 /end VAR_CHARACTERISTIC
 /begin VAR_CHARACTERISTIC TP_U8TCSCpBrkTorqDecRateOfEngStl EngCalVariantCriterion
  /begin VAR_ADDRESS 0x8003A277 0x8003B077 0x8003BE77 0x8003CC77 0x8003DA77 0x8003E877 0x8003F677 0x80040477 0x80041277 0x80042077 0x80042E77 0x80043C77 0x80044A77 0x80045877 0x80046677 0x80047477 0x80048277 0x80049077 0x80049E77 0x8004AC77 0x8004BA77 0x8004C877 0x8004D677 0x8004E477 /end VAR_ADDRESS
 /end VAR_CHARACTERISTIC
 /begin VAR_CHARACTERISTIC TP_U8TCSCpBrkTorqDecRateOfHWIS EngCalVariantCriterion
  /begin VAR_ADDRESS 0x8003A278 0x8003B078 0x8003BE78 0x8003CC78 0x8003DA78 0x8003E878 0x8003F678 0x80040478 0x80041278 0x80042078 0x80042E78 0x80043C78 0x80044A78 0x80045878 0x80046678 0x80047478 0x80048278 0x80049078 0x80049E78 0x8004AC78 0x8004BA78 0x8004C878 0x8004D678 0x8004E478 /end VAR_ADDRESS
 /end VAR_CHARACTERISTIC
 /begin VAR_CHARACTERISTIC TP_U8TCSCpBrkTorqFastDecRateOfHWIS EngCalVariantCriterion
  /begin VAR_ADDRESS 0x8003A279 0x8003B079 0x8003BE79 0x8003CC79 0x8003DA79 0x8003E879 0x8003F679 0x80040479 0x80041279 0x80042079 0x80042E79 0x80043C79 0x80044A79 0x80045879 0x80046679 0x80047479 0x80048279 0x80049079 0x80049E79 0x8004AC79 0x8004BA79 0x8004C879 0x8004D679 0x8004E479 /end VAR_ADDRESS
 /end VAR_CHARACTERISTIC
 /begin VAR_CHARACTERISTIC TP_U8TCSCpBrkTorqRecPcntOfEngStl EngCalVariantCriterion
  /begin VAR_ADDRESS 0x8003A27A 0x8003B07A 0x8003BE7A 0x8003CC7A 0x8003DA7A 0x8003E87A 0x8003F67A 0x8004047A 0x8004127A 0x8004207A 0x80042E7A 0x80043C7A 0x80044A7A 0x8004587A 0x8004667A 0x8004747A 0x8004827A 0x8004907A 0x80049E7A 0x8004AC7A 0x8004BA7A 0x8004C87A 0x8004D67A 0x8004E47A /end VAR_ADDRESS
 /end VAR_CHARACTERISTIC
 /begin VAR_CHARACTERISTIC TP_U8TCSCpBrkTorqRecPcntOfHWIS EngCalVariantCriterion
  /begin VAR_ADDRESS 0x8003A27B 0x8003B07B 0x8003BE7B 0x8003CC7B 0x8003DA7B 0x8003E87B 0x8003F67B 0x8004047B 0x8004127B 0x8004207B 0x80042E7B 0x80043C7B 0x80044A7B 0x8004587B 0x8004667B 0x8004747B 0x8004827B 0x8004907B 0x80049E7B 0x8004AC7B 0x8004BA7B 0x8004C87B 0x8004D67B 0x8004E47B /end VAR_ADDRESS
 /end VAR_CHARACTERISTIC
 /begin VAR_CHARACTERISTIC TP_U8TCSCpBrkTqDecFacOfFrntAtReSym EngCalVariantCriterion
  /begin VAR_ADDRESS 0x8003A27C 0x8003B07C 0x8003BE7C 0x8003CC7C 0x8003DA7C 0x8003E87C 0x8003F67C 0x8004047C 0x8004127C 0x8004207C 0x80042E7C 0x80043C7C 0x80044A7C 0x8004587C 0x8004667C 0x8004747C 0x8004827C 0x8004907C 0x80049E7C 0x8004AC7C 0x8004BA7C 0x8004C87C 0x8004D67C 0x8004E47C /end VAR_ADDRESS
 /end VAR_CHARACTERISTIC
 /begin VAR_CHARACTERISTIC TP_U8TCSCpBrkTqGrdtLimIncFacSpinDiffDec EngCalVariantCriterion
  /begin VAR_ADDRESS 0x8003A27D 0x8003B07D 0x8003BE7D 0x8003CC7D 0x8003DA7D 0x8003E87D 0x8003F67D 0x8004047D 0x8004127D 0x8004207D 0x80042E7D 0x80043C7D 0x80044A7D 0x8004587D 0x8004667D 0x8004747D 0x8004827D 0x8004907D 0x80049E7D 0x8004AC7D 0x8004BA7D 0x8004C87D 0x8004D67D 0x8004E47D /end VAR_ADDRESS
 /end VAR_CHARACTERISTIC
 /begin VAR_CHARACTERISTIC TP_U8TCSCpBrkTrqMaxIncRate EngCalVariantCriterion
  /begin VAR_ADDRESS 0x8003A27E 0x8003B07E 0x8003BE7E 0x8003CC7E 0x8003DA7E 0x8003E87E 0x8003F67E 0x8004047E 0x8004127E 0x8004207E 0x80042E7E 0x80043C7E 0x80044A7E 0x8004587E 0x8004667E 0x8004747E 0x8004827E 0x8004907E 0x80049E7E 0x8004AC7E 0x8004BA7E 0x8004C87E 0x8004D67E 0x8004E47E /end VAR_ADDRESS
 /end VAR_CHARACTERISTIC
 /begin VAR_CHARACTERISTIC TP_U8TCSCpBsAsmdMuDiffHill_F[0] EngCalVariantCriterion
  /begin VAR_ADDRESS 0x8003A27F 0x8003B07F 0x8003BE7F 0x8003CC7F 0x8003DA7F 0x8003E87F 0x8003F67F 0x8004047F 0x8004127F 0x8004207F 0x80042E7F 0x80043C7F 0x80044A7F 0x8004587F 0x8004667F 0x8004747F 0x8004827F 0x8004907F 0x80049E7F 0x8004AC7F 0x8004BA7F 0x8004C87F 0x8004D67F 0x8004E47F /end VAR_ADDRESS
 /end VAR_CHARACTERISTIC
 /begin VAR_CHARACTERISTIC TP_U8TCSCpBsAsmdMuDiffHill_F[1] EngCalVariantCriterion
  /begin VAR_ADDRESS 0x8003A280 0x8003B080 0x8003BE80 0x8003CC80 0x8003DA80 0x8003E880 0x8003F680 0x80040480 0x80041280 0x80042080 0x80042E80 0x80043C80 0x80044A80 0x80045880 0x80046680 0x80047480 0x80048280 0x80049080 0x80049E80 0x8004AC80 0x8004BA80 0x8004C880 0x8004D680 0x8004E480 /end VAR_ADDRESS
 /end VAR_CHARACTERISTIC
 /begin VAR_CHARACTERISTIC TP_U8TCSCpBsAsmdMuDiffHill_F[2] EngCalVariantCriterion
  /begin VAR_ADDRESS 0x8003A281 0x8003B081 0x8003BE81 0x8003CC81 0x8003DA81 0x8003E881 0x8003F681 0x80040481 0x80041281 0x80042081 0x80042E81 0x80043C81 0x80044A81 0x80045881 0x80046681 0x80047481 0x80048281 0x80049081 0x80049E81 0x8004AC81 0x8004BA81 0x8004C881 0x8004D681 0x8004E481 /end VAR_ADDRESS
 /end VAR_CHARACTERISTIC
 /begin VAR_CHARACTERISTIC TP_U8TCSCpBsAsmdMuDiffHill_F[3] EngCalVariantCriterion
  /begin VAR_ADDRESS 0x8003A282 0x8003B082 0x8003BE82 0x8003CC82 0x8003DA82 0x8003E882 0x8003F682 0x80040482 0x80041282 0x80042082 0x80042E82 0x80043C82 0x80044A82 0x80045882 0x80046682 0x80047482 0x80048282 0x80049082 0x80049E82 0x8004AC82 0x8004BA82 0x8004C882 0x8004D682 0x8004E482 /end VAR_ADDRESS
 /end VAR_CHARACTERISTIC
 /begin VAR_CHARACTERISTIC TP_U8TCSCpBsAsmdMuDiffHill_F[4] EngCalVariantCriterion
  /begin VAR_ADDRESS 0x8003A283 0x8003B083 0x8003BE83 0x8003CC83 0x8003DA83 0x8003E883 0x8003F683 0x80040483 0x80041283 0x80042083 0x80042E83 0x80043C83 0x80044A83 0x80045883 0x80046683 0x80047483 0x80048283 0x80049083 0x80049E83 0x8004AC83 0x8004BA83 0x8004C883 0x8004D683 0x8004E483 /end VAR_ADDRESS
 /end VAR_CHARACTERISTIC
 /begin VAR_CHARACTERISTIC TP_U8TCSCpBsAsmdMuDiffHill_R[0] EngCalVariantCriterion
  /begin VAR_ADDRESS 0x8003A284 0x8003B084 0x8003BE84 0x8003CC84 0x8003DA84 0x8003E884 0x8003F684 0x80040484 0x80041284 0x80042084 0x80042E84 0x80043C84 0x80044A84 0x80045884 0x80046684 0x80047484 0x80048284 0x80049084 0x80049E84 0x8004AC84 0x8004BA84 0x8004C884 0x8004D684 0x8004E484 /end VAR_ADDRESS
 /end VAR_CHARACTERISTIC
 /begin VAR_CHARACTERISTIC TP_U8TCSCpBsAsmdMuDiffHill_R[1] EngCalVariantCriterion
  /begin VAR_ADDRESS 0x8003A285 0x8003B085 0x8003BE85 0x8003CC85 0x8003DA85 0x8003E885 0x8003F685 0x80040485 0x80041285 0x80042085 0x80042E85 0x80043C85 0x80044A85 0x80045885 0x80046685 0x80047485 0x80048285 0x80049085 0x80049E85 0x8004AC85 0x8004BA85 0x8004C885 0x8004D685 0x8004E485 /end VAR_ADDRESS
 /end VAR_CHARACTERISTIC
 /begin VAR_CHARACTERISTIC TP_U8TCSCpBsAsmdMuDiffHill_R[2] EngCalVariantCriterion
  /begin VAR_ADDRESS 0x8003A286 0x8003B086 0x8003BE86 0x8003CC86 0x8003DA86 0x8003E886 0x8003F686 0x80040486 0x80041286 0x80042086 0x80042E86 0x80043C86 0x80044A86 0x80045886 0x80046686 0x80047486 0x80048286 0x80049086 0x80049E86 0x8004AC86 0x8004BA86 0x8004C886 0x8004D686 0x8004E486 /end VAR_ADDRESS
 /end VAR_CHARACTERISTIC
 /begin VAR_CHARACTERISTIC TP_U8TCSCpBsAsmdMuDiffHill_R[3] EngCalVariantCriterion
  /begin VAR_ADDRESS 0x8003A287 0x8003B087 0x8003BE87 0x8003CC87 0x8003DA87 0x8003E887 0x8003F687 0x80040487 0x80041287 0x80042087 0x80042E87 0x80043C87 0x80044A87 0x80045887 0x80046687 0x80047487 0x80048287 0x80049087 0x80049E87 0x8004AC87 0x8004BA87 0x8004C887 0x8004D687 0x8004E487 /end VAR_ADDRESS
 /end VAR_CHARACTERISTIC
 /begin VAR_CHARACTERISTIC TP_U8TCSCpBsAsmdMuDiffHill_R[4] EngCalVariantCriterion
  /begin VAR_ADDRESS 0x8003A288 0x8003B088 0x8003BE88 0x8003CC88 0x8003DA88 0x8003E888 0x8003F688 0x80040488 0x80041288 0x80042088 0x80042E88 0x80043C88 0x80044A88 0x80045888 0x80046688 0x80047488 0x80048288 0x80049088 0x80049E88 0x8004AC88 0x8004BA88 0x8004C888 0x8004D688 0x8004E488 /end VAR_ADDRESS
 /end VAR_CHARACTERISTIC
 /begin VAR_CHARACTERISTIC TP_U8TCSCpBsAsmdMuDiffSt_F[0] EngCalVariantCriterion
  /begin VAR_ADDRESS 0x8003A289 0x8003B089 0x8003BE89 0x8003CC89 0x8003DA89 0x8003E889 0x8003F689 0x80040489 0x80041289 0x80042089 0x80042E89 0x80043C89 0x80044A89 0x80045889 0x80046689 0x80047489 0x80048289 0x80049089 0x80049E89 0x8004AC89 0x8004BA89 0x8004C889 0x8004D689 0x8004E489 /end VAR_ADDRESS
 /end VAR_CHARACTERISTIC
 /begin VAR_CHARACTERISTIC TP_U8TCSCpBsAsmdMuDiffSt_F[1] EngCalVariantCriterion
  /begin VAR_ADDRESS 0x8003A28A 0x8003B08A 0x8003BE8A 0x8003CC8A 0x8003DA8A 0x8003E88A 0x8003F68A 0x8004048A 0x8004128A 0x8004208A 0x80042E8A 0x80043C8A 0x80044A8A 0x8004588A 0x8004668A 0x8004748A 0x8004828A 0x8004908A 0x80049E8A 0x8004AC8A 0x8004BA8A 0x8004C88A 0x8004D68A 0x8004E48A /end VAR_ADDRESS
 /end VAR_CHARACTERISTIC
 /begin VAR_CHARACTERISTIC TP_U8TCSCpBsAsmdMuDiffSt_F[2] EngCalVariantCriterion
  /begin VAR_ADDRESS 0x8003A28B 0x8003B08B 0x8003BE8B 0x8003CC8B 0x8003DA8B 0x8003E88B 0x8003F68B 0x8004048B 0x8004128B 0x8004208B 0x80042E8B 0x80043C8B 0x80044A8B 0x8004588B 0x8004668B 0x8004748B 0x8004828B 0x8004908B 0x80049E8B 0x8004AC8B 0x8004BA8B 0x8004C88B 0x8004D68B 0x8004E48B /end VAR_ADDRESS
 /end VAR_CHARACTERISTIC
 /begin VAR_CHARACTERISTIC TP_U8TCSCpBsAsmdMuDiffSt_F[3] EngCalVariantCriterion
  /begin VAR_ADDRESS 0x8003A28C 0x8003B08C 0x8003BE8C 0x8003CC8C 0x8003DA8C 0x8003E88C 0x8003F68C 0x8004048C 0x8004128C 0x8004208C 0x80042E8C 0x80043C8C 0x80044A8C 0x8004588C 0x8004668C 0x8004748C 0x8004828C 0x8004908C 0x80049E8C 0x8004AC8C 0x8004BA8C 0x8004C88C 0x8004D68C 0x8004E48C /end VAR_ADDRESS
 /end VAR_CHARACTERISTIC
 /begin VAR_CHARACTERISTIC TP_U8TCSCpBsAsmdMuDiffSt_F[4] EngCalVariantCriterion
  /begin VAR_ADDRESS 0x8003A28D 0x8003B08D 0x8003BE8D 0x8003CC8D 0x8003DA8D 0x8003E88D 0x8003F68D 0x8004048D 0x8004128D 0x8004208D 0x80042E8D 0x80043C8D 0x80044A8D 0x8004588D 0x8004668D 0x8004748D 0x8004828D 0x8004908D 0x80049E8D 0x8004AC8D 0x8004BA8D 0x8004C88D 0x8004D68D 0x8004E48D /end VAR_ADDRESS
 /end VAR_CHARACTERISTIC
 /begin VAR_CHARACTERISTIC TP_U8TCSCpBsAsmdMuDiffSt_R[0] EngCalVariantCriterion
  /begin VAR_ADDRESS 0x8003A28E 0x8003B08E 0x8003BE8E 0x8003CC8E 0x8003DA8E 0x8003E88E 0x8003F68E 0x8004048E 0x8004128E 0x8004208E 0x80042E8E 0x80043C8E 0x80044A8E 0x8004588E 0x8004668E 0x8004748E 0x8004828E 0x8004908E 0x80049E8E 0x8004AC8E 0x8004BA8E 0x8004C88E 0x8004D68E 0x8004E48E /end VAR_ADDRESS
 /end VAR_CHARACTERISTIC
 /begin VAR_CHARACTERISTIC TP_U8TCSCpBsAsmdMuDiffSt_R[1] EngCalVariantCriterion
  /begin VAR_ADDRESS 0x8003A28F 0x8003B08F 0x8003BE8F 0x8003CC8F 0x8003DA8F 0x8003E88F 0x8003F68F 0x8004048F 0x8004128F 0x8004208F 0x80042E8F 0x80043C8F 0x80044A8F 0x8004588F 0x8004668F 0x8004748F 0x8004828F 0x8004908F 0x80049E8F 0x8004AC8F 0x8004BA8F 0x8004C88F 0x8004D68F 0x8004E48F /end VAR_ADDRESS
 /end VAR_CHARACTERISTIC
 /begin VAR_CHARACTERISTIC TP_U8TCSCpBsAsmdMuDiffSt_R[2] EngCalVariantCriterion
  /begin VAR_ADDRESS 0x8003A290 0x8003B090 0x8003BE90 0x8003CC90 0x8003DA90 0x8003E890 0x8003F690 0x80040490 0x80041290 0x80042090 0x80042E90 0x80043C90 0x80044A90 0x80045890 0x80046690 0x80047490 0x80048290 0x80049090 0x80049E90 0x8004AC90 0x8004BA90 0x8004C890 0x8004D690 0x8004E490 /end VAR_ADDRESS
 /end VAR_CHARACTERISTIC
 /begin VAR_CHARACTERISTIC TP_U8TCSCpBsAsmdMuDiffSt_R[3] EngCalVariantCriterion
  /begin VAR_ADDRESS 0x8003A291 0x8003B091 0x8003BE91 0x8003CC91 0x8003DA91 0x8003E891 0x8003F691 0x80040491 0x80041291 0x80042091 0x80042E91 0x80043C91 0x80044A91 0x80045891 0x80046691 0x80047491 0x80048291 0x80049091 0x80049E91 0x8004AC91 0x8004BA91 0x8004C891 0x8004D691 0x8004E491 /end VAR_ADDRESS
 /end VAR_CHARACTERISTIC
 /begin VAR_CHARACTERISTIC TP_U8TCSCpBsAsmdMuDiffSt_R[4] EngCalVariantCriterion
  /begin VAR_ADDRESS 0x8003A292 0x8003B092 0x8003BE92 0x8003CC92 0x8003DA92 0x8003E892 0x8003F692 0x80040492 0x80041292 0x80042092 0x80042E92 0x80043C92 0x80044A92 0x80045892 0x80046692 0x80047492 0x80048292 0x80049092 0x80049E92 0x8004AC92 0x8004BA92 0x8004C892 0x8004D692 0x8004E492 /end VAR_ADDRESS
 /end VAR_CHARACTERISTIC
 /begin VAR_CHARACTERISTIC TP_U8TCSCpBsAsmdMuDiffTurn_F[0] EngCalVariantCriterion
  /begin VAR_ADDRESS 0x8003A293 0x8003B093 0x8003BE93 0x8003CC93 0x8003DA93 0x8003E893 0x8003F693 0x80040493 0x80041293 0x80042093 0x80042E93 0x80043C93 0x80044A93 0x80045893 0x80046693 0x80047493 0x80048293 0x80049093 0x80049E93 0x8004AC93 0x8004BA93 0x8004C893 0x8004D693 0x8004E493 /end VAR_ADDRESS
 /end VAR_CHARACTERISTIC
 /begin VAR_CHARACTERISTIC TP_U8TCSCpBsAsmdMuDiffTurn_F[1] EngCalVariantCriterion
  /begin VAR_ADDRESS 0x8003A294 0x8003B094 0x8003BE94 0x8003CC94 0x8003DA94 0x8003E894 0x8003F694 0x80040494 0x80041294 0x80042094 0x80042E94 0x80043C94 0x80044A94 0x80045894 0x80046694 0x80047494 0x80048294 0x80049094 0x80049E94 0x8004AC94 0x8004BA94 0x8004C894 0x8004D694 0x8004E494 /end VAR_ADDRESS
 /end VAR_CHARACTERISTIC
 /begin VAR_CHARACTERISTIC TP_U8TCSCpBsAsmdMuDiffTurn_F[2] EngCalVariantCriterion
  /begin VAR_ADDRESS 0x8003A295 0x8003B095 0x8003BE95 0x8003CC95 0x8003DA95 0x8003E895 0x8003F695 0x80040495 0x80041295 0x80042095 0x80042E95 0x80043C95 0x80044A95 0x80045895 0x80046695 0x80047495 0x80048295 0x80049095 0x80049E95 0x8004AC95 0x8004BA95 0x8004C895 0x8004D695 0x8004E495 /end VAR_ADDRESS
 /end VAR_CHARACTERISTIC
 /begin VAR_CHARACTERISTIC TP_U8TCSCpBsAsmdMuDiffTurn_F[3] EngCalVariantCriterion
  /begin VAR_ADDRESS 0x8003A296 0x8003B096 0x8003BE96 0x8003CC96 0x8003DA96 0x8003E896 0x8003F696 0x80040496 0x80041296 0x80042096 0x80042E96 0x80043C96 0x80044A96 0x80045896 0x80046696 0x80047496 0x80048296 0x80049096 0x80049E96 0x8004AC96 0x8004BA96 0x8004C896 0x8004D696 0x8004E496 /end VAR_ADDRESS
 /end VAR_CHARACTERISTIC
 /begin VAR_CHARACTERISTIC TP_U8TCSCpBsAsmdMuDiffTurn_F[4] EngCalVariantCriterion
  /begin VAR_ADDRESS 0x8003A297 0x8003B097 0x8003BE97 0x8003CC97 0x8003DA97 0x8003E897 0x8003F697 0x80040497 0x80041297 0x80042097 0x80042E97 0x80043C97 0x80044A97 0x80045897 0x80046697 0x80047497 0x80048297 0x80049097 0x80049E97 0x8004AC97 0x8004BA97 0x8004C897 0x8004D697 0x8004E497 /end VAR_ADDRESS
 /end VAR_CHARACTERISTIC
 /begin VAR_CHARACTERISTIC TP_U8TCSCpBsAsmdMuDiffTurn_R[0] EngCalVariantCriterion
  /begin VAR_ADDRESS 0x8003A298 0x8003B098 0x8003BE98 0x8003CC98 0x8003DA98 0x8003E898 0x8003F698 0x80040498 0x80041298 0x80042098 0x80042E98 0x80043C98 0x80044A98 0x80045898 0x80046698 0x80047498 0x80048298 0x80049098 0x80049E98 0x8004AC98 0x8004BA98 0x8004C898 0x8004D698 0x8004E498 /end VAR_ADDRESS
 /end VAR_CHARACTERISTIC
 /begin VAR_CHARACTERISTIC TP_U8TCSCpBsAsmdMuDiffTurn_R[1] EngCalVariantCriterion
  /begin VAR_ADDRESS 0x8003A299 0x8003B099 0x8003BE99 0x8003CC99 0x8003DA99 0x8003E899 0x8003F699 0x80040499 0x80041299 0x80042099 0x80042E99 0x80043C99 0x80044A99 0x80045899 0x80046699 0x80047499 0x80048299 0x80049099 0x80049E99 0x8004AC99 0x8004BA99 0x8004C899 0x8004D699 0x8004E499 /end VAR_ADDRESS
 /end VAR_CHARACTERISTIC
 /begin VAR_CHARACTERISTIC TP_U8TCSCpBsAsmdMuDiffTurn_R[2] EngCalVariantCriterion
  /begin VAR_ADDRESS 0x8003A29A 0x8003B09A 0x8003BE9A 0x8003CC9A 0x8003DA9A 0x8003E89A 0x8003F69A 0x8004049A 0x8004129A 0x8004209A 0x80042E9A 0x80043C9A 0x80044A9A 0x8004589A 0x8004669A 0x8004749A 0x8004829A 0x8004909A 0x80049E9A 0x8004AC9A 0x8004BA9A 0x8004C89A 0x8004D69A 0x8004E49A /end VAR_ADDRESS
 /end VAR_CHARACTERISTIC
 /begin VAR_CHARACTERISTIC TP_U8TCSCpBsAsmdMuDiffTurn_R[3] EngCalVariantCriterion
  /begin VAR_ADDRESS 0x8003A29B 0x8003B09B 0x8003BE9B 0x8003CC9B 0x8003DA9B 0x8003E89B 0x8003F69B 0x8004049B 0x8004129B 0x8004209B 0x80042E9B 0x80043C9B 0x80044A9B 0x8004589B 0x8004669B 0x8004749B 0x8004829B 0x8004909B 0x80049E9B 0x8004AC9B 0x8004BA9B 0x8004C89B 0x8004D69B 0x8004E49B /end VAR_ADDRESS
 /end VAR_CHARACTERISTIC
 /begin VAR_CHARACTERISTIC TP_U8TCSCpBsAsmdMuDiffTurn_R[4] EngCalVariantCriterion
  /begin VAR_ADDRESS 0x8003A29C 0x8003B09C 0x8003BE9C 0x8003CC9C 0x8003DA9C 0x8003E89C 0x8003F69C 0x8004049C 0x8004129C 0x8004209C 0x80042E9C 0x80043C9C 0x80044A9C 0x8004589C 0x8004669C 0x8004749C 0x8004829C 0x8004909C 0x80049E9C 0x8004AC9C 0x8004BA9C 0x8004C89C 0x8004D69C 0x8004E49C /end VAR_ADDRESS
 /end VAR_CHARACTERISTIC
 /begin VAR_CHARACTERISTIC TP_U8TCSCpBsHillIG4ASFBCtl_F[0] EngCalVariantCriterion
  /begin VAR_ADDRESS 0x8003A29D 0x8003B09D 0x8003BE9D 0x8003CC9D 0x8003DA9D 0x8003E89D 0x8003F69D 0x8004049D 0x8004129D 0x8004209D 0x80042E9D 0x80043C9D 0x80044A9D 0x8004589D 0x8004669D 0x8004749D 0x8004829D 0x8004909D 0x80049E9D 0x8004AC9D 0x8004BA9D 0x8004C89D 0x8004D69D 0x8004E49D /end VAR_ADDRESS
 /end VAR_CHARACTERISTIC
 /begin VAR_CHARACTERISTIC TP_U8TCSCpBsHillIG4ASFBCtl_F[1] EngCalVariantCriterion
  /begin VAR_ADDRESS 0x8003A29E 0x8003B09E 0x8003BE9E 0x8003CC9E 0x8003DA9E 0x8003E89E 0x8003F69E 0x8004049E 0x8004129E 0x8004209E 0x80042E9E 0x80043C9E 0x80044A9E 0x8004589E 0x8004669E 0x8004749E 0x8004829E 0x8004909E 0x80049E9E 0x8004AC9E 0x8004BA9E 0x8004C89E 0x8004D69E 0x8004E49E /end VAR_ADDRESS
 /end VAR_CHARACTERISTIC
 /begin VAR_CHARACTERISTIC TP_U8TCSCpBsHillIG4ASFBCtl_F[2] EngCalVariantCriterion
  /begin VAR_ADDRESS 0x8003A29F 0x8003B09F 0x8003BE9F 0x8003CC9F 0x8003DA9F 0x8003E89F 0x8003F69F 0x8004049F 0x8004129F 0x8004209F 0x80042E9F 0x80043C9F 0x80044A9F 0x8004589F 0x8004669F 0x8004749F 0x8004829F 0x8004909F 0x80049E9F 0x8004AC9F 0x8004BA9F 0x8004C89F 0x8004D69F 0x8004E49F /end VAR_ADDRESS
 /end VAR_CHARACTERISTIC
 /begin VAR_CHARACTERISTIC TP_U8TCSCpBsHillIG4ASFBCtl_F[3] EngCalVariantCriterion
  /begin VAR_ADDRESS 0x8003A2A0 0x8003B0A0 0x8003BEA0 0x8003CCA0 0x8003DAA0 0x8003E8A0 0x8003F6A0 0x800404A0 0x800412A0 0x800420A0 0x80042EA0 0x80043CA0 0x80044AA0 0x800458A0 0x800466A0 0x800474A0 0x800482A0 0x800490A0 0x80049EA0 0x8004ACA0 0x8004BAA0 0x8004C8A0 0x8004D6A0 0x8004E4A0 /end VAR_ADDRESS
 /end VAR_CHARACTERISTIC
 /begin VAR_CHARACTERISTIC TP_U8TCSCpBsHillIG4ASFBCtl_F[4] EngCalVariantCriterion
  /begin VAR_ADDRESS 0x8003A2A1 0x8003B0A1 0x8003BEA1 0x8003CCA1 0x8003DAA1 0x8003E8A1 0x8003F6A1 0x800404A1 0x800412A1 0x800420A1 0x80042EA1 0x80043CA1 0x80044AA1 0x800458A1 0x800466A1 0x800474A1 0x800482A1 0x800490A1 0x80049EA1 0x8004ACA1 0x8004BAA1 0x8004C8A1 0x8004D6A1 0x8004E4A1 /end VAR_ADDRESS
 /end VAR_CHARACTERISTIC
 /begin VAR_CHARACTERISTIC TP_U8TCSCpBsHillIG4ASFBCtl_R[0] EngCalVariantCriterion
  /begin VAR_ADDRESS 0x8003A2A2 0x8003B0A2 0x8003BEA2 0x8003CCA2 0x8003DAA2 0x8003E8A2 0x8003F6A2 0x800404A2 0x800412A2 0x800420A2 0x80042EA2 0x80043CA2 0x80044AA2 0x800458A2 0x800466A2 0x800474A2 0x800482A2 0x800490A2 0x80049EA2 0x8004ACA2 0x8004BAA2 0x8004C8A2 0x8004D6A2 0x8004E4A2 /end VAR_ADDRESS
 /end VAR_CHARACTERISTIC
 /begin VAR_CHARACTERISTIC TP_U8TCSCpBsHillIG4ASFBCtl_R[1] EngCalVariantCriterion
  /begin VAR_ADDRESS 0x8003A2A3 0x8003B0A3 0x8003BEA3 0x8003CCA3 0x8003DAA3 0x8003E8A3 0x8003F6A3 0x800404A3 0x800412A3 0x800420A3 0x80042EA3 0x80043CA3 0x80044AA3 0x800458A3 0x800466A3 0x800474A3 0x800482A3 0x800490A3 0x80049EA3 0x8004ACA3 0x8004BAA3 0x8004C8A3 0x8004D6A3 0x8004E4A3 /end VAR_ADDRESS
 /end VAR_CHARACTERISTIC
 /begin VAR_CHARACTERISTIC TP_U8TCSCpBsHillIG4ASFBCtl_R[2] EngCalVariantCriterion
  /begin VAR_ADDRESS 0x8003A2A4 0x8003B0A4 0x8003BEA4 0x8003CCA4 0x8003DAA4 0x8003E8A4 0x8003F6A4 0x800404A4 0x800412A4 0x800420A4 0x80042EA4 0x80043CA4 0x80044AA4 0x800458A4 0x800466A4 0x800474A4 0x800482A4 0x800490A4 0x80049EA4 0x8004ACA4 0x8004BAA4 0x8004C8A4 0x8004D6A4 0x8004E4A4 /end VAR_ADDRESS
 /end VAR_CHARACTERISTIC
 /begin VAR_CHARACTERISTIC TP_U8TCSCpBsHillIG4ASFBCtl_R[3] EngCalVariantCriterion
  /begin VAR_ADDRESS 0x8003A2A5 0x8003B0A5 0x8003BEA5 0x8003CCA5 0x8003DAA5 0x8003E8A5 0x8003F6A5 0x800404A5 0x800412A5 0x800420A5 0x80042EA5 0x80043CA5 0x80044AA5 0x800458A5 0x800466A5 0x800474A5 0x800482A5 0x800490A5 0x80049EA5 0x8004ACA5 0x8004BAA5 0x8004C8A5 0x8004D6A5 0x8004E4A5 /end VAR_ADDRESS
 /end VAR_CHARACTERISTIC
/end VARIANT_CODING
/end MODULE
/end PROJECT
