ASAP2_VERSION 1 60
/begin PROJECT Master ""
/begin MODULE CPP ""
/begin MOD_COMMON "" BYTE_ORDER MSB_LAST ALIGNMENT_BYTE 1 ALIGNMENT_WORD 1 ALIGNMENT_LONG 1 ALIGNMENT_FLOAT32_IEEE 1 ALIGNMENT_FLOAT64_IEEE 1 ALIGNMENT_INT64 1 /end MOD_COMMON
/begin CHARACTERISTIC BAC_S16_BAC_SLIP_SPEED_GAIN_DEP_H_V "" VALUE 0x80020F6A CalPrmBrkAssisCoorrBrk_SWORD 0 Spd12 -4096 4095.875 SYMBOL_LINK "CalPrmBrkAssisCoorrBrk01.BAC_S16_BAC_SLIP_SPEED_GAIN_DEP_H_V" 0 /end CHARACTERISTIC
/begin CHARACTERISTIC BAC_S16_BAC_SLIP_SPEED_GAIN_DEP_L_V "" VALUE 0x80020F66 CalPrmBrkAssisCoorrBrk_SWORD 0 Spd12 -4096 4095.875 SYMBOL_LINK "CalPrmBrkAssisCoorrBrk01.BAC_S16_BAC_SLIP_SPEED_GAIN_DEP_L_V" 0 /end CHARACTERISTIC
/begin CHARACTERISTIC BAC_S16_BAC_SLIP_SPEED_GAIN_DEP_M_V "" VALUE 0x80020F68 CalPrmBrkAssisCoorrBrk_SWORD 0 Spd12 -4096 4095.875 SYMBOL_LINK "CalPrmBrkAssisCoorrBrk01.BAC_S16_BAC_SLIP_SPEED_GAIN_DEP_M_V" 0 /end CHARACTERISTIC
/begin CHARACTERISTIC BAC_S8_BAC_ENTER_SLIP_HSP "" VALUE 0x80020F6E CalPrmBrkAssisCoorrBrk_SBYTE 0 Spd12 -16 15.875 SYMBOL_LINK "CalPrmBrkAssisCoorrBrk01.BAC_S8_BAC_ENTER_SLIP_HSP" 0 /end CHARACTERISTIC
/begin CHARACTERISTIC BAC_S8_BAC_ENTER_SLIP_LSP "" VALUE 0x80020F6C CalPrmBrkAssisCoorrBrk_SBYTE 0 Spd12 -16 15.875 SYMBOL_LINK "CalPrmBrkAssisCoorrBrk01.BAC_S8_BAC_ENTER_SLIP_LSP" 0 /end CHARACTERISTIC
/begin CHARACTERISTIC BAC_S8_BAC_ENTER_SLIP_MSP "" VALUE 0x80020F6D CalPrmBrkAssisCoorrBrk_SBYTE 0 Spd12 -16 15.875 SYMBOL_LINK "CalPrmBrkAssisCoorrBrk01.BAC_S8_BAC_ENTER_SLIP_MSP" 0 /end CHARACTERISTIC
/begin CHARACTERISTIC S16EpsiHndlgAgToTqGainRoadFric1 "" VALUE 0x80021882 CalPrmStrStabyCtrlBrk_SWORD 0 Gain -32768 32767 SYMBOL_LINK "CalPrmStrStabyCtrlBrk01.S16EpsiHndlgAgToTqGainRoadFric1" 0 /end CHARACTERISTIC
/begin CHARACTERISTIC S16EpsiHndlgAgToTqGainRoadFric2 "" VALUE 0x80021884 CalPrmStrStabyCtrlBrk_SWORD 0 Gain -32768 32767 SYMBOL_LINK "CalPrmStrStabyCtrlBrk01.S16EpsiHndlgAgToTqGainRoadFric2" 0 /end CHARACTERISTIC
/begin CHARACTERISTIC S16EpsiHndlgAgToTqGainRoadFric3 "" VALUE 0x80021886 CalPrmStrStabyCtrlBrk_SWORD 0 Gain -32768 32767 SYMBOL_LINK "CalPrmStrStabyCtrlBrk01.S16EpsiHndlgAgToTqGainRoadFric3" 0 /end CHARACTERISTIC
/begin CHARACTERISTIC SSM_K_EPB_ESC_system "" VALUE 0x8003A7CB CalPrmSsmBrk_UBYTE 0 OnOff1 0 255 SYMBOL_LINK "CalPrmSsmEng01.SSM_K_EPB_ESC_system" 0 /end CHARACTERISTIC
/begin CHARACTERISTIC SSM_K_EPB_Grade_Decision_Z1_Th "" VALUE 0x8003A7D6 CalPrmSsmBrk_SWORD 0 A48 -3.2768 3.2767 SYMBOL_LINK "CalPrmSsmEng01.SSM_K_EPB_Grade_Decision_Z1_Th" 0 /end CHARACTERISTIC
/begin CHARACTERISTIC SSM_K_EPB_Grade_Decision_Z2_Th "" VALUE 0x8003A7D8 CalPrmSsmBrk_SWORD 0 A48 -3.2768 3.2767 SYMBOL_LINK "CalPrmSsmEng01.SSM_K_EPB_Grade_Decision_Z2_Th" 0 /end CHARACTERISTIC
/begin CHARACTERISTIC SSM_K_EPB_Grade_Decision_Z3_Th "" VALUE 0x8003A7DA CalPrmSsmBrk_SWORD 0 A48 -3.2768 3.2767 SYMBOL_LINK "CalPrmSsmEng01.SSM_K_EPB_Grade_Decision_Z3_Th" 0 /end CHARACTERISTIC
/begin CHARACTERISTIC SSM_K_EPB_Light_Apply_Threshold "" VALUE 0x8003A7DC CalPrmSsmBrk_SWORD 0 A48 -3.2768 3.2767 SYMBOL_LINK "CalPrmSsmEng01.SSM_K_EPB_Light_Apply_Threshold" 0 /end CHARACTERISTIC
/begin CHARACTERISTIC SSM_K_EPB_Longitudinal_G_Sensor "" VALUE 0x8003A7CC CalPrmSsmBrk_UBYTE 0 OnOff1 0 255 SYMBOL_LINK "CalPrmSsmEng01.SSM_K_EPB_Longitudinal_G_Sensor" 0 /end CHARACTERISTIC
/begin CHARACTERISTIC SSM_K_EPB_Manual_Transmission "" VALUE 0x8003A7CD CalPrmSsmBrk_UBYTE 0 OnOff1 0 255 SYMBOL_LINK "CalPrmSsmEng01.SSM_K_EPB_Manual_Transmission" 0 /end CHARACTERISTIC
/begin CHARACTERISTIC SSM_K_EPB_Max_Apply_Threshold "" VALUE 0x8003A7DE CalPrmSsmBrk_SWORD 0 A48 -3.2768 3.2767 SYMBOL_LINK "CalPrmSsmEng01.SSM_K_EPB_Max_Apply_Threshold" 0 /end CHARACTERISTIC
/begin CHARACTERISTIC SSM_K_EPB_Parking_Brake_Type_DIH "" VALUE 0x8003A7CE CalPrmSsmBrk_UBYTE 0 OnOff1 0 255 SYMBOL_LINK "CalPrmSsmEng01.SSM_K_EPB_Parking_Brake_Type_DIH" 0 /end CHARACTERISTIC
/begin CHARACTERISTIC SSM_K_EPB_PropulsionSystActive_En "" VALUE 0x8003A7CF CalPrmSsmBrk_UBYTE 0 OnOff1 0 255 SYMBOL_LINK "CalPrmSsmEng01.SSM_K_EPB_PropulsionSystActive_En" 0 /end CHARACTERISTIC
/begin CHARACTERISTIC SSM_K_EPB_Push_Pull_Switch "" VALUE 0x8003A7D0 CalPrmSsmBrk_UBYTE 0 OnOff1 0 255 SYMBOL_LINK "CalPrmSsmEng01.SSM_K_EPB_Push_Pull_Switch" 0 /end CHARACTERISTIC
/begin CHARACTERISTIC SSM_K_EPB_Rear_Wheel_Drive "" VALUE 0x8003A7D1 CalPrmSsmBrk_UBYTE 0 OnOff1 0 255 SYMBOL_LINK "CalPrmSsmEng01.SSM_K_EPB_Rear_Wheel_Drive" 0 /end CHARACTERISTIC
/begin CHARACTERISTIC SSM_K_EPB_Set_Variant_Code_En "" VALUE 0x8003A7D2 CalPrmSsmBrk_UBYTE 0 OnOff1 0 255 SYMBOL_LINK "CalPrmSsmEng01.SSM_K_EPB_Set_Variant_Code_En" 0 /end CHARACTERISTIC
/begin CHARACTERISTIC SSM_K_EPB_Step_On_Brake_Message_En "" VALUE 0x8003A7D3 CalPrmSsmBrk_UBYTE 0 OnOff1 0 255 SYMBOL_LINK "CalPrmSsmEng01.SSM_K_EPB_Step_On_Brake_Message_En" 0 /end CHARACTERISTIC
/begin CHARACTERISTIC SSM_K_EPB_Telltale_Ill_time_at_IGN_OFF "" VALUE 0x8003A7D4 CalPrmSsmBrk_UBYTE 0 OnOff1 0 255 SYMBOL_LINK "CalPrmSsmEng01.SSM_K_EPB_Telltale_Ill_time_at_IGN_OFF" 0 /end CHARACTERISTIC
/begin CHARACTERISTIC SSM_K_EPB_VICM_system "" VALUE 0x8003A7D5 CalPrmSsmBrk_UBYTE 0 OnOff1 0 255 SYMBOL_LINK "CalPrmSsmEng01.SSM_K_EPB_VICM_system" 0 /end CHARACTERISTIC
/begin CHARACTERISTIC SSM_K_EPB_VehStopDecel_DynamicOn_Time_Th "" VALUE 0x8003A89E CalPrmSsmBrk_UWORD 0 Ti21 0 655.35 SYMBOL_LINK "CalPrmSsmEng01.SSM_K_EPB_VehStopDecel_DynamicOn_Time_Th" 0 /end CHARACTERISTIC
/begin CHARACTERISTIC SSM_K_EPB_VehStopDecel_En "" VALUE 0x8003A8A0 CalPrmSsmBrk_UBYTE 0 OnOff1 0 255 SYMBOL_LINK "CalPrmSsmEng01.SSM_K_EPB_VehStopDecel_En" 0 /end CHARACTERISTIC
/begin CHARACTERISTIC SSM_K_EPB_VehicleStopDecel_Th_H "" VALUE 0x8003A89C CalPrmSsmBrk_SBYTE 0 Gain -128 127 SYMBOL_LINK "CalPrmSsmEng01.SSM_K_EPB_VehicleStopDecel_Th_H" 0 /end CHARACTERISTIC
/begin CHARACTERISTIC SSM_K_EPB_VehicleStopDecel_Th_L "" VALUE 0x8003A89B CalPrmSsmBrk_SBYTE 0 Gain -128 127 SYMBOL_LINK "CalPrmSsmEng01.SSM_K_EPB_VehicleStopDecel_Th_L" 0 /end CHARACTERISTIC
/begin CHARACTERISTIC SSM_K_EPB_Vehicle_Speed_Apply_Slip_Comp_Th_L "" VALUE 0x8003A7E0 CalPrmSsmBrk_SWORD 0 Spd12 -4096 4095.875 SYMBOL_LINK "CalPrmSsmEng01.SSM_K_EPB_Vehicle_Speed_Apply_Slip_Comp_Th_L" 0 /end CHARACTERISTIC
/begin CHARACTERISTIC SSM_K_EPB_Vehicle_Speed_Apply_Th_H "" VALUE 0x8003A7E2 CalPrmSsmBrk_SWORD 0 Spd12 -4096 4095.875 SYMBOL_LINK "CalPrmSsmEng01.SSM_K_EPB_Vehicle_Speed_Apply_Th_H" 0 /end CHARACTERISTIC
/begin CHARACTERISTIC SSM_K_EPB_Vehicle_Speed_Apply_Th_L "" VALUE 0x8003A7E4 CalPrmSsmBrk_SWORD 0 Spd12 -4096 4095.875 SYMBOL_LINK "CalPrmSsmEng01.SSM_K_EPB_Vehicle_Speed_Apply_Th_L" 0 /end CHARACTERISTIC
/begin CHARACTERISTIC TP_S16TCSCpBrkPGrdtLimIncIniCntFr "" VALUE 0x8003A196 CalPrmWspcEng_SWORD 0 Ti21 -327.68 327.67 SYMBOL_LINK "CalPrmWspcEng01.TP_S16TCSCpBrkPGrdtLimIncIniCntFr" 0 /end CHARACTERISTIC
/begin CHARACTERISTIC TP_S16TCSCpBrkPGrdtLimIncIniCntRe "" VALUE 0x8003A198 CalPrmWspcEng_SWORD 0 Ti21 -327.68 327.67 SYMBOL_LINK "CalPrmWspcEng01.TP_S16TCSCpBrkPGrdtLimIncIniCntRe" 0 /end CHARACTERISTIC
/begin CHARACTERISTIC TP_S16TCSCpBrkPGrdtLimNormDecFr "" VALUE 0x8003A19A CalPrmWspcEng_SWORD 0 PGrdt15 -3276.8 3276.7 SYMBOL_LINK "CalPrmWspcEng01.TP_S16TCSCpBrkPGrdtLimNormDecFr" 0 /end CHARACTERISTIC
/begin CHARACTERISTIC TP_S16TCSCpBrkPGrdtLimNormDecRe "" VALUE 0x8003A19C CalPrmWspcEng_SWORD 0 PGrdt15 -3276.8 3276.7 SYMBOL_LINK "CalPrmWspcEng01.TP_S16TCSCpBrkPGrdtLimNormDecRe" 0 /end CHARACTERISTIC
/begin CHARACTERISTIC TP_S16TCSCpBrkPGrdtLimNormIncFr "" VALUE 0x8003A19E CalPrmWspcEng_SWORD 0 PGrdt15 -3276.8 3276.7 SYMBOL_LINK "CalPrmWspcEng01.TP_S16TCSCpBrkPGrdtLimNormIncFr" 0 /end CHARACTERISTIC
/begin CHARACTERISTIC TP_S16TCSCpBrkPGrdtLimNormIncIniFr "" VALUE 0x8003A1A0 CalPrmWspcEng_SWORD 0 PGrdt15 -3276.8 3276.7 SYMBOL_LINK "CalPrmWspcEng01.TP_S16TCSCpBrkPGrdtLimNormIncIniFr" 0 /end CHARACTERISTIC
/begin CHARACTERISTIC TP_S16TCSCpBrkPGrdtLimNormIncIniRe "" VALUE 0x8003A1A2 CalPrmWspcEng_SWORD 0 PGrdt15 -3276.8 3276.7 SYMBOL_LINK "CalPrmWspcEng01.TP_S16TCSCpBrkPGrdtLimNormIncIniRe" 0 /end CHARACTERISTIC
/begin CHARACTERISTIC TP_S16TCSCpBrkPGrdtLimNormIncRe "" VALUE 0x8003A1A4 CalPrmWspcEng_SWORD 0 PGrdt15 -3276.8 3276.7 SYMBOL_LINK "CalPrmWspcEng01.TP_S16TCSCpBrkPGrdtLimNormIncRe" 0 /end CHARACTERISTIC
/begin CHARACTERISTIC TP_S16TCSCpBrkPGrdtLimStpRednDecFr "" VALUE 0x8003A1A6 CalPrmWspcEng_SWORD 0 PGrdt15 -3276.8 3276.7 SYMBOL_LINK "CalPrmWspcEng01.TP_S16TCSCpBrkPGrdtLimStpRednDecFr" 0 /end CHARACTERISTIC
/begin CHARACTERISTIC TP_S16TCSCpBrkPGrdtLimStpRednDecRe "" VALUE 0x8003A1A8 CalPrmWspcEng_SWORD 0 PGrdt15 -3276.8 3276.7 SYMBOL_LINK "CalPrmWspcEng01.TP_S16TCSCpBrkPGrdtLimStpRednDecRe" 0 /end CHARACTERISTIC
/begin CHARACTERISTIC TP_S16TCSCpBrkPGrdtLimStpRednIncFr "" VALUE 0x8003A1AA CalPrmWspcEng_SWORD 0 PGrdt15 -3276.8 3276.7 SYMBOL_LINK "CalPrmWspcEng01.TP_S16TCSCpBrkPGrdtLimStpRednIncFr" 0 /end CHARACTERISTIC
/begin CHARACTERISTIC TP_S16TCSCpBrkPGrdtLimStpRednIncRe "" VALUE 0x8003A1AC CalPrmWspcEng_SWORD 0 PGrdt15 -3276.8 3276.7 SYMBOL_LINK "CalPrmWspcEng01.TP_S16TCSCpBrkPGrdtLimStpRednIncRe" 0 /end CHARACTERISTIC
/begin CHARACTERISTIC TP_S16TCSCpBrkPGrdtLimVCAInc "" VALUE 0x8003A1AE CalPrmWspcEng_SWORD 0 PGrdt15 -3276.8 3276.7 SYMBOL_LINK "CalPrmWspcEng01.TP_S16TCSCpBrkPGrdtLimVCAInc" 0 /end CHARACTERISTIC
/begin CHARACTERISTIC TP_S16TCSCpFadeOutCtrlHghPreSTTh_FA "" VALUE 0x8003A1D2 CalPrmWspcEng_SWORD 0 P34 -3276.8 3276.7 SYMBOL_LINK "CalPrmWspcEng01.TP_S16TCSCpFadeOutCtrlHghPreSTTh_FA" 0 /end CHARACTERISTIC
/begin CHARACTERISTIC TP_S16TCSCpFadeOutCtrlLowPreSTTh_FA "" VALUE 0x8003A1DA CalPrmWspcEng_SWORD 0 P34 -3276.8 3276.7 SYMBOL_LINK "CalPrmWspcEng01.TP_S16TCSCpFadeOutCtrlLowPreSTTh_FA" 0 /end CHARACTERISTIC
/begin CHARACTERISTIC TP_S16TCSCpFadeOutDecTQ4HghPreST_FA "" VALUE 0x8003A1E2 CalPrmWspcEng_SWORD 0 TqGrdt10 -32768 32767 SYMBOL_LINK "CalPrmWspcEng01.TP_S16TCSCpFadeOutDecTQ4HghPreST_FA" 0 /end CHARACTERISTIC
/begin CHARACTERISTIC TP_S16TCSCpFadeOutDecTQ4LowPreST_FA "" VALUE 0x8003A1EA CalPrmWspcEng_SWORD 0 TqGrdt10 -32768 32767 SYMBOL_LINK "CalPrmWspcEng01.TP_S16TCSCpFadeOutDecTQ4LowPreST_FA" 0 /end CHARACTERISTIC
/begin CHARACTERISTIC TP_S16TCSCpMaxTCCurnt "" VALUE 0x8003A204 CalPrmWspcEng_SWORD 0 Amp2 -32.768 32.767 SYMBOL_LINK "CalPrmWspcEng01.TP_S16TCSCpMaxTCCurnt" 0 /end CHARACTERISTIC
/begin CHARACTERISTIC TP_S16TCSCpSplitHilExtDistanceTh "" VALUE 0x8003A208 CalPrmWspcEng_SWORD 0 Len51 -32.768 32.767 SYMBOL_LINK "CalPrmWspcEng01.TP_S16TCSCpSplitHilExtDistanceTh" 0 /end CHARACTERISTIC
/begin CHARACTERISTIC TP_S16TCSCpTarWhlPreStMax "" VALUE 0x8003A20A CalPrmWspcEng_SWORD 0 P34 -3276.8 3276.7 SYMBOL_LINK "CalPrmWspcEng01.TP_S16TCSCpTarWhlPreStMax" 0 /end CHARACTERISTIC
/begin CHARACTERISTIC TP_S16TCSCpThOfWhlSpnDiffInSt[0] "" VALUE 0x8003A220 CalPrmWspcEng_SWORD 0 Spd12 -4096 4095.875 SYMBOL_LINK "CalPrmWspcEng01.TP_S16TCSCpThOfWhlSpnDiffInSt[0]" 0 /end CHARACTERISTIC
/begin CHARACTERISTIC TP_S16TCSCpThOfWhlSpnDiffInSt[1] "" VALUE 0x8003A222 CalPrmWspcEng_SWORD 0 Spd12 -4096 4095.875 SYMBOL_LINK "CalPrmWspcEng01.TP_S16TCSCpThOfWhlSpnDiffInSt[1]" 0 /end CHARACTERISTIC
/begin CHARACTERISTIC TP_S16TCSCpThOfWhlSpnDiffInSt[2] "" VALUE 0x8003A224 CalPrmWspcEng_SWORD 0 Spd12 -4096 4095.875 SYMBOL_LINK "CalPrmWspcEng01.TP_S16TCSCpThOfWhlSpnDiffInSt[2]" 0 /end CHARACTERISTIC
/begin CHARACTERISTIC TP_S16TCSCpThOfWhlSpnDiffInSt[3] "" VALUE 0x8003A226 CalPrmWspcEng_SWORD 0 Spd12 -4096 4095.875 SYMBOL_LINK "CalPrmWspcEng01.TP_S16TCSCpThOfWhlSpnDiffInSt[3]" 0 /end CHARACTERISTIC
/begin CHARACTERISTIC TP_S16TCSCpThOfWhlSpnDiffInSt[4] "" VALUE 0x8003A228 CalPrmWspcEng_SWORD 0 Spd12 -4096 4095.875 SYMBOL_LINK "CalPrmWspcEng01.TP_S16TCSCpThOfWhlSpnDiffInSt[4]" 0 /end CHARACTERISTIC
/begin CHARACTERISTIC TP_S16_ABS_ALLOW_SLIP_REF_HSPD "vehicle reference High speed for ABS entrance wheel slip(default 100kph)" VALUE 0x80020570 CalPrmWslcBrk_SWORD 0 Spd12 -4096 4095.875 SYMBOL_LINK "CalPrmWslcBrk01.TP_S16_ABS_ALLOW_SLIP_REF_HSPD" 0 /end CHARACTERISTIC
/begin CHARACTERISTIC TP_S16_ABS_ALLOW_SLIP_REF_LSPD "vehicle reference Low speed for ABS entrance wheel slip(default 30kph)" VALUE 0x80020572 CalPrmWslcBrk_SWORD 0 Spd12 -4096 4095.875 SYMBOL_LINK "CalPrmWslcBrk01.TP_S16_ABS_ALLOW_SLIP_REF_LSPD" 0 /end CHARACTERISTIC
/begin CHARACTERISTIC TP_S16_Additional_HDF_ref_F "Additional HDF reference, for the first 2 and 3 dump scans, Front wheel" VALUE 0x800205B2 CalPrmWslcBrk_SWORD 0 Gain -32768 32767 SYMBOL_LINK "CalPrmWslcBrk01.TP_S16_Additional_HDF_ref_F" 0 /end CHARACTERISTIC
/begin CHARACTERISTIC TP_S16_Additional_HDF_ref_R "Additional HDF reference, for the first 2 and 3 dump scans, Rear wheels" VALUE 0x800205B4 CalPrmWslcBrk_SWORD 0 Gain -32768 32767 SYMBOL_LINK "CalPrmWslcBrk01.TP_S16_Additional_HDF_ref_R" 0 /end CHARACTERISTIC
/begin CHARACTERISTIC TP_S16_BUMP_HI_SPD "Max speed ref. for bump detection, default 100kph (S16_BUMP_MED_SPD+α , max 150kph)" VALUE 0x8002061C CalPrmWslcBrk_SWORD 0 Spd12 -4096 4095.875 SYMBOL_LINK "CalPrmWslcBrk01.TP_S16_BUMP_HI_SPD" 0 /end CHARACTERISTIC
/begin CHARACTERISTIC TP_S16_BUMP_LOW_SPD "Low speed ref. for bump detection, default 40kph (0 ~ 50kph)" VALUE 0x8002061E CalPrmWslcBrk_SWORD 0 Spd12 -4096 4095.875 SYMBOL_LINK "CalPrmWslcBrk01.TP_S16_BUMP_LOW_SPD" 0 /end CHARACTERISTIC
/begin CHARACTERISTIC TP_S16_BUMP_MED_SPD "Medium speed ref. for bump detection, default 50kph (S16_BUMP_LOW_SPD+α , max 70kph)" VALUE 0x80020620 CalPrmWslcBrk_SWORD 0 Spd12 -4096 4095.875 SYMBOL_LINK "CalPrmWslcBrk01.TP_S16_BUMP_MED_SPD" 0 /end CHARACTERISTIC
/begin CHARACTERISTIC TP_S16_CBC_ALAT_ENTER_SPD_H "Ay level for CBC enter at high speed" VALUE 0x800206E6 CalPrmWslcBrk_SWORD 0 A41 -32.768 32.767 SYMBOL_LINK "CalPrmWslcBrk01.TP_S16_CBC_ALAT_ENTER_SPD_H" 0 /end CHARACTERISTIC
/begin CHARACTERISTIC TP_S16_CBC_ALAT_ENTER_SPD_H_FAST_STR "Ay level for CBC enter at high speed with fast steer" VALUE 0x80020740 CalPrmWslcBrk_SWORD 0 A41 -32.768 32.767 SYMBOL_LINK "CalPrmWslcBrk01.TP_S16_CBC_ALAT_ENTER_SPD_H_FAST_STR" 0 /end CHARACTERISTIC
/begin CHARACTERISTIC TP_S16_CBC_ALAT_ENTER_SPD_H_SLOW_STR "Ay level for CBC enter at high speed with slow steer" VALUE 0x80020742 CalPrmWslcBrk_SWORD 0 A41 -32.768 32.767 SYMBOL_LINK "CalPrmWslcBrk01.TP_S16_CBC_ALAT_ENTER_SPD_H_SLOW_STR" 0 /end CHARACTERISTIC
/begin CHARACTERISTIC TP_S16_CBC_ALAT_ENTER_SPD_M "Ay level for CBC enter at middle speed" VALUE 0x800206E8 CalPrmWslcBrk_SWORD 0 A41 -32.768 32.767 SYMBOL_LINK "CalPrmWslcBrk01.TP_S16_CBC_ALAT_ENTER_SPD_M" 0 /end CHARACTERISTIC
/begin CHARACTERISTIC TP_S16_CBC_ALAT_ENTER_SPD_M_FAST_STR "Ay level for CBC enter at middle speed with fast steer" VALUE 0x80020744 CalPrmWslcBrk_SWORD 0 A41 -32.768 32.767 SYMBOL_LINK "CalPrmWslcBrk01.TP_S16_CBC_ALAT_ENTER_SPD_M_FAST_STR" 0 /end CHARACTERISTIC
/begin CHARACTERISTIC TP_S16_CBC_ALAT_ENTER_SPD_M_SLOW_STR "Ay level for CBC enter at middle speed with slow steer" VALUE 0x80020746 CalPrmWslcBrk_SWORD 0 A41 -32.768 32.767 SYMBOL_LINK "CalPrmWslcBrk01.TP_S16_CBC_ALAT_ENTER_SPD_M_SLOW_STR" 0 /end CHARACTERISTIC
/begin CHARACTERISTIC TP_S16_CBC_ALAT_ENTER_SPD_S "Ay level for CBC enter at low speed" VALUE 0x800206EA CalPrmWslcBrk_SWORD 0 A41 -32.768 32.767 SYMBOL_LINK "CalPrmWslcBrk01.TP_S16_CBC_ALAT_ENTER_SPD_S" 0 /end CHARACTERISTIC
/begin CHARACTERISTIC TP_S16_CBC_ALAT_ENTER_SPD_S_FAST_STR "Ay level for CBC enter at low speed with fast steer" VALUE 0x80020748 CalPrmWslcBrk_SWORD 0 A41 -32.768 32.767 SYMBOL_LINK "CalPrmWslcBrk01.TP_S16_CBC_ALAT_ENTER_SPD_S_FAST_STR" 0 /end CHARACTERISTIC
/begin CHARACTERISTIC TP_S16_CBC_ALAT_ENTER_SPD_S_SLOW_STR "Ay level for CBC enter at low speed with slow steer" VALUE 0x8002074A CalPrmWslcBrk_SWORD 0 A41 -32.768 32.767 SYMBOL_LINK "CalPrmWslcBrk01.TP_S16_CBC_ALAT_ENTER_SPD_S_SLOW_STR" 0 /end CHARACTERISTIC
/begin CHARACTERISTIC TP_S16_CBC_BRAKING_DET_THRES "Min Mpress for Partial brake detect SET, default 15bar" VALUE 0x8002073A CalPrmWslcBrk_SWORD 0 P34 -3276.8 3276.7 SYMBOL_LINK "CalPrmWslcBrk01.TP_S16_CBC_BRAKING_DET_THRES" 0 /end CHARACTERISTIC
/begin CHARACTERISTIC TP_S16_CBC_BRAKING_DET_THRES_ABS "Min Mpress for Partial brake detect SET, default 15bar" VALUE 0x800206EC CalPrmWslcBrk_SWORD 0 P34 -3276.8 3276.7 SYMBOL_LINK "CalPrmWslcBrk01.TP_S16_CBC_BRAKING_DET_THRES_ABS" 0 /end CHARACTERISTIC
/begin CHARACTERISTIC TP_S16_CBC_BRAKING_MIN_THRES "Min Mpress for Partial brake detect RESET, default 5bar" VALUE 0x8002073C CalPrmWslcBrk_SWORD 0 P34 -3276.8 3276.7 SYMBOL_LINK "CalPrmWslcBrk01.TP_S16_CBC_BRAKING_MIN_THRES" 0 /end CHARACTERISTIC
/begin CHARACTERISTIC TP_S16_CBC_BRAKING_MIN_THRES_ABS "Min Mpress for Partial brake detect RESET, default 5bar" VALUE 0x800206EE CalPrmWslcBrk_SWORD 0 P34 -3276.8 3276.7 SYMBOL_LINK "CalPrmWslcBrk01.TP_S16_CBC_BRAKING_MIN_THRES_ABS" 0 /end CHARACTERISTIC
/begin CHARACTERISTIC TP_S16_CBC_MPRESS_ENTER "Mpress level for CBC enter condition" VALUE 0x8002073E CalPrmWslcBrk_SWORD 0 P34 -3276.8 3276.7 SYMBOL_LINK "CalPrmWslcBrk01.TP_S16_CBC_MPRESS_ENTER" 0 /end CHARACTERISTIC
/begin CHARACTERISTIC TP_S16_CBC_MPRESS_ENTER_ABS "Estimated mpress level for CBC enter condition" VALUE 0x800206F0 CalPrmWslcBrk_SWORD 0 P34 -3276.8 3276.7 SYMBOL_LINK "CalPrmWslcBrk01.TP_S16_CBC_MPRESS_ENTER_ABS" 0 /end CHARACTERISTIC
/begin CHARACTERISTIC TP_S16_CBC_THRES_HIGH_SPEED "CBC reference High speed(default : 120kph)" VALUE 0x800206E0 CalPrmWslcBrk_SWORD 0 Spd12 -4096 4095.875 SYMBOL_LINK "CalPrmWslcBrk01.TP_S16_CBC_THRES_HIGH_SPEED" 0 /end CHARACTERISTIC
/begin CHARACTERISTIC TP_S16_CBC_THRES_LOW_SPEED "CBC reference Low speed(default : 60kph)" VALUE 0x800206E2 CalPrmWslcBrk_SWORD 0 Spd12 -4096 4095.875 SYMBOL_LINK "CalPrmWslcBrk01.TP_S16_CBC_THRES_LOW_SPEED" 0 /end CHARACTERISTIC
/begin CHARACTERISTIC TP_S16_CBC_THRES_MED_SPEED "CBC reference Med speed(default : 90kph)" VALUE 0x800206E4 CalPrmWslcBrk_SWORD 0 Spd12 -4096 4095.875 SYMBOL_LINK "CalPrmWslcBrk01.TP_S16_CBC_THRES_MED_SPEED" 0 /end CHARACTERISTIC
/begin CHARACTERISTIC TP_S16_DP_DUTY_COMP_REF_MPRESS "Mpress reference for NO duty compensation by MP variation(default 150bar)" VALUE 0x80020554 CalPrmWslcBrk_SWORD 0 P34 -3276.8 3276.7 SYMBOL_LINK "CalPrmWslcBrk01.TP_S16_DP_DUTY_COMP_REF_MPRESS" 0 /end CHARACTERISTIC
/begin CHARACTERISTIC TP_S16_Decel_Gain_BFAFZOK_100_150_F "Decel Gain, Before AFZ OK, 100-150kph, Decel State, Front Wheels" VALUE 0x800202E4 CalPrmWslcBrk_SWORD 0 Gain -32768 32767 SYMBOL_LINK "CalPrmWslcBrk01.TP_S16_Decel_Gain_BFAFZOK_100_150_F" 0 /end CHARACTERISTIC
/begin CHARACTERISTIC TP_S16_Decel_Gain_BFAFZOK_10_20_F "Decel Gain, Before AFZ OK, 10-20kph, Decel State, Front Wheels" VALUE 0x800202E6 CalPrmWslcBrk_SWORD 0 Gain -32768 32767 SYMBOL_LINK "CalPrmWslcBrk01.TP_S16_Decel_Gain_BFAFZOK_10_20_F" 0 /end CHARACTERISTIC
/begin CHARACTERISTIC TP_S16_Decel_Gain_BFAFZOK_20_40_F "Decel Gain, Before AFZ OK, 20-40kph, Decel State, Front Wheels" VALUE 0x800202E8 CalPrmWslcBrk_SWORD 0 Gain -32768 32767 SYMBOL_LINK "CalPrmWslcBrk01.TP_S16_Decel_Gain_BFAFZOK_20_40_F" 0 /end CHARACTERISTIC
/begin CHARACTERISTIC TP_S16_Decel_Gain_BFAFZOK_40_60_F "Decel Gain, Before AFZ OK, 40-60kph, Decel State, Front Wheels" VALUE 0x800202EA CalPrmWslcBrk_SWORD 0 Gain -32768 32767 SYMBOL_LINK "CalPrmWslcBrk01.TP_S16_Decel_Gain_BFAFZOK_40_60_F" 0 /end CHARACTERISTIC
/begin CHARACTERISTIC TP_S16_Decel_Gain_BFAFZOK_60_100_F "Decel Gain, Before AFZ OK, 60-100kph, Decel State, Front Wheels" VALUE 0x800202EC CalPrmWslcBrk_SWORD 0 Gain -32768 32767 SYMBOL_LINK "CalPrmWslcBrk01.TP_S16_Decel_Gain_BFAFZOK_60_100_F" 0 /end CHARACTERISTIC
/begin CHARACTERISTIC TP_S16_Decel_Gain_BFAFZOK_Ab_150_F "Decel Gain, Before AFZ OK, Above 150kph, Decel State, Front Wheels" VALUE 0x800202EE CalPrmWslcBrk_SWORD 0 Gain -32768 32767 SYMBOL_LINK "CalPrmWslcBrk01.TP_S16_Decel_Gain_BFAFZOK_Ab_150_F" 0 /end CHARACTERISTIC
/begin CHARACTERISTIC TP_S16_Decel_Gain_BFAFZOK_B_10_F "Decel Gain, Before AFZ OK, Below 10kph, Decel State, Front Wheels" VALUE 0x800202F0 CalPrmWslcBrk_SWORD 0 Gain -32768 32767 SYMBOL_LINK "CalPrmWslcBrk01.TP_S16_Decel_Gain_BFAFZOK_B_10_F" 0 /end CHARACTERISTIC
/begin CHARACTERISTIC TP_S16_Decel_Gain_EBD_100_150kph_R "Decel Gain, EBD dump control, 100-150kph, Decel State" VALUE 0x800206C0 CalPrmWslcBrk_SWORD 0 Gain -32768 32767 SYMBOL_LINK "CalPrmWslcBrk01.TP_S16_Decel_Gain_EBD_100_150kph_R" 0 /end CHARACTERISTIC
/begin CHARACTERISTIC TP_S16_Decel_Gain_EBD_20_40kph_R "Decel Gain, EBD dump control, 20-40kph, Decel State" VALUE 0x800206C2 CalPrmWslcBrk_SWORD 0 Gain -32768 32767 SYMBOL_LINK "CalPrmWslcBrk01.TP_S16_Decel_Gain_EBD_20_40kph_R" 0 /end CHARACTERISTIC
/begin CHARACTERISTIC TP_S16_Decel_Gain_EBD_40_60kph_R "Decel Gain, EBD dump control, 40-60kph, Decel State" VALUE 0x800206C4 CalPrmWslcBrk_SWORD 0 Gain -32768 32767 SYMBOL_LINK "CalPrmWslcBrk01.TP_S16_Decel_Gain_EBD_40_60kph_R" 0 /end CHARACTERISTIC
/begin CHARACTERISTIC TP_S16_Decel_Gain_EBD_60_100kph_R "Decel Gain, EBD dump control, 60-100kph, Decel State" VALUE 0x800206C6 CalPrmWslcBrk_SWORD 0 Gain -32768 32767 SYMBOL_LINK "CalPrmWslcBrk01.TP_S16_Decel_Gain_EBD_60_100kph_R" 0 /end CHARACTERISTIC
/begin CHARACTERISTIC TP_S16_Decel_Gain_EBD_Ab_150kph_R "Decel Gain, EBD dump control, above 150kph, Decel State" VALUE 0x800206C8 CalPrmWslcBrk_SWORD 0 Gain -32768 32767 SYMBOL_LINK "CalPrmWslcBrk01.TP_S16_Decel_Gain_EBD_Ab_150kph_R" 0 /end CHARACTERISTIC
/begin CHARACTERISTIC TP_S16_Decel_Gain_EBD_B_20kph_R "Decel Gain, EBD dump control, below 20kph, Decel State" VALUE 0x800206CA CalPrmWslcBrk_SWORD 0 Gain -32768 32767 SYMBOL_LINK "CalPrmWslcBrk01.TP_S16_Decel_Gain_EBD_B_20kph_R" 0 /end CHARACTERISTIC
/begin CHARACTERISTIC TP_S16_GMA_DCT_SP_DIFF_0_50_BABS "Ref. Speed difference of Front Wheels for GMA detection, Out ABS(Front high side), Below 50kph" VALUE 0x800205EC CalPrmWslcBrk_SWORD 0 Spd12 -4096 4095.875 SYMBOL_LINK "CalPrmWslcBrk01.TP_S16_GMA_DCT_SP_DIFF_0_50_BABS" 0 /end CHARACTERISTIC
/begin CHARACTERISTIC TP_S16_GMA_DCT_SP_DIFF_50_80_BABS "Ref. Speed difference of Front Wheels for GMA detection, Out ABS(Front high side), 50-80kph" VALUE 0x800205EE CalPrmWslcBrk_SWORD 0 Spd12 -4096 4095.875 SYMBOL_LINK "CalPrmWslcBrk01.TP_S16_GMA_DCT_SP_DIFF_50_80_BABS" 0 /end CHARACTERISTIC
/begin CHARACTERISTIC TP_S16_GMA_DCT_SP_DIFF_80_M_BABS "Ref. Speed difference of Front Wheels for GMA detection, Out ABS(Front high side), above 80kph" VALUE 0x800205F0 CalPrmWslcBrk_SWORD 0 Spd12 -4096 4095.875 SYMBOL_LINK "CalPrmWslcBrk01.TP_S16_GMA_DCT_SP_DIFF_80_M_BABS" 0 /end CHARACTERISTIC
/begin CHARACTERISTIC TP_S16_HDF_REF_LMu_40_60kph_F "HDF reference, condition for special 1st cycle dump" VALUE 0x800205B6 CalPrmWslcBrk_SWORD 0 Gain -32768 32767 SYMBOL_LINK "CalPrmWslcBrk01.TP_S16_HDF_REF_LMu_40_60kph_F" 0 /end CHARACTERISTIC
/begin CHARACTERISTIC TP_S16_HDF_REF_LMu_Ab_60kph_F "HDF reference, condition for special 1st cycle dump" VALUE 0x800205B8 CalPrmWslcBrk_SWORD 0 Gain -32768 32767 SYMBOL_LINK "CalPrmWslcBrk01.TP_S16_HDF_REF_LMu_Ab_60kph_F" 0 /end CHARACTERISTIC
/begin CHARACTERISTIC TP_S16_HDF_REF_LMu_B_40kph_F "HDF reference, condition for special 1st cycle dump" VALUE 0x800205BA CalPrmWslcBrk_SWORD 0 Gain -32768 32767 SYMBOL_LINK "CalPrmWslcBrk01.TP_S16_HDF_REF_LMu_B_40kph_F" 0 /end CHARACTERISTIC
/begin CHARACTERISTIC TP_S16_NEED_DEC_PRESS_YDF_L1 "Yaw-dump factor for Pressure decrease level 1 (default : 300)" VALUE 0x80020506 CalPrmWslcBrk_SWORD 0 Gain -32768 32767 SYMBOL_LINK "CalPrmWslcBrk01.TP_S16_NEED_DEC_PRESS_YDF_L1" 0 /end CHARACTERISTIC
/begin CHARACTERISTIC TP_S16_NEED_DEC_PRESS_YDF_L2 "Yaw-dump factor for Pressure decrease level 2 (default : 1000)" VALUE 0x80020508 CalPrmWslcBrk_SWORD 0 Gain -32768 32767 SYMBOL_LINK "CalPrmWslcBrk01.TP_S16_NEED_DEC_PRESS_YDF_L2" 0 /end CHARACTERISTIC
/begin CHARACTERISTIC TP_S16_NEED_DEC_PRESS_YDF_L3 "Yaw-dump factor for Pressure decrease level 3 (default : 2000)" VALUE 0x8002050A CalPrmWslcBrk_SWORD 0 Gain -32768 32767 SYMBOL_LINK "CalPrmWslcBrk01.TP_S16_NEED_DEC_PRESS_YDF_L3" 0 /end CHARACTERISTIC
/begin CHARACTERISTIC TP_S16_SP_HI_SIDE_STB_DMP_YDF_TH_BL "YDF threshold for stable dump at Split-mu, Front High side wheel below S16_GMA_L_SPEED" VALUE 0x800204FE CalPrmWslcBrk_SWORD 0 Gain -32768 32767 SYMBOL_LINK "CalPrmWslcBrk01.TP_S16_SP_HI_SIDE_STB_DMP_YDF_TH_BL" 0 /end CHARACTERISTIC
/begin CHARACTERISTIC TP_S16_SP_HI_SIDE_STB_DMP_YDF_TH_H "YDF threshold for stable dump at Split-mu, Front High side wheel above S16_GMA_H_SPEED" VALUE 0x80020500 CalPrmWslcBrk_SWORD 0 Gain -32768 32767 SYMBOL_LINK "CalPrmWslcBrk01.TP_S16_SP_HI_SIDE_STB_DMP_YDF_TH_H" 0 /end CHARACTERISTIC
/begin CHARACTERISTIC TP_S16_SP_HI_SIDE_STB_DMP_YDF_TH_L "YDF threshold for stable dump at Split-mu, Front High side wheel above S16_GMA_L_SPEED" VALUE 0x80020502 CalPrmWslcBrk_SWORD 0 Gain -32768 32767 SYMBOL_LINK "CalPrmWslcBrk01.TP_S16_SP_HI_SIDE_STB_DMP_YDF_TH_L" 0 /end CHARACTERISTIC
/begin CHARACTERISTIC TP_S16_SP_HI_SIDE_STB_DMP_YDF_TH_M "YDF threshold for stable dump at Split-mu, Front High side wheel above S16_GMA_M_SPEED" VALUE 0x80020504 CalPrmWslcBrk_SWORD 0 Gain -32768 32767 SYMBOL_LINK "CalPrmWslcBrk01.TP_S16_SP_HI_SIDE_STB_DMP_YDF_TH_M" 0 /end CHARACTERISTIC
/begin CHARACTERISTIC TP_S16_Slip_Gain_BFAFZOK_100_150_F "Slip Gain, Before AFZ OK, 100-150kph, Decel State, Front Wheels" VALUE 0x800202F2 CalPrmWslcBrk_SWORD 0 Gain -32768 32767 SYMBOL_LINK "CalPrmWslcBrk01.TP_S16_Slip_Gain_BFAFZOK_100_150_F" 0 /end CHARACTERISTIC
/begin CHARACTERISTIC TP_S16_Slip_Gain_BFAFZOK_10_20_F "Slip Gain, Before AFZ OK, 10-20kph, Decel State, Front Wheels" VALUE 0x800202F4 CalPrmWslcBrk_SWORD 0 Gain -32768 32767 SYMBOL_LINK "CalPrmWslcBrk01.TP_S16_Slip_Gain_BFAFZOK_10_20_F" 0 /end CHARACTERISTIC
/begin CHARACTERISTIC TP_S16_Slip_Gain_BFAFZOK_20_40_F "Slip Gain, Before AFZ OK, 20-40kph, Decel State, Front Wheels" VALUE 0x800202F6 CalPrmWslcBrk_SWORD 0 Gain -32768 32767 SYMBOL_LINK "CalPrmWslcBrk01.TP_S16_Slip_Gain_BFAFZOK_20_40_F" 0 /end CHARACTERISTIC
/begin CHARACTERISTIC TP_S16_Slip_Gain_BFAFZOK_40_60_F "Slip Gain, Before AFZ OK, 40-60kph, Decel State, Front Wheels" VALUE 0x800202F8 CalPrmWslcBrk_SWORD 0 Gain -32768 32767 SYMBOL_LINK "CalPrmWslcBrk01.TP_S16_Slip_Gain_BFAFZOK_40_60_F" 0 /end CHARACTERISTIC
/begin CHARACTERISTIC TP_S16_Slip_Gain_BFAFZOK_60_100_F "Slip Gain, Before AFZ OK, 60-100kph, Decel State, Front Wheels" VALUE 0x800202FA CalPrmWslcBrk_SWORD 0 Gain -32768 32767 SYMBOL_LINK "CalPrmWslcBrk01.TP_S16_Slip_Gain_BFAFZOK_60_100_F" 0 /end CHARACTERISTIC
/begin CHARACTERISTIC TP_S16_Slip_Gain_BFAFZOK_Ab_150_F "Slip Gain, Before AFZ OK, Above 150kph, Decel State, Front Wheels" VALUE 0x800202FC CalPrmWslcBrk_SWORD 0 Gain -32768 32767 SYMBOL_LINK "CalPrmWslcBrk01.TP_S16_Slip_Gain_BFAFZOK_Ab_150_F" 0 /end CHARACTERISTIC
/begin CHARACTERISTIC TP_S16_Slip_Gain_BFAFZOK_B_10_F "Slip Gain, Before AFZ OK, Below 10kph, Decel State, Front Wheels" VALUE 0x800202FE CalPrmWslcBrk_SWORD 0 Gain -32768 32767 SYMBOL_LINK "CalPrmWslcBrk01.TP_S16_Slip_Gain_BFAFZOK_B_10_F" 0 /end CHARACTERISTIC
/begin CHARACTERISTIC TP_S16_Slip_Gain_EBD_100_150kph_R "Slip Gain, EBD dump control, 100-150kph, Decel State" VALUE 0x800206CC CalPrmWslcBrk_SWORD 0 Gain -32768 32767 SYMBOL_LINK "CalPrmWslcBrk01.TP_S16_Slip_Gain_EBD_100_150kph_R" 0 /end CHARACTERISTIC
/begin CHARACTERISTIC TP_S16_Slip_Gain_EBD_20_40kph_R "Slip Gain, EBD dump control, 20-40kph, Decel State" VALUE 0x800206CE CalPrmWslcBrk_SWORD 0 Gain -32768 32767 SYMBOL_LINK "CalPrmWslcBrk01.TP_S16_Slip_Gain_EBD_20_40kph_R" 0 /end CHARACTERISTIC
/begin CHARACTERISTIC TP_S16_Slip_Gain_EBD_40_60kph_R "Slip Gain, EBD dump control, 40-60kph, Decel State" VALUE 0x800206D0 CalPrmWslcBrk_SWORD 0 Gain -32768 32767 SYMBOL_LINK "CalPrmWslcBrk01.TP_S16_Slip_Gain_EBD_40_60kph_R" 0 /end CHARACTERISTIC
/begin CHARACTERISTIC TP_S16_Slip_Gain_EBD_60_100kph_R "Slip Gain, EBD dump control, 60-100kph, Decel State" VALUE 0x800206D2 CalPrmWslcBrk_SWORD 0 Gain -32768 32767 SYMBOL_LINK "CalPrmWslcBrk01.TP_S16_Slip_Gain_EBD_60_100kph_R" 0 /end CHARACTERISTIC
/begin CHARACTERISTIC TP_S16_Slip_Gain_EBD_Ab_150kph_R "Slip Gain, EBD dump control, above 150kph, Decel State" VALUE 0x800206D4 CalPrmWslcBrk_SWORD 0 Gain -32768 32767 SYMBOL_LINK "CalPrmWslcBrk01.TP_S16_Slip_Gain_EBD_Ab_150kph_R" 0 /end CHARACTERISTIC
/begin CHARACTERISTIC TP_S16_Slip_Gain_EBD_B_20kph_R "Slip Gain, EBD dump control, below 20kph, Decel State" VALUE 0x800206D6 CalPrmWslcBrk_SWORD 0 Gain -32768 32767 SYMBOL_LINK "CalPrmWslcBrk01.TP_S16_Slip_Gain_EBD_B_20kph_R" 0 /end CHARACTERISTIC
/begin CHARACTERISTIC TP_S8_ABS_ALLOW_SLIP_HSPD "Max. ABS entrance wheel slip on out-ABS" VALUE 0x80020574 CalPrmWslcBrk_SBYTE 0 Perc6 -128 127 SYMBOL_LINK "CalPrmWslcBrk01.TP_S8_ABS_ALLOW_SLIP_HSPD" 0 /end CHARACTERISTIC
/begin CHARACTERISTIC TP_S8_ABS_ALLOW_SLIP_HSPD_BEND "Max. ABS entrance wheel slip when BEND is detected(ESC:outside wheel/ABS:all front wheels)" VALUE 0x80020575 CalPrmWslcBrk_SBYTE 0 Perc6 -128 127 SYMBOL_LINK "CalPrmWslcBrk01.TP_S8_ABS_ALLOW_SLIP_HSPD_BEND" 0 /end CHARACTERISTIC
/begin CHARACTERISTIC TP_S8_ABS_ALLOW_SLIP_HSPD_BEND_IN "Max. ABS entrance inside wheel slip of left BEND detected(ESC only)" VALUE 0x80020576 CalPrmWslcBrk_SBYTE 0 Perc6 -128 127 SYMBOL_LINK "CalPrmWslcBrk01.TP_S8_ABS_ALLOW_SLIP_HSPD_BEND_IN" 0 /end CHARACTERISTIC
/begin CHARACTERISTIC TP_S8_ABS_ALLOW_SLIP_HSPD_BEND_OUT "Max. ABS entrance inside wheel slip of right BEND detected(ESC only)" VALUE 0x80020577 CalPrmWslcBrk_SBYTE 0 Perc6 -128 127 SYMBOL_LINK "CalPrmWslcBrk01.TP_S8_ABS_ALLOW_SLIP_HSPD_BEND_OUT" 0 /end CHARACTERISTIC
/begin CHARACTERISTIC TP_S8_ABS_ALLOW_SLIP_HSPD_IN "Max. ABS entrance wheel slip on in-ABS" VALUE 0x80020578 CalPrmWslcBrk_SBYTE 0 Perc6 -128 127 SYMBOL_LINK "CalPrmWslcBrk01.TP_S8_ABS_ALLOW_SLIP_HSPD_IN" 0 /end CHARACTERISTIC
/begin CHARACTERISTIC TP_S8_ABS_ALLOW_SLIP_LSPD "Min. ABS entrance wheel slip on out-ABS" VALUE 0x80020579 CalPrmWslcBrk_SBYTE 0 Perc6 -128 127 SYMBOL_LINK "CalPrmWslcBrk01.TP_S8_ABS_ALLOW_SLIP_LSPD" 0 /end CHARACTERISTIC
/begin CHARACTERISTIC TP_S8_ABS_ALLOW_SLIP_LSPD_BEND "Min. ABS entrance wheel slip when BEND is detected(ESC:outside wheel/ABS:all front wheels)" VALUE 0x8002057A CalPrmWslcBrk_SBYTE 0 Perc6 -128 127 SYMBOL_LINK "CalPrmWslcBrk01.TP_S8_ABS_ALLOW_SLIP_LSPD_BEND" 0 /end CHARACTERISTIC
/begin CHARACTERISTIC TP_S8_ABS_ALLOW_SLIP_LSPD_BEND_IN "Min. ABS entrance inside wheel slip of left BEND detected(ESC only)" VALUE 0x8002057B CalPrmWslcBrk_SBYTE 0 Perc6 -128 127 SYMBOL_LINK "CalPrmWslcBrk01.TP_S8_ABS_ALLOW_SLIP_LSPD_BEND_IN" 0 /end CHARACTERISTIC
/begin CHARACTERISTIC TP_S8_ABS_ALLOW_SLIP_LSPD_BEND_OUT "Min. ABS entrance inside wheel slip of right BEND detected(ESC only)" VALUE 0x8002057C CalPrmWslcBrk_SBYTE 0 Perc6 -128 127 SYMBOL_LINK "CalPrmWslcBrk01.TP_S8_ABS_ALLOW_SLIP_LSPD_BEND_OUT" 0 /end CHARACTERISTIC
/begin CHARACTERISTIC TP_S8_ABS_ALLOW_SLIP_LSPD_IN "Min. ABS entrance wheel slip on in-ABS" VALUE 0x8002057D CalPrmWslcBrk_SBYTE 0 Perc6 -128 127 SYMBOL_LINK "CalPrmWslcBrk01.TP_S8_ABS_ALLOW_SLIP_LSPD_IN" 0 /end CHARACTERISTIC
/begin CHARACTERISTIC TP_S8_ADDON_TIME_FOR_LOW_MP_F "Add reapply time for slight braking, front" VALUE 0x8002055C CalPrmWslcBrk_SBYTE 0 Gain -128 127 SYMBOL_LINK "CalPrmWslcBrk01.TP_S8_ADDON_TIME_FOR_LOW_MP_F" 0 /end CHARACTERISTIC
/begin CHARACTERISTIC TP_S8_ADDON_TIME_FOR_LOW_MP_R "Add reapply time for slight braking, rear" VALUE 0x8002055D CalPrmWslcBrk_SBYTE 0 Gain -128 127 SYMBOL_LINK "CalPrmWslcBrk01.TP_S8_ADDON_TIME_FOR_LOW_MP_R" 0 /end CHARACTERISTIC
/begin CHARACTERISTIC TP_S8_Arad_1stPoint_B_20KPH "1st reference point to set the reference EBD cut slip depending on wheel acceleration, Below 20KPH" VALUE 0x80020689 CalPrmWslcBrk_SBYTE 0 A20 -32 31.75 SYMBOL_LINK "CalPrmWslcBrk01.TP_S8_Arad_1stPoint_B_20KPH" 0 /end CHARACTERISTIC
/begin CHARACTERISTIC TP_S8_Arad_2ndPoint_B_20KPH "2nd reference point to set the reference EBD cut slip depending on wheel acceleration, Below 20KPH" VALUE 0x8002068A CalPrmWslcBrk_SBYTE 0 A20 -32 31.75 SYMBOL_LINK "CalPrmWslcBrk01.TP_S8_Arad_2ndPoint_B_20KPH" 0 /end CHARACTERISTIC
/begin CHARACTERISTIC TP_S8_Arad_3rdPoint_B_20KPH "3rd reference point to set the reference EBD cut slip depending on wheel acceleration, Below 20KPH" VALUE 0x8002068B CalPrmWslcBrk_SBYTE 0 A20 -32 31.75 SYMBOL_LINK "CalPrmWslcBrk01.TP_S8_Arad_3rdPoint_B_20KPH" 0 /end CHARACTERISTIC
/begin CHARACTERISTIC TP_S8_Arad_Fact_1_2P_B_20KPH "subtracting value from initial cut slip at wheel acceleration between Arad_1stPoint ~ Arad_2ndPoint, Below 20KPH" VALUE 0x8002068C CalPrmWslcBrk_SBYTE 0 Perc6 -128 127 SYMBOL_LINK "CalPrmWslcBrk01.TP_S8_Arad_Fact_1_2P_B_20KPH" 0 /end CHARACTERISTIC
/begin CHARACTERISTIC TP_S8_Arad_Fact_2_3P_B_20KPH "subtracting value from initial cut slip at wheel acceleration between Arad_2ndPoint ~ Arad_3rdPoint, Below 20KPH" VALUE 0x8002068D CalPrmWslcBrk_SBYTE 0 Perc6 -128 127 SYMBOL_LINK "CalPrmWslcBrk01.TP_S8_Arad_Fact_2_3P_B_20KPH" 0 /end CHARACTERISTIC
/begin CHARACTERISTIC TP_S8_Arad_Fact_Ab_3P_B_20KPH "subtracting value from initial cut slip at wheel acceleration above Arad_3rdPoint, Below 20KPH" VALUE 0x8002068E CalPrmWslcBrk_SBYTE 0 Perc6 -128 127 SYMBOL_LINK "CalPrmWslcBrk01.TP_S8_Arad_Fact_Ab_3P_B_20KPH" 0 /end CHARACTERISTIC
/begin CHARACTERISTIC TP_S8_Arad_Fact_B_1P_B_20KPH "subtracting value from initial cut slip at wheel acceleration below Arad_1stPoint, Below 20KPH" VALUE 0x8002068F CalPrmWslcBrk_SBYTE 0 Perc6 -128 127 SYMBOL_LINK "CalPrmWslcBrk01.TP_S8_Arad_Fact_B_1P_B_20KPH" 0 /end CHARACTERISTIC
/begin CHARACTERISTIC TP_S8_BUMP_PEAK_ACC_REF_1_DUMP "Peak Accel threshold for 1 dump scan, default 7g, min 4g, max 10g" VALUE 0x80020622 CalPrmWslcBrk_SBYTE 0 A20 -32 31.75 SYMBOL_LINK "CalPrmWslcBrk01.TP_S8_BUMP_PEAK_ACC_REF_1_DUMP" 0 /end CHARACTERISTIC
/begin CHARACTERISTIC TP_S8_BUMP_PEAK_ACC_REF_MAX_DUMP "Peak Accel threshold for max dump scan, default 14g, min 10g, max 25g" VALUE 0x80020623 CalPrmWslcBrk_SBYTE 0 A20 -32 31.75 SYMBOL_LINK "CalPrmWslcBrk01.TP_S8_BUMP_PEAK_ACC_REF_MAX_DUMP" 0 /end CHARACTERISTIC
/begin CHARACTERISTIC TP_S8_Decel_Gain_LMu_10_20k_F_HDC "Decel Gain during HDC, Low Mu, 10-20kph, Front Wheels, Default Low Mu gain" VALUE 0x80020560 CalPrmWslcBrk_SBYTE 0 Gain -128 127 SYMBOL_LINK "CalPrmWslcBrk01.TP_S8_Decel_Gain_LMu_10_20k_F_HDC" 0 /end CHARACTERISTIC
/begin CHARACTERISTIC TP_S8_Decel_Gain_LMu_B_10k_F_HDC "Decel Gain during HDC, Low Mu, Below 10kph, Front Wheels, Default Low Mu gain" VALUE 0x80020561 CalPrmWslcBrk_SBYTE 0 Gain -128 127 SYMBOL_LINK "CalPrmWslcBrk01.TP_S8_Decel_Gain_LMu_B_10k_F_HDC" 0 /end CHARACTERISTIC
/begin CHARACTERISTIC TP_S8_EBD_Cut_Arad_100_150KPH "Arad Threshold to start EBD control, 100~150KPH" VALUE 0x80020677 CalPrmWslcBrk_SBYTE 0 A20 -32 31.75 SYMBOL_LINK "CalPrmWslcBrk01.TP_S8_EBD_Cut_Arad_100_150KPH" 0 /end CHARACTERISTIC
/begin CHARACTERISTIC TP_S8_EBD_Cut_Arad_20_40KPH "Arad Threshold to start EBD control, 20~40KPH" VALUE 0x80020678 CalPrmWslcBrk_SBYTE 0 A20 -32 31.75 SYMBOL_LINK "CalPrmWslcBrk01.TP_S8_EBD_Cut_Arad_20_40KPH" 0 /end CHARACTERISTIC
/begin CHARACTERISTIC TP_S8_EBD_Cut_Arad_40_60KPH "Arad Threshold to start EBD control, 40~60KPH" VALUE 0x80020679 CalPrmWslcBrk_SBYTE 0 A20 -32 31.75 SYMBOL_LINK "CalPrmWslcBrk01.TP_S8_EBD_Cut_Arad_40_60KPH" 0 /end CHARACTERISTIC
/begin CHARACTERISTIC TP_S8_EBD_Cut_Arad_60_100KPH "Arad Threshold to start EBD control, 60~100KPH" VALUE 0x8002067A CalPrmWslcBrk_SBYTE 0 A20 -32 31.75 SYMBOL_LINK "CalPrmWslcBrk01.TP_S8_EBD_Cut_Arad_60_100KPH" 0 /end CHARACTERISTIC
/begin CHARACTERISTIC TP_S8_EBD_Cut_Arad_Ab_150KPH "Arad Threshold to start EBD control, Above 150KPH" VALUE 0x8002067B CalPrmWslcBrk_SBYTE 0 A20 -32 31.75 SYMBOL_LINK "CalPrmWslcBrk01.TP_S8_EBD_Cut_Arad_Ab_150KPH" 0 /end CHARACTERISTIC
/begin CHARACTERISTIC TP_S8_EBD_Cut_Arad_B_20KPH "Arad Threshold to start EBD control, Below 20KPH" VALUE 0x8002067C CalPrmWslcBrk_SBYTE 0 A20 -32 31.75 SYMBOL_LINK "CalPrmWslcBrk01.TP_S8_EBD_Cut_Arad_B_20KPH" 0 /end CHARACTERISTIC
/begin CHARACTERISTIC TP_S8_FORCED_HLD_SLIP_CHMU_A80KPH_F "Front Wheel slip to allow stable forced hold for Certain High Mu above 80kph" VALUE 0x80020611 CalPrmWslcBrk_SBYTE 0 Perc6 -128 127 SYMBOL_LINK "CalPrmWslcBrk01.TP_S8_FORCED_HLD_SLIP_CHMU_A80KPH_F" 0 /end CHARACTERISTIC
/begin CHARACTERISTIC TP_S8_FORCED_HLD_SLIP_CHMU_B40KPH_F "Front Wheel slip to allow stable forced hold for Certain High Mu below 40kph" VALUE 0x80020612 CalPrmWslcBrk_SBYTE 0 Perc6 -128 127 SYMBOL_LINK "CalPrmWslcBrk01.TP_S8_FORCED_HLD_SLIP_CHMU_B40KPH_F" 0 /end CHARACTERISTIC
/begin CHARACTERISTIC TP_S8_FORCED_HLD_SLIP_CHMU_B80KPH_F "Front Wheel slip to allow stable forced hold for Certain High Mu 40-80kph" VALUE 0x80020613 CalPrmWslcBrk_SBYTE 0 Perc6 -128 127 SYMBOL_LINK "CalPrmWslcBrk01.TP_S8_FORCED_HLD_SLIP_CHMU_B80KPH_F" 0 /end CHARACTERISTIC
/begin CHARACTERISTIC TP_S8_F_WL_Fact_ASum1G_SlipPos "Cut slip compensation value for positive Front wheel slip, if Front arad sum > -1g" VALUE 0x800206B3 CalPrmWslcBrk_SBYTE 0 Perc6 -128 127 SYMBOL_LINK "CalPrmWslcBrk01.TP_S8_F_WL_Fact_ASum1G_SlipPos" 0 /end CHARACTERISTIC
/begin CHARACTERISTIC TP_S8_F_WL_Fact_ASum3G_SlipPos "Cut slip compensation value for positive Front wheel slip, if -1g > Front arad sum > -3g" VALUE 0x800206B4 CalPrmWslcBrk_SBYTE 0 Perc6 -128 127 SYMBOL_LINK "CalPrmWslcBrk01.TP_S8_F_WL_Fact_ASum3G_SlipPos" 0 /end CHARACTERISTIC
/begin CHARACTERISTIC TP_S8_F_WL_Fact_ASumAb3G_SlipPos "Cut slip compensation value for positive Front wheel slip, if Front arad sum < -3g" VALUE 0x800206B5 CalPrmWslcBrk_SBYTE 0 Perc6 -128 127 SYMBOL_LINK "CalPrmWslcBrk01.TP_S8_F_WL_Fact_ASumAb3G_SlipPos" 0 /end CHARACTERISTIC
/begin CHARACTERISTIC TP_S8_GMA_DCT_SLIP_DIFF_0_50_BABS "Ref. Slip difference of Front Wheels for GMA detection, Out ABS(Front high side), Below 50kph" VALUE 0x800205F2 CalPrmWslcBrk_SBYTE 0 Perc6 -128 127 SYMBOL_LINK "CalPrmWslcBrk01.TP_S8_GMA_DCT_SLIP_DIFF_0_50_BABS" 0 /end CHARACTERISTIC
/begin CHARACTERISTIC TP_S8_GMA_DCT_SLIP_DIFF_50_80_BABS "Ref. Slip difference of Front Wheels for GMA detection, Out ABS(Front high side), 50-80kph" VALUE 0x800205F3 CalPrmWslcBrk_SBYTE 0 Perc6 -128 127 SYMBOL_LINK "CalPrmWslcBrk01.TP_S8_GMA_DCT_SLIP_DIFF_50_80_BABS" 0 /end CHARACTERISTIC
/begin CHARACTERISTIC TP_S8_GMA_DCT_SLIP_DIFF_80_M_BABS "Ref. Slip difference of Front Wheels for GMA detection, Out ABS(Front high side), above 80kph" VALUE 0x800205F4 CalPrmWslcBrk_SBYTE 0 Perc6 -128 127 SYMBOL_LINK "CalPrmWslcBrk01.TP_S8_GMA_DCT_SLIP_DIFF_80_M_BABS" 0 /end CHARACTERISTIC
/begin CHARACTERISTIC TP_S8_LFC_Conven_Reapply_Time_F "NO Valve On Time for Each On/Off Reapply for Front" VALUE 0x800202AE CalPrmWslcBrk_SBYTE 0 Gain -128 127 SYMBOL_LINK "CalPrmWslcBrk01.TP_S8_LFC_Conven_Reapply_Time_F" 0 /end CHARACTERISTIC
/begin CHARACTERISTIC TP_S8_LFC_Conven_Reapply_Time_R "NO Valve On Time for Each On/Off Reapply for Rear" VALUE 0x800202AF CalPrmWslcBrk_SBYTE 0 Gain -128 127 SYMBOL_LINK "CalPrmWslcBrk01.TP_S8_LFC_Conven_Reapply_Time_R" 0 /end CHARACTERISTIC
/begin CHARACTERISTIC TP_S8_LFC_Conven_Reapply_Time_R_EBD "NO Valve On Time for Each On/Off Reapply for Rear EBD" VALUE 0x80020674 CalPrmWslcBrk_SBYTE 0 Gain -128 127 SYMBOL_LINK "CalPrmWslcBrk01.TP_S8_LFC_Conven_Reapply_Time_R_EBD" 0 /end CHARACTERISTIC
/begin CHARACTERISTIC TP_S8_Rough_Disab_Dump_BF_AFZOK_F "Ref. Dump counter, Inhibit duty compensation for Fast Rise Rate (Before AFZok, Front Wheels)" VALUE 0x8002057F CalPrmWslcBrk_SBYTE 0 Gain -128 127 SYMBOL_LINK "CalPrmWslcBrk01.TP_S8_Rough_Disab_Dump_BF_AFZOK_F" 0 /end CHARACTERISTIC
/begin CHARACTERISTIC TP_S8_Rough_Disab_Dump_BF_AFZOK_R "Ref. Dump counter, Inhibit duty compensation for Fast Rise Rate (Before AFZok, Rear Wheels)" VALUE 0x80020580 CalPrmWslcBrk_SBYTE 0 Gain -128 127 SYMBOL_LINK "CalPrmWslcBrk01.TP_S8_Rough_Disab_Dump_BF_AFZOK_R" 0 /end CHARACTERISTIC
/begin CHARACTERISTIC TP_S8_Rough_Disab_Dump_High_F "Ref. Dump counter, Inhibit duty compensation for Fast Rise Rate (High-mu, Front Wheels)" VALUE 0x80020581 CalPrmWslcBrk_SBYTE 0 Gain -128 127 SYMBOL_LINK "CalPrmWslcBrk01.TP_S8_Rough_Disab_Dump_High_F" 0 /end CHARACTERISTIC
/begin CHARACTERISTIC TP_S8_Rough_Disab_Dump_High_R "Ref. Dump counter, Inhibit duty compensation for Fast Rise Rate (High-mu, Rear Wheels)" VALUE 0x80020582 CalPrmWslcBrk_SBYTE 0 Gain -128 127 SYMBOL_LINK "CalPrmWslcBrk01.TP_S8_Rough_Disab_Dump_High_R" 0 /end CHARACTERISTIC
/begin CHARACTERISTIC TP_S8_Rough_Disab_Dump_Low_F "Ref. Dump counter, Inhibit duty compensation for Fast Rise Rate (Low-mu, Front Wheels)" VALUE 0x80020583 CalPrmWslcBrk_SBYTE 0 Gain -128 127 SYMBOL_LINK "CalPrmWslcBrk01.TP_S8_Rough_Disab_Dump_Low_F" 0 /end CHARACTERISTIC
/begin CHARACTERISTIC TP_S8_Rough_Disab_Dump_Low_R "Ref. Dump counter, Inhibit duty compensation for Fast Rise Rate (Low-mu, Rear Wheels)" VALUE 0x80020584 CalPrmWslcBrk_SBYTE 0 Gain -128 127 SYMBOL_LINK "CalPrmWslcBrk01.TP_S8_Rough_Disab_Dump_Low_R" 0 /end CHARACTERISTIC
/begin CHARACTERISTIC TP_S8_Rough_Disab_Dump_Med_F "Ref. Dump counter, Inhibit duty compensation for Fast Rise Rate (Medium-mu, Front Wheels)" VALUE 0x80020585 CalPrmWslcBrk_SBYTE 0 Gain -128 127 SYMBOL_LINK "CalPrmWslcBrk01.TP_S8_Rough_Disab_Dump_Med_F" 0 /end CHARACTERISTIC
/begin CHARACTERISTIC TP_S8_Rough_Disab_Dump_Med_R "Ref. Dump counter, Inhibit duty compensation for Fast Rise Rate (Medium-mu, Rear Wheels)" VALUE 0x80020586 CalPrmWslcBrk_SBYTE 0 Gain -128 127 SYMBOL_LINK "CalPrmWslcBrk01.TP_S8_Rough_Disab_Dump_Med_R" 0 /end CHARACTERISTIC
/begin CHARACTERISTIC TP_S8_Rough_Disab_Dump_Ref_F "Ref. Dump counter, Inhibit duty compensation for Fast Rise Rate (Rough road, Front Wheels)" VALUE 0x80020587 CalPrmWslcBrk_SBYTE 0 Gain -128 127 SYMBOL_LINK "CalPrmWslcBrk01.TP_S8_Rough_Disab_Dump_Ref_F" 0 /end CHARACTERISTIC
/begin CHARACTERISTIC TP_S8_Rough_Disab_Dump_Ref_R "Ref. Dump counter, Inhibit duty compensation for Fast Rise Rate (Rough road, Rear Wheels)" VALUE 0x80020588 CalPrmWslcBrk_SBYTE 0 Gain -128 127 SYMBOL_LINK "CalPrmWslcBrk01.TP_S8_Rough_Disab_Dump_Ref_R" 0 /end CHARACTERISTIC
/begin CHARACTERISTIC TP_S8_Slip_Gain_LMu_10_20k_F_HDC "Slip  Gain during HDC, Low Mu, 10-20kph, Front Wheels, Default Low Mu gain" VALUE 0x80020562 CalPrmWslcBrk_SBYTE 0 Gain -128 127 SYMBOL_LINK "CalPrmWslcBrk01.TP_S8_Slip_Gain_LMu_10_20k_F_HDC" 0 /end CHARACTERISTIC
/begin CHARACTERISTIC TP_S8_Slip_Gain_LMu_B_10k_F_HDC "Slip  Gain during HDC, Low Mu, Below 10kph, Front Wheels, Default Low Mu gain" VALUE 0x80020563 CalPrmWslcBrk_SBYTE 0 Gain -128 127 SYMBOL_LINK "CalPrmWslcBrk01.TP_S8_Slip_Gain_LMu_B_10k_F_HDC" 0 /end CHARACTERISTIC
/begin CHARACTERISTIC TP_S8_UNSTABLE_RISE_REF_ARAD_1st_F "Arad Ref. for starting Unstable Rise, Before AFZOK, Front Wheels" VALUE 0x80020418 CalPrmWslcBrk_SBYTE 0 A20 -32 31.75 SYMBOL_LINK "CalPrmWslcBrk01.TP_S8_UNSTABLE_RISE_REF_ARAD_1st_F" 0 /end CHARACTERISTIC
/begin CHARACTERISTIC TP_S8_UNSTABLE_RISE_REF_ARAD_1st_R "Arad Ref. for starting Unstable Rise, Before AFZOK, Rear Wheels" VALUE 0x80020419 CalPrmWslcBrk_SBYTE 0 A20 -32 31.75 SYMBOL_LINK "CalPrmWslcBrk01.TP_S8_UNSTABLE_RISE_REF_ARAD_1st_R" 0 /end CHARACTERISTIC
/begin CHARACTERISTIC TP_S8_dP_Arad_Ref_Ab_HMu_F "Arad Ref. for starting Unstable Rise, above High-mu, Front Wheels" VALUE 0x8002041C CalPrmWslcBrk_SBYTE 0 A20 -32 31.75 SYMBOL_LINK "CalPrmWslcBrk01.TP_S8_dP_Arad_Ref_Ab_HMu_F" 0 /end CHARACTERISTIC
/begin CHARACTERISTIC TP_S8_dP_Arad_Ref_Bw_LMu_F "Arad Ref. for starting Unstable Rise, Below Low mu, Front Wheels" VALUE 0x80020430 CalPrmWslcBrk_SBYTE 0 A20 -32 31.75 SYMBOL_LINK "CalPrmWslcBrk01.TP_S8_dP_Arad_Ref_Bw_LMu_F" 0 /end CHARACTERISTIC
/begin CHARACTERISTIC TP_S8_dP_Arad_Ref_LMMu_MMu_F "Arad Ref. for starting Unstable Rise, From Low-Medium to Medium mu, Front Wheels" VALUE 0x80020428 CalPrmWslcBrk_SBYTE 0 A20 -32 31.75 SYMBOL_LINK "CalPrmWslcBrk01.TP_S8_dP_Arad_Ref_LMMu_MMu_F" 0 /end CHARACTERISTIC
/begin CHARACTERISTIC TP_S8_dP_Arad_Ref_LMu_LMMu_F "Arad Ref. for starting Unstable Rise, From Low to Low-Medium mu, Front Wheels" VALUE 0x8002042C CalPrmWslcBrk_SBYTE 0 A20 -32 31.75 SYMBOL_LINK "CalPrmWslcBrk01.TP_S8_dP_Arad_Ref_LMu_LMMu_F" 0 /end CHARACTERISTIC
/begin CHARACTERISTIC TP_S8_dP_Arad_Ref_MHMu_HMu_F "Arad Ref. for starting Unstable Rise, From Med-High to High-mu, Front Wheels" VALUE 0x80020420 CalPrmWslcBrk_SBYTE 0 A20 -32 31.75 SYMBOL_LINK "CalPrmWslcBrk01.TP_S8_dP_Arad_Ref_MHMu_HMu_F" 0 /end CHARACTERISTIC
/begin CHARACTERISTIC TP_S8_dP_Arad_Ref_MMu_MHMu_F "Arad Ref. for starting Unstable Rise, From Medium to Med-High mu, Front Wheels" VALUE 0x80020424 CalPrmWslcBrk_SBYTE 0 A20 -32 31.75 SYMBOL_LINK "CalPrmWslcBrk01.TP_S8_dP_Arad_Ref_MMu_MHMu_F" 0 /end CHARACTERISTIC
/begin CHARACTERISTIC TP_S8_dP_Arad_Ref_SpHMu_F "Arad Ref. for starting Unstable Rise at Split mu, High-side Front Wheel" VALUE 0x80020434 CalPrmWslcBrk_SBYTE 0 A20 -32 31.75 SYMBOL_LINK "CalPrmWslcBrk01.TP_S8_dP_Arad_Ref_SpHMu_F" 0 /end CHARACTERISTIC
/begin CHARACTERISTIC TP_U8TCSCpAfterIIntActScan "" VALUE 0x8003A26B CalPrmWspcEng_UBYTE 0 Ti21 0 2.55 SYMBOL_LINK "CalPrmWspcEng01.TP_U8TCSCpAfterIIntActScan" 0 /end CHARACTERISTIC
/begin CHARACTERISTIC TP_U8TCSCpAsmdMuDiff4SplitMuDct "" VALUE 0x8003A26C CalPrmWspcEng_UBYTE 0 A42 0 2.55 SYMBOL_LINK "CalPrmWspcEng01.TP_U8TCSCpAsmdMuDiff4SplitMuDct" 0 /end CHARACTERISTIC
/begin CHARACTERISTIC TP_U8TCSCpAveWhlAcc_1 "" VALUE 0x8003A26E CalPrmWspcEng_UBYTE 0 A42 0 2.55 SYMBOL_LINK "CalPrmWspcEng01.TP_U8TCSCpAveWhlAcc_1" 0 /end CHARACTERISTIC
/begin CHARACTERISTIC TP_U8TCSCpAveWhlAcc_2 "" VALUE 0x8003A26F CalPrmWspcEng_UBYTE 0 A42 0 2.55 SYMBOL_LINK "CalPrmWspcEng01.TP_U8TCSCpAveWhlAcc_2" 0 /end CHARACTERISTIC
/begin CHARACTERISTIC TP_U8TCSCpBsAsmdMuDiffSt_F[0] "" VALUE 0x8003A289 CalPrmWspcEng_UBYTE 0 A42 0 2.55 SYMBOL_LINK "CalPrmWspcEng01.TP_U8TCSCpBsAsmdMuDiffSt_F[0]" 0 /end CHARACTERISTIC
/begin CHARACTERISTIC TP_U8TCSCpBsAsmdMuDiffSt_F[1] "" VALUE 0x8003A28A CalPrmWspcEng_UBYTE 0 A42 0 2.55 SYMBOL_LINK "CalPrmWspcEng01.TP_U8TCSCpBsAsmdMuDiffSt_F[1]" 0 /end CHARACTERISTIC
/begin CHARACTERISTIC TP_U8TCSCpBsAsmdMuDiffSt_F[2] "" VALUE 0x8003A28B CalPrmWspcEng_UBYTE 0 A42 0 2.55 SYMBOL_LINK "CalPrmWspcEng01.TP_U8TCSCpBsAsmdMuDiffSt_F[2]" 0 /end CHARACTERISTIC
/begin CHARACTERISTIC TP_U8TCSCpBsAsmdMuDiffSt_F[3] "" VALUE 0x8003A28C CalPrmWspcEng_UBYTE 0 A42 0 2.55 SYMBOL_LINK "CalPrmWspcEng01.TP_U8TCSCpBsAsmdMuDiffSt_F[3]" 0 /end CHARACTERISTIC
/begin CHARACTERISTIC TP_U8TCSCpBsAsmdMuDiffSt_F[4] "" VALUE 0x8003A28D CalPrmWspcEng_UBYTE 0 A42 0 2.55 SYMBOL_LINK "CalPrmWspcEng01.TP_U8TCSCpBsAsmdMuDiffSt_F[4]" 0 /end CHARACTERISTIC
/begin CHARACTERISTIC TP_U8TCSCpBsAsmdMuDiffSt_R[0] "" VALUE 0x8003A28E CalPrmWspcEng_UBYTE 0 A42 0 2.55 SYMBOL_LINK "CalPrmWspcEng01.TP_U8TCSCpBsAsmdMuDiffSt_R[0]" 0 /end CHARACTERISTIC
/begin CHARACTERISTIC TP_U8TCSCpBsAsmdMuDiffSt_R[1] "" VALUE 0x8003A28F CalPrmWspcEng_UBYTE 0 A42 0 2.55 SYMBOL_LINK "CalPrmWspcEng01.TP_U8TCSCpBsAsmdMuDiffSt_R[1]" 0 /end CHARACTERISTIC
/begin CHARACTERISTIC TP_U8TCSCpBsAsmdMuDiffSt_R[2] "" VALUE 0x8003A290 CalPrmWspcEng_UBYTE 0 A42 0 2.55 SYMBOL_LINK "CalPrmWspcEng01.TP_U8TCSCpBsAsmdMuDiffSt_R[2]" 0 /end CHARACTERISTIC
/begin CHARACTERISTIC TP_U8TCSCpBsAsmdMuDiffSt_R[3] "" VALUE 0x8003A291 CalPrmWspcEng_UBYTE 0 A42 0 2.55 SYMBOL_LINK "CalPrmWspcEng01.TP_U8TCSCpBsAsmdMuDiffSt_R[3]" 0 /end CHARACTERISTIC
/begin CHARACTERISTIC TP_U8TCSCpBsAsmdMuDiffSt_R[4] "" VALUE 0x8003A292 CalPrmWspcEng_UBYTE 0 A42 0 2.55 SYMBOL_LINK "CalPrmWspcEng01.TP_U8TCSCpBsAsmdMuDiffSt_R[4]" 0 /end CHARACTERISTIC
/begin CHARACTERISTIC TP_U8TCSCpChngRateWhlSpin_1 "" VALUE 0x8003A2F8 CalPrmWspcEng_UBYTE 0 A42 0 2.55 SYMBOL_LINK "CalPrmWspcEng01.TP_U8TCSCpChngRateWhlSpin_1" 0 /end CHARACTERISTIC
/begin CHARACTERISTIC TP_U8TCSCpChngRateWhlSpin_2 "" VALUE 0x8003A2F9 CalPrmWspcEng_UBYTE 0 A42 0 2.55 SYMBOL_LINK "CalPrmWspcEng01.TP_U8TCSCpChngRateWhlSpin_2" 0 /end CHARACTERISTIC
/begin CHARACTERISTIC TP_U8TCSCpCurntFiltGain "" VALUE 0x8003A2FA CalPrmWspcEng_UBYTE 0 Gain 0 255 SYMBOL_LINK "CalPrmWspcEng01.TP_U8TCSCpCurntFiltGain" 0 /end CHARACTERISTIC
/begin CHARACTERISTIC TP_U8TCSCpFltGain4GearShiftSt "" VALUE 0x8003A300 CalPrmWspcEng_UBYTE 0 Gain 0 255 SYMBOL_LINK "CalPrmWspcEng01.TP_U8TCSCpFltGain4GearShiftSt" 0 /end CHARACTERISTIC
/begin CHARACTERISTIC TP_U8TCSCpFltGain4GearShiftTurn "" VALUE 0x8003A301 CalPrmWspcEng_UBYTE 0 Gain 0 255 SYMBOL_LINK "CalPrmWspcEng01.TP_U8TCSCpFltGain4GearShiftTurn" 0 /end CHARACTERISTIC
/begin CHARACTERISTIC TP_U8TCSCpLowPresTh4IniTCVCtl "" VALUE 0x8003A31B CalPrmWspcEng_UBYTE 0 Gain 0 255 SYMBOL_LINK "CalPrmWspcEng01.TP_U8TCSCpLowPresTh4IniTCVCtl" 0 /end CHARACTERISTIC
/begin CHARACTERISTIC TP_U8TCSCpMonTime4AsymSpnCtlS_1 "" VALUE 0x8003A31C CalPrmWspcEng_UBYTE 0 Ti21 0 2.55 SYMBOL_LINK "CalPrmWspcEng01.TP_U8TCSCpMonTime4AsymSpnCtlS_1" 0 /end CHARACTERISTIC
/begin CHARACTERISTIC TP_U8TCSCpMonTime4AsymSpnCtlS_2 "" VALUE 0x8003A31D CalPrmWspcEng_UBYTE 0 Ti21 0 2.55 SYMBOL_LINK "CalPrmWspcEng01.TP_U8TCSCpMonTime4AsymSpnCtlS_2" 0 /end CHARACTERISTIC
/begin CHARACTERISTIC TP_U8TCSCpMonTime4SymSpnCtlS_1 "" VALUE 0x8003A31E CalPrmWspcEng_UBYTE 0 Ti21 0 2.55 SYMBOL_LINK "CalPrmWspcEng01.TP_U8TCSCpMonTime4SymSpnCtlS_1" 0 /end CHARACTERISTIC
/begin CHARACTERISTIC TP_U8TCSCpMonTime4SymSpnCtlS_2 "" VALUE 0x8003A31F CalPrmWspcEng_UBYTE 0 Ti21 0 2.55 SYMBOL_LINK "CalPrmWspcEng01.TP_U8TCSCpMonTime4SymSpnCtlS_2" 0 /end CHARACTERISTIC
/begin CHARACTERISTIC TP_U8TCSCpSplitHilDctAccTh "" VALUE 0x8003A33A CalPrmWspcEng_UBYTE 0 A47 0 1.275 SYMBOL_LINK "CalPrmWspcEng01.TP_U8TCSCpSplitHilDctAccTh" 0 /end CHARACTERISTIC
/begin CHARACTERISTIC TP_U8TCSCpSplitHilDctEnterCnt "" VALUE 0x8003A33B CalPrmWspcEng_UBYTE 0 Ti21 0 2.55 SYMBOL_LINK "CalPrmWspcEng01.TP_U8TCSCpSplitHilDctEnterCnt" 0 /end CHARACTERISTIC
/begin CHARACTERISTIC TP_U8TCSCpSplitHilDctExitCnt "" VALUE 0x8003A33C CalPrmWspcEng_UBYTE 0 Ti21 0 2.55 SYMBOL_LINK "CalPrmWspcEng01.TP_U8TCSCpSplitHilDctExitCnt" 0 /end CHARACTERISTIC
/begin CHARACTERISTIC TP_U8TCSCpSplitHilDctSpdTh "" VALUE 0x8003A33D CalPrmWspcEng_UBYTE 0 Spd12 0 31.875 SYMBOL_LINK "CalPrmWspcEng01.TP_U8TCSCpSplitHilDctSpdTh" 0 /end CHARACTERISTIC
/begin CHARACTERISTIC TP_U8TCSCpSplitMuDctEnterCnt "" VALUE 0x8003A33E CalPrmWspcEng_UBYTE 0 Gain 0 255 SYMBOL_LINK "CalPrmWspcEng01.TP_U8TCSCpSplitMuDctEnterCnt" 0 /end CHARACTERISTIC
/begin CHARACTERISTIC TP_U8TCSCpSplitMuDctExitCnt "" VALUE 0x8003A33F CalPrmWspcEng_UBYTE 0 Gain 0 255 SYMBOL_LINK "CalPrmWspcEng01.TP_U8TCSCpSplitMuDctExitCnt" 0 /end CHARACTERISTIC
/begin CHARACTERISTIC TP_U8TCSCpSplitMuDiffExitHyst "" VALUE 0x8003A340 CalPrmWspcEng_UBYTE 0 A42 0 2.55 SYMBOL_LINK "CalPrmWspcEng01.TP_U8TCSCpSplitMuDiffExitHyst" 0 /end CHARACTERISTIC
/begin CHARACTERISTIC TP_U8TCSCpSymDctScanTime "" VALUE 0x8003A344 CalPrmWspcEng_UBYTE 0 Ti21 0 2.55 SYMBOL_LINK "CalPrmWspcEng01.TP_U8TCSCpSymDctScanTime" 0 /end CHARACTERISTIC
/begin CHARACTERISTIC TP_U8TCSCpThOfCnt4SpnDiffSlopeDct "" VALUE 0x8003A35A CalPrmWspcEng_UBYTE 0 Gain 0 255 SYMBOL_LINK "CalPrmWspcEng01.TP_U8TCSCpThOfCnt4SpnDiffSlopeDct" 0 /end CHARACTERISTIC
/begin CHARACTERISTIC TP_U8TCSHillDctAlongTh "" VALUE 0x8003A35F CalPrmWspcEng_UBYTE 0 Gain 0 255 SYMBOL_LINK "CalPrmWspcEng01.TP_U8TCSHillDctAlongTh" 0 /end CHARACTERISTIC
/begin CHARACTERISTIC TP_U8_1ST_CYCLE_UR_RISE_SCAN_MAX "Max. Unstable Rise time, 1st cycle, Default 6, Min 2, Max 10" VALUE 0x800205D5 CalPrmWslcBrk_UBYTE 0 Gain 0 255 SYMBOL_LINK "CalPrmWslcBrk01.TP_U8_1ST_CYCLE_UR_RISE_SCAN_MAX" 0 /end CHARACTERISTIC
/begin CHARACTERISTIC TP_U8_1ST_CYCLE_UR_RISE_SCAN_MIN "Min. Unstable Rise time, 1st cycle, Default 2, Min 2, Max 6" VALUE 0x800205D6 CalPrmWslcBrk_UBYTE 0 Gain 0 255 SYMBOL_LINK "CalPrmWslcBrk01.TP_U8_1ST_CYCLE_UR_RISE_SCAN_MIN" 0 /end CHARACTERISTIC
/begin CHARACTERISTIC TP_U8_ABS_ENTRANCE_LIMIT_BY_SLIP "Enable slip limitation when deciding ABS entrance (1: -b+dV+slip limit, 0 : -b+dV)" VALUE 0x8002057E CalPrmWslcBrk_UBYTE 0 Perc6 0 255 SYMBOL_LINK "CalPrmWslcBrk01.TP_U8_ABS_ENTRANCE_LIMIT_BY_SLIP" 0 /end CHARACTERISTIC
/begin CHARACTERISTIC TP_U8_BUMP_MAX_DUMP_SCANS "Max dump scans for ABS due to bump, default 14, min 10, max 30" VALUE 0x80020624 CalPrmWslcBrk_UBYTE 0 Gain 0 255 SYMBOL_LINK "CalPrmWslcBrk01.TP_U8_BUMP_MAX_DUMP_SCANS" 0 /end CHARACTERISTIC
/begin CHARACTERISTIC TP_U8_DPDutyCompRef_HighMuSkid "High-mu skid pressure: reference for duty compensation, default 80bar" VALUE 0x80020556 CalPrmWslcBrk_UBYTE 0 Gain 0 255 SYMBOL_LINK "CalPrmWslcBrk01.TP_U8_DPDutyCompRef_HighMuSkid" 0 /end CHARACTERISTIC
/begin CHARACTERISTIC TP_U8_DPDutyCompRef_HighMuSkidR "High-mu skid pressure for rear wheels: reference for duty compensation, default 80bar" VALUE 0x80020557 CalPrmWslcBrk_UBYTE 0 Gain 0 255 SYMBOL_LINK "CalPrmWslcBrk01.TP_U8_DPDutyCompRef_HighMuSkidR" 0 /end CHARACTERISTIC
/begin CHARACTERISTIC TP_U8_DPDutyCompRef_MPVariation "Minimum MP variation for 1 duty, default 7bar, min 5, max 10" VALUE 0x80020558 CalPrmWslcBrk_UBYTE 0 P34 0 25.5 SYMBOL_LINK "CalPrmWslcBrk01.TP_U8_DPDutyCompRef_MPVariation" 0 /end CHARACTERISTIC
/begin CHARACTERISTIC TP_U8_DPDutyCompRef_MPVariationR "Minimum MP variation for 1 duty, rear wheels, default 7bar, min 5, max 10" VALUE 0x80020559 CalPrmWslcBrk_UBYTE 0 P34 0 25.5 SYMBOL_LINK "CalPrmWslcBrk01.TP_U8_DPDutyCompRef_MPVariationR" 0 /end CHARACTERISTIC
/begin CHARACTERISTIC TP_U8_DPDutyCompRef_PDiffFromSkid "Minimum ΔP for 1 duty, default 7bar, min 5, max 10" VALUE 0x8002055A CalPrmWslcBrk_UBYTE 0 P34 0 25.5 SYMBOL_LINK "CalPrmWslcBrk01.TP_U8_DPDutyCompRef_PDiffFromSkid" 0 /end CHARACTERISTIC
/begin CHARACTERISTIC TP_U8_DPDutyCompRef_PDiffFromSkidR "Minimum ΔP for 1 duty, rear wheels, default 7bar, min 5, max 10" VALUE 0x8002055B CalPrmWslcBrk_UBYTE 0 P34 0 25.5 SYMBOL_LINK "CalPrmWslcBrk01.TP_U8_DPDutyCompRef_PDiffFromSkidR" 0 /end CHARACTERISTIC
/begin CHARACTERISTIC TP_U8_EBD_Cut_Slip_100_150kph "EBD Cut-in slip, 20-40kph, tuning range (Min:3%) ~(Max:20%)" VALUE 0x80020683 CalPrmWslcBrk_UBYTE 0 Gain 0 255 SYMBOL_LINK "CalPrmWslcBrk01.TP_U8_EBD_Cut_Slip_100_150kph" 0 /end CHARACTERISTIC
/begin CHARACTERISTIC TP_U8_EBD_Cut_Slip_20_40kph "EBD Cut-in slip, 20-40kph, tuning range (Min:3%) ~(Max:20%)" VALUE 0x80020684 CalPrmWslcBrk_UBYTE 0 Gain 0 255 SYMBOL_LINK "CalPrmWslcBrk01.TP_U8_EBD_Cut_Slip_20_40kph" 0 /end CHARACTERISTIC
/begin CHARACTERISTIC TP_U8_EBD_Cut_Slip_40_60kph "EBD Cut-in slip, 40-60kph, tunng range (Min:3%) ~(Max:20%)" VALUE 0x80020685 CalPrmWslcBrk_UBYTE 0 Gain 0 255 SYMBOL_LINK "CalPrmWslcBrk01.TP_U8_EBD_Cut_Slip_40_60kph" 0 /end CHARACTERISTIC
/begin CHARACTERISTIC TP_U8_EBD_Cut_Slip_60_100kph "EBD Cut-in slip, 60-100kph, tuning range (Min:3%) ~(Max:20%)" VALUE 0x80020686 CalPrmWslcBrk_UBYTE 0 Gain 0 255 SYMBOL_LINK "CalPrmWslcBrk01.TP_U8_EBD_Cut_Slip_60_100kph" 0 /end CHARACTERISTIC
/begin CHARACTERISTIC TP_U8_EBD_Cut_Slip_Ab_150kph "EBD Cut-in slip, Above 150kph, tuning range (Min:3%) ~(Max:20%)" VALUE 0x80020687 CalPrmWslcBrk_UBYTE 0 Gain 0 255 SYMBOL_LINK "CalPrmWslcBrk01.TP_U8_EBD_Cut_Slip_Ab_150kph" 0 /end CHARACTERISTIC
/begin CHARACTERISTIC TP_U8_EBD_Cut_Slip_B_20kph "EBD Cut-in slip, Below 20kph, tuning range (Min:3%) ~(Max:20%)" VALUE 0x80020688 CalPrmWslcBrk_UBYTE 0 Gain 0 255 SYMBOL_LINK "CalPrmWslcBrk01.TP_U8_EBD_Cut_Slip_B_20kph" 0 /end CHARACTERISTIC
/begin CHARACTERISTIC TP_U8_EDC_SYS_ENABLE "" VALUE 0x8003A080 CalPrmWslcEng_UBYTE 0 Gain 0 255 SYMBOL_LINK "CalPrmWslcEng01.TP_U8_EDC_SYS_ENABLE" 0 /end CHARACTERISTIC
/begin CHARACTERISTIC TP_U8_High_Vel_dV_Pro_BF_AFZOK_F "dV ratio of 160kph or above, before AFZ_OK, Front Wheels(min limit: TP_U8_dV_BF_AFZOK_160kph_F)" VALUE 0x80020228 CalPrmWslcBrk_UBYTE 0 Perc10 0 99.603 SYMBOL_LINK "CalPrmWslcBrk01.TP_U8_High_Vel_dV_Pro_BF_AFZOK_F" 0 /end CHARACTERISTIC
/begin CHARACTERISTIC TP_U8_LIMIT_CNT_FOR_BMP_DCT "Num of unstable state scans to inhibit bump detection on Homo mu, default 14" VALUE 0x80020625 CalPrmWslcBrk_UBYTE 0 Gain 0 255 SYMBOL_LINK "CalPrmWslcBrk01.TP_U8_LIMIT_CNT_FOR_BMP_DCT" 0 /end CHARACTERISTIC
/begin CHARACTERISTIC TP_U8_LIMIT_CNT_SPLT_FOR_BMP_DCT "Num of unstable state scans to inhibit bump detection on Split mu, default 11" VALUE 0x80020626 CalPrmWslcBrk_UBYTE 0 Gain 0 255 SYMBOL_LINK "CalPrmWslcBrk01.TP_U8_LIMIT_CNT_SPLT_FOR_BMP_DCT" 0 /end CHARACTERISTIC
/begin CHARACTERISTIC TP_U8_LIMIT_DMP_CNT_FOR_BMP_DCT "Num of dump scans to inhibit bump detection, default 4" VALUE 0x80020627 CalPrmWslcBrk_UBYTE 0 Gain 0 255 SYMBOL_LINK "CalPrmWslcBrk01.TP_U8_LIMIT_DMP_CNT_FOR_BMP_DCT" 0 /end CHARACTERISTIC
/begin CHARACTERISTIC TP_U8_STB_DMP_MAX_HIGH_BothOverInF "Stable Dump limitation level for Front Wheel if Both Front and Rear Wheels are in Over Ctrl, high-mu (default : 2)" VALUE 0x80020526 CalPrmWslcBrk_UBYTE 0 Gain 0 255 SYMBOL_LINK "CalPrmWslcBrk01.TP_U8_STB_DMP_MAX_HIGH_BothOverInF" 0 /end CHARACTERISTIC
/begin CHARACTERISTIC TP_U8_STB_DMP_MAX_LOW_BothOverInF "Stable Dump limitation level for Front Wheel if Both Front and Rear Wheels are in Over Ctrl, low-mu (default : 4)" VALUE 0x80020527 CalPrmWslcBrk_UBYTE 0 Gain 0 255 SYMBOL_LINK "CalPrmWslcBrk01.TP_U8_STB_DMP_MAX_LOW_BothOverInF" 0 /end CHARACTERISTIC
/begin CHARACTERISTIC TP_U8_STB_DMP_MAX_MED_BothOverInF "Stable Dump limitation level for Front Wheel if Both Front and Rear Wheels are in Over Ctrl, med-mu (default : 2)" VALUE 0x80020528 CalPrmWslcBrk_UBYTE 0 Gain 0 255 SYMBOL_LINK "CalPrmWslcBrk01.TP_U8_STB_DMP_MAX_MED_BothOverInF" 0 /end CHARACTERISTIC
/begin CHARACTERISTIC TP_U8_STB_DMP_MAX_SP_BothOverInF "Stable Dump limitation level for Front Wheel if Both Front and Rear Wheels are in Over Ctrl, split-mu (default : 2)" VALUE 0x80020529 CalPrmWslcBrk_UBYTE 0 Gain 0 255 SYMBOL_LINK "CalPrmWslcBrk01.TP_U8_STB_DMP_MAX_SP_BothOverInF" 0 /end CHARACTERISTIC
/begin CHARACTERISTIC TP_U8_UNSTABLE_RISE_REF_DUMP_1st_F "Number of Dump scans Ref. for starting Unstable Rise, Before AFZOK, Front Wheels" VALUE 0x8002041A CalPrmWslcBrk_UBYTE 0 Gain 0 255 SYMBOL_LINK "CalPrmWslcBrk01.TP_U8_UNSTABLE_RISE_REF_DUMP_1st_F" 0 /end CHARACTERISTIC
/begin CHARACTERISTIC TP_U8_UNSTABLE_RISE_REF_DUMP_1st_R "Number of Dump scans Ref. for starting Unstable Rise, Before AFZOK, Rear Wheels" VALUE 0x8002041B CalPrmWslcBrk_UBYTE 0 Gain 0 255 SYMBOL_LINK "CalPrmWslcBrk01.TP_U8_UNSTABLE_RISE_REF_DUMP_1st_R" 0 /end CHARACTERISTIC
/begin CHARACTERISTIC TP_U8_Usage_Level_of_ESC_Sen "Use ESC sensor in GMA Hold Compensation for (3: All / 2: Rear / 1: Front / 0: after GMA)" VALUE 0x800204D2 CalPrmWslcBrk_UBYTE 0 Gain 0 255 SYMBOL_LINK "CalPrmWslcBrk01.TP_U8_Usage_Level_of_ESC_Sen" 0 /end CHARACTERISTIC
/begin CHARACTERISTIC TP_U8_dPTim_Dump_Ref_Ab_HMu_1_F "1st reference point to set the dP rise time depending on the number of dump scans, above High-mu, Front Wheels" VALUE 0x8002043A CalPrmWslcBrk_UBYTE 0 Gain 0 255 SYMBOL_LINK "CalPrmWslcBrk01.TP_U8_dPTim_Dump_Ref_Ab_HMu_1_F" 0 /end CHARACTERISTIC
/begin CHARACTERISTIC TP_U8_dPTim_Dump_Ref_Ab_HMu_2_F "2nd reference point to set the dP rise time depending on the number of dump scans, above High-mu, Front Wheels" VALUE 0x8002043B CalPrmWslcBrk_UBYTE 0 Gain 0 255 SYMBOL_LINK "CalPrmWslcBrk01.TP_U8_dPTim_Dump_Ref_Ab_HMu_2_F" 0 /end CHARACTERISTIC
/begin CHARACTERISTIC TP_U8_dPTim_Dump_Ref_Ab_HMu_3_F "3rd reference point to set the dP rise time depending on the number of dump scans, above High-mu, Front Wheels" VALUE 0x8002043C CalPrmWslcBrk_UBYTE 0 Gain 0 255 SYMBOL_LINK "CalPrmWslcBrk01.TP_U8_dPTim_Dump_Ref_Ab_HMu_3_F" 0 /end CHARACTERISTIC
/begin CHARACTERISTIC TP_U8_dPTim_Dump_Ref_Bw_LMu_1_F "1st reference point to set the dP rise time depending on the number of dump scans, Below Low mu, Front Wheels" VALUE 0x80020480 CalPrmWslcBrk_UBYTE 0 Gain 0 255 SYMBOL_LINK "CalPrmWslcBrk01.TP_U8_dPTim_Dump_Ref_Bw_LMu_1_F" 0 /end CHARACTERISTIC
/begin CHARACTERISTIC TP_U8_dPTim_Dump_Ref_Bw_LMu_2_F "2nd reference point to set the dP rise time depending on the number of dump scans, Below Low mu, Front Wheels" VALUE 0x80020481 CalPrmWslcBrk_UBYTE 0 Gain 0 255 SYMBOL_LINK "CalPrmWslcBrk01.TP_U8_dPTim_Dump_Ref_Bw_LMu_2_F" 0 /end CHARACTERISTIC
/begin CHARACTERISTIC TP_U8_dPTim_Dump_Ref_Bw_LMu_3_F "3rd reference point to set the dP rise time depending on the number of dump scans, Below Low mu, Front Wheels" VALUE 0x80020482 CalPrmWslcBrk_UBYTE 0 Gain 0 255 SYMBOL_LINK "CalPrmWslcBrk01.TP_U8_dPTim_Dump_Ref_Bw_LMu_3_F" 0 /end CHARACTERISTIC
/begin CHARACTERISTIC TP_U8_dPTim_Dump_Ref_LMMu_MMu_1_F "1st reference point to set the dP rise time depending on the number of dump scans, Low-Med to Medium mu, Front Wheels" VALUE 0x80020464 CalPrmWslcBrk_UBYTE 0 Gain 0 255 SYMBOL_LINK "CalPrmWslcBrk01.TP_U8_dPTim_Dump_Ref_LMMu_MMu_1_F" 0 /end CHARACTERISTIC
/begin CHARACTERISTIC TP_U8_dPTim_Dump_Ref_LMMu_MMu_2_F "2nd reference point to set the dP rise time depending on the number of dump scans, Low-Med to Medium mu, Front Wheels" VALUE 0x80020465 CalPrmWslcBrk_UBYTE 0 Gain 0 255 SYMBOL_LINK "CalPrmWslcBrk01.TP_U8_dPTim_Dump_Ref_LMMu_MMu_2_F" 0 /end CHARACTERISTIC
/begin CHARACTERISTIC TP_U8_dPTim_Dump_Ref_LMMu_MMu_3_F "3rd reference point to set the dP rise time depending on the number of dump scans, Low-Med to Medium mu, Front Wheels" VALUE 0x80020466 CalPrmWslcBrk_UBYTE 0 Gain 0 255 SYMBOL_LINK "CalPrmWslcBrk01.TP_U8_dPTim_Dump_Ref_LMMu_MMu_3_F" 0 /end CHARACTERISTIC
/begin CHARACTERISTIC TP_U8_dPTim_Dump_Ref_LMu_LMMu_1_F "1st reference point to set the dP rise time depending on the number of dump scans, Low to Low-Med mu, Front Wheels" VALUE 0x80020472 CalPrmWslcBrk_UBYTE 0 Gain 0 255 SYMBOL_LINK "CalPrmWslcBrk01.TP_U8_dPTim_Dump_Ref_LMu_LMMu_1_F" 0 /end CHARACTERISTIC
/begin CHARACTERISTIC TP_U8_dPTim_Dump_Ref_LMu_LMMu_2_F "2nd reference point to set the dP rise time depending on the number of dump scans, Low to Low-Med mu, Front Wheels" VALUE 0x80020473 CalPrmWslcBrk_UBYTE 0 Gain 0 255 SYMBOL_LINK "CalPrmWslcBrk01.TP_U8_dPTim_Dump_Ref_LMu_LMMu_2_F" 0 /end CHARACTERISTIC
/begin CHARACTERISTIC TP_U8_dPTim_Dump_Ref_LMu_LMMu_3_F "3rd reference point to set the dP rise time depending on the number of dump scans, Low to Low-Med mu, Front Wheels" VALUE 0x80020474 CalPrmWslcBrk_UBYTE 0 Gain 0 255 SYMBOL_LINK "CalPrmWslcBrk01.TP_U8_dPTim_Dump_Ref_LMu_LMMu_3_F" 0 /end CHARACTERISTIC
/begin CHARACTERISTIC TP_U8_dPTim_Dump_Ref_MHMu_HMu_1_F "1st reference point to set the dP rise time depending on the number of dump scans, Med-High to High mu, Front Wheels" VALUE 0x80020448 CalPrmWslcBrk_UBYTE 0 Gain 0 255 SYMBOL_LINK "CalPrmWslcBrk01.TP_U8_dPTim_Dump_Ref_MHMu_HMu_1_F" 0 /end CHARACTERISTIC
/begin CHARACTERISTIC TP_U8_dPTim_Dump_Ref_MHMu_HMu_2_F "2nd reference point to set the dP rise time depending on the number of dump scans, Med-High to High mu, Front Wheels" VALUE 0x80020449 CalPrmWslcBrk_UBYTE 0 Gain 0 255 SYMBOL_LINK "CalPrmWslcBrk01.TP_U8_dPTim_Dump_Ref_MHMu_HMu_2_F" 0 /end CHARACTERISTIC
/begin CHARACTERISTIC TP_U8_dPTim_Dump_Ref_MHMu_HMu_3_F "3rd reference point to set the dP rise time depending on the number of dump scans, Med-High to High mu, Front Wheels" VALUE 0x8002044A CalPrmWslcBrk_UBYTE 0 Gain 0 255 SYMBOL_LINK "CalPrmWslcBrk01.TP_U8_dPTim_Dump_Ref_MHMu_HMu_3_F" 0 /end CHARACTERISTIC
/begin CHARACTERISTIC TP_U8_dPTim_Dump_Ref_MMu_MHMu_1_F "1st reference point to set the dP rise time depending on the number of dump scans, Medium to Med-High mu, Front Wheels" VALUE 0x80020456 CalPrmWslcBrk_UBYTE 0 Gain 0 255 SYMBOL_LINK "CalPrmWslcBrk01.TP_U8_dPTim_Dump_Ref_MMu_MHMu_1_F" 0 /end CHARACTERISTIC
/begin CHARACTERISTIC TP_U8_dPTim_Dump_Ref_MMu_MHMu_2_F "2nd reference point to set the dP rise time depending on the number of dump scans, Medium to Med-High mu, Front Wheels" VALUE 0x80020457 CalPrmWslcBrk_UBYTE 0 Gain 0 255 SYMBOL_LINK "CalPrmWslcBrk01.TP_U8_dPTim_Dump_Ref_MMu_MHMu_2_F" 0 /end CHARACTERISTIC
/begin CHARACTERISTIC TP_U8_dPTim_Dump_Ref_MMu_MHMu_3_F "3rd reference point to set the dP rise time depending on the number of dump scans, Medium to Med-High mu, Front Wheels" VALUE 0x80020458 CalPrmWslcBrk_UBYTE 0 Gain 0 255 SYMBOL_LINK "CalPrmWslcBrk01.TP_U8_dPTim_Dump_Ref_MMu_MHMu_3_F" 0 /end CHARACTERISTIC
/begin CHARACTERISTIC TP_U8_dPTim_Dump_Ref_SPHMu_1_F "1st reference point to set the dP rise time depending on the number of dump scans, Split mu, High-side Front Wheels" VALUE 0x8002048E CalPrmWslcBrk_UBYTE 0 Gain 0 255 SYMBOL_LINK "CalPrmWslcBrk01.TP_U8_dPTim_Dump_Ref_SPHMu_1_F" 0 /end CHARACTERISTIC
/begin CHARACTERISTIC TP_U8_dPTim_Dump_Ref_SPHMu_2_F "2nd reference point to set the dP rise time depending on the number of dump scans, Split mu, High-side Front Wheels" VALUE 0x8002048F CalPrmWslcBrk_UBYTE 0 Gain 0 255 SYMBOL_LINK "CalPrmWslcBrk01.TP_U8_dPTim_Dump_Ref_SPHMu_2_F" 0 /end CHARACTERISTIC
/begin CHARACTERISTIC TP_U8_dPTim_Dump_Ref_SPHMu_3_F "3rd reference point to set the dP rise time depending on the number of dump scans, Split mu, High-side Front Wheels" VALUE 0x80020490 CalPrmWslcBrk_UBYTE 0 Gain 0 255 SYMBOL_LINK "CalPrmWslcBrk01.TP_U8_dPTim_Dump_Ref_SPHMu_3_F" 0 /end CHARACTERISTIC
/begin CHARACTERISTIC TP_U8_dPTim_by_Dump_Ab_HMu_1_F "dP rise time if num. of dump scans is smaller than 1st reference point, above High-mu, Front Wheels" VALUE 0x80020436 CalPrmWslcBrk_UBYTE 0 Gain 0 255 SYMBOL_LINK "CalPrmWslcBrk01.TP_U8_dPTim_by_Dump_Ab_HMu_1_F" 0 /end CHARACTERISTIC
/begin CHARACTERISTIC TP_U8_dPTim_by_Dump_Ab_HMu_2_F "dP rise time if num. of dump scans is between 1st and 2nd reference point, above High-mu, Front Wheels" VALUE 0x80020437 CalPrmWslcBrk_UBYTE 0 Gain 0 255 SYMBOL_LINK "CalPrmWslcBrk01.TP_U8_dPTim_by_Dump_Ab_HMu_2_F" 0 /end CHARACTERISTIC
/begin CHARACTERISTIC TP_U8_dPTim_by_Dump_Ab_HMu_3_F "dP rise time if num. of dump scans is between 2nd and 3rd reference point, above High-mu, Front Wheels" VALUE 0x80020438 CalPrmWslcBrk_UBYTE 0 Gain 0 255 SYMBOL_LINK "CalPrmWslcBrk01.TP_U8_dPTim_by_Dump_Ab_HMu_3_F" 0 /end CHARACTERISTIC
/begin CHARACTERISTIC TP_U8_dPTim_by_Dump_Ab_HMu_Max_F "dP rise time if num. of dump scans is larger than 3rd reference point, above High-mu, Front Wheels" VALUE 0x80020439 CalPrmWslcBrk_UBYTE 0 Gain 0 255 SYMBOL_LINK "CalPrmWslcBrk01.TP_U8_dPTim_by_Dump_Ab_HMu_Max_F" 0 /end CHARACTERISTIC
/begin CHARACTERISTIC TP_U8_dPTim_by_Dump_Bw_LMu_1_F "dP rise time if num. of dump scans is smaller than 1st reference point, Below Low mu, Front Wheels" VALUE 0x8002047C CalPrmWslcBrk_UBYTE 0 Gain 0 255 SYMBOL_LINK "CalPrmWslcBrk01.TP_U8_dPTim_by_Dump_Bw_LMu_1_F" 0 /end CHARACTERISTIC
/begin CHARACTERISTIC TP_U8_dPTim_by_Dump_Bw_LMu_2_F "dP rise time if num. of dump scans is between 1st and 2nd reference point, Below Low mu, Front Wheels" VALUE 0x8002047D CalPrmWslcBrk_UBYTE 0 Gain 0 255 SYMBOL_LINK "CalPrmWslcBrk01.TP_U8_dPTim_by_Dump_Bw_LMu_2_F" 0 /end CHARACTERISTIC
/begin CHARACTERISTIC TP_U8_dPTim_by_Dump_Bw_LMu_3_F "dP rise time if num. of dump scans is between 2nd and 3rd reference point, Below Low mu, Front Wheels" VALUE 0x8002047E CalPrmWslcBrk_UBYTE 0 Gain 0 255 SYMBOL_LINK "CalPrmWslcBrk01.TP_U8_dPTim_by_Dump_Bw_LMu_3_F" 0 /end CHARACTERISTIC
/begin CHARACTERISTIC TP_U8_dPTim_by_Dump_Bw_LMu_Max_F "dP rise time if num. of dump scans is larger than 3rd reference point, Below Low mu, Front Wheels" VALUE 0x8002047F CalPrmWslcBrk_UBYTE 0 Gain 0 255 SYMBOL_LINK "CalPrmWslcBrk01.TP_U8_dPTim_by_Dump_Bw_LMu_Max_F" 0 /end CHARACTERISTIC
/begin CHARACTERISTIC TP_U8_dPTim_by_Dump_LMMu_MMu_1_F "dP rise time if num. of dump scans is smaller than 1st reference point, Low-Med to Medium mu, Front Wheels" VALUE 0x80020460 CalPrmWslcBrk_UBYTE 0 Gain 0 255 SYMBOL_LINK "CalPrmWslcBrk01.TP_U8_dPTim_by_Dump_LMMu_MMu_1_F" 0 /end CHARACTERISTIC
/begin CHARACTERISTIC TP_U8_dPTim_by_Dump_LMMu_MMu_2_F "dP rise time if num. of dump scans is between 1st and 2nd reference point, Low-Med to Medium mu, Front Wheels" VALUE 0x80020461 CalPrmWslcBrk_UBYTE 0 Gain 0 255 SYMBOL_LINK "CalPrmWslcBrk01.TP_U8_dPTim_by_Dump_LMMu_MMu_2_F" 0 /end CHARACTERISTIC
/begin CHARACTERISTIC TP_U8_dPTim_by_Dump_LMMu_MMu_3_F "dP rise time if num. of dump scans is between 2nd and 3rd reference point, Low-Med to Medium mu, Front Wheels" VALUE 0x80020462 CalPrmWslcBrk_UBYTE 0 Gain 0 255 SYMBOL_LINK "CalPrmWslcBrk01.TP_U8_dPTim_by_Dump_LMMu_MMu_3_F" 0 /end CHARACTERISTIC
/begin CHARACTERISTIC TP_U8_dPTim_by_Dump_LMMu_MMu_Max_F "dP rise time if num. of dump scans is larger than 3rd reference point, Low-Med to Medium mu, Front Wheels" VALUE 0x80020463 CalPrmWslcBrk_UBYTE 0 Gain 0 255 SYMBOL_LINK "CalPrmWslcBrk01.TP_U8_dPTim_by_Dump_LMMu_MMu_Max_F" 0 /end CHARACTERISTIC
/begin CHARACTERISTIC TP_U8_dPTim_by_Dump_LMu_LMMu_1_F "dP rise time if num. of dump scans is smaller than 1st reference point, Low to Low-Med mu, Front Wheels" VALUE 0x8002046E CalPrmWslcBrk_UBYTE 0 Gain 0 255 SYMBOL_LINK "CalPrmWslcBrk01.TP_U8_dPTim_by_Dump_LMu_LMMu_1_F" 0 /end CHARACTERISTIC
/begin CHARACTERISTIC TP_U8_dPTim_by_Dump_LMu_LMMu_2_F "dP rise time if num. of dump scans is between 1st and 2nd reference point, Low to Low-Med mu, Front Wheels" VALUE 0x8002046F CalPrmWslcBrk_UBYTE 0 Gain 0 255 SYMBOL_LINK "CalPrmWslcBrk01.TP_U8_dPTim_by_Dump_LMu_LMMu_2_F" 0 /end CHARACTERISTIC
/begin CHARACTERISTIC TP_U8_dPTim_by_Dump_LMu_LMMu_3_F "dP rise time if num. of dump scans is between 2nd and 3rd reference point, Low to Low-Med mu, Front Wheels" VALUE 0x80020470 CalPrmWslcBrk_UBYTE 0 Gain 0 255 SYMBOL_LINK "CalPrmWslcBrk01.TP_U8_dPTim_by_Dump_LMu_LMMu_3_F" 0 /end CHARACTERISTIC
/begin CHARACTERISTIC TP_U8_dPTim_by_Dump_LMu_LMMu_Max_F "dP rise time if num. of dump scans is larger than 3rd reference point, Low to Low-Med mu, Front Wheels" VALUE 0x80020471 CalPrmWslcBrk_UBYTE 0 Gain 0 255 SYMBOL_LINK "CalPrmWslcBrk01.TP_U8_dPTim_by_Dump_LMu_LMMu_Max_F" 0 /end CHARACTERISTIC
/begin CHARACTERISTIC TP_U8_dPTim_by_Dump_MHMu_HMu_1_F "dP rise time if num. of dump scans is smaller than 1st reference point, Med-High to High mu, Front Wheels" VALUE 0x80020444 CalPrmWslcBrk_UBYTE 0 Gain 0 255 SYMBOL_LINK "CalPrmWslcBrk01.TP_U8_dPTim_by_Dump_MHMu_HMu_1_F" 0 /end CHARACTERISTIC
/begin CHARACTERISTIC TP_U8_dPTim_by_Dump_MHMu_HMu_2_F "dP rise time if num. of dump scans is between 1st and 2nd reference point, Med-High to High mu, Front Wheels" VALUE 0x80020445 CalPrmWslcBrk_UBYTE 0 Gain 0 255 SYMBOL_LINK "CalPrmWslcBrk01.TP_U8_dPTim_by_Dump_MHMu_HMu_2_F" 0 /end CHARACTERISTIC
/begin CHARACTERISTIC TP_U8_dPTim_by_Dump_MHMu_HMu_3_F "dP rise time if num. of dump scans is between 2nd and 3rd reference point, Med-High to High mu, Front Wheels" VALUE 0x80020446 CalPrmWslcBrk_UBYTE 0 Gain 0 255 SYMBOL_LINK "CalPrmWslcBrk01.TP_U8_dPTim_by_Dump_MHMu_HMu_3_F" 0 /end CHARACTERISTIC
/begin CHARACTERISTIC TP_U8_dPTim_by_Dump_MHMu_HMu_Max_F "dP rise time if num. of dump scans is larger than 3rd reference point, Med-High to High mu, Front Wheels" VALUE 0x80020447 CalPrmWslcBrk_UBYTE 0 Gain 0 255 SYMBOL_LINK "CalPrmWslcBrk01.TP_U8_dPTim_by_Dump_MHMu_HMu_Max_F" 0 /end CHARACTERISTIC
/begin CHARACTERISTIC TP_U8_dPTim_by_Dump_MMu_MHMu_1_F "dP rise time if num. of dump scans is smaller than 1st reference point, Medium to Med-High mu, Front Wheels" VALUE 0x80020452 CalPrmWslcBrk_UBYTE 0 Gain 0 255 SYMBOL_LINK "CalPrmWslcBrk01.TP_U8_dPTim_by_Dump_MMu_MHMu_1_F" 0 /end CHARACTERISTIC
/begin CHARACTERISTIC TP_U8_dPTim_by_Dump_MMu_MHMu_2_F "dP rise time if num. of dump scans is between 1st and 2nd reference point, Medium to Med-High mu, Front Wheels" VALUE 0x80020453 CalPrmWslcBrk_UBYTE 0 Gain 0 255 SYMBOL_LINK "CalPrmWslcBrk01.TP_U8_dPTim_by_Dump_MMu_MHMu_2_F" 0 /end CHARACTERISTIC
/begin CHARACTERISTIC TP_U8_dPTim_by_Dump_MMu_MHMu_3_F "dP rise time if num. of dump scans is between 2nd and 3rd reference point, Medium to Med-High mu, Front Wheels" VALUE 0x80020454 CalPrmWslcBrk_UBYTE 0 Gain 0 255 SYMBOL_LINK "CalPrmWslcBrk01.TP_U8_dPTim_by_Dump_MMu_MHMu_3_F" 0 /end CHARACTERISTIC
/begin CHARACTERISTIC TP_U8_dPTim_by_Dump_MMu_MHMu_Max_F "dP rise time if num. of dump scans is larger than 3rd reference point, Medium to Med-High mu, Front Wheels" VALUE 0x80020455 CalPrmWslcBrk_UBYTE 0 Gain 0 255 SYMBOL_LINK "CalPrmWslcBrk01.TP_U8_dPTim_by_Dump_MMu_MHMu_Max_F" 0 /end CHARACTERISTIC
/begin CHARACTERISTIC TP_U8_dPTim_by_Dump_SPHMu_1_F "dP rise time if num. of dump scans is smaller than 1st reference point, Split mu, High-side Front Wheels" VALUE 0x8002048A CalPrmWslcBrk_UBYTE 0 Gain 0 255 SYMBOL_LINK "CalPrmWslcBrk01.TP_U8_dPTim_by_Dump_SPHMu_1_F" 0 /end CHARACTERISTIC
/begin CHARACTERISTIC TP_U8_dPTim_by_Dump_SPHMu_2_F "dP rise time if num. of dump scans is between 1st and 2nd reference point, Split mu, High-side Front Wheels" VALUE 0x8002048B CalPrmWslcBrk_UBYTE 0 Gain 0 255 SYMBOL_LINK "CalPrmWslcBrk01.TP_U8_dPTim_by_Dump_SPHMu_2_F" 0 /end CHARACTERISTIC
/begin CHARACTERISTIC TP_U8_dPTim_by_Dump_SPHMu_3_F "dP rise time if num. of dump scans is between 2nd and 3rd reference point, Split mu, High-side Front Wheels" VALUE 0x8002048C CalPrmWslcBrk_UBYTE 0 Gain 0 255 SYMBOL_LINK "CalPrmWslcBrk01.TP_U8_dPTim_by_Dump_SPHMu_3_F" 0 /end CHARACTERISTIC
/begin CHARACTERISTIC TP_U8_dPTim_by_Dump_SPHMu_Max_F "dP rise time if num. of dump scans is larger than 3rd reference point, Split mu, High-side Front Wheels" VALUE 0x8002048D CalPrmWslcBrk_UBYTE 0 Gain 0 255 SYMBOL_LINK "CalPrmWslcBrk01.TP_U8_dPTim_by_Dump_SPHMu_Max_F" 0 /end CHARACTERISTIC
/begin CHARACTERISTIC TP_U8_dP_Dump_cnt_Ref_Ab_HMu_F "Number of Dump scans Ref. for starting Unstable Rise, above High-mu, Front Wheels" VALUE 0x8002041D CalPrmWslcBrk_UBYTE 0 Gain 0 255 SYMBOL_LINK "CalPrmWslcBrk01.TP_U8_dP_Dump_cnt_Ref_Ab_HMu_F" 0 /end CHARACTERISTIC
/begin CHARACTERISTIC TP_U8_dP_Dump_cnt_Ref_Bw_LMu_F "Number of Dump scans Ref. for starting Unstable Rise, Below Low mu, Front Wheels" VALUE 0x80020431 CalPrmWslcBrk_UBYTE 0 Gain 0 255 SYMBOL_LINK "CalPrmWslcBrk01.TP_U8_dP_Dump_cnt_Ref_Bw_LMu_F" 0 /end CHARACTERISTIC
/begin CHARACTERISTIC TP_U8_dP_Dump_cnt_Ref_LMMu_MMu_F "Number of Dump scans Ref. for starting Unstable Rise, From Low-Medium to Medium mu, Front Wheels" VALUE 0x80020429 CalPrmWslcBrk_UBYTE 0 Gain 0 255 SYMBOL_LINK "CalPrmWslcBrk01.TP_U8_dP_Dump_cnt_Ref_LMMu_MMu_F" 0 /end CHARACTERISTIC
/begin CHARACTERISTIC TP_U8_dP_Dump_cnt_Ref_LMu_LMMu_F "Number of Dump scans Ref. for starting Unstable Rise, From Low to Low-Medium mu, Front Wheels" VALUE 0x8002042D CalPrmWslcBrk_UBYTE 0 Gain 0 255 SYMBOL_LINK "CalPrmWslcBrk01.TP_U8_dP_Dump_cnt_Ref_LMu_LMMu_F" 0 /end CHARACTERISTIC
/begin CHARACTERISTIC TP_U8_dP_Dump_cnt_Ref_MHMu_HMu_F "Number of Dump scans Ref. for starting Unstable Rise, From Med-High to High-mu, Front Wheels" VALUE 0x80020421 CalPrmWslcBrk_UBYTE 0 Gain 0 255 SYMBOL_LINK "CalPrmWslcBrk01.TP_U8_dP_Dump_cnt_Ref_MHMu_HMu_F" 0 /end CHARACTERISTIC
/begin CHARACTERISTIC TP_U8_dP_Dump_cnt_Ref_MMu_MHMu_F "Number of Dump scans Ref. for starting Unstable Rise, From Medium to Med-High mu, Front Wheels" VALUE 0x80020425 CalPrmWslcBrk_UBYTE 0 Gain 0 255 SYMBOL_LINK "CalPrmWslcBrk01.TP_U8_dP_Dump_cnt_Ref_MMu_MHMu_F" 0 /end CHARACTERISTIC
/begin CHARACTERISTIC TP_U8_dP_Dump_cnt_Ref_SpHMu_F "Number of Dump scans Ref. for starting Unstable Rise at Split mu, High-side Front Wheel" VALUE 0x80020435 CalPrmWslcBrk_UBYTE 0 Gain 0 255 SYMBOL_LINK "CalPrmWslcBrk01.TP_U8_dP_Dump_cnt_Ref_SpHMu_F" 0 /end CHARACTERISTIC
/begin CHARACTERISTIC TP_U8_dP_HMu_Dct_AradRef_1st_F "Arad Reference to detect High Mu for Unstable-rise compensation at 1st cycle, Front Wheels" VALUE 0x800205E0 CalPrmWslcBrk_UBYTE 0 A20 0 63.75 SYMBOL_LINK "CalPrmWslcBrk01.TP_U8_dP_HMu_Dct_AradRef_1st_F" 0 /end CHARACTERISTIC
/begin CHARACTERISTIC TP_U8_dP_HMu_Dct_DumpRef_1st_F "Dump Reference to detect High Mu for Unstable-rise compensation at 1st cycle, Front Wheels" VALUE 0x800205E1 CalPrmWslcBrk_UBYTE 0 Gain 0 255 SYMBOL_LINK "CalPrmWslcBrk01.TP_U8_dP_HMu_Dct_DumpRef_1st_F" 0 /end CHARACTERISTIC
/begin CHARACTERISTIC TP_U8_dP_LMu_Dct_AradRef_1st_F "Arad Reference to detect Low Mu for Unstable-rise compensation at 1st cycle, Front Wheels" VALUE 0x800205E2 CalPrmWslcBrk_UBYTE 0 A20 0 63.75 SYMBOL_LINK "CalPrmWslcBrk01.TP_U8_dP_LMu_Dct_AradRef_1st_F" 0 /end CHARACTERISTIC
/begin CHARACTERISTIC TP_U8_dP_LMu_Dct_DumpRef_1st_F "Dump Reference to detect Low Mu for Unstable-rise compensation at 1st cycle, Front Wheels" VALUE 0x800205E3 CalPrmWslcBrk_UBYTE 0 Gain 0 255 SYMBOL_LINK "CalPrmWslcBrk01.TP_U8_dP_LMu_Dct_DumpRef_1st_F" 0 /end CHARACTERISTIC
/begin CHARACTERISTIC TP_U8_dV_BF_AFZOK_100kph_F "dV, below 100kph to 80kph, before AFZ_OK, Front Wheels" VALUE 0x80020224 CalPrmWslcBrk_UBYTE 0 Spd12 0 31.875 SYMBOL_LINK "CalPrmWslcBrk01.TP_U8_dV_BF_AFZOK_100kph_F" 0 /end CHARACTERISTIC
/begin CHARACTERISTIC TP_U8_dV_BF_AFZOK_10kph_F "dV, below 10kph, before AFZ_OK, Front Wheels" VALUE 0x8002021F CalPrmWslcBrk_UBYTE 0 Spd12 0 31.875 SYMBOL_LINK "CalPrmWslcBrk01.TP_U8_dV_BF_AFZOK_10kph_F" 0 /end CHARACTERISTIC
/begin CHARACTERISTIC TP_U8_dV_BF_AFZOK_120kph_F "dV, below 120kph to 100kph, before AFZ_OK, Front Wheels" VALUE 0x80020225 CalPrmWslcBrk_UBYTE 0 Spd12 0 31.875 SYMBOL_LINK "CalPrmWslcBrk01.TP_U8_dV_BF_AFZOK_120kph_F" 0 /end CHARACTERISTIC
/begin CHARACTERISTIC TP_U8_dV_BF_AFZOK_140kph_F "dV, below 140kph to 120kph, before AFZ_OK, Front Wheels" VALUE 0x80020226 CalPrmWslcBrk_UBYTE 0 Spd12 0 31.875 SYMBOL_LINK "CalPrmWslcBrk01.TP_U8_dV_BF_AFZOK_140kph_F" 0 /end CHARACTERISTIC
/begin CHARACTERISTIC TP_U8_dV_BF_AFZOK_160kph_F "dV, below 160kph to 140kph, before AFZ_OK, Front Wheels" VALUE 0x80020227 CalPrmWslcBrk_UBYTE 0 Spd12 0 31.875 SYMBOL_LINK "CalPrmWslcBrk01.TP_U8_dV_BF_AFZOK_160kph_F" 0 /end CHARACTERISTIC
/begin CHARACTERISTIC TP_U8_dV_BF_AFZOK_20kph_F "dV, below 20kph to 10kph, before AFZ_OK, Front Wheels" VALUE 0x80020220 CalPrmWslcBrk_UBYTE 0 Spd12 0 31.875 SYMBOL_LINK "CalPrmWslcBrk01.TP_U8_dV_BF_AFZOK_20kph_F" 0 /end CHARACTERISTIC
/begin CHARACTERISTIC TP_U8_dV_BF_AFZOK_40kph_F "dV, below 40kph to 20kph, before AFZ_OK, Front Wheels" VALUE 0x80020221 CalPrmWslcBrk_UBYTE 0 Spd12 0 31.875 SYMBOL_LINK "CalPrmWslcBrk01.TP_U8_dV_BF_AFZOK_40kph_F" 0 /end CHARACTERISTIC
/begin CHARACTERISTIC TP_U8_dV_BF_AFZOK_60kph_F "dV, below 60kph to 40kph, before AFZ_OK, Front Wheels" VALUE 0x80020222 CalPrmWslcBrk_UBYTE 0 Spd12 0 31.875 SYMBOL_LINK "CalPrmWslcBrk01.TP_U8_dV_BF_AFZOK_60kph_F" 0 /end CHARACTERISTIC
/begin CHARACTERISTIC TP_U8_dV_BF_AFZOK_80kph_F "dV, below 80kph to 60kph, before AFZ_OK, Front Wheels" VALUE 0x80020223 CalPrmWslcBrk_UBYTE 0 Spd12 0 31.875 SYMBOL_LINK "CalPrmWslcBrk01.TP_U8_dV_BF_AFZOK_80kph_F" 0 /end CHARACTERISTIC
/begin CHARACTERISTIC TQS16_MU_HIGH "" VALUE 0x80020A1E CalPrmLatDynsCoorrBrk_SWORD 0 Gain -32768 32767 SYMBOL_LINK "CalPrmLatDynsCoorrBrk01.TQS16_MU_HIGH" 0 /end CHARACTERISTIC
/begin CHARACTERISTIC TQS16_MU_LOW "" VALUE 0x80020A18 CalPrmLatDynsCoorrBrk_SWORD 0 Gain -32768 32767 SYMBOL_LINK "CalPrmLatDynsCoorrBrk01.TQS16_MU_LOW" 0 /end CHARACTERISTIC
/begin CHARACTERISTIC TQS16_MU_MED "" VALUE 0x80020A1A CalPrmLatDynsCoorrBrk_SWORD 0 Gain -32768 32767 SYMBOL_LINK "CalPrmLatDynsCoorrBrk01.TQS16_MU_MED" 0 /end CHARACTERISTIC
/begin CHARACTERISTIC TQS16_MU_MED_HIGH "" VALUE 0x80020A1C CalPrmLatDynsCoorrBrk_SWORD 0 Gain -32768 32767 SYMBOL_LINK "CalPrmLatDynsCoorrBrk01.TQS16_MU_MED_HIGH" 0 /end CHARACTERISTIC
/begin CHARACTERISTIC TQS16_ROP_WSTR_DOT_ENT_100K "" VALUE 0x80020BF0 CalPrmLatDynsCoorrBrk_SWORD 0 Gain -32768 32767 SYMBOL_LINK "CalPrmLatDynsCoorrBrk01.TQS16_ROP_WSTR_DOT_ENT_100K" 0 /end CHARACTERISTIC
/begin CHARACTERISTIC TQS16_ROP_WSTR_DOT_ENT_120K "" VALUE 0x80020BF2 CalPrmLatDynsCoorrBrk_SWORD 0 Gain -32768 32767 SYMBOL_LINK "CalPrmLatDynsCoorrBrk01.TQS16_ROP_WSTR_DOT_ENT_120K" 0 /end CHARACTERISTIC
/begin CHARACTERISTIC TQS16_ROP_WSTR_DOT_ENT_40K "" VALUE 0x80020BF4 CalPrmLatDynsCoorrBrk_SWORD 0 Gain -32768 32767 SYMBOL_LINK "CalPrmLatDynsCoorrBrk01.TQS16_ROP_WSTR_DOT_ENT_40K" 0 /end CHARACTERISTIC
/begin CHARACTERISTIC TQS16_ROP_WSTR_DOT_ENT_50K "" VALUE 0x80020BF6 CalPrmLatDynsCoorrBrk_SWORD 0 Gain -32768 32767 SYMBOL_LINK "CalPrmLatDynsCoorrBrk01.TQS16_ROP_WSTR_DOT_ENT_50K" 0 /end CHARACTERISTIC
/begin CHARACTERISTIC TQS16_ROP_WSTR_DOT_ENT_60K "" VALUE 0x80020BF8 CalPrmLatDynsCoorrBrk_SWORD 0 Gain -32768 32767 SYMBOL_LINK "CalPrmLatDynsCoorrBrk01.TQS16_ROP_WSTR_DOT_ENT_60K" 0 /end CHARACTERISTIC
/begin CHARACTERISTIC TQS16_ROP_WSTR_DOT_ENT_70K "" VALUE 0x80020BFA CalPrmLatDynsCoorrBrk_SWORD 0 Gain -32768 32767 SYMBOL_LINK "CalPrmLatDynsCoorrBrk01.TQS16_ROP_WSTR_DOT_ENT_70K" 0 /end CHARACTERISTIC
/begin CHARACTERISTIC TQS16_ROP_WSTR_DOT_ENT_80K "" VALUE 0x80020BFC CalPrmLatDynsCoorrBrk_SWORD 0 Gain -32768 32767 SYMBOL_LINK "CalPrmLatDynsCoorrBrk01.TQS16_ROP_WSTR_DOT_ENT_80K" 0 /end CHARACTERISTIC
/begin CHARACTERISTIC TQS16_ROP_WSTR_DOT_EXT_100K "" VALUE 0x80020BFE CalPrmLatDynsCoorrBrk_SWORD 0 Gain -32768 32767 SYMBOL_LINK "CalPrmLatDynsCoorrBrk01.TQS16_ROP_WSTR_DOT_EXT_100K" 0 /end CHARACTERISTIC
/begin CHARACTERISTIC TQS16_ROP_WSTR_DOT_EXT_120K "" VALUE 0x80020C00 CalPrmLatDynsCoorrBrk_SWORD 0 Gain -32768 32767 SYMBOL_LINK "CalPrmLatDynsCoorrBrk01.TQS16_ROP_WSTR_DOT_EXT_120K" 0 /end CHARACTERISTIC
/begin CHARACTERISTIC TQS16_ROP_WSTR_DOT_EXT_40K "" VALUE 0x80020C02 CalPrmLatDynsCoorrBrk_SWORD 0 Gain -32768 32767 SYMBOL_LINK "CalPrmLatDynsCoorrBrk01.TQS16_ROP_WSTR_DOT_EXT_40K" 0 /end CHARACTERISTIC
/begin CHARACTERISTIC TQS16_ROP_WSTR_DOT_EXT_50K "" VALUE 0x80020C04 CalPrmLatDynsCoorrBrk_SWORD 0 Gain -32768 32767 SYMBOL_LINK "CalPrmLatDynsCoorrBrk01.TQS16_ROP_WSTR_DOT_EXT_50K" 0 /end CHARACTERISTIC
/begin CHARACTERISTIC TQS16_ROP_WSTR_DOT_EXT_60K "" VALUE 0x80020C06 CalPrmLatDynsCoorrBrk_SWORD 0 Gain -32768 32767 SYMBOL_LINK "CalPrmLatDynsCoorrBrk01.TQS16_ROP_WSTR_DOT_EXT_60K" 0 /end CHARACTERISTIC
/begin CHARACTERISTIC TQS16_ROP_WSTR_DOT_EXT_70K "" VALUE 0x80020C08 CalPrmLatDynsCoorrBrk_SWORD 0 Gain -32768 32767 SYMBOL_LINK "CalPrmLatDynsCoorrBrk01.TQS16_ROP_WSTR_DOT_EXT_70K" 0 /end CHARACTERISTIC
/begin CHARACTERISTIC TQS16_ROP_WSTR_DOT_EXT_80K "" VALUE 0x80020C0A CalPrmLatDynsCoorrBrk_SWORD 0 Gain -32768 32767 SYMBOL_LINK "CalPrmLatDynsCoorrBrk01.TQS16_ROP_WSTR_DOT_EXT_80K" 0 /end CHARACTERISTIC
/begin CHARACTERISTIC TQS16_ROP_YAW_DOT_ENT_100K "" VALUE 0x80020BD4 CalPrmLatDynsCoorrBrk_SWORD 0 Gain -32768 32767 SYMBOL_LINK "CalPrmLatDynsCoorrBrk01.TQS16_ROP_YAW_DOT_ENT_100K" 0 /end CHARACTERISTIC
/begin CHARACTERISTIC TQS16_ROP_YAW_DOT_ENT_120K "" VALUE 0x80020BD6 CalPrmLatDynsCoorrBrk_SWORD 0 Gain -32768 32767 SYMBOL_LINK "CalPrmLatDynsCoorrBrk01.TQS16_ROP_YAW_DOT_ENT_120K" 0 /end CHARACTERISTIC
/begin CHARACTERISTIC TQS16_ROP_YAW_DOT_ENT_40K "" VALUE 0x80020BD8 CalPrmLatDynsCoorrBrk_SWORD 0 Gain -32768 32767 SYMBOL_LINK "CalPrmLatDynsCoorrBrk01.TQS16_ROP_YAW_DOT_ENT_40K" 0 /end CHARACTERISTIC
/begin CHARACTERISTIC TQS16_ROP_YAW_DOT_ENT_50K "" VALUE 0x80020BDA CalPrmLatDynsCoorrBrk_SWORD 0 Gain -32768 32767 SYMBOL_LINK "CalPrmLatDynsCoorrBrk01.TQS16_ROP_YAW_DOT_ENT_50K" 0 /end CHARACTERISTIC
/begin CHARACTERISTIC TQS16_ROP_YAW_DOT_ENT_60K "" VALUE 0x80020BDC CalPrmLatDynsCoorrBrk_SWORD 0 Gain -32768 32767 SYMBOL_LINK "CalPrmLatDynsCoorrBrk01.TQS16_ROP_YAW_DOT_ENT_60K" 0 /end CHARACTERISTIC
/begin CHARACTERISTIC TQS16_ROP_YAW_DOT_ENT_70K "" VALUE 0x80020BDE CalPrmLatDynsCoorrBrk_SWORD 0 Gain -32768 32767 SYMBOL_LINK "CalPrmLatDynsCoorrBrk01.TQS16_ROP_YAW_DOT_ENT_70K" 0 /end CHARACTERISTIC
/begin CHARACTERISTIC TQS16_ROP_YAW_DOT_ENT_80K "" VALUE 0x80020BE0 CalPrmLatDynsCoorrBrk_SWORD 0 Gain -32768 32767 SYMBOL_LINK "CalPrmLatDynsCoorrBrk01.TQS16_ROP_YAW_DOT_ENT_80K" 0 /end CHARACTERISTIC
/begin CHARACTERISTIC TQS16_ROP_YAW_DOT_EXT_100K "" VALUE 0x80020BE2 CalPrmLatDynsCoorrBrk_SWORD 0 Gain -32768 32767 SYMBOL_LINK "CalPrmLatDynsCoorrBrk01.TQS16_ROP_YAW_DOT_EXT_100K" 0 /end CHARACTERISTIC
/begin CHARACTERISTIC TQS16_ROP_YAW_DOT_EXT_120K "" VALUE 0x80020BE4 CalPrmLatDynsCoorrBrk_SWORD 0 Gain -32768 32767 SYMBOL_LINK "CalPrmLatDynsCoorrBrk01.TQS16_ROP_YAW_DOT_EXT_120K" 0 /end CHARACTERISTIC
/begin CHARACTERISTIC TQS16_ROP_YAW_DOT_EXT_40K "" VALUE 0x80020BE6 CalPrmLatDynsCoorrBrk_SWORD 0 Gain -32768 32767 SYMBOL_LINK "CalPrmLatDynsCoorrBrk01.TQS16_ROP_YAW_DOT_EXT_40K" 0 /end CHARACTERISTIC
/begin CHARACTERISTIC TQS16_ROP_YAW_DOT_EXT_50K "" VALUE 0x80020BE8 CalPrmLatDynsCoorrBrk_SWORD 0 Gain -32768 32767 SYMBOL_LINK "CalPrmLatDynsCoorrBrk01.TQS16_ROP_YAW_DOT_EXT_50K" 0 /end CHARACTERISTIC
/begin CHARACTERISTIC TQS16_ROP_YAW_DOT_EXT_60K "" VALUE 0x80020BEA CalPrmLatDynsCoorrBrk_SWORD 0 Gain -32768 32767 SYMBOL_LINK "CalPrmLatDynsCoorrBrk01.TQS16_ROP_YAW_DOT_EXT_60K" 0 /end CHARACTERISTIC
/begin CHARACTERISTIC TQS16_ROP_YAW_DOT_EXT_70K "" VALUE 0x80020BEC CalPrmLatDynsCoorrBrk_SWORD 0 Gain -32768 32767 SYMBOL_LINK "CalPrmLatDynsCoorrBrk01.TQS16_ROP_YAW_DOT_EXT_70K" 0 /end CHARACTERISTIC
/begin CHARACTERISTIC TQS16_ROP_YAW_DOT_EXT_80K "" VALUE 0x80020BEE CalPrmLatDynsCoorrBrk_SWORD 0 Gain -32768 32767 SYMBOL_LINK "CalPrmLatDynsCoorrBrk01.TQS16_ROP_YAW_DOT_EXT_80K" 0 /end CHARACTERISTIC
/begin CHARACTERISTIC TQS16_TVBB_CTRL_PD_WEG_ENGINE_HTQ "" VALUE 0x80020E02 CalPrmLatDynsCoorrBrk_SWORD 0 Gain -32768 32767 SYMBOL_LINK "CalPrmLatDynsCoorrBrk01.TQS16_TVBB_CTRL_PD_WEG_ENGINE_HTQ" 0 /end CHARACTERISTIC
/begin CHARACTERISTIC TQS16_TVBB_CTRL_PD_WEG_ENGINE_LTQ "" VALUE 0x80020E04 CalPrmLatDynsCoorrBrk_SWORD 0 Gain -32768 32767 SYMBOL_LINK "CalPrmLatDynsCoorrBrk01.TQS16_TVBB_CTRL_PD_WEG_ENGINE_LTQ" 0 /end CHARACTERISTIC
/begin CHARACTERISTIC TQS16_TVBB_CTRL_PD_WEG_ENGINE_MHTQ "" VALUE 0x80020E06 CalPrmLatDynsCoorrBrk_SWORD 0 Gain -32768 32767 SYMBOL_LINK "CalPrmLatDynsCoorrBrk01.TQS16_TVBB_CTRL_PD_WEG_ENGINE_MHTQ" 0 /end CHARACTERISTIC
/begin CHARACTERISTIC TQS16_TVBB_CTRL_PD_WEG_ENGINE_MLTQ "" VALUE 0x80020E08 CalPrmLatDynsCoorrBrk_SWORD 0 Gain -32768 32767 SYMBOL_LINK "CalPrmLatDynsCoorrBrk01.TQS16_TVBB_CTRL_PD_WEG_ENGINE_MLTQ" 0 /end CHARACTERISTIC
/begin CHARACTERISTIC TQS16_TVBB_CTRL_PD_WEG_HMU_HSPD "" VALUE 0x80020DA0 CalPrmLatDynsCoorrBrk_SWORD 0 Gain -32768 32767 SYMBOL_LINK "CalPrmLatDynsCoorrBrk01.TQS16_TVBB_CTRL_PD_WEG_HMU_HSPD" 0 /end CHARACTERISTIC
/begin CHARACTERISTIC TQS16_TVBB_CTRL_PD_WEG_HMU_LSPD "" VALUE 0x80020D9A CalPrmLatDynsCoorrBrk_SWORD 0 Gain -32768 32767 SYMBOL_LINK "CalPrmLatDynsCoorrBrk01.TQS16_TVBB_CTRL_PD_WEG_HMU_LSPD" 0 /end CHARACTERISTIC
/begin CHARACTERISTIC TQS16_TVBB_CTRL_PD_WEG_HMU_MHSPD "" VALUE 0x80020D9E CalPrmLatDynsCoorrBrk_SWORD 0 Gain -32768 32767 SYMBOL_LINK "CalPrmLatDynsCoorrBrk01.TQS16_TVBB_CTRL_PD_WEG_HMU_MHSPD" 0 /end CHARACTERISTIC
/begin CHARACTERISTIC TQS16_TVBB_CTRL_PD_WEG_HMU_MLSPD "" VALUE 0x80020D9C CalPrmLatDynsCoorrBrk_SWORD 0 Gain -32768 32767 SYMBOL_LINK "CalPrmLatDynsCoorrBrk01.TQS16_TVBB_CTRL_PD_WEG_HMU_MLSPD" 0 /end CHARACTERISTIC
/begin CHARACTERISTIC TQS16_TVBB_CTRL_PD_WEG_LMU_HSPD "" VALUE 0x80020DC0 CalPrmLatDynsCoorrBrk_SWORD 0 Gain -32768 32767 SYMBOL_LINK "CalPrmLatDynsCoorrBrk01.TQS16_TVBB_CTRL_PD_WEG_LMU_HSPD" 0 /end CHARACTERISTIC
/begin CHARACTERISTIC TQS16_TVBB_CTRL_PD_WEG_LMU_LSPD "" VALUE 0x80020DBA CalPrmLatDynsCoorrBrk_SWORD 0 Gain -32768 32767 SYMBOL_LINK "CalPrmLatDynsCoorrBrk01.TQS16_TVBB_CTRL_PD_WEG_LMU_LSPD" 0 /end CHARACTERISTIC
/begin CHARACTERISTIC TQS16_TVBB_CTRL_PD_WEG_LMU_MHSPD "" VALUE 0x80020DBE CalPrmLatDynsCoorrBrk_SWORD 0 Gain -32768 32767 SYMBOL_LINK "CalPrmLatDynsCoorrBrk01.TQS16_TVBB_CTRL_PD_WEG_LMU_MHSPD" 0 /end CHARACTERISTIC
/begin CHARACTERISTIC TQS16_TVBB_CTRL_PD_WEG_LMU_MLSPD "" VALUE 0x80020DBC CalPrmLatDynsCoorrBrk_SWORD 0 Gain -32768 32767 SYMBOL_LINK "CalPrmLatDynsCoorrBrk01.TQS16_TVBB_CTRL_PD_WEG_LMU_MLSPD" 0 /end CHARACTERISTIC
/begin CHARACTERISTIC TQS16_TVBB_CTRL_PD_WEG_MMU_HSPD "" VALUE 0x80020DB0 CalPrmLatDynsCoorrBrk_SWORD 0 Gain -32768 32767 SYMBOL_LINK "CalPrmLatDynsCoorrBrk01.TQS16_TVBB_CTRL_PD_WEG_MMU_HSPD" 0 /end CHARACTERISTIC
/begin CHARACTERISTIC TQS16_TVBB_CTRL_PD_WEG_MMU_LSPD "" VALUE 0x80020DAA CalPrmLatDynsCoorrBrk_SWORD 0 Gain -32768 32767 SYMBOL_LINK "CalPrmLatDynsCoorrBrk01.TQS16_TVBB_CTRL_PD_WEG_MMU_LSPD" 0 /end CHARACTERISTIC
/begin CHARACTERISTIC TQS16_TVBB_CTRL_PD_WEG_MMU_MHSPD "" VALUE 0x80020DAE CalPrmLatDynsCoorrBrk_SWORD 0 Gain -32768 32767 SYMBOL_LINK "CalPrmLatDynsCoorrBrk01.TQS16_TVBB_CTRL_PD_WEG_MMU_MHSPD" 0 /end CHARACTERISTIC
/begin CHARACTERISTIC TQS16_TVBB_CTRL_PD_WEG_MMU_MLSPD "" VALUE 0x80020DAC CalPrmLatDynsCoorrBrk_SWORD 0 Gain -32768 32767 SYMBOL_LINK "CalPrmLatDynsCoorrBrk01.TQS16_TVBB_CTRL_PD_WEG_MMU_MLSPD" 0 /end CHARACTERISTIC
/begin CHARACTERISTIC TQS16_TVBB_ENGINE_HTQ "" VALUE 0x80020DF6 CalPrmLatDynsCoorrBrk_SWORD 0 Gain -32768 32767 SYMBOL_LINK "CalPrmLatDynsCoorrBrk01.TQS16_TVBB_ENGINE_HTQ" 0 /end CHARACTERISTIC
/begin CHARACTERISTIC TQS16_TVBB_ENGINE_LTQ "" VALUE 0x80020DF8 CalPrmLatDynsCoorrBrk_SWORD 0 Gain -32768 32767 SYMBOL_LINK "CalPrmLatDynsCoorrBrk01.TQS16_TVBB_ENGINE_LTQ" 0 /end CHARACTERISTIC
/begin CHARACTERISTIC TQS16_TVBB_ENGINE_MHTQ "" VALUE 0x80020DFA CalPrmLatDynsCoorrBrk_SWORD 0 Gain -32768 32767 SYMBOL_LINK "CalPrmLatDynsCoorrBrk01.TQS16_TVBB_ENGINE_MHTQ" 0 /end CHARACTERISTIC
/begin CHARACTERISTIC TQS16_TVBB_ENGINE_MLTQ "" VALUE 0x80020DFC CalPrmLatDynsCoorrBrk_SWORD 0 Gain -32768 32767 SYMBOL_LINK "CalPrmLatDynsCoorrBrk01.TQS16_TVBB_ENGINE_MLTQ" 0 /end CHARACTERISTIC
/begin CHARACTERISTIC TQS16_TVBB_HMU_HSPD "" VALUE 0x80020D98 CalPrmLatDynsCoorrBrk_SWORD 0 Gain -32768 32767 SYMBOL_LINK "CalPrmLatDynsCoorrBrk01.TQS16_TVBB_HMU_HSPD" 0 /end CHARACTERISTIC
/begin CHARACTERISTIC TQS16_TVBB_HMU_LSPD "" VALUE 0x80020D92 CalPrmLatDynsCoorrBrk_SWORD 0 Gain -32768 32767 SYMBOL_LINK "CalPrmLatDynsCoorrBrk01.TQS16_TVBB_HMU_LSPD" 0 /end CHARACTERISTIC
/begin CHARACTERISTIC TQS16_TVBB_HMU_MHSPD "" VALUE 0x80020D96 CalPrmLatDynsCoorrBrk_SWORD 0 Gain -32768 32767 SYMBOL_LINK "CalPrmLatDynsCoorrBrk01.TQS16_TVBB_HMU_MHSPD" 0 /end CHARACTERISTIC
/begin CHARACTERISTIC TQS16_TVBB_HMU_MLSPD "" VALUE 0x80020D94 CalPrmLatDynsCoorrBrk_SWORD 0 Gain -32768 32767 SYMBOL_LINK "CalPrmLatDynsCoorrBrk01.TQS16_TVBB_HMU_MLSPD" 0 /end CHARACTERISTIC
/begin CHARACTERISTIC TQS16_TVBB_LMU_HSPD "" VALUE 0x80020DB8 CalPrmLatDynsCoorrBrk_SWORD 0 Gain -32768 32767 SYMBOL_LINK "CalPrmLatDynsCoorrBrk01.TQS16_TVBB_LMU_HSPD" 0 /end CHARACTERISTIC
/begin CHARACTERISTIC TQS16_TVBB_LMU_LSPD "" VALUE 0x80020DB2 CalPrmLatDynsCoorrBrk_SWORD 0 Gain -32768 32767 SYMBOL_LINK "CalPrmLatDynsCoorrBrk01.TQS16_TVBB_LMU_LSPD" 0 /end CHARACTERISTIC
/begin CHARACTERISTIC TQS16_TVBB_LMU_MHSPD "" VALUE 0x80020DB6 CalPrmLatDynsCoorrBrk_SWORD 0 Gain -32768 32767 SYMBOL_LINK "CalPrmLatDynsCoorrBrk01.TQS16_TVBB_LMU_MHSPD" 0 /end CHARACTERISTIC
/begin CHARACTERISTIC TQS16_TVBB_LMU_MLSPD "" VALUE 0x80020DB4 CalPrmLatDynsCoorrBrk_SWORD 0 Gain -32768 32767 SYMBOL_LINK "CalPrmLatDynsCoorrBrk01.TQS16_TVBB_LMU_MLSPD" 0 /end CHARACTERISTIC
/begin CHARACTERISTIC TQS16_TVBB_MMU_HSPD "" VALUE 0x80020DA8 CalPrmLatDynsCoorrBrk_SWORD 0 Gain -32768 32767 SYMBOL_LINK "CalPrmLatDynsCoorrBrk01.TQS16_TVBB_MMU_HSPD" 0 /end CHARACTERISTIC
/begin CHARACTERISTIC TQS16_TVBB_MMU_LSPD "" VALUE 0x80020DA2 CalPrmLatDynsCoorrBrk_SWORD 0 Gain -32768 32767 SYMBOL_LINK "CalPrmLatDynsCoorrBrk01.TQS16_TVBB_MMU_LSPD" 0 /end CHARACTERISTIC
/begin CHARACTERISTIC TQS16_TVBB_MMU_MHSPD "" VALUE 0x80020DA6 CalPrmLatDynsCoorrBrk_SWORD 0 Gain -32768 32767 SYMBOL_LINK "CalPrmLatDynsCoorrBrk01.TQS16_TVBB_MMU_MHSPD" 0 /end CHARACTERISTIC
/begin CHARACTERISTIC TQS16_TVBB_MMU_MLSPD "" VALUE 0x80020DA4 CalPrmLatDynsCoorrBrk_SWORD 0 Gain -32768 32767 SYMBOL_LINK "CalPrmLatDynsCoorrBrk01.TQS16_TVBB_MMU_MLSPD" 0 /end CHARACTERISTIC
/begin CHARACTERISTIC TQS16_TVBB_TH_AY_VX_DOT_GAIN_HM_1 "" VALUE 0x80020E0A CalPrmLatDynsCoorrBrk_SWORD 0 Gain -32768 32767 SYMBOL_LINK "CalPrmLatDynsCoorrBrk01.TQS16_TVBB_TH_AY_VX_DOT_GAIN_HM_1" 0 /end CHARACTERISTIC
/begin CHARACTERISTIC TQS16_TVBB_TH_AY_VX_DOT_GAIN_HM_2 "" VALUE 0x80020E0C CalPrmLatDynsCoorrBrk_SWORD 0 Gain -32768 32767 SYMBOL_LINK "CalPrmLatDynsCoorrBrk01.TQS16_TVBB_TH_AY_VX_DOT_GAIN_HM_2" 0 /end CHARACTERISTIC
/begin CHARACTERISTIC TQS16_TVBB_TH_AY_VX_DOT_GAIN_HM_3 "" VALUE 0x80020E0E CalPrmLatDynsCoorrBrk_SWORD 0 Gain -32768 32767 SYMBOL_LINK "CalPrmLatDynsCoorrBrk01.TQS16_TVBB_TH_AY_VX_DOT_GAIN_HM_3" 0 /end CHARACTERISTIC
/begin CHARACTERISTIC TQS16_TVBB_TH_AY_VX_DOT_GAIN_LM_1 "" VALUE 0x80020E10 CalPrmLatDynsCoorrBrk_SWORD 0 Gain -32768 32767 SYMBOL_LINK "CalPrmLatDynsCoorrBrk01.TQS16_TVBB_TH_AY_VX_DOT_GAIN_LM_1" 0 /end CHARACTERISTIC
/begin CHARACTERISTIC TQS16_TVBB_TH_AY_VX_DOT_GAIN_LM_2 "" VALUE 0x80020E12 CalPrmLatDynsCoorrBrk_SWORD 0 Gain -32768 32767 SYMBOL_LINK "CalPrmLatDynsCoorrBrk01.TQS16_TVBB_TH_AY_VX_DOT_GAIN_LM_2" 0 /end CHARACTERISTIC
/begin CHARACTERISTIC TQS16_TVBB_TH_AY_VX_DOT_GAIN_LM_3 "" VALUE 0x80020E14 CalPrmLatDynsCoorrBrk_SWORD 0 Gain -32768 32767 SYMBOL_LINK "CalPrmLatDynsCoorrBrk01.TQS16_TVBB_TH_AY_VX_DOT_GAIN_LM_3" 0 /end CHARACTERISTIC
/begin CHARACTERISTIC TQS16_TVBB_TH_AY_VX_DOT_GAIN_MM_1 "" VALUE 0x80020E16 CalPrmLatDynsCoorrBrk_SWORD 0 Gain -32768 32767 SYMBOL_LINK "CalPrmLatDynsCoorrBrk01.TQS16_TVBB_TH_AY_VX_DOT_GAIN_MM_1" 0 /end CHARACTERISTIC
/begin CHARACTERISTIC TQS16_TVBB_TH_AY_VX_DOT_GAIN_MM_2 "" VALUE 0x80020E18 CalPrmLatDynsCoorrBrk_SWORD 0 Gain -32768 32767 SYMBOL_LINK "CalPrmLatDynsCoorrBrk01.TQS16_TVBB_TH_AY_VX_DOT_GAIN_MM_2" 0 /end CHARACTERISTIC
/begin CHARACTERISTIC TQS16_TVBB_TH_AY_VX_DOT_GAIN_MM_3 "" VALUE 0x80020E1A CalPrmLatDynsCoorrBrk_SWORD 0 Gain -32768 32767 SYMBOL_LINK "CalPrmLatDynsCoorrBrk01.TQS16_TVBB_TH_AY_VX_DOT_GAIN_MM_3" 0 /end CHARACTERISTIC
/begin CHARACTERISTIC TQS16_TVBB_TH_REF_AY_VX_DOT_HM_1 "" VALUE 0x80020E1C CalPrmLatDynsCoorrBrk_SWORD 0 Gain -32768 32767 SYMBOL_LINK "CalPrmLatDynsCoorrBrk01.TQS16_TVBB_TH_REF_AY_VX_DOT_HM_1" 0 /end CHARACTERISTIC
/begin CHARACTERISTIC TQS16_TVBB_TH_REF_AY_VX_DOT_HM_2 "" VALUE 0x80020E1E CalPrmLatDynsCoorrBrk_SWORD 0 Gain -32768 32767 SYMBOL_LINK "CalPrmLatDynsCoorrBrk01.TQS16_TVBB_TH_REF_AY_VX_DOT_HM_2" 0 /end CHARACTERISTIC
/begin CHARACTERISTIC TQS16_TVBB_TH_REF_AY_VX_DOT_HM_3 "" VALUE 0x80020E20 CalPrmLatDynsCoorrBrk_SWORD 0 Gain -32768 32767 SYMBOL_LINK "CalPrmLatDynsCoorrBrk01.TQS16_TVBB_TH_REF_AY_VX_DOT_HM_3" 0 /end CHARACTERISTIC
/begin CHARACTERISTIC TQS16_TVBB_TH_REF_AY_VX_DOT_LM_1 "" VALUE 0x80020E22 CalPrmLatDynsCoorrBrk_SWORD 0 Gain -32768 32767 SYMBOL_LINK "CalPrmLatDynsCoorrBrk01.TQS16_TVBB_TH_REF_AY_VX_DOT_LM_1" 0 /end CHARACTERISTIC
/begin CHARACTERISTIC TQS16_TVBB_TH_REF_AY_VX_DOT_LM_2 "" VALUE 0x80020E24 CalPrmLatDynsCoorrBrk_SWORD 0 Gain -32768 32767 SYMBOL_LINK "CalPrmLatDynsCoorrBrk01.TQS16_TVBB_TH_REF_AY_VX_DOT_LM_2" 0 /end CHARACTERISTIC
/begin CHARACTERISTIC TQS16_TVBB_TH_REF_AY_VX_DOT_LM_3 "" VALUE 0x80020E26 CalPrmLatDynsCoorrBrk_SWORD 0 Gain -32768 32767 SYMBOL_LINK "CalPrmLatDynsCoorrBrk01.TQS16_TVBB_TH_REF_AY_VX_DOT_LM_3" 0 /end CHARACTERISTIC
/begin CHARACTERISTIC TQS16_TVBB_TH_REF_AY_VX_DOT_MM_1 "" VALUE 0x80020E28 CalPrmLatDynsCoorrBrk_SWORD 0 Gain -32768 32767 SYMBOL_LINK "CalPrmLatDynsCoorrBrk01.TQS16_TVBB_TH_REF_AY_VX_DOT_MM_1" 0 /end CHARACTERISTIC
/begin CHARACTERISTIC TQS16_TVBB_TH_REF_AY_VX_DOT_MM_2 "" VALUE 0x80020E2A CalPrmLatDynsCoorrBrk_SWORD 0 Gain -32768 32767 SYMBOL_LINK "CalPrmLatDynsCoorrBrk01.TQS16_TVBB_TH_REF_AY_VX_DOT_MM_2" 0 /end CHARACTERISTIC
/begin CHARACTERISTIC TQS16_TVBB_TH_REF_AY_VX_DOT_MM_3 "" VALUE 0x80020E2C CalPrmLatDynsCoorrBrk_SWORD 0 Gain -32768 32767 SYMBOL_LINK "CalPrmLatDynsCoorrBrk01.TQS16_TVBB_TH_REF_AY_VX_DOT_MM_3" 0 /end CHARACTERISTIC
/begin CHARACTERISTIC TQS16_YC_D_GAIN_F_OS_IN "" VALUE 0x8002093C CalPrmLatDynsCoorrBrk_SWORD 0 Gain -32768 32767 SYMBOL_LINK "CalPrmLatDynsCoorrBrk01.TQS16_YC_D_GAIN_F_OS_IN" 0 /end CHARACTERISTIC
/begin CHARACTERISTIC TQS16_YC_D_GAIN_F_OS_IN_H "" VALUE 0x8002093A CalPrmLatDynsCoorrBrk_SWORD 0 Gain -32768 32767 SYMBOL_LINK "CalPrmLatDynsCoorrBrk01.TQS16_YC_D_GAIN_F_OS_IN_H" 0 /end CHARACTERISTIC
/begin CHARACTERISTIC TQS16_YC_D_GAIN_F_OS_IN_L "" VALUE 0x8002093E CalPrmLatDynsCoorrBrk_SWORD 0 Gain -32768 32767 SYMBOL_LINK "CalPrmLatDynsCoorrBrk01.TQS16_YC_D_GAIN_F_OS_IN_L" 0 /end CHARACTERISTIC
/begin CHARACTERISTIC TQS16_YC_D_GAIN_F_OS_OUT_DEC "" VALUE 0x8002094E CalPrmLatDynsCoorrBrk_SWORD 0 Gain -32768 32767 SYMBOL_LINK "CalPrmLatDynsCoorrBrk01.TQS16_YC_D_GAIN_F_OS_OUT_DEC" 0 /end CHARACTERISTIC
/begin CHARACTERISTIC TQS16_YC_D_GAIN_F_OS_OUT_DEC_H "" VALUE 0x80020946 CalPrmLatDynsCoorrBrk_SWORD 0 Gain -32768 32767 SYMBOL_LINK "CalPrmLatDynsCoorrBrk01.TQS16_YC_D_GAIN_F_OS_OUT_DEC_H" 0 /end CHARACTERISTIC
/begin CHARACTERISTIC TQS16_YC_D_GAIN_F_OS_OUT_DEC_L "" VALUE 0x80020956 CalPrmLatDynsCoorrBrk_SWORD 0 Gain -32768 32767 SYMBOL_LINK "CalPrmLatDynsCoorrBrk01.TQS16_YC_D_GAIN_F_OS_OUT_DEC_L" 0 /end CHARACTERISTIC
/begin CHARACTERISTIC TQS16_YC_D_GAIN_F_OS_OUT_INC "" VALUE 0x80020950 CalPrmLatDynsCoorrBrk_SWORD 0 Gain -32768 32767 SYMBOL_LINK "CalPrmLatDynsCoorrBrk01.TQS16_YC_D_GAIN_F_OS_OUT_INC" 0 /end CHARACTERISTIC
/begin CHARACTERISTIC TQS16_YC_D_GAIN_F_OS_OUT_INC_H "" VALUE 0x80020948 CalPrmLatDynsCoorrBrk_SWORD 0 Gain -32768 32767 SYMBOL_LINK "CalPrmLatDynsCoorrBrk01.TQS16_YC_D_GAIN_F_OS_OUT_INC_H" 0 /end CHARACTERISTIC
/begin CHARACTERISTIC TQS16_YC_D_GAIN_F_OS_OUT_INC_L "" VALUE 0x80020958 CalPrmLatDynsCoorrBrk_SWORD 0 Gain -32768 32767 SYMBOL_LINK "CalPrmLatDynsCoorrBrk01.TQS16_YC_D_GAIN_F_OS_OUT_INC_L" 0 /end CHARACTERISTIC
/begin CHARACTERISTIC TQS16_YC_D_GAIN_R_US_IN_DEC "" VALUE 0x8002091A CalPrmLatDynsCoorrBrk_SWORD 0 Gain -32768 32767 SYMBOL_LINK "CalPrmLatDynsCoorrBrk01.TQS16_YC_D_GAIN_R_US_IN_DEC" 0 /end CHARACTERISTIC
/begin CHARACTERISTIC TQS16_YC_D_GAIN_R_US_IN_INC "" VALUE 0x8002091C CalPrmLatDynsCoorrBrk_SWORD 0 Gain -32768 32767 SYMBOL_LINK "CalPrmLatDynsCoorrBrk01.TQS16_YC_D_GAIN_R_US_IN_INC" 0 /end CHARACTERISTIC
/begin CHARACTERISTIC TQS16_YC_D_GAIN_R_US_IN_INC_H "" VALUE 0x8002091E CalPrmLatDynsCoorrBrk_SWORD 0 Gain -32768 32767 SYMBOL_LINK "CalPrmLatDynsCoorrBrk01.TQS16_YC_D_GAIN_R_US_IN_INC_H" 0 /end CHARACTERISTIC
/begin CHARACTERISTIC TQS16_YC_D_GAIN_R_US_IN_INC_L "" VALUE 0x80020920 CalPrmLatDynsCoorrBrk_SWORD 0 Gain -32768 32767 SYMBOL_LINK "CalPrmLatDynsCoorrBrk01.TQS16_YC_D_GAIN_R_US_IN_INC_L" 0 /end CHARACTERISTIC
/begin CHARACTERISTIC TQS16_YC_D_GAIN_R_US_OUT_DEC "" VALUE 0x8002092A CalPrmLatDynsCoorrBrk_SWORD 0 Gain -32768 32767 SYMBOL_LINK "CalPrmLatDynsCoorrBrk01.TQS16_YC_D_GAIN_R_US_OUT_DEC" 0 /end CHARACTERISTIC
/begin CHARACTERISTIC TQS16_YC_D_GAIN_R_US_OUT_DEC_H "" VALUE 0x80020932 CalPrmLatDynsCoorrBrk_SWORD 0 Gain -32768 32767 SYMBOL_LINK "CalPrmLatDynsCoorrBrk01.TQS16_YC_D_GAIN_R_US_OUT_DEC_H" 0 /end CHARACTERISTIC
/begin CHARACTERISTIC TQS16_YC_D_GAIN_R_US_OUT_DEC_L "" VALUE 0x80020922 CalPrmLatDynsCoorrBrk_SWORD 0 Gain -32768 32767 SYMBOL_LINK "CalPrmLatDynsCoorrBrk01.TQS16_YC_D_GAIN_R_US_OUT_DEC_L" 0 /end CHARACTERISTIC
/begin CHARACTERISTIC TQS16_YC_D_GAIN_R_US_OUT_INC "" VALUE 0x8002092C CalPrmLatDynsCoorrBrk_SWORD 0 Gain -32768 32767 SYMBOL_LINK "CalPrmLatDynsCoorrBrk01.TQS16_YC_D_GAIN_R_US_OUT_INC" 0 /end CHARACTERISTIC
/begin CHARACTERISTIC TQS16_YC_D_GAIN_R_US_OUT_INC_H "" VALUE 0x80020934 CalPrmLatDynsCoorrBrk_SWORD 0 Gain -32768 32767 SYMBOL_LINK "CalPrmLatDynsCoorrBrk01.TQS16_YC_D_GAIN_R_US_OUT_INC_H" 0 /end CHARACTERISTIC
/begin CHARACTERISTIC TQS16_YC_D_GAIN_R_US_OUT_INC_L "" VALUE 0x80020924 CalPrmLatDynsCoorrBrk_SWORD 0 Gain -32768 32767 SYMBOL_LINK "CalPrmLatDynsCoorrBrk01.TQS16_YC_D_GAIN_R_US_OUT_INC_L" 0 /end CHARACTERISTIC
/begin CHARACTERISTIC TQS16_YC_FF_GAIN_OS_OUT_HIG_SP_H_MU "" VALUE 0x8002096A CalPrmLatDynsCoorrBrk_SWORD 0 Gain -32768 32767 SYMBOL_LINK "CalPrmLatDynsCoorrBrk01.TQS16_YC_FF_GAIN_OS_OUT_HIG_SP_H_MU" 0 /end CHARACTERISTIC
/begin CHARACTERISTIC TQS16_YC_FF_GAIN_OS_OUT_HIG_SP_L_MU "" VALUE 0x8002095E CalPrmLatDynsCoorrBrk_SWORD 0 Gain -32768 32767 SYMBOL_LINK "CalPrmLatDynsCoorrBrk01.TQS16_YC_FF_GAIN_OS_OUT_HIG_SP_L_MU" 0 /end CHARACTERISTIC
/begin CHARACTERISTIC TQS16_YC_FF_GAIN_OS_OUT_HIG_SP_M_MU "" VALUE 0x80020964 CalPrmLatDynsCoorrBrk_SWORD 0 Gain -32768 32767 SYMBOL_LINK "CalPrmLatDynsCoorrBrk01.TQS16_YC_FF_GAIN_OS_OUT_HIG_SP_M_MU" 0 /end CHARACTERISTIC
/begin CHARACTERISTIC TQS16_YC_FF_GAIN_OS_OUT_LOW_SP_H_MU "" VALUE 0x8002096E CalPrmLatDynsCoorrBrk_SWORD 0 Gain -32768 32767 SYMBOL_LINK "CalPrmLatDynsCoorrBrk01.TQS16_YC_FF_GAIN_OS_OUT_LOW_SP_H_MU" 0 /end CHARACTERISTIC
/begin CHARACTERISTIC TQS16_YC_FF_GAIN_OS_OUT_LOW_SP_L_MU "" VALUE 0x80020960 CalPrmLatDynsCoorrBrk_SWORD 0 Gain -32768 32767 SYMBOL_LINK "CalPrmLatDynsCoorrBrk01.TQS16_YC_FF_GAIN_OS_OUT_LOW_SP_L_MU" 0 /end CHARACTERISTIC
/begin CHARACTERISTIC TQS16_YC_FF_GAIN_OS_OUT_LOW_SP_M_MU "" VALUE 0x80020966 CalPrmLatDynsCoorrBrk_SWORD 0 Gain -32768 32767 SYMBOL_LINK "CalPrmLatDynsCoorrBrk01.TQS16_YC_FF_GAIN_OS_OUT_LOW_SP_M_MU" 0 /end CHARACTERISTIC
/begin CHARACTERISTIC TQS16_YC_FF_GAIN_OS_OUT_MED_SP_H_MU "" VALUE 0x8002096C CalPrmLatDynsCoorrBrk_SWORD 0 Gain -32768 32767 SYMBOL_LINK "CalPrmLatDynsCoorrBrk01.TQS16_YC_FF_GAIN_OS_OUT_MED_SP_H_MU" 0 /end CHARACTERISTIC
/begin CHARACTERISTIC TQS16_YC_FF_GAIN_OS_OUT_MED_SP_L_MU "" VALUE 0x80020962 CalPrmLatDynsCoorrBrk_SWORD 0 Gain -32768 32767 SYMBOL_LINK "CalPrmLatDynsCoorrBrk01.TQS16_YC_FF_GAIN_OS_OUT_MED_SP_L_MU" 0 /end CHARACTERISTIC
/begin CHARACTERISTIC TQS16_YC_FF_GAIN_OS_OUT_MED_SP_M_MU "" VALUE 0x80020968 CalPrmLatDynsCoorrBrk_SWORD 0 Gain -32768 32767 SYMBOL_LINK "CalPrmLatDynsCoorrBrk01.TQS16_YC_FF_GAIN_OS_OUT_MED_SP_M_MU" 0 /end CHARACTERISTIC
/begin CHARACTERISTIC TQS16_YC_P_GAIN_F_OS_IN_H "" VALUE 0x80020940 CalPrmLatDynsCoorrBrk_SWORD 0 Gain -32768 32767 SYMBOL_LINK "CalPrmLatDynsCoorrBrk01.TQS16_YC_P_GAIN_F_OS_IN_H" 0 /end CHARACTERISTIC
/begin CHARACTERISTIC TQS16_YC_P_GAIN_F_OS_IN_L "" VALUE 0x80020944 CalPrmLatDynsCoorrBrk_SWORD 0 Gain -32768 32767 SYMBOL_LINK "CalPrmLatDynsCoorrBrk01.TQS16_YC_P_GAIN_F_OS_IN_L" 0 /end CHARACTERISTIC
/begin CHARACTERISTIC TQS16_YC_P_GAIN_F_OS_IN_M "" VALUE 0x80020942 CalPrmLatDynsCoorrBrk_SWORD 0 Gain -32768 32767 SYMBOL_LINK "CalPrmLatDynsCoorrBrk01.TQS16_YC_P_GAIN_F_OS_IN_M" 0 /end CHARACTERISTIC
/begin CHARACTERISTIC TQS16_YC_P_GAIN_F_OS_OUT_DEC "" VALUE 0x80020952 CalPrmLatDynsCoorrBrk_SWORD 0 Gain -32768 32767 SYMBOL_LINK "CalPrmLatDynsCoorrBrk01.TQS16_YC_P_GAIN_F_OS_OUT_DEC" 0 /end CHARACTERISTIC
/begin CHARACTERISTIC TQS16_YC_P_GAIN_F_OS_OUT_DEC_H "" VALUE 0x8002094A CalPrmLatDynsCoorrBrk_SWORD 0 Gain -32768 32767 SYMBOL_LINK "CalPrmLatDynsCoorrBrk01.TQS16_YC_P_GAIN_F_OS_OUT_DEC_H" 0 /end CHARACTERISTIC
/begin CHARACTERISTIC TQS16_YC_P_GAIN_F_OS_OUT_DEC_L "" VALUE 0x8002095A CalPrmLatDynsCoorrBrk_SWORD 0 Gain -32768 32767 SYMBOL_LINK "CalPrmLatDynsCoorrBrk01.TQS16_YC_P_GAIN_F_OS_OUT_DEC_L" 0 /end CHARACTERISTIC
/begin CHARACTERISTIC TQS16_YC_P_GAIN_F_OS_OUT_INC "" VALUE 0x80020954 CalPrmLatDynsCoorrBrk_SWORD 0 Gain -32768 32767 SYMBOL_LINK "CalPrmLatDynsCoorrBrk01.TQS16_YC_P_GAIN_F_OS_OUT_INC" 0 /end CHARACTERISTIC
/begin CHARACTERISTIC TQS16_YC_P_GAIN_F_OS_OUT_INC_H "" VALUE 0x8002094C CalPrmLatDynsCoorrBrk_SWORD 0 Gain -32768 32767 SYMBOL_LINK "CalPrmLatDynsCoorrBrk01.TQS16_YC_P_GAIN_F_OS_OUT_INC_H" 0 /end CHARACTERISTIC
/begin CHARACTERISTIC TQS16_YC_P_GAIN_F_OS_OUT_INC_L "" VALUE 0x8002095C CalPrmLatDynsCoorrBrk_SWORD 0 Gain -32768 32767 SYMBOL_LINK "CalPrmLatDynsCoorrBrk01.TQS16_YC_P_GAIN_F_OS_OUT_INC_L" 0 /end CHARACTERISTIC
/begin CHARACTERISTIC TQS16_YC_P_GAIN_R_US_OUT_DEC "" VALUE 0x8002092E CalPrmLatDynsCoorrBrk_SWORD 0 Gain -32768 32767 SYMBOL_LINK "CalPrmLatDynsCoorrBrk01.TQS16_YC_P_GAIN_R_US_OUT_DEC" 0 /end CHARACTERISTIC
/begin CHARACTERISTIC TQS16_YC_P_GAIN_R_US_OUT_DEC_H "" VALUE 0x80020936 CalPrmLatDynsCoorrBrk_SWORD 0 Gain -32768 32767 SYMBOL_LINK "CalPrmLatDynsCoorrBrk01.TQS16_YC_P_GAIN_R_US_OUT_DEC_H" 0 /end CHARACTERISTIC
/begin CHARACTERISTIC TQS16_YC_P_GAIN_R_US_OUT_DEC_L "" VALUE 0x80020928 CalPrmLatDynsCoorrBrk_SWORD 0 Gain -32768 32767 SYMBOL_LINK "CalPrmLatDynsCoorrBrk01.TQS16_YC_P_GAIN_R_US_OUT_DEC_L" 0 /end CHARACTERISTIC
/begin CHARACTERISTIC TQS16_YC_P_GAIN_R_US_OUT_INC "" VALUE 0x80020930 CalPrmLatDynsCoorrBrk_SWORD 0 Gain -32768 32767 SYMBOL_LINK "CalPrmLatDynsCoorrBrk01.TQS16_YC_P_GAIN_R_US_OUT_INC" 0 /end CHARACTERISTIC
/begin CHARACTERISTIC TQS16_YC_P_GAIN_R_US_OUT_INC_H "" VALUE 0x80020938 CalPrmLatDynsCoorrBrk_SWORD 0 Gain -32768 32767 SYMBOL_LINK "CalPrmLatDynsCoorrBrk01.TQS16_YC_P_GAIN_R_US_OUT_INC_H" 0 /end CHARACTERISTIC
/begin CHARACTERISTIC TQS16_YC_P_GAIN_R_US_OUT_INC_L "" VALUE 0x80020926 CalPrmLatDynsCoorrBrk_SWORD 0 Gain -32768 32767 SYMBOL_LINK "CalPrmLatDynsCoorrBrk01.TQS16_YC_P_GAIN_R_US_OUT_INC_L" 0 /end CHARACTERISTIC
/begin CHARACTERISTIC TQS16_YC_R_SPEED_DEP_HIG_H_GAIN "" VALUE 0x800208DE CalPrmLatDynsCoorrBrk_SWORD 0 Gain -32768 32767 SYMBOL_LINK "CalPrmLatDynsCoorrBrk01.TQS16_YC_R_SPEED_DEP_HIG_H_GAIN" 0 /end CHARACTERISTIC
/begin CHARACTERISTIC TQS16_YC_R_SPEED_DEP_HIG_L_GAIN "" VALUE 0x800208CE CalPrmLatDynsCoorrBrk_SWORD 0 Gain -32768 32767 SYMBOL_LINK "CalPrmLatDynsCoorrBrk01.TQS16_YC_R_SPEED_DEP_HIG_L_GAIN" 0 /end CHARACTERISTIC
/begin CHARACTERISTIC TQS16_YC_R_SPEED_DEP_HIG_M_GAIN "" VALUE 0x800208D6 CalPrmLatDynsCoorrBrk_SWORD 0 Gain -32768 32767 SYMBOL_LINK "CalPrmLatDynsCoorrBrk01.TQS16_YC_R_SPEED_DEP_HIG_M_GAIN" 0 /end CHARACTERISTIC
/begin CHARACTERISTIC TQS16_YC_R_SPEED_DEP_LOW_H_GAIN "" VALUE 0x800208E2 CalPrmLatDynsCoorrBrk_SWORD 0 Gain -32768 32767 SYMBOL_LINK "CalPrmLatDynsCoorrBrk01.TQS16_YC_R_SPEED_DEP_LOW_H_GAIN" 0 /end CHARACTERISTIC
/begin CHARACTERISTIC TQS16_YC_R_SPEED_DEP_LOW_L_GAIN "" VALUE 0x800208D2 CalPrmLatDynsCoorrBrk_SWORD 0 Gain -32768 32767 SYMBOL_LINK "CalPrmLatDynsCoorrBrk01.TQS16_YC_R_SPEED_DEP_LOW_L_GAIN" 0 /end CHARACTERISTIC
/begin CHARACTERISTIC TQS16_YC_R_SPEED_DEP_LOW_M_GAIN "" VALUE 0x800208DA CalPrmLatDynsCoorrBrk_SWORD 0 Gain -32768 32767 SYMBOL_LINK "CalPrmLatDynsCoorrBrk01.TQS16_YC_R_SPEED_DEP_LOW_M_GAIN" 0 /end CHARACTERISTIC
/begin CHARACTERISTIC TQS16_YC_R_SPEED_DEP_MED_H_GAIN "" VALUE 0x800208E0 CalPrmLatDynsCoorrBrk_SWORD 0 Gain -32768 32767 SYMBOL_LINK "CalPrmLatDynsCoorrBrk01.TQS16_YC_R_SPEED_DEP_MED_H_GAIN" 0 /end CHARACTERISTIC
/begin CHARACTERISTIC TQS16_YC_R_SPEED_DEP_MED_L_GAIN "" VALUE 0x800208D0 CalPrmLatDynsCoorrBrk_SWORD 0 Gain -32768 32767 SYMBOL_LINK "CalPrmLatDynsCoorrBrk01.TQS16_YC_R_SPEED_DEP_MED_L_GAIN" 0 /end CHARACTERISTIC
/begin CHARACTERISTIC TQS16_YC_R_SPEED_DEP_MED_M_GAIN "" VALUE 0x800208D8 CalPrmLatDynsCoorrBrk_SWORD 0 Gain -32768 32767 SYMBOL_LINK "CalPrmLatDynsCoorrBrk01.TQS16_YC_R_SPEED_DEP_MED_M_GAIN" 0 /end CHARACTERISTIC
/begin CHARACTERISTIC TQS16_YC_R_SPEED_DEP_VLOW_H_GAIN "" VALUE 0x800208E4 CalPrmLatDynsCoorrBrk_SWORD 0 Gain -32768 32767 SYMBOL_LINK "CalPrmLatDynsCoorrBrk01.TQS16_YC_R_SPEED_DEP_VLOW_H_GAIN" 0 /end CHARACTERISTIC
/begin CHARACTERISTIC TQS16_YC_R_SPEED_DEP_VLOW_L_GAIN "" VALUE 0x800208D4 CalPrmLatDynsCoorrBrk_SWORD 0 Gain -32768 32767 SYMBOL_LINK "CalPrmLatDynsCoorrBrk01.TQS16_YC_R_SPEED_DEP_VLOW_L_GAIN" 0 /end CHARACTERISTIC
/begin CHARACTERISTIC TQS16_YC_R_SPEED_DEP_VLOW_M_GAIN "" VALUE 0x800208DC CalPrmLatDynsCoorrBrk_SWORD 0 Gain -32768 32767 SYMBOL_LINK "CalPrmLatDynsCoorrBrk01.TQS16_YC_R_SPEED_DEP_VLOW_M_GAIN" 0 /end CHARACTERISTIC
/begin CHARACTERISTIC TQS16_YC_R_SP_DEP_HIG_ABS_GAIN "" VALUE 0x800208BE CalPrmLatDynsCoorrBrk_SWORD 0 Gain -32768 32767 SYMBOL_LINK "CalPrmLatDynsCoorrBrk01.TQS16_YC_R_SP_DEP_HIG_ABS_GAIN" 0 /end CHARACTERISTIC
/begin CHARACTERISTIC TQS16_YC_R_SP_DEP_HIG_ABS_H_GAIN "" VALUE 0x800208C6 CalPrmLatDynsCoorrBrk_SWORD 0 Gain -32768 32767 SYMBOL_LINK "CalPrmLatDynsCoorrBrk01.TQS16_YC_R_SP_DEP_HIG_ABS_H_GAIN" 0 /end CHARACTERISTIC
/begin CHARACTERISTIC TQS16_YC_R_SP_DEP_HIG_ABS_L_GAIN "" VALUE 0x800208B6 CalPrmLatDynsCoorrBrk_SWORD 0 Gain -32768 32767 SYMBOL_LINK "CalPrmLatDynsCoorrBrk01.TQS16_YC_R_SP_DEP_HIG_ABS_L_GAIN" 0 /end CHARACTERISTIC
/begin CHARACTERISTIC TQS16_YC_R_SP_DEP_LOW_ABS_GAIN "" VALUE 0x800208C2 CalPrmLatDynsCoorrBrk_SWORD 0 Gain -32768 32767 SYMBOL_LINK "CalPrmLatDynsCoorrBrk01.TQS16_YC_R_SP_DEP_LOW_ABS_GAIN" 0 /end CHARACTERISTIC
/begin CHARACTERISTIC TQS16_YC_R_SP_DEP_LOW_ABS_H_GAIN "" VALUE 0x800208CA CalPrmLatDynsCoorrBrk_SWORD 0 Gain -32768 32767 SYMBOL_LINK "CalPrmLatDynsCoorrBrk01.TQS16_YC_R_SP_DEP_LOW_ABS_H_GAIN" 0 /end CHARACTERISTIC
/begin CHARACTERISTIC TQS16_YC_R_SP_DEP_LOW_ABS_L_GAIN "" VALUE 0x800208BA CalPrmLatDynsCoorrBrk_SWORD 0 Gain -32768 32767 SYMBOL_LINK "CalPrmLatDynsCoorrBrk01.TQS16_YC_R_SP_DEP_LOW_ABS_L_GAIN" 0 /end CHARACTERISTIC
/begin CHARACTERISTIC TQS16_YC_R_SP_DEP_MED_ABS_GAIN "" VALUE 0x800208C0 CalPrmLatDynsCoorrBrk_SWORD 0 Gain -32768 32767 SYMBOL_LINK "CalPrmLatDynsCoorrBrk01.TQS16_YC_R_SP_DEP_MED_ABS_GAIN" 0 /end CHARACTERISTIC
/begin CHARACTERISTIC TQS16_YC_R_SP_DEP_MED_ABS_H_GAIN "" VALUE 0x800208C8 CalPrmLatDynsCoorrBrk_SWORD 0 Gain -32768 32767 SYMBOL_LINK "CalPrmLatDynsCoorrBrk01.TQS16_YC_R_SP_DEP_MED_ABS_H_GAIN" 0 /end CHARACTERISTIC
/begin CHARACTERISTIC TQS16_YC_R_SP_DEP_MED_ABS_L_GAIN "" VALUE 0x800208B8 CalPrmLatDynsCoorrBrk_SWORD 0 Gain -32768 32767 SYMBOL_LINK "CalPrmLatDynsCoorrBrk01.TQS16_YC_R_SP_DEP_MED_ABS_L_GAIN" 0 /end CHARACTERISTIC
/begin CHARACTERISTIC TQS16_YC_R_SP_DEP_VLOW_ABS_GAIN "" VALUE 0x800208C4 CalPrmLatDynsCoorrBrk_SWORD 0 Gain -32768 32767 SYMBOL_LINK "CalPrmLatDynsCoorrBrk01.TQS16_YC_R_SP_DEP_VLOW_ABS_GAIN" 0 /end CHARACTERISTIC
/begin CHARACTERISTIC TQS16_YC_R_SP_DEP_VLOW_ABS_H_GAIN "" VALUE 0x800208CC CalPrmLatDynsCoorrBrk_SWORD 0 Gain -32768 32767 SYMBOL_LINK "CalPrmLatDynsCoorrBrk01.TQS16_YC_R_SP_DEP_VLOW_ABS_H_GAIN" 0 /end CHARACTERISTIC
/begin CHARACTERISTIC TQS16_YC_R_SP_DEP_VLOW_ABS_L_GAIN "" VALUE 0x800208BC CalPrmLatDynsCoorrBrk_SWORD 0 Gain -32768 32767 SYMBOL_LINK "CalPrmLatDynsCoorrBrk01.TQS16_YC_R_SP_DEP_VLOW_ABS_L_GAIN" 0 /end CHARACTERISTIC
/begin CHARACTERISTIC TQS16_YC_SPEED_DEP_HIG2_V "" VALUE 0x80020A14 CalPrmLatDynsCoorrBrk_SWORD 0 Gain -32768 32767 SYMBOL_LINK "CalPrmLatDynsCoorrBrk01.TQS16_YC_SPEED_DEP_HIG2_V" 0 /end CHARACTERISTIC
/begin CHARACTERISTIC TQS16_YC_SPEED_DEP_HIG_H_GAIN "" VALUE 0x80020912 CalPrmLatDynsCoorrBrk_SWORD 0 Gain -32768 32767 SYMBOL_LINK "CalPrmLatDynsCoorrBrk01.TQS16_YC_SPEED_DEP_HIG_H_GAIN" 0 /end CHARACTERISTIC
/begin CHARACTERISTIC TQS16_YC_SPEED_DEP_HIG_L_GAIN "" VALUE 0x80020902 CalPrmLatDynsCoorrBrk_SWORD 0 Gain -32768 32767 SYMBOL_LINK "CalPrmLatDynsCoorrBrk01.TQS16_YC_SPEED_DEP_HIG_L_GAIN" 0 /end CHARACTERISTIC
/begin CHARACTERISTIC TQS16_YC_SPEED_DEP_HIG_M_GAIN "" VALUE 0x8002090A CalPrmLatDynsCoorrBrk_SWORD 0 Gain -32768 32767 SYMBOL_LINK "CalPrmLatDynsCoorrBrk01.TQS16_YC_SPEED_DEP_HIG_M_GAIN" 0 /end CHARACTERISTIC
/begin CHARACTERISTIC TQS16_YC_SPEED_DEP_HIG_V "" VALUE 0x80020A12 CalPrmLatDynsCoorrBrk_SWORD 0 Gain -32768 32767 SYMBOL_LINK "CalPrmLatDynsCoorrBrk01.TQS16_YC_SPEED_DEP_HIG_V" 0 /end CHARACTERISTIC
/begin CHARACTERISTIC TQS16_YC_SPEED_DEP_LOW_H_GAIN "" VALUE 0x80020916 CalPrmLatDynsCoorrBrk_SWORD 0 Gain -32768 32767 SYMBOL_LINK "CalPrmLatDynsCoorrBrk01.TQS16_YC_SPEED_DEP_LOW_H_GAIN" 0 /end CHARACTERISTIC
/begin CHARACTERISTIC TQS16_YC_SPEED_DEP_LOW_L_GAIN "" VALUE 0x80020906 CalPrmLatDynsCoorrBrk_SWORD 0 Gain -32768 32767 SYMBOL_LINK "CalPrmLatDynsCoorrBrk01.TQS16_YC_SPEED_DEP_LOW_L_GAIN" 0 /end CHARACTERISTIC
/begin CHARACTERISTIC TQS16_YC_SPEED_DEP_LOW_M_GAIN "" VALUE 0x8002090E CalPrmLatDynsCoorrBrk_SWORD 0 Gain -32768 32767 SYMBOL_LINK "CalPrmLatDynsCoorrBrk01.TQS16_YC_SPEED_DEP_LOW_M_GAIN" 0 /end CHARACTERISTIC
/begin CHARACTERISTIC TQS16_YC_SPEED_DEP_LOW_V "" VALUE 0x80020A0C CalPrmLatDynsCoorrBrk_SWORD 0 Gain -32768 32767 SYMBOL_LINK "CalPrmLatDynsCoorrBrk01.TQS16_YC_SPEED_DEP_LOW_V" 0 /end CHARACTERISTIC
/begin CHARACTERISTIC TQS16_YC_SPEED_DEP_MED2_V "" VALUE 0x80020A10 CalPrmLatDynsCoorrBrk_SWORD 0 Gain -32768 32767 SYMBOL_LINK "CalPrmLatDynsCoorrBrk01.TQS16_YC_SPEED_DEP_MED2_V" 0 /end CHARACTERISTIC
/begin CHARACTERISTIC TQS16_YC_SPEED_DEP_MED_H_GAIN "" VALUE 0x80020914 CalPrmLatDynsCoorrBrk_SWORD 0 Gain -32768 32767 SYMBOL_LINK "CalPrmLatDynsCoorrBrk01.TQS16_YC_SPEED_DEP_MED_H_GAIN" 0 /end CHARACTERISTIC
/begin CHARACTERISTIC TQS16_YC_SPEED_DEP_MED_L_GAIN "" VALUE 0x80020904 CalPrmLatDynsCoorrBrk_SWORD 0 Gain -32768 32767 SYMBOL_LINK "CalPrmLatDynsCoorrBrk01.TQS16_YC_SPEED_DEP_MED_L_GAIN" 0 /end CHARACTERISTIC
/begin CHARACTERISTIC TQS16_YC_SPEED_DEP_MED_M_GAIN "" VALUE 0x8002090C CalPrmLatDynsCoorrBrk_SWORD 0 Gain -32768 32767 SYMBOL_LINK "CalPrmLatDynsCoorrBrk01.TQS16_YC_SPEED_DEP_MED_M_GAIN" 0 /end CHARACTERISTIC
/begin CHARACTERISTIC TQS16_YC_SPEED_DEP_MED_V "" VALUE 0x80020A0E CalPrmLatDynsCoorrBrk_SWORD 0 Gain -32768 32767 SYMBOL_LINK "CalPrmLatDynsCoorrBrk01.TQS16_YC_SPEED_DEP_MED_V" 0 /end CHARACTERISTIC
/begin CHARACTERISTIC TQS16_YC_SPEED_DEP_VER_HIG_V "" VALUE 0x80020A16 CalPrmLatDynsCoorrBrk_SWORD 0 Gain -32768 32767 SYMBOL_LINK "CalPrmLatDynsCoorrBrk01.TQS16_YC_SPEED_DEP_VER_HIG_V" 0 /end CHARACTERISTIC
/begin CHARACTERISTIC TQS16_YC_SPEED_DEP_VLOW_H_GAIN "" VALUE 0x80020918 CalPrmLatDynsCoorrBrk_SWORD 0 Gain -32768 32767 SYMBOL_LINK "CalPrmLatDynsCoorrBrk01.TQS16_YC_SPEED_DEP_VLOW_H_GAIN" 0 /end CHARACTERISTIC
/begin CHARACTERISTIC TQS16_YC_SPEED_DEP_VLOW_L_GAIN "" VALUE 0x80020908 CalPrmLatDynsCoorrBrk_SWORD 0 Gain -32768 32767 SYMBOL_LINK "CalPrmLatDynsCoorrBrk01.TQS16_YC_SPEED_DEP_VLOW_L_GAIN" 0 /end CHARACTERISTIC
/begin CHARACTERISTIC TQS16_YC_SPEED_DEP_VLOW_M_GAIN "" VALUE 0x80020910 CalPrmLatDynsCoorrBrk_SWORD 0 Gain -32768 32767 SYMBOL_LINK "CalPrmLatDynsCoorrBrk01.TQS16_YC_SPEED_DEP_VLOW_M_GAIN" 0 /end CHARACTERISTIC
/begin CHARACTERISTIC TQS16_YC_SPEED_DEP_VLOW_V "" VALUE 0x80020A0A CalPrmLatDynsCoorrBrk_SWORD 0 Gain -32768 32767 SYMBOL_LINK "CalPrmLatDynsCoorrBrk01.TQS16_YC_SPEED_DEP_VLOW_V" 0 /end CHARACTERISTIC
/begin CHARACTERISTIC TQh_roll "" VALUE 0x80020C30 CalPrmLatDynsCoorrBrk_SWORD 0 Gain -32768 32767 SYMBOL_LINK "CalPrmLatDynsCoorrBrk01.TQh_roll" 0 /end CHARACTERISTIC
/begin CHARACTERISTIC TQiix_roll "" VALUE 0x80020C32 CalPrmLatDynsCoorrBrk_SWORD 0 Gain -32768 32767 SYMBOL_LINK "CalPrmLatDynsCoorrBrk01.TQiix_roll" 0 /end CHARACTERISTIC
/begin CHARACTERISTIC TQmass_roll "" VALUE 0x80020C34 CalPrmLatDynsCoorrBrk_SWORD 0 Gain -32768 32767 SYMBOL_LINK "CalPrmLatDynsCoorrBrk01.TQmass_roll" 0 /end CHARACTERISTIC
/begin CHARACTERISTIC TQroll_damping "" VALUE 0x80020C36 CalPrmLatDynsCoorrBrk_SWORD 0 Gain -32768 32767 SYMBOL_LINK "CalPrmLatDynsCoorrBrk01.TQroll_damping" 0 /end CHARACTERISTIC
/begin CHARACTERISTIC TQroll_stiffness "" VALUE 0x80020C38 CalPrmLatDynsCoorrBrk_SWORD 0 Gain -32768 32767 SYMBOL_LINK "CalPrmLatDynsCoorrBrk01.TQroll_stiffness" 0 /end CHARACTERISTIC
/begin CHARACTERISTIC U16EpsiHndlgCtrlEntrAssiAg "" VALUE 0x8002183C CalPrmStrStabyCtrlBrk_UWORD 0 Gain 0 65535 SYMBOL_LINK "CalPrmStrStabyCtrlBrk01.U16EpsiHndlgCtrlEntrAssiAg" 0 /end CHARACTERISTIC
/begin CHARACTERISTIC U16EpsiHndlgCtrlEntrVehSpd "" VALUE 0x80021838 CalPrmStrStabyCtrlBrk_UWORD 0 Gain 0 65535 SYMBOL_LINK "CalPrmStrStabyCtrlBrk01.U16EpsiHndlgCtrlEntrVehSpd" 0 /end CHARACTERISTIC
/begin CHARACTERISTIC U16EpsiHndlgCtrlHldAssiAg "" VALUE 0x8002183E CalPrmStrStabyCtrlBrk_UWORD 0 Gain 0 65535 SYMBOL_LINK "CalPrmStrStabyCtrlBrk01.U16EpsiHndlgCtrlHldAssiAg" 0 /end CHARACTERISTIC
/begin CHARACTERISTIC U16EpsiHndlgCtrlHldVehSpd "" VALUE 0x8002183A CalPrmStrStabyCtrlBrk_UWORD 0 Gain 0 65535 SYMBOL_LINK "CalPrmStrStabyCtrlBrk01.U16EpsiHndlgCtrlHldVehSpd" 0 /end CHARACTERISTIC
/begin CHARACTERISTIC U16EpsiHndlgPGainWghtSteerWhlAgGrdt1 "" VALUE 0x80021874 CalPrmStrStabyCtrlBrk_UWORD 0 Gain 0 65535 SYMBOL_LINK "CalPrmStrStabyCtrlBrk01.U16EpsiHndlgPGainWghtSteerWhlAgGrdt1" 0 /end CHARACTERISTIC
/begin CHARACTERISTIC U16EpsiHndlgPGainWghtSteerWhlAgGrdt2 "" VALUE 0x80021876 CalPrmStrStabyCtrlBrk_UWORD 0 Gain 0 65535 SYMBOL_LINK "CalPrmStrStabyCtrlBrk01.U16EpsiHndlgPGainWghtSteerWhlAgGrdt2" 0 /end CHARACTERISTIC
/begin CHARACTERISTIC U16EpsiHndlgPGainWghtSteerWhlAgGrdt3 "" VALUE 0x80021878 CalPrmStrStabyCtrlBrk_UWORD 0 Gain 0 65535 SYMBOL_LINK "CalPrmStrStabyCtrlBrk01.U16EpsiHndlgPGainWghtSteerWhlAgGrdt3" 0 /end CHARACTERISTIC
/begin CHARACTERISTIC U16EpsiHndlgSteerWhlAgGrdtPGainWght1 "" VALUE 0x8002187A CalPrmStrStabyCtrlBrk_UWORD 0 Gain 0 65535 SYMBOL_LINK "CalPrmStrStabyCtrlBrk01.U16EpsiHndlgSteerWhlAgGrdtPGainWght1" 0 /end CHARACTERISTIC
/begin CHARACTERISTIC U16EpsiHndlgSteerWhlAgGrdtPGainWght2 "" VALUE 0x8002187C CalPrmStrStabyCtrlBrk_UWORD 0 Gain 0 65535 SYMBOL_LINK "CalPrmStrStabyCtrlBrk01.U16EpsiHndlgSteerWhlAgGrdtPGainWght2" 0 /end CHARACTERISTIC
/begin CHARACTERISTIC U16EpsiHndlgSteerWhlAgGrdtPGainWght3 "" VALUE 0x8002187E CalPrmStrStabyCtrlBrk_UWORD 0 Gain 0 65535 SYMBOL_LINK "CalPrmStrStabyCtrlBrk01.U16EpsiHndlgSteerWhlAgGrdtPGainWght3" 0 /end CHARACTERISTIC
/begin CHARACTERISTIC U16EpsiHndlgYawAssiAgVehSpdInsdIncDGain1 "" VALUE 0x8002186A CalPrmStrStabyCtrlBrk_UWORD 0 Gain 0 65535 SYMBOL_LINK "CalPrmStrStabyCtrlBrk01.U16EpsiHndlgYawAssiAgVehSpdInsdIncDGain1" 0 /end CHARACTERISTIC
/begin CHARACTERISTIC U16EpsiHndlgYawAssiAgVehSpdInsdIncDGain2 "" VALUE 0x8002186C CalPrmStrStabyCtrlBrk_UWORD 0 Gain 0 65535 SYMBOL_LINK "CalPrmStrStabyCtrlBrk01.U16EpsiHndlgYawAssiAgVehSpdInsdIncDGain2" 0 /end CHARACTERISTIC
/begin CHARACTERISTIC U16EpsiHndlgYawAssiAgVehSpdInsdIncDGain3 "" VALUE 0x8002186E CalPrmStrStabyCtrlBrk_UWORD 0 Gain 0 65535 SYMBOL_LINK "CalPrmStrStabyCtrlBrk01.U16EpsiHndlgYawAssiAgVehSpdInsdIncDGain3" 0 /end CHARACTERISTIC
/begin CHARACTERISTIC U16EpsiHndlgYawAssiAgVehSpdInsdIncDGain4 "" VALUE 0x80021870 CalPrmStrStabyCtrlBrk_UWORD 0 Gain 0 65535 SYMBOL_LINK "CalPrmStrStabyCtrlBrk01.U16EpsiHndlgYawAssiAgVehSpdInsdIncDGain4" 0 /end CHARACTERISTIC
/begin CHARACTERISTIC U16EpsiHndlgYawAssiAgVehSpdInsdIncDGain5 "" VALUE 0x80021872 CalPrmStrStabyCtrlBrk_UWORD 0 Gain 0 65535 SYMBOL_LINK "CalPrmStrStabyCtrlBrk01.U16EpsiHndlgYawAssiAgVehSpdInsdIncDGain5" 0 /end CHARACTERISTIC
/begin CHARACTERISTIC U16EpsiHndlgYawAssiAgVehSpdOutdDecDGain1 "" VALUE 0x80021860 CalPrmStrStabyCtrlBrk_UWORD 0 Gain 0 65535 SYMBOL_LINK "CalPrmStrStabyCtrlBrk01.U16EpsiHndlgYawAssiAgVehSpdOutdDecDGain1" 0 /end CHARACTERISTIC
/begin CHARACTERISTIC U16EpsiHndlgYawAssiAgVehSpdOutdDecDGain2 "" VALUE 0x80021862 CalPrmStrStabyCtrlBrk_UWORD 0 Gain 0 65535 SYMBOL_LINK "CalPrmStrStabyCtrlBrk01.U16EpsiHndlgYawAssiAgVehSpdOutdDecDGain2" 0 /end CHARACTERISTIC
/begin CHARACTERISTIC U16EpsiHndlgYawAssiAgVehSpdOutdDecDGain3 "" VALUE 0x80021864 CalPrmStrStabyCtrlBrk_UWORD 0 Gain 0 65535 SYMBOL_LINK "CalPrmStrStabyCtrlBrk01.U16EpsiHndlgYawAssiAgVehSpdOutdDecDGain3" 0 /end CHARACTERISTIC
/begin CHARACTERISTIC U16EpsiHndlgYawAssiAgVehSpdOutdDecDGain4 "" VALUE 0x80021866 CalPrmStrStabyCtrlBrk_UWORD 0 Gain 0 65535 SYMBOL_LINK "CalPrmStrStabyCtrlBrk01.U16EpsiHndlgYawAssiAgVehSpdOutdDecDGain4" 0 /end CHARACTERISTIC
/begin CHARACTERISTIC U16EpsiHndlgYawAssiAgVehSpdOutdDecDGain5 "" VALUE 0x80021868 CalPrmStrStabyCtrlBrk_UWORD 0 Gain 0 65535 SYMBOL_LINK "CalPrmStrStabyCtrlBrk01.U16EpsiHndlgYawAssiAgVehSpdOutdDecDGain5" 0 /end CHARACTERISTIC
/begin CHARACTERISTIC U16EpsiHndlgYawAssiAgVehSpdOutdDecPGain1 "" VALUE 0x80021856 CalPrmStrStabyCtrlBrk_UWORD 0 Gain 0 65535 SYMBOL_LINK "CalPrmStrStabyCtrlBrk01.U16EpsiHndlgYawAssiAgVehSpdOutdDecPGain1" 0 /end CHARACTERISTIC
/begin CHARACTERISTIC U16EpsiHndlgYawAssiAgVehSpdOutdDecPGain2 "" VALUE 0x80021858 CalPrmStrStabyCtrlBrk_UWORD 0 Gain 0 65535 SYMBOL_LINK "CalPrmStrStabyCtrlBrk01.U16EpsiHndlgYawAssiAgVehSpdOutdDecPGain2" 0 /end CHARACTERISTIC
/begin CHARACTERISTIC U16EpsiHndlgYawAssiAgVehSpdOutdDecPGain3 "" VALUE 0x8002185A CalPrmStrStabyCtrlBrk_UWORD 0 Gain 0 65535 SYMBOL_LINK "CalPrmStrStabyCtrlBrk01.U16EpsiHndlgYawAssiAgVehSpdOutdDecPGain3" 0 /end CHARACTERISTIC
/begin CHARACTERISTIC U16EpsiHndlgYawAssiAgVehSpdOutdDecPGain4 "" VALUE 0x8002185C CalPrmStrStabyCtrlBrk_UWORD 0 Gain 0 65535 SYMBOL_LINK "CalPrmStrStabyCtrlBrk01.U16EpsiHndlgYawAssiAgVehSpdOutdDecPGain4" 0 /end CHARACTERISTIC
/begin CHARACTERISTIC U16EpsiHndlgYawAssiAgVehSpdOutdDecPGain5 "" VALUE 0x8002185E CalPrmStrStabyCtrlBrk_UWORD 0 Gain 0 65535 SYMBOL_LINK "CalPrmStrStabyCtrlBrk01.U16EpsiHndlgYawAssiAgVehSpdOutdDecPGain5" 0 /end CHARACTERISTIC
/begin CHARACTERISTIC U16EpsiHndlgYawAssiAgVehSpdOutdIncDGain1 "" VALUE 0x8002184C CalPrmStrStabyCtrlBrk_UWORD 0 Gain 0 65535 SYMBOL_LINK "CalPrmStrStabyCtrlBrk01.U16EpsiHndlgYawAssiAgVehSpdOutdIncDGain1" 0 /end CHARACTERISTIC
/begin CHARACTERISTIC U16EpsiHndlgYawAssiAgVehSpdOutdIncDGain2 "" VALUE 0x8002184E CalPrmStrStabyCtrlBrk_UWORD 0 Gain 0 65535 SYMBOL_LINK "CalPrmStrStabyCtrlBrk01.U16EpsiHndlgYawAssiAgVehSpdOutdIncDGain2" 0 /end CHARACTERISTIC
/begin CHARACTERISTIC U16EpsiHndlgYawAssiAgVehSpdOutdIncDGain3 "" VALUE 0x80021850 CalPrmStrStabyCtrlBrk_UWORD 0 Gain 0 65535 SYMBOL_LINK "CalPrmStrStabyCtrlBrk01.U16EpsiHndlgYawAssiAgVehSpdOutdIncDGain3" 0 /end CHARACTERISTIC
/begin CHARACTERISTIC U16EpsiHndlgYawAssiAgVehSpdOutdIncDGain4 "" VALUE 0x80021852 CalPrmStrStabyCtrlBrk_UWORD 0 Gain 0 65535 SYMBOL_LINK "CalPrmStrStabyCtrlBrk01.U16EpsiHndlgYawAssiAgVehSpdOutdIncDGain4" 0 /end CHARACTERISTIC
/begin CHARACTERISTIC U16EpsiHndlgYawAssiAgVehSpdOutdIncDGain5 "" VALUE 0x80021854 CalPrmStrStabyCtrlBrk_UWORD 0 Gain 0 65535 SYMBOL_LINK "CalPrmStrStabyCtrlBrk01.U16EpsiHndlgYawAssiAgVehSpdOutdIncDGain5" 0 /end CHARACTERISTIC
/begin CHARACTERISTIC U16EpsiHndlgYawAssiAgVehSpdOutdIncPGain1 "" VALUE 0x80021842 CalPrmStrStabyCtrlBrk_UWORD 0 Gain 0 65535 SYMBOL_LINK "CalPrmStrStabyCtrlBrk01.U16EpsiHndlgYawAssiAgVehSpdOutdIncPGain1" 0 /end CHARACTERISTIC
/begin CHARACTERISTIC U16EpsiHndlgYawAssiAgVehSpdOutdIncPGain2 "" VALUE 0x80021844 CalPrmStrStabyCtrlBrk_UWORD 0 Gain 0 65535 SYMBOL_LINK "CalPrmStrStabyCtrlBrk01.U16EpsiHndlgYawAssiAgVehSpdOutdIncPGain2" 0 /end CHARACTERISTIC
/begin CHARACTERISTIC U16EpsiHndlgYawAssiAgVehSpdOutdIncPGain3 "" VALUE 0x80021846 CalPrmStrStabyCtrlBrk_UWORD 0 Gain 0 65535 SYMBOL_LINK "CalPrmStrStabyCtrlBrk01.U16EpsiHndlgYawAssiAgVehSpdOutdIncPGain3" 0 /end CHARACTERISTIC
/begin CHARACTERISTIC U16EpsiHndlgYawAssiAgVehSpdOutdIncPGain4 "" VALUE 0x80021848 CalPrmStrStabyCtrlBrk_UWORD 0 Gain 0 65535 SYMBOL_LINK "CalPrmStrStabyCtrlBrk01.U16EpsiHndlgYawAssiAgVehSpdOutdIncPGain4" 0 /end CHARACTERISTIC
/begin CHARACTERISTIC U16EpsiHndlgYawAssiAgVehSpdOutdIncPGain5 "" VALUE 0x8002184A CalPrmStrStabyCtrlBrk_UWORD 0 Gain 0 65535 SYMBOL_LINK "CalPrmStrStabyCtrlBrk01.U16EpsiHndlgYawAssiAgVehSpdOutdIncPGain5" 0 /end CHARACTERISTIC
/begin CHARACTERISTIC U16EpsiSplitAgToTqDGain "" VALUE 0x8002181A CalPrmStrStabyCtrlBrk_UWORD 0 Gain 0 65535 SYMBOL_LINK "CalPrmStrStabyCtrlBrk01.U16EpsiSplitAgToTqDGain" 0 /end CHARACTERISTIC
/begin CHARACTERISTIC U16EpsiSplitAgToTqPGain "" VALUE 0x80021818 CalPrmStrStabyCtrlBrk_UWORD 0 Gain 0 65535 SYMBOL_LINK "CalPrmStrStabyCtrlBrk01.U16EpsiSplitAgToTqPGain" 0 /end CHARACTERISTIC
/begin CHARACTERISTIC U16EpsiSplitAgToTqVehSpdNegGain1 "" VALUE 0x80021826 CalPrmStrStabyCtrlBrk_UWORD 0 Gain 0 65535 SYMBOL_LINK "CalPrmStrStabyCtrlBrk01.U16EpsiSplitAgToTqVehSpdNegGain1" 0 /end CHARACTERISTIC
/begin CHARACTERISTIC U16EpsiSplitAgToTqVehSpdNegGain2 "" VALUE 0x80021828 CalPrmStrStabyCtrlBrk_UWORD 0 Gain 0 65535 SYMBOL_LINK "CalPrmStrStabyCtrlBrk01.U16EpsiSplitAgToTqVehSpdNegGain2" 0 /end CHARACTERISTIC
/begin CHARACTERISTIC U16EpsiSplitAgToTqVehSpdNegGain3 "" VALUE 0x8002182A CalPrmStrStabyCtrlBrk_UWORD 0 Gain 0 65535 SYMBOL_LINK "CalPrmStrStabyCtrlBrk01.U16EpsiSplitAgToTqVehSpdNegGain3" 0 /end CHARACTERISTIC
/begin CHARACTERISTIC U16EpsiSplitAgToTqVehSpdNegGain4 "" VALUE 0x8002182C CalPrmStrStabyCtrlBrk_UWORD 0 Gain 0 65535 SYMBOL_LINK "CalPrmStrStabyCtrlBrk01.U16EpsiSplitAgToTqVehSpdNegGain4" 0 /end CHARACTERISTIC
/begin CHARACTERISTIC U16EpsiSplitAgToTqVehSpdNegGain5 "" VALUE 0x8002182E CalPrmStrStabyCtrlBrk_UWORD 0 Gain 0 65535 SYMBOL_LINK "CalPrmStrStabyCtrlBrk01.U16EpsiSplitAgToTqVehSpdNegGain5" 0 /end CHARACTERISTIC
/begin CHARACTERISTIC U16EpsiSplitAgToTqVehSpdPosGain1 "" VALUE 0x8002181C CalPrmStrStabyCtrlBrk_UWORD 0 Gain 0 65535 SYMBOL_LINK "CalPrmStrStabyCtrlBrk01.U16EpsiSplitAgToTqVehSpdPosGain1" 0 /end CHARACTERISTIC
/begin CHARACTERISTIC U16EpsiSplitAgToTqVehSpdPosGain2 "" VALUE 0x8002181E CalPrmStrStabyCtrlBrk_UWORD 0 Gain 0 65535 SYMBOL_LINK "CalPrmStrStabyCtrlBrk01.U16EpsiSplitAgToTqVehSpdPosGain2" 0 /end CHARACTERISTIC
/begin CHARACTERISTIC U16EpsiSplitAgToTqVehSpdPosGain3 "" VALUE 0x80021820 CalPrmStrStabyCtrlBrk_UWORD 0 Gain 0 65535 SYMBOL_LINK "CalPrmStrStabyCtrlBrk01.U16EpsiSplitAgToTqVehSpdPosGain3" 0 /end CHARACTERISTIC
/begin CHARACTERISTIC U16EpsiSplitAgToTqVehSpdPosGain4 "" VALUE 0x80021822 CalPrmStrStabyCtrlBrk_UWORD 0 Gain 0 65535 SYMBOL_LINK "CalPrmStrStabyCtrlBrk01.U16EpsiSplitAgToTqVehSpdPosGain4" 0 /end CHARACTERISTIC
/begin CHARACTERISTIC U16EpsiSplitAgToTqVehSpdPosGain5 "" VALUE 0x80021824 CalPrmStrStabyCtrlBrk_UWORD 0 Gain 0 65535 SYMBOL_LINK "CalPrmStrStabyCtrlBrk01.U16EpsiSplitAgToTqVehSpdPosGain5" 0 /end CHARACTERISTIC
/begin CHARACTERISTIC U16EpsiSplitAssiAgEstimdPeakPErr1 "" VALUE 0x800217BA CalPrmStrStabyCtrlBrk_UWORD 0 Gain 0 65535 SYMBOL_LINK "CalPrmStrStabyCtrlBrk01.U16EpsiSplitAssiAgEstimdPeakPErr1" 0 /end CHARACTERISTIC
/begin CHARACTERISTIC U16EpsiSplitAssiAgEstimdPeakPErr2 "" VALUE 0x800217BC CalPrmStrStabyCtrlBrk_UWORD 0 Gain 0 65535 SYMBOL_LINK "CalPrmStrStabyCtrlBrk01.U16EpsiSplitAssiAgEstimdPeakPErr2" 0 /end CHARACTERISTIC
/begin CHARACTERISTIC U16EpsiSplitAssiAgEstimdPeakPErr3 "" VALUE 0x800217BE CalPrmStrStabyCtrlBrk_UWORD 0 Gain 0 65535 SYMBOL_LINK "CalPrmStrStabyCtrlBrk01.U16EpsiSplitAssiAgEstimdPeakPErr3" 0 /end CHARACTERISTIC
/begin CHARACTERISTIC U16EpsiSplitAssiAgEstimdPeakPErr4 "" VALUE 0x800217C0 CalPrmStrStabyCtrlBrk_UWORD 0 Gain 0 65535 SYMBOL_LINK "CalPrmStrStabyCtrlBrk01.U16EpsiSplitAssiAgEstimdPeakPErr4" 0 /end CHARACTERISTIC
/begin CHARACTERISTIC U16EpsiSplitAssiAgEstimdPeakPErr5 "" VALUE 0x800217C2 CalPrmStrStabyCtrlBrk_UWORD 0 Gain 0 65535 SYMBOL_LINK "CalPrmStrStabyCtrlBrk01.U16EpsiSplitAssiAgEstimdPeakPErr5" 0 /end CHARACTERISTIC
/begin CHARACTERISTIC U16EpsiSplitAssiAgGmaSlipGain "" VALUE 0x800217D8 CalPrmStrStabyCtrlBrk_UWORD 0 Gain 0 65535 SYMBOL_LINK "CalPrmStrStabyCtrlBrk01.U16EpsiSplitAssiAgGmaSlipGain" 0 /end CHARACTERISTIC
/begin CHARACTERISTIC U16EpsiSplitAssiAgVehSpdGain1 "" VALUE 0x800217CE CalPrmStrStabyCtrlBrk_UWORD 0 Gain 0 65535 SYMBOL_LINK "CalPrmStrStabyCtrlBrk01.U16EpsiSplitAssiAgVehSpdGain1" 0 /end CHARACTERISTIC
/begin CHARACTERISTIC U16EpsiSplitAssiAgVehSpdGain2 "" VALUE 0x800217D0 CalPrmStrStabyCtrlBrk_UWORD 0 Gain 0 65535 SYMBOL_LINK "CalPrmStrStabyCtrlBrk01.U16EpsiSplitAssiAgVehSpdGain2" 0 /end CHARACTERISTIC
/begin CHARACTERISTIC U16EpsiSplitAssiAgVehSpdGain3 "" VALUE 0x800217D2 CalPrmStrStabyCtrlBrk_UWORD 0 Gain 0 65535 SYMBOL_LINK "CalPrmStrStabyCtrlBrk01.U16EpsiSplitAssiAgVehSpdGain3" 0 /end CHARACTERISTIC
/begin CHARACTERISTIC U16EpsiSplitAssiAgVehSpdGain4 "" VALUE 0x800217D4 CalPrmStrStabyCtrlBrk_UWORD 0 Gain 0 65535 SYMBOL_LINK "CalPrmStrStabyCtrlBrk01.U16EpsiSplitAssiAgVehSpdGain4" 0 /end CHARACTERISTIC
/begin CHARACTERISTIC U16EpsiSplitAssiAgVehSpdGain5 "" VALUE 0x800217D6 CalPrmStrStabyCtrlBrk_UWORD 0 Gain 0 65535 SYMBOL_LINK "CalPrmStrStabyCtrlBrk01.U16EpsiSplitAssiAgVehSpdGain5" 0 /end CHARACTERISTIC
/begin CHARACTERISTIC U16EpsiSplitCtrlEntrAssiAg "" VALUE 0x800217B6 CalPrmStrStabyCtrlBrk_UWORD 0 Gain 0 65535 SYMBOL_LINK "CalPrmStrStabyCtrlBrk01.U16EpsiSplitCtrlEntrAssiAg" 0 /end CHARACTERISTIC
/begin CHARACTERISTIC U16EpsiSplitCtrlEntrVehSpd "" VALUE 0x800217B2 CalPrmStrStabyCtrlBrk_UWORD 0 Gain 0 65535 SYMBOL_LINK "CalPrmStrStabyCtrlBrk01.U16EpsiSplitCtrlEntrVehSpd" 0 /end CHARACTERISTIC
/begin CHARACTERISTIC U16EpsiSplitCtrlHldAssiAg "" VALUE 0x800217B8 CalPrmStrStabyCtrlBrk_UWORD 0 Gain 0 65535 SYMBOL_LINK "CalPrmStrStabyCtrlBrk01.U16EpsiSplitCtrlHldAssiAg" 0 /end CHARACTERISTIC
/begin CHARACTERISTIC U16EpsiSplitCtrlHldVehSpd "" VALUE 0x800217B4 CalPrmStrStabyCtrlBrk_UWORD 0 Gain 0 65535 SYMBOL_LINK "CalPrmStrStabyCtrlBrk01.U16EpsiSplitCtrlHldVehSpd" 0 /end CHARACTERISTIC
/begin CHARACTERISTIC U16EpsiSplitDetALat "" VALUE 0x800217AC CalPrmStrStabyCtrlBrk_UWORD 0 Gain 0 65535 SYMBOL_LINK "CalPrmStrStabyCtrlBrk01.U16EpsiSplitDetALat" 0 /end CHARACTERISTIC
/begin CHARACTERISTIC U16EpsiSplitDrvrCoeffDrvrTqMin "" VALUE 0x80021814 CalPrmStrStabyCtrlBrk_UWORD 0 Gain 0 65535 SYMBOL_LINK "CalPrmStrStabyCtrlBrk01.U16EpsiSplitDrvrCoeffDrvrTqMin" 0 /end CHARACTERISTIC
/begin CHARACTERISTIC U16EpsiSplitDrvrCoeffSteerGrdtMin "" VALUE 0x80021816 CalPrmStrStabyCtrlBrk_UWORD 0 Gain 0 65535 SYMBOL_LINK "CalPrmStrStabyCtrlBrk01.U16EpsiSplitDrvrCoeffSteerGrdtMin" 0 /end CHARACTERISTIC
/begin CHARACTERISTIC U16EpsiSplitDrvrTqThdSteerGrdt11 "" VALUE 0x800217F4 CalPrmStrStabyCtrlBrk_UWORD 0 Gain 0 65535 SYMBOL_LINK "CalPrmStrStabyCtrlBrk01.U16EpsiSplitDrvrTqThdSteerGrdt11" 0 /end CHARACTERISTIC
/begin CHARACTERISTIC U16EpsiSplitDrvrTqThdSteerGrdt12 "" VALUE 0x800217F6 CalPrmStrStabyCtrlBrk_UWORD 0 Gain 0 65535 SYMBOL_LINK "CalPrmStrStabyCtrlBrk01.U16EpsiSplitDrvrTqThdSteerGrdt12" 0 /end CHARACTERISTIC
/begin CHARACTERISTIC U16EpsiSplitDrvrTqThdSteerGrdt21 "" VALUE 0x800217FC CalPrmStrStabyCtrlBrk_UWORD 0 Gain 0 65535 SYMBOL_LINK "CalPrmStrStabyCtrlBrk01.U16EpsiSplitDrvrTqThdSteerGrdt21" 0 /end CHARACTERISTIC
/begin CHARACTERISTIC U16EpsiSplitDrvrTqThdSteerGrdt22 "" VALUE 0x800217FE CalPrmStrStabyCtrlBrk_UWORD 0 Gain 0 65535 SYMBOL_LINK "CalPrmStrStabyCtrlBrk01.U16EpsiSplitDrvrTqThdSteerGrdt22" 0 /end CHARACTERISTIC
/begin CHARACTERISTIC U16EpsiSplitDrvrTqThdSteerGrdt31 "" VALUE 0x80021804 CalPrmStrStabyCtrlBrk_UWORD 0 Gain 0 65535 SYMBOL_LINK "CalPrmStrStabyCtrlBrk01.U16EpsiSplitDrvrTqThdSteerGrdt31" 0 /end CHARACTERISTIC
/begin CHARACTERISTIC U16EpsiSplitDrvrTqThdSteerGrdt32 "" VALUE 0x80021806 CalPrmStrStabyCtrlBrk_UWORD 0 Gain 0 65535 SYMBOL_LINK "CalPrmStrStabyCtrlBrk01.U16EpsiSplitDrvrTqThdSteerGrdt32" 0 /end CHARACTERISTIC
/begin CHARACTERISTIC U16EpsiSplitDrvrTqThdSteerGrdt41 "" VALUE 0x8002180C CalPrmStrStabyCtrlBrk_UWORD 0 Gain 0 65535 SYMBOL_LINK "CalPrmStrStabyCtrlBrk01.U16EpsiSplitDrvrTqThdSteerGrdt41" 0 /end CHARACTERISTIC
/begin CHARACTERISTIC U16EpsiSplitDrvrTqThdSteerGrdt42 "" VALUE 0x8002180E CalPrmStrStabyCtrlBrk_UWORD 0 Gain 0 65535 SYMBOL_LINK "CalPrmStrStabyCtrlBrk01.U16EpsiSplitDrvrTqThdSteerGrdt42" 0 /end CHARACTERISTIC
/begin CHARACTERISTIC U16EpsiSplitEstimdPeakPErrAssiAg1 "" VALUE 0x800217C4 CalPrmStrStabyCtrlBrk_UWORD 0 Gain 0 65535 SYMBOL_LINK "CalPrmStrStabyCtrlBrk01.U16EpsiSplitEstimdPeakPErrAssiAg1" 0 /end CHARACTERISTIC
/begin CHARACTERISTIC U16EpsiSplitEstimdPeakPErrAssiAg2 "" VALUE 0x800217C6 CalPrmStrStabyCtrlBrk_UWORD 0 Gain 0 65535 SYMBOL_LINK "CalPrmStrStabyCtrlBrk01.U16EpsiSplitEstimdPeakPErrAssiAg2" 0 /end CHARACTERISTIC
/begin CHARACTERISTIC U16EpsiSplitEstimdPeakPErrAssiAg3 "" VALUE 0x800217C8 CalPrmStrStabyCtrlBrk_UWORD 0 Gain 0 65535 SYMBOL_LINK "CalPrmStrStabyCtrlBrk01.U16EpsiSplitEstimdPeakPErrAssiAg3" 0 /end CHARACTERISTIC
/begin CHARACTERISTIC U16EpsiSplitEstimdPeakPErrAssiAg4 "" VALUE 0x800217CA CalPrmStrStabyCtrlBrk_UWORD 0 Gain 0 65535 SYMBOL_LINK "CalPrmStrStabyCtrlBrk01.U16EpsiSplitEstimdPeakPErrAssiAg4" 0 /end CHARACTERISTIC
/begin CHARACTERISTIC U16EpsiSplitEstimdPeakPErrAssiAg5 "" VALUE 0x800217CC CalPrmStrStabyCtrlBrk_UWORD 0 Gain 0 65535 SYMBOL_LINK "CalPrmStrStabyCtrlBrk01.U16EpsiSplitEstimdPeakPErrAssiAg5" 0 /end CHARACTERISTIC
/begin CHARACTERISTIC U16EpsiSplitSteerGrdtDrvrTqThd11 "" VALUE 0x800217F8 CalPrmStrStabyCtrlBrk_UWORD 0 Gain 0 65535 SYMBOL_LINK "CalPrmStrStabyCtrlBrk01.U16EpsiSplitSteerGrdtDrvrTqThd11" 0 /end CHARACTERISTIC
/begin CHARACTERISTIC U16EpsiSplitSteerGrdtDrvrTqThd12 "" VALUE 0x800217FA CalPrmStrStabyCtrlBrk_UWORD 0 Gain 0 65535 SYMBOL_LINK "CalPrmStrStabyCtrlBrk01.U16EpsiSplitSteerGrdtDrvrTqThd12" 0 /end CHARACTERISTIC
/begin CHARACTERISTIC U16EpsiSplitSteerGrdtDrvrTqThd21 "" VALUE 0x80021800 CalPrmStrStabyCtrlBrk_UWORD 0 Gain 0 65535 SYMBOL_LINK "CalPrmStrStabyCtrlBrk01.U16EpsiSplitSteerGrdtDrvrTqThd21" 0 /end CHARACTERISTIC
/begin CHARACTERISTIC U16EpsiSplitSteerGrdtDrvrTqThd22 "" VALUE 0x80021802 CalPrmStrStabyCtrlBrk_UWORD 0 Gain 0 65535 SYMBOL_LINK "CalPrmStrStabyCtrlBrk01.U16EpsiSplitSteerGrdtDrvrTqThd22" 0 /end CHARACTERISTIC
/begin CHARACTERISTIC U16EpsiSplitSteerGrdtDrvrTqThd31 "" VALUE 0x80021808 CalPrmStrStabyCtrlBrk_UWORD 0 Gain 0 65535 SYMBOL_LINK "CalPrmStrStabyCtrlBrk01.U16EpsiSplitSteerGrdtDrvrTqThd31" 0 /end CHARACTERISTIC
/begin CHARACTERISTIC U16EpsiSplitSteerGrdtDrvrTqThd32 "" VALUE 0x8002180A CalPrmStrStabyCtrlBrk_UWORD 0 Gain 0 65535 SYMBOL_LINK "CalPrmStrStabyCtrlBrk01.U16EpsiSplitSteerGrdtDrvrTqThd32" 0 /end CHARACTERISTIC
/begin CHARACTERISTIC U16EpsiSplitSteerGrdtDrvrTqThd41 "" VALUE 0x80021810 CalPrmStrStabyCtrlBrk_UWORD 0 Gain 0 65535 SYMBOL_LINK "CalPrmStrStabyCtrlBrk01.U16EpsiSplitSteerGrdtDrvrTqThd41" 0 /end CHARACTERISTIC
/begin CHARACTERISTIC U16EpsiSplitSteerGrdtDrvrTqThd42 "" VALUE 0x80021812 CalPrmStrStabyCtrlBrk_UWORD 0 Gain 0 65535 SYMBOL_LINK "CalPrmStrStabyCtrlBrk01.U16EpsiSplitSteerGrdtDrvrTqThd42" 0 /end CHARACTERISTIC
/begin CHARACTERISTIC U16EpsiSplitYawAssiAgVehSpdIGain1 "" VALUE 0x800217E4 CalPrmStrStabyCtrlBrk_UWORD 0 Gain 0 65535 SYMBOL_LINK "CalPrmStrStabyCtrlBrk01.U16EpsiSplitYawAssiAgVehSpdIGain1" 0 /end CHARACTERISTIC
/begin CHARACTERISTIC U16EpsiSplitYawAssiAgVehSpdIGain2 "" VALUE 0x800217E6 CalPrmStrStabyCtrlBrk_UWORD 0 Gain 0 65535 SYMBOL_LINK "CalPrmStrStabyCtrlBrk01.U16EpsiSplitYawAssiAgVehSpdIGain2" 0 /end CHARACTERISTIC
/begin CHARACTERISTIC U16EpsiSplitYawAssiAgVehSpdIGain3 "" VALUE 0x800217E8 CalPrmStrStabyCtrlBrk_UWORD 0 Gain 0 65535 SYMBOL_LINK "CalPrmStrStabyCtrlBrk01.U16EpsiSplitYawAssiAgVehSpdIGain3" 0 /end CHARACTERISTIC
/begin CHARACTERISTIC U16EpsiSplitYawAssiAgVehSpdIGain4 "" VALUE 0x800217EA CalPrmStrStabyCtrlBrk_UWORD 0 Gain 0 65535 SYMBOL_LINK "CalPrmStrStabyCtrlBrk01.U16EpsiSplitYawAssiAgVehSpdIGain4" 0 /end CHARACTERISTIC
/begin CHARACTERISTIC U16EpsiSplitYawAssiAgVehSpdIGain5 "" VALUE 0x800217EC CalPrmStrStabyCtrlBrk_UWORD 0 Gain 0 65535 SYMBOL_LINK "CalPrmStrStabyCtrlBrk01.U16EpsiSplitYawAssiAgVehSpdIGain5" 0 /end CHARACTERISTIC
/begin CHARACTERISTIC U16EpsiSplitYawAssiAgVehSpdPGain1 "" VALUE 0x800217DA CalPrmStrStabyCtrlBrk_UWORD 0 Gain 0 65535 SYMBOL_LINK "CalPrmStrStabyCtrlBrk01.U16EpsiSplitYawAssiAgVehSpdPGain1" 0 /end CHARACTERISTIC
/begin CHARACTERISTIC U16EpsiSplitYawAssiAgVehSpdPGain2 "" VALUE 0x800217DC CalPrmStrStabyCtrlBrk_UWORD 0 Gain 0 65535 SYMBOL_LINK "CalPrmStrStabyCtrlBrk01.U16EpsiSplitYawAssiAgVehSpdPGain2" 0 /end CHARACTERISTIC
/begin CHARACTERISTIC U16EpsiSplitYawAssiAgVehSpdPGain3 "" VALUE 0x800217DE CalPrmStrStabyCtrlBrk_UWORD 0 Gain 0 65535 SYMBOL_LINK "CalPrmStrStabyCtrlBrk01.U16EpsiSplitYawAssiAgVehSpdPGain3" 0 /end CHARACTERISTIC
/begin CHARACTERISTIC U16EpsiSplitYawAssiAgVehSpdPGain4 "" VALUE 0x800217E0 CalPrmStrStabyCtrlBrk_UWORD 0 Gain 0 65535 SYMBOL_LINK "CalPrmStrStabyCtrlBrk01.U16EpsiSplitYawAssiAgVehSpdPGain4" 0 /end CHARACTERISTIC
/begin CHARACTERISTIC U16EpsiSplitYawAssiAgVehSpdPGain5 "" VALUE 0x800217E2 CalPrmStrStabyCtrlBrk_UWORD 0 Gain 0 65535 SYMBOL_LINK "CalPrmStrStabyCtrlBrk01.U16EpsiSplitYawAssiAgVehSpdPGain5" 0 /end CHARACTERISTIC
/begin CHARACTERISTIC U16EpsiSplitYawThd "" VALUE 0x800217EE CalPrmStrStabyCtrlBrk_UWORD 0 Gain 0 65535 SYMBOL_LINK "CalPrmStrStabyCtrlBrk01.U16EpsiSplitYawThd" 0 /end CHARACTERISTIC
/begin CHARACTERISTIC U16EpsiTqMax "" VALUE 0x800217A0 CalPrmStrStabyCtrlBrk_UWORD 0 Gain 0 65535 SYMBOL_LINK "CalPrmStrStabyCtrlBrk01.U16EpsiTqMax" 0 /end CHARACTERISTIC
/begin CHARACTERISTIC U16EpsiVehSpd1 "" VALUE 0x800217A2 CalPrmStrStabyCtrlBrk_UWORD 0 Gain 0 65535 SYMBOL_LINK "CalPrmStrStabyCtrlBrk01.U16EpsiVehSpd1" 0 /end CHARACTERISTIC
/begin CHARACTERISTIC U16EpsiVehSpd2 "" VALUE 0x800217A4 CalPrmStrStabyCtrlBrk_UWORD 0 Gain 0 65535 SYMBOL_LINK "CalPrmStrStabyCtrlBrk01.U16EpsiVehSpd2" 0 /end CHARACTERISTIC
/begin CHARACTERISTIC U16EpsiVehSpd3 "" VALUE 0x800217A6 CalPrmStrStabyCtrlBrk_UWORD 0 Gain 0 65535 SYMBOL_LINK "CalPrmStrStabyCtrlBrk01.U16EpsiVehSpd3" 0 /end CHARACTERISTIC
/begin CHARACTERISTIC U16EpsiVehSpd4 "" VALUE 0x800217A8 CalPrmStrStabyCtrlBrk_UWORD 0 Gain 0 65535 SYMBOL_LINK "CalPrmStrStabyCtrlBrk01.U16EpsiVehSpd4" 0 /end CHARACTERISTIC
/begin CHARACTERISTIC U16EpsiVehSpd5 "" VALUE 0x800217AA CalPrmStrStabyCtrlBrk_UWORD 0 Gain 0 65535 SYMBOL_LINK "CalPrmStrStabyCtrlBrk01.U16EpsiVehSpd5" 0 /end CHARACTERISTIC
/begin CHARACTERISTIC U16_SIGPROCR_AX_OFFSET_CHECK_ENG_DRAG_1 "Temp" VALUE 0x8003A032 CalPrmSigProcrEng_UWORD 0 Gain 0 65535 SYMBOL_LINK "CalPrmSigProcrEng01.U16_SIGPROCR_AX_OFFSET_CHECK_ENG_DRAG_1" 0 /end CHARACTERISTIC
/begin CHARACTERISTIC U8EpsiHndlgAgToTqGain "" VALUE 0x80021880 CalPrmStrStabyCtrlBrk_UBYTE 0 Gain 0 255 SYMBOL_LINK "CalPrmStrStabyCtrlBrk01.U8EpsiHndlgAgToTqGain" 0 /end CHARACTERISTIC
/begin CHARACTERISTIC U8EpsiHndlgDampgTqGainDrvrTqIdxSum1 "" VALUE 0x8002188B CalPrmStrStabyCtrlBrk_UBYTE 0 Gain 0 255 SYMBOL_LINK "CalPrmStrStabyCtrlBrk01.U8EpsiHndlgDampgTqGainDrvrTqIdxSum1" 0 /end CHARACTERISTIC
/begin CHARACTERISTIC U8EpsiHndlgDampgTqGainDrvrTqIdxSum2 "" VALUE 0x8002188C CalPrmStrStabyCtrlBrk_UBYTE 0 Gain 0 255 SYMBOL_LINK "CalPrmStrStabyCtrlBrk01.U8EpsiHndlgDampgTqGainDrvrTqIdxSum2" 0 /end CHARACTERISTIC
/begin CHARACTERISTIC U8EpsiHndlgDampgTqGainDrvrTqIdxSum3 "" VALUE 0x8002188D CalPrmStrStabyCtrlBrk_UBYTE 0 Gain 0 255 SYMBOL_LINK "CalPrmStrStabyCtrlBrk01.U8EpsiHndlgDampgTqGainDrvrTqIdxSum3" 0 /end CHARACTERISTIC
/begin CHARACTERISTIC U8EpsiHndlgDampgTqVehSpdGain1 "" VALUE 0x80021891 CalPrmStrStabyCtrlBrk_UBYTE 0 Gain 0 255 SYMBOL_LINK "CalPrmStrStabyCtrlBrk01.U8EpsiHndlgDampgTqVehSpdGain1" 0 /end CHARACTERISTIC
/begin CHARACTERISTIC U8EpsiHndlgDampgTqVehSpdGain2 "" VALUE 0x80021892 CalPrmStrStabyCtrlBrk_UBYTE 0 Gain 0 255 SYMBOL_LINK "CalPrmStrStabyCtrlBrk01.U8EpsiHndlgDampgTqVehSpdGain2" 0 /end CHARACTERISTIC
/begin CHARACTERISTIC U8EpsiHndlgDampgTqVehSpdGain3 "" VALUE 0x80021893 CalPrmStrStabyCtrlBrk_UBYTE 0 Gain 0 255 SYMBOL_LINK "CalPrmStrStabyCtrlBrk01.U8EpsiHndlgDampgTqVehSpdGain3" 0 /end CHARACTERISTIC
/begin CHARACTERISTIC U8EpsiHndlgDampgTqVehSpdGain4 "" VALUE 0x80021894 CalPrmStrStabyCtrlBrk_UBYTE 0 Gain 0 255 SYMBOL_LINK "CalPrmStrStabyCtrlBrk01.U8EpsiHndlgDampgTqVehSpdGain4" 0 /end CHARACTERISTIC
/begin CHARACTERISTIC U8EpsiHndlgDampgTqVehSpdGain5 "" VALUE 0x80021895 CalPrmStrStabyCtrlBrk_UBYTE 0 Gain 0 255 SYMBOL_LINK "CalPrmStrStabyCtrlBrk01.U8EpsiHndlgDampgTqVehSpdGain5" 0 /end CHARACTERISTIC
/begin CHARACTERISTIC U8EpsiHndlgDrvrTqIdxSumDampgTqGain1 "" VALUE 0x8002188E CalPrmStrStabyCtrlBrk_UBYTE 0 Gain 0 255 SYMBOL_LINK "CalPrmStrStabyCtrlBrk01.U8EpsiHndlgDrvrTqIdxSumDampgTqGain1" 0 /end CHARACTERISTIC
/begin CHARACTERISTIC U8EpsiHndlgDrvrTqIdxSumDampgTqGain2 "" VALUE 0x8002188F CalPrmStrStabyCtrlBrk_UBYTE 0 Gain 0 255 SYMBOL_LINK "CalPrmStrStabyCtrlBrk01.U8EpsiHndlgDrvrTqIdxSumDampgTqGain2" 0 /end CHARACTERISTIC
/begin CHARACTERISTIC U8EpsiHndlgDrvrTqIdxSumDampgTqGain3 "" VALUE 0x80021890 CalPrmStrStabyCtrlBrk_UBYTE 0 Gain 0 255 SYMBOL_LINK "CalPrmStrStabyCtrlBrk01.U8EpsiHndlgDrvrTqIdxSumDampgTqGain3" 0 /end CHARACTERISTIC
/begin CHARACTERISTIC U8EpsiHndlgFadeOutTi "" VALUE 0x80021896 CalPrmStrStabyCtrlBrk_UBYTE 0 Gain 0 255 SYMBOL_LINK "CalPrmStrStabyCtrlBrk01.U8EpsiHndlgFadeOutTi" 0 /end CHARACTERISTIC
/begin CHARACTERISTIC U8EpsiHndlgFadeOutTq "" VALUE 0x80021897 CalPrmStrStabyCtrlBrk_UBYTE 0 Gain 0 255 SYMBOL_LINK "CalPrmStrStabyCtrlBrk01.U8EpsiHndlgFadeOutTq" 0 /end CHARACTERISTIC
/begin CHARACTERISTIC U8EpsiHndlgRoadFricAgToTqGain1 "" VALUE 0x80021888 CalPrmStrStabyCtrlBrk_UBYTE 0 Gain 0 255 SYMBOL_LINK "CalPrmStrStabyCtrlBrk01.U8EpsiHndlgRoadFricAgToTqGain1" 0 /end CHARACTERISTIC
/begin CHARACTERISTIC U8EpsiHndlgRoadFricAgToTqGain2 "" VALUE 0x80021889 CalPrmStrStabyCtrlBrk_UBYTE 0 Gain 0 255 SYMBOL_LINK "CalPrmStrStabyCtrlBrk01.U8EpsiHndlgRoadFricAgToTqGain2" 0 /end CHARACTERISTIC
/begin CHARACTERISTIC U8EpsiHndlgRoadFricAgToTqGain3 "" VALUE 0x8002188A CalPrmStrStabyCtrlBrk_UBYTE 0 Gain 0 255 SYMBOL_LINK "CalPrmStrStabyCtrlBrk01.U8EpsiHndlgRoadFricAgToTqGain3" 0 /end CHARACTERISTIC
/begin CHARACTERISTIC U8EpsiSplitCtrlEntrRoadFricThd1 "" VALUE 0x800217AE CalPrmStrStabyCtrlBrk_UBYTE 0 Gain 0 255 SYMBOL_LINK "CalPrmStrStabyCtrlBrk01.U8EpsiSplitCtrlEntrRoadFricThd1" 0 /end CHARACTERISTIC
/begin CHARACTERISTIC U8EpsiSplitCtrlEntrRoadFricThd2 "" VALUE 0x800217AF CalPrmStrStabyCtrlBrk_UBYTE 0 Gain 0 255 SYMBOL_LINK "CalPrmStrStabyCtrlBrk01.U8EpsiSplitCtrlEntrRoadFricThd2" 0 /end CHARACTERISTIC
/begin CHARACTERISTIC U8EpsiSplitCtrlHldRoadFricThd1 "" VALUE 0x800217B0 CalPrmStrStabyCtrlBrk_UBYTE 0 Gain 0 255 SYMBOL_LINK "CalPrmStrStabyCtrlBrk01.U8EpsiSplitCtrlHldRoadFricThd1" 0 /end CHARACTERISTIC
/begin CHARACTERISTIC U8EpsiSplitCtrlHldRoadFricThd2 "" VALUE 0x800217B1 CalPrmStrStabyCtrlBrk_UBYTE 0 Gain 0 255 SYMBOL_LINK "CalPrmStrStabyCtrlBrk01.U8EpsiSplitCtrlHldRoadFricThd2" 0 /end CHARACTERISTIC
/begin CHARACTERISTIC U8EpsiSplitDampgTqVehSpdGain1 "" VALUE 0x80021830 CalPrmStrStabyCtrlBrk_UBYTE 0 Gain 0 255 SYMBOL_LINK "CalPrmStrStabyCtrlBrk01.U8EpsiSplitDampgTqVehSpdGain1" 0 /end CHARACTERISTIC
/begin CHARACTERISTIC U8EpsiSplitDampgTqVehSpdGain2 "" VALUE 0x80021831 CalPrmStrStabyCtrlBrk_UBYTE 0 Gain 0 255 SYMBOL_LINK "CalPrmStrStabyCtrlBrk01.U8EpsiSplitDampgTqVehSpdGain2" 0 /end CHARACTERISTIC
/begin CHARACTERISTIC U8EpsiSplitDampgTqVehSpdGain3 "" VALUE 0x80021832 CalPrmStrStabyCtrlBrk_UBYTE 0 Gain 0 255 SYMBOL_LINK "CalPrmStrStabyCtrlBrk01.U8EpsiSplitDampgTqVehSpdGain3" 0 /end CHARACTERISTIC
/begin CHARACTERISTIC U8EpsiSplitDampgTqVehSpdGain4 "" VALUE 0x80021833 CalPrmStrStabyCtrlBrk_UBYTE 0 Gain 0 255 SYMBOL_LINK "CalPrmStrStabyCtrlBrk01.U8EpsiSplitDampgTqVehSpdGain4" 0 /end CHARACTERISTIC
/begin CHARACTERISTIC U8EpsiSplitDampgTqVehSpdGain5 "" VALUE 0x80021834 CalPrmStrStabyCtrlBrk_UBYTE 0 Gain 0 255 SYMBOL_LINK "CalPrmStrStabyCtrlBrk01.U8EpsiSplitDampgTqVehSpdGain5" 0 /end CHARACTERISTIC
/begin CHARACTERISTIC U8EpsiSplitDrvrTqCoeff1 "" VALUE 0x800217F0 CalPrmStrStabyCtrlBrk_UBYTE 0 Gain 0 255 SYMBOL_LINK "CalPrmStrStabyCtrlBrk01.U8EpsiSplitDrvrTqCoeff1" 0 /end CHARACTERISTIC
/begin CHARACTERISTIC U8EpsiSplitDrvrTqCoeff2 "" VALUE 0x800217F1 CalPrmStrStabyCtrlBrk_UBYTE 0 Gain 0 255 SYMBOL_LINK "CalPrmStrStabyCtrlBrk01.U8EpsiSplitDrvrTqCoeff2" 0 /end CHARACTERISTIC
/begin CHARACTERISTIC U8EpsiSplitDrvrTqCoeff3 "" VALUE 0x800217F2 CalPrmStrStabyCtrlBrk_UBYTE 0 Gain 0 255 SYMBOL_LINK "CalPrmStrStabyCtrlBrk01.U8EpsiSplitDrvrTqCoeff3" 0 /end CHARACTERISTIC
/begin CHARACTERISTIC U8EpsiSplitDrvrTqCoeff4 "" VALUE 0x800217F3 CalPrmStrStabyCtrlBrk_UBYTE 0 Gain 0 255 SYMBOL_LINK "CalPrmStrStabyCtrlBrk01.U8EpsiSplitDrvrTqCoeff4" 0 /end CHARACTERISTIC
/begin CHARACTERISTIC U8EpsiSplitFadeOutTi "" VALUE 0x80021835 CalPrmStrStabyCtrlBrk_UBYTE 0 Gain 0 255 SYMBOL_LINK "CalPrmStrStabyCtrlBrk01.U8EpsiSplitFadeOutTi" 0 /end CHARACTERISTIC
/begin CHARACTERISTIC U8EpsiSplitFadeOutTq "" VALUE 0x80021836 CalPrmStrStabyCtrlBrk_UBYTE 0 Gain 0 255 SYMBOL_LINK "CalPrmStrStabyCtrlBrk01.U8EpsiSplitFadeOutTq" 0 /end CHARACTERISTIC
/begin CHARACTERISTIC U8EpsiYawRateErrThdGain "" VALUE 0x80021841 CalPrmStrStabyCtrlBrk_UBYTE 0 Gain 0 255 SYMBOL_LINK "CalPrmStrStabyCtrlBrk01.U8EpsiYawRateErrThdGain" 0 /end CHARACTERISTIC
/begin CHARACTERISTIC U8EpsiYawRateErrThdRoughRoadGain "" VALUE 0x80021840 CalPrmStrStabyCtrlBrk_UBYTE 0 Gain 0 255 SYMBOL_LINK "CalPrmStrStabyCtrlBrk01.U8EpsiYawRateErrThdRoughRoadGain" 0 /end CHARACTERISTIC
/begin CHARACTERISTIC U8_SIGPROCR_AX_OFFSET_CHECK_DYN_FLAT "Temp" VALUE 0x80020207 CalPrmSigProcrBrk_UBYTE 0 Gain 0 255 SYMBOL_LINK "CalPrmSigProcrBrk01.U8_SIGPROCR_AX_OFFSET_CHECK_DYN_FLAT" 0 /end CHARACTERISTIC
/begin CHARACTERISTIC U8_SIGPROCR_AX_OFFSET_CHECK_ENG_DRAG_2 "Temp" VALUE 0x8003A034 CalPrmSigProcrEng_UBYTE 0 Gain 0 255 SYMBOL_LINK "CalPrmSigProcrEng01.U8_SIGPROCR_AX_OFFSET_CHECK_ENG_DRAG_2" 0 /end CHARACTERISTIC
/begin CHARACTERISTIC U8_SIGPROCR_AX_OFFSET_CHECK_KIN_FLAT_1 "Temp" VALUE 0x80020208 CalPrmSigProcrBrk_UBYTE 0 Gain 0 255 SYMBOL_LINK "CalPrmSigProcrBrk01.U8_SIGPROCR_AX_OFFSET_CHECK_KIN_FLAT_1" 0 /end CHARACTERISTIC
/begin CHARACTERISTIC U8_SIGPROCR_AX_OFFSET_CHECK_KIN_FLAT_2 "Temp" VALUE 0x80020209 CalPrmSigProcrBrk_UBYTE 0 Gain 0 255 SYMBOL_LINK "CalPrmSigProcrBrk01.U8_SIGPROCR_AX_OFFSET_CHECK_KIN_FLAT_2" 0 /end CHARACTERISTIC
/begin CHARACTERISTIC U8_SIGPROCR_AX_OFFSET_MODEL_AIR_AREA "Temp" VALUE 0x80020206 CalPrmSigProcrBrk_UBYTE 0 Gain 0 255 SYMBOL_LINK "CalPrmSigProcrBrk01.U8_SIGPROCR_AX_OFFSET_MODEL_AIR_AREA" 0 /end CHARACTERISTIC
/begin CHARACTERISTIC U8_SIGPROCR_AX_OFFSET_MODEL_AIR_CD "Temp" VALUE 0x80020204 CalPrmSigProcrBrk_UBYTE 0 Gain 0 255 SYMBOL_LINK "CalPrmSigProcrBrk01.U8_SIGPROCR_AX_OFFSET_MODEL_AIR_CD" 0 /end CHARACTERISTIC
/begin CHARACTERISTIC U8_SIGPROCR_AX_OFFSET_MODEL_AIR_RO "Temp" VALUE 0x80020205 CalPrmSigProcrBrk_UBYTE 0 Gain 0 255 SYMBOL_LINK "CalPrmSigProcrBrk01.U8_SIGPROCR_AX_OFFSET_MODEL_AIR_RO" 0 /end CHARACTERISTIC
/begin CHARACTERISTIC U8_SIGPROCR_AX_OFFSET_MODEL_ENG_ETA_1 "Temp" VALUE 0x8003A02C CalPrmSigProcrEng_UBYTE 0 Gain 0 255 SYMBOL_LINK "CalPrmSigProcrEng01.U8_SIGPROCR_AX_OFFSET_MODEL_ENG_ETA_1" 0 /end CHARACTERISTIC
/begin CHARACTERISTIC U8_SIGPROCR_AX_OFFSET_MODEL_ENG_ETA_2 "Temp" VALUE 0x8003A02D CalPrmSigProcrEng_UBYTE 0 Gain 0 255 SYMBOL_LINK "CalPrmSigProcrEng01.U8_SIGPROCR_AX_OFFSET_MODEL_ENG_ETA_2" 0 /end CHARACTERISTIC
/begin CHARACTERISTIC U8_SIGPROCR_AX_OFFSET_MODEL_ENG_ETA_3 "Temp" VALUE 0x8003A02E CalPrmSigProcrEng_UBYTE 0 Gain 0 255 SYMBOL_LINK "CalPrmSigProcrEng01.U8_SIGPROCR_AX_OFFSET_MODEL_ENG_ETA_3" 0 /end CHARACTERISTIC
/begin CHARACTERISTIC U8_SIGPROCR_AX_OFFSET_MODEL_ENG_ETA_4 "Temp" VALUE 0x8003A02F CalPrmSigProcrEng_UBYTE 0 Gain 0 255 SYMBOL_LINK "CalPrmSigProcrEng01.U8_SIGPROCR_AX_OFFSET_MODEL_ENG_ETA_4" 0 /end CHARACTERISTIC
/begin CHARACTERISTIC U8_SIGPROCR_AX_OFFSET_MODEL_ENG_ETA_5 "Temp" VALUE 0x8003A030 CalPrmSigProcrEng_UBYTE 0 Gain 0 255 SYMBOL_LINK "CalPrmSigProcrEng01.U8_SIGPROCR_AX_OFFSET_MODEL_ENG_ETA_5" 0 /end CHARACTERISTIC
/begin CHARACTERISTIC U8_SIGPROCR_AX_OFFSET_MODEL_ENG_ETA_6 "Temp" VALUE 0x8003A031 CalPrmSigProcrEng_UBYTE 0 Gain 0 255 SYMBOL_LINK "CalPrmSigProcrEng01.U8_SIGPROCR_AX_OFFSET_MODEL_ENG_ETA_6" 0 /end CHARACTERISTIC
/begin CHARACTERISTIC U8_SIGPROCR_AX_OFFSET_MODEL_ENG_RESIST_1 "Temp" VALUE 0x8003A035 CalPrmSigProcrEng_UBYTE 0 Gain 0 255 SYMBOL_LINK "CalPrmSigProcrEng01.U8_SIGPROCR_AX_OFFSET_MODEL_ENG_RESIST_1" 0 /end CHARACTERISTIC
/begin CHARACTERISTIC U8_SIGPROCR_AX_OFFSET_MODEL_ENG_RESIST_2 "Temp" VALUE 0x8003A036 CalPrmSigProcrEng_UBYTE 0 Gain 0 255 SYMBOL_LINK "CalPrmSigProcrEng01.U8_SIGPROCR_AX_OFFSET_MODEL_ENG_RESIST_2" 0 /end CHARACTERISTIC
/begin CHARACTERISTIC U8_SIGPROCR_AX_OFFSET_MODEL_ENG_RESIST_3 "Temp" VALUE 0x8003A037 CalPrmSigProcrEng_UBYTE 0 Gain 0 255 SYMBOL_LINK "CalPrmSigProcrEng01.U8_SIGPROCR_AX_OFFSET_MODEL_ENG_RESIST_3" 0 /end CHARACTERISTIC
/begin CHARACTERISTIC U8_SIGPROCR_AX_OFFSET_MODEL_ENG_RESIST_4 "Temp" VALUE 0x8003A038 CalPrmSigProcrEng_UBYTE 0 Gain 0 255 SYMBOL_LINK "CalPrmSigProcrEng01.U8_SIGPROCR_AX_OFFSET_MODEL_ENG_RESIST_4" 0 /end CHARACTERISTIC
/begin CHARACTERISTIC U8_SIGPROCR_AX_OFFSET_MODEL_ENG_RESIST_5 "Temp" VALUE 0x8003A039 CalPrmSigProcrEng_UBYTE 0 Gain 0 255 SYMBOL_LINK "CalPrmSigProcrEng01.U8_SIGPROCR_AX_OFFSET_MODEL_ENG_RESIST_5" 0 /end CHARACTERISTIC
/begin CHARACTERISTIC U8_SIGPROCR_AX_OFFSET_MODEL_ENG_RESIST_6 "Temp" VALUE 0x8003A03A CalPrmSigProcrEng_UBYTE 0 Gain 0 255 SYMBOL_LINK "CalPrmSigProcrEng01.U8_SIGPROCR_AX_OFFSET_MODEL_ENG_RESIST_6" 0 /end CHARACTERISTIC
/begin CHARACTERISTIC U8_SIGPROCR_AX_OFFSET_MODEL_ROLL_TOTAL "Temp" VALUE 0x8002020A CalPrmSigProcrBrk_UBYTE 0 Gain 0 255 SYMBOL_LINK "CalPrmSigProcrBrk01.U8_SIGPROCR_AX_OFFSET_MODEL_ROLL_TOTAL" 0 /end CHARACTERISTIC
/begin COMPU_METHOD A20 "" LINEAR "%.15" "g" COEFFS_LINEAR 0.25 0 /end COMPU_METHOD
/begin COMPU_METHOD A41 "" LINEAR "%.15" "g" COEFFS_LINEAR 0.001 0 /end COMPU_METHOD
/begin COMPU_METHOD A42 "" LINEAR "%.15" "g" COEFFS_LINEAR 0.01 0 /end COMPU_METHOD
/begin COMPU_METHOD A47 "" LINEAR "%.15" "g" COEFFS_LINEAR 0.005 0 /end COMPU_METHOD
/begin COMPU_METHOD A48 "" LINEAR "%.15" "g" COEFFS_LINEAR 0.0001 0 /end COMPU_METHOD
/begin COMPU_METHOD Amp2 "" LINEAR "%.15" "A" COEFFS_LINEAR 0.001 0 /end COMPU_METHOD
/begin COMPU_METHOD Gain "" LINEAR "%.15" "NA" COEFFS_LINEAR 1 0 /end COMPU_METHOD
/begin COMPU_METHOD Len51 "" LINEAR "%.15" "m" COEFFS_LINEAR 0.001 0 /end COMPU_METHOD
/begin COMPU_METHOD OnOff1 "" LINEAR "%.15" "NA" COEFFS_LINEAR 1 0 STATUS_STRING_REF OnOffTable /end COMPU_METHOD
/begin COMPU_METHOD P34 "" LINEAR "%.15" "bar" COEFFS_LINEAR 0.1 0 /end COMPU_METHOD
/begin COMPU_METHOD PGrdt15 "" LINEAR "%.15" "bar/10ms" COEFFS_LINEAR 0.1 0 /end COMPU_METHOD
/begin COMPU_METHOD Perc10 "" LINEAR "%.15" "Percentage" COEFFS_LINEAR 0.3906 0 /end COMPU_METHOD
/begin COMPU_METHOD Perc6 "" LINEAR "%.15" "Percentage" COEFFS_LINEAR 1 0 /end COMPU_METHOD
/begin COMPU_METHOD R11 "" LINEAR "%.15" "ohm" COEFFS_LINEAR 0.001 0 /end COMPU_METHOD
/begin COMPU_METHOD Ratio1 "" LINEAR "%.15" "NA" COEFFS_LINEAR 0.01 0 /end COMPU_METHOD
/begin COMPU_METHOD ReqSts1 "" LINEAR "%.15" "NA" COEFFS_LINEAR 1 0 STATUS_STRING_REF ReqStsTable /end COMPU_METHOD
/begin COMPU_METHOD RollrBench1 "" LINEAR "%.15" "NA" COEFFS_LINEAR 1 0 STATUS_STRING_REF RollBenchStsTable /end COMPU_METHOD
/begin COMPU_METHOD RvsGear1 "" LINEAR "%.15" "NA" COEFFS_LINEAR 1 0 STATUS_STRING_REF RvsGearTable /end COMPU_METHOD
/begin COMPU_METHOD ShiftSts1 "" LINEAR "%.15" "NA" COEFFS_LINEAR 1 0 STATUS_STRING_REF ShiftStsTable /end COMPU_METHOD
/begin COMPU_METHOD Spd12 "" LINEAR "%.15" "kph" COEFFS_LINEAR 0.125 0 /end COMPU_METHOD
/begin COMPU_METHOD Spd21 "" LINEAR "%.15" "kph" COEFFS_LINEAR 0.01 0 /end COMPU_METHOD
/begin COMPU_METHOD Spd31 "" LINEAR "%.15" "kph" COEFFS_LINEAR 0.1 0 /end COMPU_METHOD
/begin COMPU_METHOD SusptDetnSts1 "" LINEAR "%.15" "NA" COEFFS_LINEAR 1 0 STATUS_STRING_REF SusDetTable /end COMPU_METHOD
/begin COMPU_METHOD T31 "" LINEAR "%.15" "degC" COEFFS_LINEAR 1 0 /end COMPU_METHOD
/begin COMPU_METHOD TcVlvMod "" LINEAR "%.15" "NA" COEFFS_LINEAR 1 0 STATUS_STRING_REF TcVlvModTable /end COMPU_METHOD
/begin COMPU_METHOD ThermCndctvtyOfAir1 "" LINEAR "%.15" "WPermK" COEFFS_LINEAR 0.0001 0 /end COMPU_METHOD
/begin COMPU_METHOD Ti21 "" LINEAR "%.15" "sec" COEFFS_LINEAR 0.01 0 /end COMPU_METHOD
/begin COMPU_METHOD TqGrdt10 "" LINEAR "%.15" "Nm/10ms" COEFFS_LINEAR 1 0 /end COMPU_METHOD
/begin COMPU_METHOD TqGrdt8 "" LINEAR "%.15" "NmPersec" COEFFS_LINEAR 8 0 /end COMPU_METHOD
/begin COMPU_METHOD TqRatio21 "" LINEAR "%.15" "NA" COEFFS_LINEAR 0.01 0 /end COMPU_METHOD
/begin COMPU_METHOD TrqRatioEst1 "" LINEAR "%.15" "NA" COEFFS_LINEAR 0.1 0 /end COMPU_METHOD
/begin COMPU_METHOD TrsmGearReqTyp1 "" LINEAR "%.15" "NA" COEFFS_LINEAR 1 0 STATUS_STRING_REF TrsmGearReqTable /end COMPU_METHOD
/begin COMPU_METHOD TrsmGearTar1 "" LINEAR "%.15" "NA" COEFFS_LINEAR 1 0 STATUS_STRING_REF TrsmGearTarTable /end COMPU_METHOD
/begin COMPU_VTAB OnOff1 "" TAB_VERB 2 0 "off" 1 "on" DEFAULT_VALUE "" /end COMPU_VTAB
/begin COMPU_VTAB OnOffTable "" TAB_VERB 2 0 "Off" 1 "On" DEFAULT_VALUE "" /end COMPU_VTAB
/begin COMPU_VTAB ReqStsTable "" TAB_VERB 2 0 "NotRequested" 1 "Requested" DEFAULT_VALUE "" /end COMPU_VTAB
/begin COMPU_VTAB RollBenchStsTable "" TAB_VERB 2 5 "RollerbenchActive" 27 "RollerbenchInactive" DEFAULT_VALUE "" /end COMPU_VTAB
/begin COMPU_VTAB RvsGearTable "" TAB_VERB 2 0 "ReversedGearNotUsed" 1 "ReversedGearUsed" DEFAULT_VALUE "" /end COMPU_VTAB
/begin COMPU_VTAB ShiftStsTable "" TAB_VERB 2 0 "NoShiftInProgs" 1 "ShiftInProgs" DEFAULT_VALUE "" /end COMPU_VTAB
/begin COMPU_VTAB SusDetTable "" TAB_VERB 2 0 "SuspectNotDetected" 1 "SuspectDetected" DEFAULT_VALUE "" /end COMPU_VTAB
/begin COMPU_VTAB TcVlvModTable "" TAB_VERB 9 0 "Not control" 1 "TCMF initial rise control" 2 "TCMF rise control" 3 "TCMF rise pattern control" 4 "TCMF hold/dump control" 5 "TCMF initial hold control" 6 "TCMF compensation hold control" 7 "TCMF compensation dump control" 8 "Not TCMF and only suction control" DEFAULT_VALUE "" /end COMPU_VTAB
/begin COMPU_VTAB TrsmGearReqTable "" TAB_VERB 4 0 "NoActn" 1 "MaxGearReq" 2 "MinGearReq" 3 "HldGearReq" DEFAULT_VALUE "" /end COMPU_VTAB
/begin COMPU_VTAB TrsmGearTarTable "" TAB_VERB 10 0 "PN" 1 "1stSpeed" 2 "2ndSpeed" 3 "3rdSpeed" 4 "4thSpeed" 5 "5thSpeed" 6 "6thSpeed" 7 "7thSpeed" 8 "8thSpeed" 14 "R" DEFAULT_VALUE "" /end COMPU_VTAB
/begin RECORD_LAYOUT CalPrmBrkAssisCoorrBrk_SBYTE FNC_VALUES 1 SBYTE COLUMN_DIR DIRECT ALIGNMENT_BYTE 1 ALIGNMENT_WORD 1 ALIGNMENT_LONG 1 ALIGNMENT_FLOAT32_IEEE 1 ALIGNMENT_FLOAT64_IEEE 1 ALIGNMENT_INT64 1 /end RECORD_LAYOUT
/begin RECORD_LAYOUT CalPrmBrkAssisCoorrBrk_SWORD FNC_VALUES 1 SWORD COLUMN_DIR DIRECT ALIGNMENT_BYTE 1 ALIGNMENT_WORD 1 ALIGNMENT_LONG 1 ALIGNMENT_FLOAT32_IEEE 1 ALIGNMENT_FLOAT64_IEEE 1 ALIGNMENT_INT64 1 /end RECORD_LAYOUT
/begin RECORD_LAYOUT CalPrmLatDynsCoorrBrk_SWORD FNC_VALUES 1 SWORD COLUMN_DIR DIRECT ALIGNMENT_BYTE 1 ALIGNMENT_WORD 1 ALIGNMENT_LONG 1 ALIGNMENT_FLOAT32_IEEE 1 ALIGNMENT_FLOAT64_IEEE 1 ALIGNMENT_INT64 1 /end RECORD_LAYOUT
/begin RECORD_LAYOUT CalPrmSigProcrBrk_UBYTE FNC_VALUES 1 UBYTE COLUMN_DIR DIRECT ALIGNMENT_BYTE 1 ALIGNMENT_WORD 1 ALIGNMENT_LONG 1 ALIGNMENT_FLOAT32_IEEE 1 ALIGNMENT_FLOAT64_IEEE 1 ALIGNMENT_INT64 1 /end RECORD_LAYOUT
/begin RECORD_LAYOUT CalPrmSigProcrEng_UBYTE FNC_VALUES 1 UBYTE COLUMN_DIR DIRECT ALIGNMENT_BYTE 1 ALIGNMENT_WORD 1 ALIGNMENT_LONG 1 ALIGNMENT_FLOAT32_IEEE 1 ALIGNMENT_FLOAT64_IEEE 1 ALIGNMENT_INT64 1 /end RECORD_LAYOUT
/begin RECORD_LAYOUT CalPrmSigProcrEng_UWORD FNC_VALUES 1 UWORD COLUMN_DIR DIRECT ALIGNMENT_BYTE 1 ALIGNMENT_WORD 1 ALIGNMENT_LONG 1 ALIGNMENT_FLOAT32_IEEE 1 ALIGNMENT_FLOAT64_IEEE 1 ALIGNMENT_INT64 1 /end RECORD_LAYOUT
/begin RECORD_LAYOUT CalPrmSsmBrk_SBYTE FNC_VALUES 1 SBYTE COLUMN_DIR DIRECT ALIGNMENT_BYTE 1 ALIGNMENT_WORD 1 ALIGNMENT_LONG 1 ALIGNMENT_FLOAT32_IEEE 1 ALIGNMENT_FLOAT64_IEEE 1 ALIGNMENT_INT64 1 /end RECORD_LAYOUT
/begin RECORD_LAYOUT CalPrmSsmBrk_SWORD FNC_VALUES 1 SWORD COLUMN_DIR DIRECT ALIGNMENT_BYTE 1 ALIGNMENT_WORD 1 ALIGNMENT_LONG 1 ALIGNMENT_FLOAT32_IEEE 1 ALIGNMENT_FLOAT64_IEEE 1 ALIGNMENT_INT64 1 /end RECORD_LAYOUT
/begin RECORD_LAYOUT CalPrmSsmBrk_UBYTE FNC_VALUES 1 UBYTE COLUMN_DIR DIRECT ALIGNMENT_BYTE 1 ALIGNMENT_WORD 1 ALIGNMENT_LONG 1 ALIGNMENT_FLOAT32_IEEE 1 ALIGNMENT_FLOAT64_IEEE 1 ALIGNMENT_INT64 1 /end RECORD_LAYOUT
/begin RECORD_LAYOUT CalPrmSsmBrk_UWORD FNC_VALUES 1 UWORD COLUMN_DIR DIRECT ALIGNMENT_BYTE 1 ALIGNMENT_WORD 1 ALIGNMENT_LONG 1 ALIGNMENT_FLOAT32_IEEE 1 ALIGNMENT_FLOAT64_IEEE 1 ALIGNMENT_INT64 1 /end RECORD_LAYOUT
/begin RECORD_LAYOUT CalPrmStrStabyCtrlBrk_SWORD FNC_VALUES 1 SWORD COLUMN_DIR DIRECT ALIGNMENT_BYTE 1 ALIGNMENT_WORD 1 ALIGNMENT_LONG 1 ALIGNMENT_FLOAT32_IEEE 1 ALIGNMENT_FLOAT64_IEEE 1 ALIGNMENT_INT64 1 /end RECORD_LAYOUT
/begin RECORD_LAYOUT CalPrmStrStabyCtrlBrk_UBYTE FNC_VALUES 1 UBYTE COLUMN_DIR DIRECT ALIGNMENT_BYTE 1 ALIGNMENT_WORD 1 ALIGNMENT_LONG 1 ALIGNMENT_FLOAT32_IEEE 1 ALIGNMENT_FLOAT64_IEEE 1 ALIGNMENT_INT64 1 /end RECORD_LAYOUT
/begin RECORD_LAYOUT CalPrmStrStabyCtrlBrk_UWORD FNC_VALUES 1 UWORD COLUMN_DIR DIRECT ALIGNMENT_BYTE 1 ALIGNMENT_WORD 1 ALIGNMENT_LONG 1 ALIGNMENT_FLOAT32_IEEE 1 ALIGNMENT_FLOAT64_IEEE 1 ALIGNMENT_INT64 1 /end RECORD_LAYOUT
/begin RECORD_LAYOUT CalPrmWslcBrk_SBYTE FNC_VALUES 1 SBYTE COLUMN_DIR DIRECT ALIGNMENT_BYTE 1 ALIGNMENT_WORD 1 ALIGNMENT_LONG 1 ALIGNMENT_FLOAT32_IEEE 1 ALIGNMENT_FLOAT64_IEEE 1 ALIGNMENT_INT64 1 /end RECORD_LAYOUT
/begin RECORD_LAYOUT CalPrmWslcBrk_SWORD FNC_VALUES 1 SWORD COLUMN_DIR DIRECT ALIGNMENT_BYTE 1 ALIGNMENT_WORD 1 ALIGNMENT_LONG 1 ALIGNMENT_FLOAT32_IEEE 1 ALIGNMENT_FLOAT64_IEEE 1 ALIGNMENT_INT64 1 /end RECORD_LAYOUT
/begin RECORD_LAYOUT CalPrmWslcBrk_UBYTE FNC_VALUES 1 UBYTE COLUMN_DIR DIRECT ALIGNMENT_BYTE 1 ALIGNMENT_WORD 1 ALIGNMENT_LONG 1 ALIGNMENT_FLOAT32_IEEE 1 ALIGNMENT_FLOAT64_IEEE 1 ALIGNMENT_INT64 1 /end RECORD_LAYOUT
/begin RECORD_LAYOUT CalPrmWslcEng_UBYTE FNC_VALUES 1 UBYTE COLUMN_DIR DIRECT ALIGNMENT_BYTE 1 ALIGNMENT_WORD 1 ALIGNMENT_LONG 1 ALIGNMENT_FLOAT32_IEEE 1 ALIGNMENT_FLOAT64_IEEE 1 ALIGNMENT_INT64 1 /end RECORD_LAYOUT
/begin RECORD_LAYOUT CalPrmWspcEng_SWORD FNC_VALUES 1 SWORD COLUMN_DIR DIRECT ALIGNMENT_BYTE 1 ALIGNMENT_WORD 1 ALIGNMENT_LONG 1 ALIGNMENT_FLOAT32_IEEE 1 ALIGNMENT_FLOAT64_IEEE 1 ALIGNMENT_INT64 1 /end RECORD_LAYOUT
/begin RECORD_LAYOUT CalPrmWspcEng_UBYTE FNC_VALUES 1 UBYTE COLUMN_DIR DIRECT ALIGNMENT_BYTE 1 ALIGNMENT_WORD 1 ALIGNMENT_LONG 1 ALIGNMENT_FLOAT32_IEEE 1 ALIGNMENT_FLOAT64_IEEE 1 ALIGNMENT_INT64 1 /end RECORD_LAYOUT
/begin GROUP LatDynsCoorrCalPrm "" /begin SUB_GROUP A.ESC_Control B.EHC_Control C.TVBB_Control D.ROP_Control /end SUB_GROUP /end GROUP
/begin GROUP LatDynsCoorr_BrkCal "" /begin SUB_GROUP LatDynsCoorrCalPrm /end SUB_GROUP /end GROUP
/begin GROUP LoPCoorrCalPrm "" /begin SUB_GROUP a_EBP b_BDW /end SUB_GROUP /end GROUP
/begin GROUP LoPCoorr_BrkCal "" /begin SUB_GROUP LoPCoorrCalPrm /end SUB_GROUP /end GROUP
/begin GROUP Normal ""
 /begin REF_CHARACTERISTIC TP_S16TCSCpBrkPGrdtLimNormDecFr TP_S16TCSCpBrkPGrdtLimNormDecRe TP_S16TCSCpBrkPGrdtLimNormIncFr TP_S16TCSCpBrkPGrdtLimNormIncRe /end REF_CHARACTERISTIC
/end GROUP
/begin GROUP Normal_Initial ""
 /begin REF_CHARACTERISTIC TP_S16TCSCpBrkPGrdtLimIncIniCntFr TP_S16TCSCpBrkPGrdtLimIncIniCntRe TP_S16TCSCpBrkPGrdtLimNormIncIniFr TP_S16TCSCpBrkPGrdtLimNormIncIniRe /end REF_CHARACTERISTIC
/end GROUP
/begin GROUP OS_Gain ""
 /begin REF_CHARACTERISTIC TQS16_YC_D_GAIN_F_OS_IN TQS16_YC_D_GAIN_F_OS_IN_H TQS16_YC_D_GAIN_F_OS_IN_L TQS16_YC_D_GAIN_F_OS_OUT_DEC TQS16_YC_D_GAIN_F_OS_OUT_DEC_H TQS16_YC_D_GAIN_F_OS_OUT_DEC_L TQS16_YC_D_GAIN_F_OS_OUT_INC TQS16_YC_D_GAIN_F_OS_OUT_INC_H TQS16_YC_D_GAIN_F_OS_OUT_INC_L TQS16_YC_FF_GAIN_OS_OUT_HIG_SP_H_MU TQS16_YC_FF_GAIN_OS_OUT_HIG_SP_L_MU TQS16_YC_FF_GAIN_OS_OUT_HIG_SP_M_MU TQS16_YC_FF_GAIN_OS_OUT_LOW_SP_H_MU TQS16_YC_FF_GAIN_OS_OUT_LOW_SP_L_MU TQS16_YC_FF_GAIN_OS_OUT_LOW_SP_M_MU TQS16_YC_FF_GAIN_OS_OUT_MED_SP_H_MU TQS16_YC_FF_GAIN_OS_OUT_MED_SP_L_MU TQS16_YC_FF_GAIN_OS_OUT_MED_SP_M_MU TQS16_YC_P_GAIN_F_OS_IN_H TQS16_YC_P_GAIN_F_OS_IN_L TQS16_YC_P_GAIN_F_OS_IN_M TQS16_YC_P_GAIN_F_OS_OUT_DEC TQS16_YC_P_GAIN_F_OS_OUT_DEC_H TQS16_YC_P_GAIN_F_OS_OUT_DEC_L TQS16_YC_P_GAIN_F_OS_OUT_INC TQS16_YC_P_GAIN_F_OS_OUT_INC_H TQS16_YC_P_GAIN_F_OS_OUT_INC_L TQS16_YC_SPEED_DEP_HIG_H_GAIN TQS16_YC_SPEED_DEP_HIG_L_GAIN TQS16_YC_SPEED_DEP_HIG_M_GAIN TQS16_YC_SPEED_DEP_LOW_H_GAIN TQS16_YC_SPEED_DEP_LOW_L_GAIN TQS16_YC_SPEED_DEP_LOW_M_GAIN TQS16_YC_SPEED_DEP_MED_H_GAIN TQS16_YC_SPEED_DEP_MED_L_GAIN TQS16_YC_SPEED_DEP_MED_M_GAIN TQS16_YC_SPEED_DEP_VLOW_H_GAIN TQS16_YC_SPEED_DEP_VLOW_L_GAIN TQS16_YC_SPEED_DEP_VLOW_M_GAIN /end REF_CHARACTERISTIC
/end GROUP
/begin GROUP Road_Grade ""
 /begin REF_CHARACTERISTIC SSM_K_EPB_Grade_Decision_Z1_Th SSM_K_EPB_Grade_Decision_Z2_Th SSM_K_EPB_Grade_Decision_Z3_Th SSM_K_EPB_Light_Apply_Threshold SSM_K_EPB_Max_Apply_Threshold /end REF_CHARACTERISTIC
/end GROUP
/begin GROUP Rop_Wstr_Dot ""
 /begin REF_CHARACTERISTIC TQS16_ROP_WSTR_DOT_ENT_100K TQS16_ROP_WSTR_DOT_ENT_120K TQS16_ROP_WSTR_DOT_ENT_40K TQS16_ROP_WSTR_DOT_ENT_50K TQS16_ROP_WSTR_DOT_ENT_60K TQS16_ROP_WSTR_DOT_ENT_70K TQS16_ROP_WSTR_DOT_ENT_80K TQS16_ROP_WSTR_DOT_EXT_100K TQS16_ROP_WSTR_DOT_EXT_120K TQS16_ROP_WSTR_DOT_EXT_40K TQS16_ROP_WSTR_DOT_EXT_50K TQS16_ROP_WSTR_DOT_EXT_60K TQS16_ROP_WSTR_DOT_EXT_70K TQS16_ROP_WSTR_DOT_EXT_80K /end REF_CHARACTERISTIC
/end GROUP
/begin GROUP Rop_Yaw_Dot ""
 /begin REF_CHARACTERISTIC TQS16_ROP_YAW_DOT_ENT_100K TQS16_ROP_YAW_DOT_ENT_120K TQS16_ROP_YAW_DOT_ENT_40K TQS16_ROP_YAW_DOT_ENT_50K TQS16_ROP_YAW_DOT_ENT_60K TQS16_ROP_YAW_DOT_ENT_70K TQS16_ROP_YAW_DOT_ENT_80K TQS16_ROP_YAW_DOT_EXT_100K TQS16_ROP_YAW_DOT_EXT_120K TQS16_ROP_YAW_DOT_EXT_40K TQS16_ROP_YAW_DOT_EXT_50K TQS16_ROP_YAW_DOT_EXT_60K TQS16_ROP_YAW_DOT_EXT_70K TQS16_ROP_YAW_DOT_EXT_80K /end REF_CHARACTERISTIC
/end GROUP
/begin GROUP SIGPROCR_BrkCal ""
 /begin REF_CHARACTERISTIC U8_SIGPROCR_AX_OFFSET_CHECK_DYN_FLAT U8_SIGPROCR_AX_OFFSET_CHECK_KIN_FLAT_1 U8_SIGPROCR_AX_OFFSET_CHECK_KIN_FLAT_2 U8_SIGPROCR_AX_OFFSET_MODEL_AIR_AREA U8_SIGPROCR_AX_OFFSET_MODEL_AIR_CD U8_SIGPROCR_AX_OFFSET_MODEL_AIR_RO U8_SIGPROCR_AX_OFFSET_MODEL_ROLL_TOTAL /end REF_CHARACTERISTIC
/end GROUP
/begin GROUP SIGPROCR_EngCal ""
 /begin REF_CHARACTERISTIC U16_SIGPROCR_AX_OFFSET_CHECK_ENG_DRAG_1 U8_SIGPROCR_AX_OFFSET_CHECK_ENG_DRAG_2 U8_SIGPROCR_AX_OFFSET_MODEL_ENG_ETA_1 U8_SIGPROCR_AX_OFFSET_MODEL_ENG_ETA_2 U8_SIGPROCR_AX_OFFSET_MODEL_ENG_ETA_3 U8_SIGPROCR_AX_OFFSET_MODEL_ENG_ETA_4 U8_SIGPROCR_AX_OFFSET_MODEL_ENG_ETA_5 U8_SIGPROCR_AX_OFFSET_MODEL_ENG_ETA_6 U8_SIGPROCR_AX_OFFSET_MODEL_ENG_RESIST_1 U8_SIGPROCR_AX_OFFSET_MODEL_ENG_RESIST_2 U8_SIGPROCR_AX_OFFSET_MODEL_ENG_RESIST_3 U8_SIGPROCR_AX_OFFSET_MODEL_ENG_RESIST_4 U8_SIGPROCR_AX_OFFSET_MODEL_ENG_RESIST_5 U8_SIGPROCR_AX_OFFSET_MODEL_ENG_RESIST_6 /end REF_CHARACTERISTIC
/end GROUP
/begin GROUP Split_Detect ""
 /begin REF_CHARACTERISTIC TP_U8TCSCpAsmdMuDiff4SplitMuDct TP_U8TCSCpSplitMuDctEnterCnt TP_U8TCSCpSplitMuDctExitCnt TP_U8TCSCpSplitMuDiffExitHyst /end REF_CHARACTERISTIC
/end GROUP
/begin GROUP Split_Detection "" /begin SUB_GROUP Split_Detect Split_Hill_Detect /end SUB_GROUP /end GROUP
/begin GROUP Split_Hill_Detect ""
 /begin REF_CHARACTERISTIC TP_S16TCSCpSplitHilExtDistanceTh TP_U8TCSCpSplitHilDctAccTh TP_U8TCSCpSplitHilDctEnterCnt TP_U8TCSCpSplitHilDctExitCnt TP_U8TCSCpSplitHilDctSpdTh TP_U8TCSHillDctAlongTh /end REF_CHARACTERISTIC
/end GROUP
/begin GROUP SsmBrkCalPrm "" /begin SUB_GROUP a_AVH /end SUB_GROUP /end GROUP
/begin GROUP SsmEngCalPrm "" /begin SUB_GROUP a_SsmDetn b_AVH c_HSA d_ISG /end SUB_GROUP /end GROUP
/begin GROUP Ssm_BrkCal "" /begin SUB_GROUP SsmBrkCalPrm /end SUB_GROUP /end GROUP
/begin GROUP Ssm_EngCal "" /begin SUB_GROUP EpbCalPrm SsmEngCalPrm /end SUB_GROUP /end GROUP
/begin GROUP SteepReduction ""
 /begin REF_CHARACTERISTIC TP_S16TCSCpBrkPGrdtLimStpRednDecFr TP_S16TCSCpBrkPGrdtLimStpRednDecRe TP_S16TCSCpBrkPGrdtLimStpRednIncFr TP_S16TCSCpBrkPGrdtLimStpRednIncRe /end REF_CHARACTERISTIC
/end GROUP
/begin GROUP StrStabyCtrl_BrkCal ""
 /begin REF_CHARACTERISTIC S16EpsiHndlgAgToTqGainRoadFric1 S16EpsiHndlgAgToTqGainRoadFric2 S16EpsiHndlgAgToTqGainRoadFric3 U16EpsiHndlgCtrlEntrAssiAg U16EpsiHndlgCtrlEntrVehSpd U16EpsiHndlgCtrlHldAssiAg U16EpsiHndlgCtrlHldVehSpd U16EpsiHndlgPGainWghtSteerWhlAgGrdt1 U16EpsiHndlgPGainWghtSteerWhlAgGrdt2 U16EpsiHndlgPGainWghtSteerWhlAgGrdt3 U16EpsiHndlgSteerWhlAgGrdtPGainWght1 U16EpsiHndlgSteerWhlAgGrdtPGainWght2 U16EpsiHndlgSteerWhlAgGrdtPGainWght3 U16EpsiHndlgYawAssiAgVehSpdInsdIncDGain1 U16EpsiHndlgYawAssiAgVehSpdInsdIncDGain2 U16EpsiHndlgYawAssiAgVehSpdInsdIncDGain3 U16EpsiHndlgYawAssiAgVehSpdInsdIncDGain4 U16EpsiHndlgYawAssiAgVehSpdInsdIncDGain5 U16EpsiHndlgYawAssiAgVehSpdOutdDecDGain1 U16EpsiHndlgYawAssiAgVehSpdOutdDecDGain2 U16EpsiHndlgYawAssiAgVehSpdOutdDecDGain3 U16EpsiHndlgYawAssiAgVehSpdOutdDecDGain4 U16EpsiHndlgYawAssiAgVehSpdOutdDecDGain5 U16EpsiHndlgYawAssiAgVehSpdOutdDecPGain1 U16EpsiHndlgYawAssiAgVehSpdOutdDecPGain2 U16EpsiHndlgYawAssiAgVehSpdOutdDecPGain3 U16EpsiHndlgYawAssiAgVehSpdOutdDecPGain4 U16EpsiHndlgYawAssiAgVehSpdOutdDecPGain5 U16EpsiHndlgYawAssiAgVehSpdOutdIncDGain1 U16EpsiHndlgYawAssiAgVehSpdOutdIncDGain2 U16EpsiHndlgYawAssiAgVehSpdOutdIncDGain3 U16EpsiHndlgYawAssiAgVehSpdOutdIncDGain4 U16EpsiHndlgYawAssiAgVehSpdOutdIncDGain5 U16EpsiHndlgYawAssiAgVehSpdOutdIncPGain1 U16EpsiHndlgYawAssiAgVehSpdOutdIncPGain2 U16EpsiHndlgYawAssiAgVehSpdOutdIncPGain3 U16EpsiHndlgYawAssiAgVehSpdOutdIncPGain4 U16EpsiHndlgYawAssiAgVehSpdOutdIncPGain5 U16EpsiSplitAgToTqDGain U16EpsiSplitAgToTqPGain U16EpsiSplitAgToTqVehSpdNegGain1 U16EpsiSplitAgToTqVehSpdNegGain2 U16EpsiSplitAgToTqVehSpdNegGain3 U16EpsiSplitAgToTqVehSpdNegGain4 U16EpsiSplitAgToTqVehSpdNegGain5 U16EpsiSplitAgToTqVehSpdPosGain1 U16EpsiSplitAgToTqVehSpdPosGain2 U16EpsiSplitAgToTqVehSpdPosGain3 U16EpsiSplitAgToTqVehSpdPosGain4 U16EpsiSplitAgToTqVehSpdPosGain5 U16EpsiSplitAssiAgEstimdPeakPErr1 U16EpsiSplitAssiAgEstimdPeakPErr2 U16EpsiSplitAssiAgEstimdPeakPErr3 U16EpsiSplitAssiAgEstimdPeakPErr4 U16EpsiSplitAssiAgEstimdPeakPErr5 U16EpsiSplitAssiAgGmaSlipGain U16EpsiSplitAssiAgVehSpdGain1 U16EpsiSplitAssiAgVehSpdGain2 U16EpsiSplitAssiAgVehSpdGain3 U16EpsiSplitAssiAgVehSpdGain4 U16EpsiSplitAssiAgVehSpdGain5 U16EpsiSplitCtrlEntrAssiAg U16EpsiSplitCtrlEntrVehSpd U16EpsiSplitCtrlHldAssiAg U16EpsiSplitCtrlHldVehSpd U16EpsiSplitDetALat U16EpsiSplitDrvrCoeffDrvrTqMin U16EpsiSplitDrvrCoeffSteerGrdtMin U16EpsiSplitDrvrTqThdSteerGrdt11 U16EpsiSplitDrvrTqThdSteerGrdt12 U16EpsiSplitDrvrTqThdSteerGrdt21 U16EpsiSplitDrvrTqThdSteerGrdt22 U16EpsiSplitDrvrTqThdSteerGrdt31 U16EpsiSplitDrvrTqThdSteerGrdt32 U16EpsiSplitDrvrTqThdSteerGrdt41 U16EpsiSplitDrvrTqThdSteerGrdt42 U16EpsiSplitEstimdPeakPErrAssiAg1 U16EpsiSplitEstimdPeakPErrAssiAg2 U16EpsiSplitEstimdPeakPErrAssiAg3 U16EpsiSplitEstimdPeakPErrAssiAg4 U16EpsiSplitEstimdPeakPErrAssiAg5 U16EpsiSplitSteerGrdtDrvrTqThd11 U16EpsiSplitSteerGrdtDrvrTqThd12 U16EpsiSplitSteerGrdtDrvrTqThd21 U16EpsiSplitSteerGrdtDrvrTqThd22 U16EpsiSplitSteerGrdtDrvrTqThd31 U16EpsiSplitSteerGrdtDrvrTqThd32 U16EpsiSplitSteerGrdtDrvrTqThd41 U16EpsiSplitSteerGrdtDrvrTqThd42 U16EpsiSplitYawAssiAgVehSpdIGain1 U16EpsiSplitYawAssiAgVehSpdIGain2 U16EpsiSplitYawAssiAgVehSpdIGain3 U16EpsiSplitYawAssiAgVehSpdIGain4 U16EpsiSplitYawAssiAgVehSpdIGain5 U16EpsiSplitYawAssiAgVehSpdPGain1 U16EpsiSplitYawAssiAgVehSpdPGain2 U16EpsiSplitYawAssiAgVehSpdPGain3 U16EpsiSplitYawAssiAgVehSpdPGain4 U16EpsiSplitYawAssiAgVehSpdPGain5 U16EpsiSplitYawThd U16EpsiTqMax U16EpsiVehSpd1 U16EpsiVehSpd2 U16EpsiVehSpd3 U16EpsiVehSpd4 U16EpsiVehSpd5 U8EpsiHndlgAgToTqGain U8EpsiHndlgDampgTqGainDrvrTqIdxSum1 U8EpsiHndlgDampgTqGainDrvrTqIdxSum2 U8EpsiHndlgDampgTqGainDrvrTqIdxSum3 U8EpsiHndlgDampgTqVehSpdGain1 U8EpsiHndlgDampgTqVehSpdGain2 U8EpsiHndlgDampgTqVehSpdGain3 U8EpsiHndlgDampgTqVehSpdGain4 U8EpsiHndlgDampgTqVehSpdGain5 U8EpsiHndlgDrvrTqIdxSumDampgTqGain1 U8EpsiHndlgDrvrTqIdxSumDampgTqGain2 U8EpsiHndlgDrvrTqIdxSumDampgTqGain3 U8EpsiHndlgFadeOutTi U8EpsiHndlgFadeOutTq U8EpsiHndlgRoadFricAgToTqGain1 U8EpsiHndlgRoadFricAgToTqGain2 U8EpsiHndlgRoadFricAgToTqGain3 U8EpsiSplitCtrlEntrRoadFricThd1 U8EpsiSplitCtrlEntrRoadFricThd2 U8EpsiSplitCtrlHldRoadFricThd1 U8EpsiSplitCtrlHldRoadFricThd2 U8EpsiSplitDampgTqVehSpdGain1 U8EpsiSplitDampgTqVehSpdGain2 U8EpsiSplitDampgTqVehSpdGain3 U8EpsiSplitDampgTqVehSpdGain4 U8EpsiSplitDampgTqVehSpdGain5 U8EpsiSplitDrvrTqCoeff1 U8EpsiSplitDrvrTqCoeff2 U8EpsiSplitDrvrTqCoeff3 U8EpsiSplitDrvrTqCoeff4 U8EpsiSplitFadeOutTi U8EpsiSplitFadeOutTq U8EpsiYawRateErrThdGain U8EpsiYawRateErrThdRoughRoadGain /end REF_CHARACTERISTIC
/end GROUP
/begin GROUP TVBB_AyDot_Weg_HM ""
 /begin REF_CHARACTERISTIC TQS16_TVBB_TH_AY_VX_DOT_GAIN_HM_1 TQS16_TVBB_TH_AY_VX_DOT_GAIN_HM_2 TQS16_TVBB_TH_AY_VX_DOT_GAIN_HM_3 TQS16_TVBB_TH_REF_AY_VX_DOT_HM_1 TQS16_TVBB_TH_REF_AY_VX_DOT_HM_2 TQS16_TVBB_TH_REF_AY_VX_DOT_HM_3 /end REF_CHARACTERISTIC
/end GROUP
/begin GROUP TVBB_AyDot_Weg_LM ""
 /begin REF_CHARACTERISTIC TQS16_TVBB_TH_AY_VX_DOT_GAIN_LM_1 TQS16_TVBB_TH_AY_VX_DOT_GAIN_LM_2 TQS16_TVBB_TH_AY_VX_DOT_GAIN_LM_3 TQS16_TVBB_TH_REF_AY_VX_DOT_LM_1 TQS16_TVBB_TH_REF_AY_VX_DOT_LM_2 TQS16_TVBB_TH_REF_AY_VX_DOT_LM_3 /end REF_CHARACTERISTIC
/end GROUP
/begin GROUP TVBB_AyDot_Weg_MM ""
 /begin REF_CHARACTERISTIC TQS16_TVBB_TH_AY_VX_DOT_GAIN_MM_1 TQS16_TVBB_TH_AY_VX_DOT_GAIN_MM_2 TQS16_TVBB_TH_AY_VX_DOT_GAIN_MM_3 TQS16_TVBB_TH_REF_AY_VX_DOT_MM_1 TQS16_TVBB_TH_REF_AY_VX_DOT_MM_2 TQS16_TVBB_TH_REF_AY_VX_DOT_MM_3 /end REF_CHARACTERISTIC
/end GROUP
/begin GROUP TVBB_Enter_DelYaw_Weg "" /begin SUB_GROUP TVBB_AyDot_Weg_HM TVBB_AyDot_Weg_LM TVBB_AyDot_Weg_MM /end SUB_GROUP /end GROUP
/begin GROUP TVBB_Mmt_Weg_HM ""
 /begin REF_CHARACTERISTIC TQS16_TVBB_CTRL_PD_WEG_HMU_HSPD TQS16_TVBB_CTRL_PD_WEG_HMU_LSPD TQS16_TVBB_CTRL_PD_WEG_HMU_MHSPD TQS16_TVBB_CTRL_PD_WEG_HMU_MLSPD TQS16_TVBB_HMU_HSPD TQS16_TVBB_HMU_LSPD TQS16_TVBB_HMU_MHSPD TQS16_TVBB_HMU_MLSPD /end REF_CHARACTERISTIC
/end GROUP
/begin GROUP TVBB_Mmt_Weg_LM ""
 /begin REF_CHARACTERISTIC TQS16_TVBB_CTRL_PD_WEG_LMU_HSPD TQS16_TVBB_CTRL_PD_WEG_LMU_LSPD TQS16_TVBB_CTRL_PD_WEG_LMU_MHSPD TQS16_TVBB_CTRL_PD_WEG_LMU_MLSPD TQS16_TVBB_LMU_HSPD TQS16_TVBB_LMU_LSPD TQS16_TVBB_LMU_MHSPD TQS16_TVBB_LMU_MLSPD /end REF_CHARACTERISTIC
/end GROUP
/begin GROUP TVBB_Mmt_Weg_MM ""
 /begin REF_CHARACTERISTIC TQS16_TVBB_CTRL_PD_WEG_MMU_HSPD TQS16_TVBB_CTRL_PD_WEG_MMU_LSPD TQS16_TVBB_CTRL_PD_WEG_MMU_MHSPD TQS16_TVBB_CTRL_PD_WEG_MMU_MLSPD TQS16_TVBB_MMU_HSPD TQS16_TVBB_MMU_LSPD TQS16_TVBB_MMU_MHSPD TQS16_TVBB_MMU_MLSPD /end REF_CHARACTERISTIC
/end GROUP
/begin GROUP TVBB_Tar_Mmt_Eng_tq ""
 /begin REF_CHARACTERISTIC TQS16_TVBB_CTRL_PD_WEG_ENGINE_HTQ TQS16_TVBB_CTRL_PD_WEG_ENGINE_LTQ TQS16_TVBB_CTRL_PD_WEG_ENGINE_MHTQ TQS16_TVBB_CTRL_PD_WEG_ENGINE_MLTQ TQS16_TVBB_ENGINE_HTQ TQS16_TVBB_ENGINE_LTQ TQS16_TVBB_ENGINE_MHTQ TQS16_TVBB_ENGINE_MLTQ /end REF_CHARACTERISTIC
/end GROUP
/begin GROUP TorqueBasedBTCS ""
 /begin REF_CHARACTERISTIC TP_S16TCSCpMaxTCCurnt TP_S16TCSCpTarWhlPreStMax TP_U8TCSCpAfterIIntActScan TP_U8TCSCpAveWhlAcc_1 TP_U8TCSCpAveWhlAcc_2 TP_U8TCSCpChngRateWhlSpin_1 TP_U8TCSCpChngRateWhlSpin_2 TP_U8TCSCpCurntFiltGain TP_U8TCSCpFltGain4GearShiftSt TP_U8TCSCpFltGain4GearShiftTurn TP_U8TCSCpLowPresTh4IniTCVCtl TP_U8TCSCpMonTime4AsymSpnCtlS_1 TP_U8TCSCpMonTime4AsymSpnCtlS_2 TP_U8TCSCpMonTime4SymSpnCtlS_1 TP_U8TCSCpMonTime4SymSpnCtlS_2 TP_U8TCSCpSymDctScanTime TP_U8TCSCpThOfCnt4SpnDiffSlopeDct /end REF_CHARACTERISTIC
 /begin SUB_GROUP Split_Detection /end SUB_GROUP
/end GROUP
/begin GROUP US_Gain ""
 /begin REF_CHARACTERISTIC TQS16_YC_D_GAIN_R_US_IN_DEC TQS16_YC_D_GAIN_R_US_IN_INC TQS16_YC_D_GAIN_R_US_IN_INC_H TQS16_YC_D_GAIN_R_US_IN_INC_L TQS16_YC_D_GAIN_R_US_OUT_DEC TQS16_YC_D_GAIN_R_US_OUT_DEC_H TQS16_YC_D_GAIN_R_US_OUT_DEC_L TQS16_YC_D_GAIN_R_US_OUT_INC TQS16_YC_D_GAIN_R_US_OUT_INC_H TQS16_YC_D_GAIN_R_US_OUT_INC_L TQS16_YC_P_GAIN_R_US_OUT_DEC TQS16_YC_P_GAIN_R_US_OUT_DEC_H TQS16_YC_P_GAIN_R_US_OUT_DEC_L TQS16_YC_P_GAIN_R_US_OUT_INC TQS16_YC_P_GAIN_R_US_OUT_INC_H TQS16_YC_P_GAIN_R_US_OUT_INC_L TQS16_YC_R_SPEED_DEP_HIG_H_GAIN TQS16_YC_R_SPEED_DEP_HIG_L_GAIN TQS16_YC_R_SPEED_DEP_HIG_M_GAIN TQS16_YC_R_SPEED_DEP_LOW_H_GAIN TQS16_YC_R_SPEED_DEP_LOW_L_GAIN TQS16_YC_R_SPEED_DEP_LOW_M_GAIN TQS16_YC_R_SPEED_DEP_MED_H_GAIN TQS16_YC_R_SPEED_DEP_MED_L_GAIN TQS16_YC_R_SPEED_DEP_MED_M_GAIN TQS16_YC_R_SPEED_DEP_VLOW_H_GAIN TQS16_YC_R_SPEED_DEP_VLOW_L_GAIN TQS16_YC_R_SPEED_DEP_VLOW_M_GAIN TQS16_YC_R_SP_DEP_HIG_ABS_GAIN TQS16_YC_R_SP_DEP_HIG_ABS_H_GAIN TQS16_YC_R_SP_DEP_HIG_ABS_L_GAIN TQS16_YC_R_SP_DEP_LOW_ABS_GAIN TQS16_YC_R_SP_DEP_LOW_ABS_H_GAIN TQS16_YC_R_SP_DEP_LOW_ABS_L_GAIN TQS16_YC_R_SP_DEP_MED_ABS_GAIN TQS16_YC_R_SP_DEP_MED_ABS_H_GAIN TQS16_YC_R_SP_DEP_MED_ABS_L_GAIN TQS16_YC_R_SP_DEP_VLOW_ABS_GAIN TQS16_YC_R_SP_DEP_VLOW_ABS_H_GAIN TQS16_YC_R_SP_DEP_VLOW_ABS_L_GAIN /end REF_CHARACTERISTIC
/end GROUP
/begin GROUP VCA "" /begin REF_CHARACTERISTIC TP_S16TCSCpBrkPGrdtLimVCAInc /end REF_CHARACTERISTIC /end GROUP
/begin GROUP VehLgtCoorr_BrkCal "" /begin SUB_GROUP AccBrkCalPrm AebBrkCalPrm DpbBrkCalPrm /end SUB_GROUP /end GROUP
/begin GROUP VehLgtCoorr_EngCal "" /begin SUB_GROUP AccEngCalPrm AebEngCalPrm ComEngCalPrm DpbEngCalPrm /end SUB_GROUP /end GROUP
/begin GROUP Veh_Stat ""
 /begin REF_CHARACTERISTIC SSM_K_EPB_ESC_system SSM_K_EPB_Longitudinal_G_Sensor SSM_K_EPB_Manual_Transmission SSM_K_EPB_Parking_Brake_Type_DIH SSM_K_EPB_PropulsionSystActive_En SSM_K_EPB_Push_Pull_Switch SSM_K_EPB_Rear_Wheel_Drive SSM_K_EPB_Set_Variant_Code_En SSM_K_EPB_Step_On_Brake_Message_En SSM_K_EPB_Telltale_Ill_time_at_IGN_OFF SSM_K_EPB_VICM_system SSM_K_EPB_VehStopDecel_DynamicOn_Time_Th SSM_K_EPB_VehStopDecel_En SSM_K_EPB_VehicleStopDecel_Th_H SSM_K_EPB_VehicleStopDecel_Th_L SSM_K_EPB_Vehicle_Speed_Apply_Slip_Comp_Th_L SSM_K_EPB_Vehicle_Speed_Apply_Th_H SSM_K_EPB_Vehicle_Speed_Apply_Th_L /end REF_CHARACTERISTIC
/end GROUP
/begin GROUP WSLC_BrkCal "" /begin SUB_GROUP AbsCalPrm CbcCalPrm EbdCalPrm /end SUB_GROUP /end GROUP
/begin GROUP WhlPEstimdCalPrm ""
 /begin SUB_GROUP A_WpeHwPrm B_WpeBrkVolumePresPrm C_WpeTcVlvPrm D_WpeNoVlvPrm E_WpeNcVlcPrm F_WpeCmnPrm /end SUB_GROUP
/end GROUP
/begin GROUP WslcEngCalPrm "" /begin REF_CHARACTERISTIC TP_U8_EDC_SYS_ENABLE /end REF_CHARACTERISTIC
 /begin SUB_GROUP A_EDC_SPEED_SETTING B_EDC_ENTRY_THRESHOLD C_EDC_EXIT_THRESHOLD D_EDC_TARGET_DELTA_V E_EDC_PD_GAIN F_EDC_INHIBITION G_EDC_TORQ_DEC_RATE H_EDC_TORQ_INC_LIMIT I_EDC_TM_GEAR_RATIO J_EDC_LOGIC_PARAMETER /end SUB_GROUP
/end GROUP
/begin GROUP Wslc_EngCal "" /begin SUB_GROUP WslcEngCalPrm /end SUB_GROUP /end GROUP
/begin GROUP Wspc_EngCal "" /begin SUB_GROUP BtcsCalPrm EtcsCalPrm /end SUB_GROUP /end GROUP
/begin GROUP a.Esc_Road_Mu "" /begin REF_CHARACTERISTIC TQS16_MU_HIGH TQS16_MU_LOW TQS16_MU_MED TQS16_MU_MED_HIGH /end REF_CHARACTERISTIC /end GROUP
/begin GROUP a.Gain_Speed_V ""
 /begin REF_CHARACTERISTIC TQS16_YC_SPEED_DEP_HIG2_V TQS16_YC_SPEED_DEP_HIG_V TQS16_YC_SPEED_DEP_LOW_V TQS16_YC_SPEED_DEP_MED2_V TQS16_YC_SPEED_DEP_MED_V TQS16_YC_SPEED_DEP_VER_HIG_V TQS16_YC_SPEED_DEP_VLOW_V /end REF_CHARACTERISTIC
/end GROUP
/begin GROUP a.Rop_Model ""
 /begin REF_CHARACTERISTIC TQh_roll TQiix_roll TQmass_roll TQroll_damping TQroll_stiffness /end REF_CHARACTERISTIC
/end GROUP
/begin GROUP a_1stCycle_UR_MinMax_Time ""
 /begin REF_CHARACTERISTIC TP_U8_1ST_CYCLE_UR_RISE_SCAN_MAX TP_U8_1ST_CYCLE_UR_RISE_SCAN_MIN /end REF_CHARACTERISTIC
/end GROUP
/begin GROUP a_1st_Stable_Dump_Threshold ""
 /begin REF_CHARACTERISTIC TP_S16_SP_HI_SIDE_STB_DMP_YDF_TH_BL TP_S16_SP_HI_SIDE_STB_DMP_YDF_TH_H TP_S16_SP_HI_SIDE_STB_DMP_YDF_TH_L TP_S16_SP_HI_SIDE_STB_DMP_YDF_TH_M /end REF_CHARACTERISTIC
/end GROUP
/begin GROUP a_ABS_Bump_detection_1 ""
 /begin REF_CHARACTERISTIC TP_S16_BUMP_HI_SPD TP_S16_BUMP_LOW_SPD TP_S16_BUMP_MED_SPD TP_S8_BUMP_PEAK_ACC_REF_1_DUMP TP_S8_BUMP_PEAK_ACC_REF_MAX_DUMP TP_U8_BUMP_MAX_DUMP_SCANS TP_U8_LIMIT_CNT_FOR_BMP_DCT TP_U8_LIMIT_CNT_SPLT_FOR_BMP_DCT TP_U8_LIMIT_DMP_CNT_FOR_BMP_DCT /end REF_CHARACTERISTIC
/end GROUP
/begin GROUP a_ABS_enter_limit_by_slip ""
 /begin REF_CHARACTERISTIC TP_S16_ABS_ALLOW_SLIP_REF_HSPD TP_S16_ABS_ALLOW_SLIP_REF_LSPD TP_S8_ABS_ALLOW_SLIP_HSPD TP_S8_ABS_ALLOW_SLIP_HSPD_BEND TP_S8_ABS_ALLOW_SLIP_HSPD_BEND_IN TP_S8_ABS_ALLOW_SLIP_HSPD_BEND_OUT TP_S8_ABS_ALLOW_SLIP_HSPD_IN TP_S8_ABS_ALLOW_SLIP_LSPD TP_S8_ABS_ALLOW_SLIP_LSPD_BEND TP_S8_ABS_ALLOW_SLIP_LSPD_BEND_IN TP_S8_ABS_ALLOW_SLIP_LSPD_BEND_OUT TP_S8_ABS_ALLOW_SLIP_LSPD_IN TP_U8_ABS_ENTRANCE_LIMIT_BY_SLIP /end REF_CHARACTERISTIC
/end GROUP
/begin GROUP a_AVH ""
 /begin SUB_GROUP aa_Roll_Detection ab_Max_Activation_Time ac_Max_Slope ad_AVH_Logic_Tuning ae_AVH_etc /end SUB_GROUP
/end GROUP
/begin GROUP a_Application_Tuning ""
 /begin SUB_GROUP a_Mu_Detection b_dV_setting c_GMA d_LFC e_dP_Control f_Rough_Road g_ABS_in_ESC_system /end SUB_GROUP
/end GROUP
/begin GROUP a_Asymmetric ""
 /begin REF_CHARACTERISTIC TP_S16TCSCpThOfWhlSpnDiffInSt[0] TP_S16TCSCpThOfWhlSpnDiffInSt[1] TP_S16TCSCpThOfWhlSpnDiffInSt[2] TP_S16TCSCpThOfWhlSpnDiffInSt[3] TP_S16TCSCpThOfWhlSpnDiffInSt[4] /end REF_CHARACTERISTIC
/end GROUP
/begin GROUP a_Asymmetric_Torque "" /begin SUB_GROUP a_Base_Torque b_P_Effect c_I_Effect /end SUB_GROUP /end GROUP
/begin GROUP a_BF_AFZOK_UR_Thres ""
 /begin REF_CHARACTERISTIC TP_S8_UNSTABLE_RISE_REF_ARAD_1st_F TP_S8_UNSTABLE_RISE_REF_ARAD_1st_R TP_U8_UNSTABLE_RISE_REF_DUMP_1st_F TP_U8_UNSTABLE_RISE_REF_DUMP_1st_R /end REF_CHARACTERISTIC
/end GROUP
/begin GROUP a_BF_AFZ_OK_Front ""
 /begin REF_CHARACTERISTIC TP_U8_High_Vel_dV_Pro_BF_AFZOK_F TP_U8_dV_BF_AFZOK_100kph_F TP_U8_dV_BF_AFZOK_10kph_F TP_U8_dV_BF_AFZOK_120kph_F TP_U8_dV_BF_AFZOK_140kph_F TP_U8_dV_BF_AFZOK_160kph_F TP_U8_dV_BF_AFZOK_20kph_F TP_U8_dV_BF_AFZOK_40kph_F TP_U8_dV_BF_AFZOK_60kph_F TP_U8_dV_BF_AFZOK_80kph_F /end REF_CHARACTERISTIC
/end GROUP
/begin GROUP a_BaseTorque_Straight ""
 /begin REF_CHARACTERISTIC TP_U8TCSCpBsAsmdMuDiffSt_F[0] TP_U8TCSCpBsAsmdMuDiffSt_F[1] TP_U8TCSCpBsAsmdMuDiffSt_F[2] TP_U8TCSCpBsAsmdMuDiffSt_F[3] TP_U8TCSCpBsAsmdMuDiffSt_F[4] TP_U8TCSCpBsAsmdMuDiffSt_R[0] TP_U8TCSCpBsAsmdMuDiffSt_R[1] TP_U8TCSCpBsAsmdMuDiffSt_R[2] TP_U8TCSCpBsAsmdMuDiffSt_R[3] TP_U8TCSCpBsAsmdMuDiffSt_R[4] /end REF_CHARACTERISTIC
/end GROUP
/begin GROUP a_Base_Torque "" /begin SUB_GROUP a_BaseTorque_Straight b_BaseTorque_Hill c_BaseTorque_Turn /end SUB_GROUP /end GROUP
/begin GROUP a_Before_AFZ_OK "" /begin SUB_GROUP a_BF_AFZ_OK_Front b_BF_AFZ_OK_Rear /end SUB_GROUP /end GROUP
/begin GROUP a_Before_AFZ_OK_Gain_Front ""
 /begin REF_CHARACTERISTIC TP_S16_Decel_Gain_BFAFZOK_100_150_F TP_S16_Decel_Gain_BFAFZOK_10_20_F TP_S16_Decel_Gain_BFAFZOK_20_40_F TP_S16_Decel_Gain_BFAFZOK_40_60_F TP_S16_Decel_Gain_BFAFZOK_60_100_F TP_S16_Decel_Gain_BFAFZOK_Ab_150_F TP_S16_Decel_Gain_BFAFZOK_B_10_F TP_S16_Slip_Gain_BFAFZOK_100_150_F TP_S16_Slip_Gain_BFAFZOK_10_20_F TP_S16_Slip_Gain_BFAFZOK_20_40_F TP_S16_Slip_Gain_BFAFZOK_40_60_F TP_S16_Slip_Gain_BFAFZOK_60_100_F TP_S16_Slip_Gain_BFAFZOK_Ab_150_F TP_S16_Slip_Gain_BFAFZOK_B_10_F /end REF_CHARACTERISTIC
/end GROUP
/begin GROUP a_Below_20KPH ""
 /begin REF_CHARACTERISTIC TP_S8_Arad_1stPoint_B_20KPH TP_S8_Arad_2ndPoint_B_20KPH TP_S8_Arad_3rdPoint_B_20KPH TP_S8_Arad_Fact_1_2P_B_20KPH TP_S8_Arad_Fact_2_3P_B_20KPH TP_S8_Arad_Fact_Ab_3P_B_20KPH TP_S8_Arad_Fact_B_1P_B_20KPH /end REF_CHARACTERISTIC
/end GROUP
/begin GROUP a_Both_Over_F ""
 /begin REF_CHARACTERISTIC TP_U8_STB_DMP_MAX_HIGH_BothOverInF TP_U8_STB_DMP_MAX_LOW_BothOverInF TP_U8_STB_DMP_MAX_MED_BothOverInF TP_U8_STB_DMP_MAX_SP_BothOverInF /end REF_CHARACTERISTIC
/end GROUP
/begin GROUP a_BrkAssisCoorrDetn ""
 /begin REF_CHARACTERISTIC BAC_S16_BAC_SLIP_SPEED_GAIN_DEP_H_V BAC_S16_BAC_SLIP_SPEED_GAIN_DEP_L_V BAC_S16_BAC_SLIP_SPEED_GAIN_DEP_M_V BAC_S8_BAC_ENTER_SLIP_HSP BAC_S8_BAC_ENTER_SLIP_LSP BAC_S8_BAC_ENTER_SLIP_MSP /end REF_CHARACTERISTIC
/end GROUP
/begin GROUP a_CBC_Enter_Ay_Thres ""
 /begin REF_CHARACTERISTIC TP_S16_CBC_ALAT_ENTER_SPD_H_FAST_STR TP_S16_CBC_ALAT_ENTER_SPD_H_SLOW_STR TP_S16_CBC_ALAT_ENTER_SPD_M_FAST_STR TP_S16_CBC_ALAT_ENTER_SPD_M_SLOW_STR TP_S16_CBC_ALAT_ENTER_SPD_S_FAST_STR TP_S16_CBC_ALAT_ENTER_SPD_S_SLOW_STR /end REF_CHARACTERISTIC
/end GROUP
/begin GROUP a_CBC_Enter_Thres ""
 /begin REF_CHARACTERISTIC TP_S16_CBC_BRAKING_DET_THRES TP_S16_CBC_BRAKING_MIN_THRES TP_S16_CBC_MPRESS_ENTER /end REF_CHARACTERISTIC
 /begin SUB_GROUP a_CBC_Enter_Ay_Thres b_CBC_Enter_Arad_Thres c_CBC_Enter_Decel_Thres d_CBC_Enter_Slip_Thres /end SUB_GROUP
/end GROUP
/begin GROUP a_CBC_Ref_Speed ""
 /begin REF_CHARACTERISTIC TP_S16_CBC_THRES_HIGH_SPEED TP_S16_CBC_THRES_LOW_SPEED TP_S16_CBC_THRES_MED_SPEED /end REF_CHARACTERISTIC
/end GROUP
/begin GROUP a_CBC_abs_Enter_Thres ""
 /begin REF_CHARACTERISTIC TP_S16_CBC_ALAT_ENTER_SPD_H TP_S16_CBC_ALAT_ENTER_SPD_M TP_S16_CBC_ALAT_ENTER_SPD_S TP_S16_CBC_BRAKING_DET_THRES_ABS TP_S16_CBC_BRAKING_MIN_THRES_ABS TP_S16_CBC_MPRESS_ENTER_ABS /end REF_CHARACTERISTIC
/end GROUP
/begin GROUP a_Certain_Hmu ""
 /begin REF_CHARACTERISTIC TP_S8_FORCED_HLD_SLIP_CHMU_A80KPH_F TP_S8_FORCED_HLD_SLIP_CHMU_B40KPH_F TP_S8_FORCED_HLD_SLIP_CHMU_B80KPH_F /end REF_CHARACTERISTIC
/end GROUP
/begin GROUP a_Conventional_Reapply_Time ""
 /begin REF_CHARACTERISTIC TP_S8_LFC_Conven_Reapply_Time_F TP_S8_LFC_Conven_Reapply_Time_R /end REF_CHARACTERISTIC
/end GROUP
/begin GROUP a_Cyclic_comp_disable ""
 /begin REF_CHARACTERISTIC TP_S8_Rough_Disab_Dump_BF_AFZOK_F TP_S8_Rough_Disab_Dump_BF_AFZOK_R TP_S8_Rough_Disab_Dump_High_F TP_S8_Rough_Disab_Dump_High_R TP_S8_Rough_Disab_Dump_Low_F TP_S8_Rough_Disab_Dump_Low_R TP_S8_Rough_Disab_Dump_Med_F TP_S8_Rough_Disab_Dump_Med_R TP_S8_Rough_Disab_Dump_Ref_F TP_S8_Rough_Disab_Dump_Ref_R /end REF_CHARACTERISTIC
/end GROUP
/begin GROUP a_DeltaP_Comp_Duty ""
 /begin REF_CHARACTERISTIC TP_S16_DP_DUTY_COMP_REF_MPRESS TP_S8_ADDON_TIME_FOR_LOW_MP_F TP_S8_ADDON_TIME_FOR_LOW_MP_R TP_U8_DPDutyCompRef_HighMuSkid TP_U8_DPDutyCompRef_HighMuSkidR TP_U8_DPDutyCompRef_MPVariation TP_U8_DPDutyCompRef_MPVariationR TP_U8_DPDutyCompRef_PDiffFromSkid TP_U8_DPDutyCompRef_PDiffFromSkidR /end REF_CHARACTERISTIC
/end GROUP
/begin GROUP a_DumpHold_YDF_Ref ""
 /begin REF_CHARACTERISTIC TP_S16_NEED_DEC_PRESS_YDF_L1 TP_S16_NEED_DEC_PRESS_YDF_L2 TP_S16_NEED_DEC_PRESS_YDF_L3 /end REF_CHARACTERISTIC
/end GROUP
/begin GROUP a_EBD_Apply "" /begin SUB_GROUP a_EBD_Reapply_Time b_EBD_Reapply_Hold_Scans /end SUB_GROUP /end GROUP
/begin GROUP a_EBD_Cut_in_arad_Thres ""
 /begin REF_CHARACTERISTIC TP_S8_EBD_Cut_Arad_100_150KPH TP_S8_EBD_Cut_Arad_20_40KPH TP_S8_EBD_Cut_Arad_40_60KPH TP_S8_EBD_Cut_Arad_60_100KPH TP_S8_EBD_Cut_Arad_Ab_150KPH TP_S8_EBD_Cut_Arad_B_20KPH /end REF_CHARACTERISTIC
/end GROUP
/begin GROUP a_EBD_Dump_Gain ""
 /begin REF_CHARACTERISTIC TP_S16_Decel_Gain_EBD_100_150kph_R TP_S16_Decel_Gain_EBD_20_40kph_R TP_S16_Decel_Gain_EBD_40_60kph_R TP_S16_Decel_Gain_EBD_60_100kph_R TP_S16_Decel_Gain_EBD_Ab_150kph_R TP_S16_Decel_Gain_EBD_B_20kph_R TP_S16_Slip_Gain_EBD_100_150kph_R TP_S16_Slip_Gain_EBD_20_40kph_R TP_S16_Slip_Gain_EBD_40_60kph_R TP_S16_Slip_Gain_EBD_60_100kph_R TP_S16_Slip_Gain_EBD_Ab_150kph_R TP_S16_Slip_Gain_EBD_B_20kph_R /end REF_CHARACTERISTIC
/end GROUP
/begin GROUP a_EBD_Reapply_Time "" /begin REF_CHARACTERISTIC TP_S8_LFC_Conven_Reapply_Time_R_EBD /end REF_CHARACTERISTIC /end GROUP
/begin GROUP a_EBD_slip_Thres_Initial ""
 /begin REF_CHARACTERISTIC TP_U8_EBD_Cut_Slip_100_150kph TP_U8_EBD_Cut_Slip_20_40kph TP_U8_EBD_Cut_Slip_40_60kph TP_U8_EBD_Cut_Slip_60_100kph TP_U8_EBD_Cut_Slip_Ab_150kph TP_U8_EBD_Cut_Slip_B_20kph /end REF_CHARACTERISTIC
/end GROUP
/begin GROUP a_EBP "" /begin SUB_GROUP aa_EBP_Activation ab_EBP_Enter ac_EBP_Exit /end SUB_GROUP /end GROUP
/begin GROUP a_Fadeout_straight_FA ""
 /begin REF_CHARACTERISTIC TP_S16TCSCpFadeOutCtrlHghPreSTTh_FA TP_S16TCSCpFadeOutCtrlLowPreSTTh_FA TP_S16TCSCpFadeOutDecTQ4HghPreST_FA TP_S16TCSCpFadeOutDecTQ4LowPreST_FA /end REF_CHARACTERISTIC
/end GROUP
/begin GROUP a_First_Cycle_Adaptation "" /begin REF_CHARACTERISTIC TP_S16_Additional_HDF_ref_F TP_S16_Additional_HDF_ref_R /end REF_CHARACTERISTIC
 /begin SUB_GROUP a_First_Cycle_Low_Ref_Front b_First_Cycle_Low_Ref_Rear c_First_Cycle_LowMed_Ref_Front d_First_Cycle_LowMed_Ref_Rear /end SUB_GROUP
/end GROUP
/begin GROUP a_First_Cycle_Low_Ref_Front ""
 /begin REF_CHARACTERISTIC TP_S16_HDF_REF_LMu_40_60kph_F TP_S16_HDF_REF_LMu_Ab_60kph_F TP_S16_HDF_REF_LMu_B_40kph_F /end REF_CHARACTERISTIC
/end GROUP
/begin GROUP a_Front_H "" /begin REF_CHARACTERISTIC TP_S8_dP_Arad_Ref_Ab_HMu_F TP_U8_dP_Dump_cnt_Ref_Ab_HMu_F /end REF_CHARACTERISTIC /end GROUP
/begin GROUP a_Front_H_T ""
 /begin REF_CHARACTERISTIC TP_U8_dPTim_Dump_Ref_Ab_HMu_1_F TP_U8_dPTim_Dump_Ref_Ab_HMu_2_F TP_U8_dPTim_Dump_Ref_Ab_HMu_3_F TP_U8_dPTim_by_Dump_Ab_HMu_1_F TP_U8_dPTim_by_Dump_Ab_HMu_2_F TP_U8_dPTim_by_Dump_Ab_HMu_3_F TP_U8_dPTim_by_Dump_Ab_HMu_Max_F /end REF_CHARACTERISTIC
/end GROUP
/begin GROUP a_Front_Initial ""
 /begin REF_CHARACTERISTIC TP_U8_dP_HMu_Dct_AradRef_1st_F TP_U8_dP_HMu_Dct_DumpRef_1st_F TP_U8_dP_LMu_Dct_AradRef_1st_F TP_U8_dP_LMu_Dct_DumpRef_1st_F /end REF_CHARACTERISTIC
/end GROUP
/begin GROUP a_Front_L "" /begin REF_CHARACTERISTIC TP_S8_dP_Arad_Ref_Bw_LMu_F TP_U8_dP_Dump_cnt_Ref_Bw_LMu_F /end REF_CHARACTERISTIC /end GROUP
/begin GROUP a_Front_LM ""
 /begin REF_CHARACTERISTIC TP_S8_dP_Arad_Ref_LMMu_MMu_F TP_U8_dP_Dump_cnt_Ref_LMMu_MMu_F /end REF_CHARACTERISTIC
/end GROUP
/begin GROUP a_Front_LM_T ""
 /begin REF_CHARACTERISTIC TP_U8_dPTim_Dump_Ref_LMMu_MMu_1_F TP_U8_dPTim_Dump_Ref_LMMu_MMu_2_F TP_U8_dPTim_Dump_Ref_LMMu_MMu_3_F TP_U8_dPTim_by_Dump_LMMu_MMu_1_F TP_U8_dPTim_by_Dump_LMMu_MMu_2_F TP_U8_dPTim_by_Dump_LMMu_MMu_3_F TP_U8_dPTim_by_Dump_LMMu_MMu_Max_F /end REF_CHARACTERISTIC
/end GROUP
/begin GROUP a_Front_L_T ""
 /begin REF_CHARACTERISTIC TP_U8_dPTim_Dump_Ref_Bw_LMu_1_F TP_U8_dPTim_Dump_Ref_Bw_LMu_2_F TP_U8_dPTim_Dump_Ref_Bw_LMu_3_F TP_U8_dPTim_by_Dump_Bw_LMu_1_F TP_U8_dPTim_by_Dump_Bw_LMu_2_F TP_U8_dPTim_by_Dump_Bw_LMu_3_F TP_U8_dPTim_by_Dump_Bw_LMu_Max_F /end REF_CHARACTERISTIC
/end GROUP
/begin GROUP a_Front_M ""
 /begin REF_CHARACTERISTIC TP_S8_dP_Arad_Ref_MMu_MHMu_F TP_U8_dP_Dump_cnt_Ref_MMu_MHMu_F /end REF_CHARACTERISTIC
/end GROUP
/begin GROUP a_Front_MH ""
 /begin REF_CHARACTERISTIC TP_S8_dP_Arad_Ref_MHMu_HMu_F TP_U8_dP_Dump_cnt_Ref_MHMu_HMu_F /end REF_CHARACTERISTIC
/end GROUP
/begin GROUP a_Front_MH_T ""
 /begin REF_CHARACTERISTIC TP_U8_dPTim_Dump_Ref_MHMu_HMu_1_F TP_U8_dPTim_Dump_Ref_MHMu_HMu_2_F TP_U8_dPTim_Dump_Ref_MHMu_HMu_3_F TP_U8_dPTim_by_Dump_MHMu_HMu_1_F TP_U8_dPTim_by_Dump_MHMu_HMu_2_F TP_U8_dPTim_by_Dump_MHMu_HMu_3_F TP_U8_dPTim_by_Dump_MHMu_HMu_Max_F /end REF_CHARACTERISTIC
/end GROUP
/begin GROUP a_Front_M_T ""
 /begin REF_CHARACTERISTIC TP_U8_dPTim_Dump_Ref_MMu_MHMu_1_F TP_U8_dPTim_Dump_Ref_MMu_MHMu_2_F TP_U8_dPTim_Dump_Ref_MMu_MHMu_3_F TP_U8_dPTim_by_Dump_MMu_MHMu_1_F TP_U8_dPTim_by_Dump_MMu_MHMu_2_F TP_U8_dPTim_by_Dump_MMu_MHMu_3_F TP_U8_dPTim_by_Dump_MMu_MHMu_Max_F /end REF_CHARACTERISTIC
/end GROUP
/begin GROUP a_Front_Pulse_down_LMu_AB ""
 /begin REF_CHARACTERISTIC TP_S8_Decel_Gain_LMu_10_20k_F_HDC TP_S8_Decel_Gain_LMu_B_10k_F_HDC TP_S8_Slip_Gain_LMu_10_20k_F_HDC TP_S8_Slip_Gain_LMu_B_10k_F_HDC /end REF_CHARACTERISTIC
/end GROUP
/begin GROUP a_Front_SP_HighSide "" /begin REF_CHARACTERISTIC TP_S8_dP_Arad_Ref_SpHMu_F TP_U8_dP_Dump_cnt_Ref_SpHMu_F /end REF_CHARACTERISTIC /end GROUP
/begin GROUP a_Front_SP_HighSide_T ""
 /begin REF_CHARACTERISTIC TP_U8_dPTim_Dump_Ref_SPHMu_1_F TP_U8_dPTim_Dump_Ref_SPHMu_2_F TP_U8_dPTim_Dump_Ref_SPHMu_3_F TP_U8_dPTim_by_Dump_SPHMu_1_F TP_U8_dPTim_by_Dump_SPHMu_2_F TP_U8_dPTim_by_Dump_SPHMu_3_F TP_U8_dPTim_by_Dump_SPHMu_Max_F /end REF_CHARACTERISTIC
/end GROUP
/begin GROUP a_Front_UL ""
 /begin REF_CHARACTERISTIC TP_S8_dP_Arad_Ref_LMu_LMMu_F TP_U8_dP_Dump_cnt_Ref_LMu_LMMu_F /end REF_CHARACTERISTIC
/end GROUP
/begin GROUP a_Front_UL_T ""
 /begin REF_CHARACTERISTIC TP_U8_dPTim_Dump_Ref_LMu_LMMu_1_F TP_U8_dPTim_Dump_Ref_LMu_LMMu_2_F TP_U8_dPTim_Dump_Ref_LMu_LMMu_3_F TP_U8_dPTim_by_Dump_LMu_LMMu_1_F TP_U8_dPTim_by_Dump_LMu_LMMu_2_F TP_U8_dPTim_by_Dump_LMu_LMMu_3_F TP_U8_dPTim_by_Dump_LMu_LMMu_Max_F /end REF_CHARACTERISTIC
/end GROUP
/begin GROUP a_Front_positive_slip ""
 /begin REF_CHARACTERISTIC TP_S8_F_WL_Fact_ASum1G_SlipPos TP_S8_F_WL_Fact_ASum3G_SlipPos TP_S8_F_WL_Fact_ASumAb3G_SlipPos /end REF_CHARACTERISTIC
/end GROUP
/begin GROUP a_GMA_Control "" /begin REF_CHARACTERISTIC TP_U8_Usage_Level_of_ESC_Sen /end REF_CHARACTERISTIC /end GROUP
/begin GROUP a_GMA_Detection_BfABS ""
 /begin REF_CHARACTERISTIC TP_S16_GMA_DCT_SP_DIFF_0_50_BABS TP_S16_GMA_DCT_SP_DIFF_50_80_BABS TP_S16_GMA_DCT_SP_DIFF_80_M_BABS TP_S8_GMA_DCT_SLIP_DIFF_0_50_BABS TP_S8_GMA_DCT_SLIP_DIFF_50_80_BABS TP_S8_GMA_DCT_SLIP_DIFF_80_M_BABS /end REF_CHARACTERISTIC
/end GROUP
/end MODULE
/end PROJECT
