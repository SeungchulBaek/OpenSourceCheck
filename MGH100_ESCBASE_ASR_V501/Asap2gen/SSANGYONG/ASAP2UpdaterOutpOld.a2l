ASAP2_VERSION 1 60
/begin PROJECT Master ""
/begin MODULE CPP ""
/begin MOD_COMMON "" BYTE_ORDER MSB_LAST ALIGNMENT_BYTE 1 ALIGNMENT_WORD 1 ALIGNMENT_LONG 1 ALIGNMENT_FLOAT32_IEEE 1 ALIGNMENT_FLOAT64_IEEE 1 ALIGNMENT_INT64 1 /end MOD_COMMON
/begin CHARACTERISTIC U16MotActtnVehWhlSpdAbs "If vehicle speed is smaller than this value, ABS control not active" VALUE 0x800213D8 CalPrmBrkTqCtrlrBrk_UWORD 0 Spd11 0 1023.984375 SYMBOL_LINK "CalPrmBrkTqCtrlrBrk01.U16MotActtnVehWhlSpdAbs" 0 /end CHARACTERISTIC
/begin COMPU_METHOD Spd11 "" LINEAR "%.15" "kph" COEFFS_LINEAR 0.015625 0 /end COMPU_METHOD
/begin RECORD_LAYOUT CalPrmBrkTqCtrlrBrk_UWORD FNC_VALUES 1 UWORD COLUMN_DIR DIRECT ALIGNMENT_BYTE 1 ALIGNMENT_WORD 1 ALIGNMENT_LONG 1 ALIGNMENT_FLOAT32_IEEE 1 ALIGNMENT_FLOAT64_IEEE 1 ALIGNMENT_INT64 1 /end RECORD_LAYOUT
/begin GROUP A.AbsMotCtrlInhb "" /begin REF_CHARACTERISTIC U16MotActtnVehWhlSpdAbs /end REF_CHARACTERISTIC /end GROUP
/begin GROUP A.AbsMotCtrlr "" /begin SUB_GROUP A.AbsMotCtrlInhb B.AbsIniMotU C.AbsCtrlMotU /end SUB_GROUP /end GROUP
/begin VARIANT_CODING
 /begin VAR_CHARACTERISTIC TQYc_Map[7][11] BrkCalVariantCriterion
  /begin VAR_ADDRESS 0x8002015A 0x8002355A 0x8002695A 0x80029D5A 0x8002D15A 0x8003055A 0x8003395A 0x80036D5A /end VAR_ADDRESS
 /end VAR_CHARACTERISTIC
 /begin VAR_CHARACTERISTIC TQYc_Map[7][1] BrkCalVariantCriterion
  /begin VAR_ADDRESS 0x80020146 0x80023546 0x80026946 0x80029D46 0x8002D146 0x80030546 0x80033946 0x80036D46 /end VAR_ADDRESS
 /end VAR_CHARACTERISTIC
 /begin VAR_CHARACTERISTIC TQYc_Map[7][2] BrkCalVariantCriterion
  /begin VAR_ADDRESS 0x80020148 0x80023548 0x80026948 0x80029D48 0x8002D148 0x80030548 0x80033948 0x80036D48 /end VAR_ADDRESS
 /end VAR_CHARACTERISTIC
 /begin VAR_CHARACTERISTIC TQYc_Map[7][3] BrkCalVariantCriterion
  /begin VAR_ADDRESS 0x8002014A 0x8002354A 0x8002694A 0x80029D4A 0x8002D14A 0x8003054A 0x8003394A 0x80036D4A /end VAR_ADDRESS
 /end VAR_CHARACTERISTIC
 /begin VAR_CHARACTERISTIC TQYc_Map[7][4] BrkCalVariantCriterion
  /begin VAR_ADDRESS 0x8002014C 0x8002354C 0x8002694C 0x80029D4C 0x8002D14C 0x8003054C 0x8003394C 0x80036D4C /end VAR_ADDRESS
 /end VAR_CHARACTERISTIC
 /begin VAR_CHARACTERISTIC TQYc_Map[7][5] BrkCalVariantCriterion
  /begin VAR_ADDRESS 0x8002014E 0x8002354E 0x8002694E 0x80029D4E 0x8002D14E 0x8003054E 0x8003394E 0x80036D4E /end VAR_ADDRESS
 /end VAR_CHARACTERISTIC
 /begin VAR_CHARACTERISTIC TQYc_Map[7][6] BrkCalVariantCriterion
  /begin VAR_ADDRESS 0x80020150 0x80023550 0x80026950 0x80029D50 0x8002D150 0x80030550 0x80033950 0x80036D50 /end VAR_ADDRESS
 /end VAR_CHARACTERISTIC
 /begin VAR_CHARACTERISTIC TQYc_Map[7][7] BrkCalVariantCriterion
  /begin VAR_ADDRESS 0x80020152 0x80023552 0x80026952 0x80029D52 0x8002D152 0x80030552 0x80033952 0x80036D52 /end VAR_ADDRESS
 /end VAR_CHARACTERISTIC
 /begin VAR_CHARACTERISTIC TQYc_Map[7][8] BrkCalVariantCriterion
  /begin VAR_ADDRESS 0x80020154 0x80023554 0x80026954 0x80029D54 0x8002D154 0x80030554 0x80033954 0x80036D54 /end VAR_ADDRESS
 /end VAR_CHARACTERISTIC
 /begin VAR_CHARACTERISTIC TQYc_Map[7][9] BrkCalVariantCriterion
  /begin VAR_ADDRESS 0x80020156 0x80023556 0x80026956 0x80029D56 0x8002D156 0x80030556 0x80033956 0x80036D56 /end VAR_ADDRESS
 /end VAR_CHARACTERISTIC
 /begin VAR_CHARACTERISTIC TQYc_Map[8][0] BrkCalVariantCriterion
  /begin VAR_ADDRESS 0x8002015C 0x8002355C 0x8002695C 0x80029D5C 0x8002D15C 0x8003055C 0x8003395C 0x80036D5C /end VAR_ADDRESS
 /end VAR_CHARACTERISTIC
 /begin VAR_CHARACTERISTIC TQYc_Map[8][10] BrkCalVariantCriterion
  /begin VAR_ADDRESS 0x80020170 0x80023570 0x80026970 0x80029D70 0x8002D170 0x80030570 0x80033970 0x80036D70 /end VAR_ADDRESS
 /end VAR_CHARACTERISTIC
 /begin VAR_CHARACTERISTIC TQYc_Map[8][11] BrkCalVariantCriterion
  /begin VAR_ADDRESS 0x80020172 0x80023572 0x80026972 0x80029D72 0x8002D172 0x80030572 0x80033972 0x80036D72 /end VAR_ADDRESS
 /end VAR_CHARACTERISTIC
 /begin VAR_CHARACTERISTIC TQYc_Map[8][1] BrkCalVariantCriterion
  /begin VAR_ADDRESS 0x8002015E 0x8002355E 0x8002695E 0x80029D5E 0x8002D15E 0x8003055E 0x8003395E 0x80036D5E /end VAR_ADDRESS
 /end VAR_CHARACTERISTIC
 /begin VAR_CHARACTERISTIC TQYc_Map[8][2] BrkCalVariantCriterion
  /begin VAR_ADDRESS 0x80020160 0x80023560 0x80026960 0x80029D60 0x8002D160 0x80030560 0x80033960 0x80036D60 /end VAR_ADDRESS
 /end VAR_CHARACTERISTIC
 /begin VAR_CHARACTERISTIC TQYc_Map[8][3] BrkCalVariantCriterion
  /begin VAR_ADDRESS 0x80020162 0x80023562 0x80026962 0x80029D62 0x8002D162 0x80030562 0x80033962 0x80036D62 /end VAR_ADDRESS
 /end VAR_CHARACTERISTIC
 /begin VAR_CHARACTERISTIC TQYc_Map[8][4] BrkCalVariantCriterion
  /begin VAR_ADDRESS 0x80020164 0x80023564 0x80026964 0x80029D64 0x8002D164 0x80030564 0x80033964 0x80036D64 /end VAR_ADDRESS
 /end VAR_CHARACTERISTIC
 /begin VAR_CHARACTERISTIC TQYc_Map[8][5] BrkCalVariantCriterion
  /begin VAR_ADDRESS 0x80020166 0x80023566 0x80026966 0x80029D66 0x8002D166 0x80030566 0x80033966 0x80036D66 /end VAR_ADDRESS
 /end VAR_CHARACTERISTIC
 /begin VAR_CHARACTERISTIC TQYc_Map[8][6] BrkCalVariantCriterion
  /begin VAR_ADDRESS 0x80020168 0x80023568 0x80026968 0x80029D68 0x8002D168 0x80030568 0x80033968 0x80036D68 /end VAR_ADDRESS
 /end VAR_CHARACTERISTIC
 /begin VAR_CHARACTERISTIC TQYc_Map[8][7] BrkCalVariantCriterion
  /begin VAR_ADDRESS 0x8002016A 0x8002356A 0x8002696A 0x80029D6A 0x8002D16A 0x8003056A 0x8003396A 0x80036D6A /end VAR_ADDRESS
 /end VAR_CHARACTERISTIC
 /begin VAR_CHARACTERISTIC TQYc_Map[8][8] BrkCalVariantCriterion
  /begin VAR_ADDRESS 0x8002016C 0x8002356C 0x8002696C 0x80029D6C 0x8002D16C 0x8003056C 0x8003396C 0x80036D6C /end VAR_ADDRESS
 /end VAR_CHARACTERISTIC
 /begin VAR_CHARACTERISTIC TQYc_Map[8][9] BrkCalVariantCriterion
  /begin VAR_ADDRESS 0x8002016E 0x8002356E 0x8002696E 0x80029D6E 0x8002D16E 0x8003056E 0x8003396E 0x80036D6E /end VAR_ADDRESS
 /end VAR_CHARACTERISTIC
 /begin VAR_CHARACTERISTIC TQYc_Map[9][0] BrkCalVariantCriterion
  /begin VAR_ADDRESS 0x80020174 0x80023574 0x80026974 0x80029D74 0x8002D174 0x80030574 0x80033974 0x80036D74 /end VAR_ADDRESS
 /end VAR_CHARACTERISTIC
 /begin VAR_CHARACTERISTIC TQYc_Map[9][10] BrkCalVariantCriterion
  /begin VAR_ADDRESS 0x80020188 0x80023588 0x80026988 0x80029D88 0x8002D188 0x80030588 0x80033988 0x80036D88 /end VAR_ADDRESS
 /end VAR_CHARACTERISTIC
 /begin VAR_CHARACTERISTIC TQYc_Map[9][11] BrkCalVariantCriterion
  /begin VAR_ADDRESS 0x8002018A 0x8002358A 0x8002698A 0x80029D8A 0x8002D18A 0x8003058A 0x8003398A 0x80036D8A /end VAR_ADDRESS
 /end VAR_CHARACTERISTIC
 /begin VAR_CHARACTERISTIC TQYc_Map[9][1] BrkCalVariantCriterion
  /begin VAR_ADDRESS 0x80020176 0x80023576 0x80026976 0x80029D76 0x8002D176 0x80030576 0x80033976 0x80036D76 /end VAR_ADDRESS
 /end VAR_CHARACTERISTIC
 /begin VAR_CHARACTERISTIC TQYc_Map[9][2] BrkCalVariantCriterion
  /begin VAR_ADDRESS 0x80020178 0x80023578 0x80026978 0x80029D78 0x8002D178 0x80030578 0x80033978 0x80036D78 /end VAR_ADDRESS
 /end VAR_CHARACTERISTIC
 /begin VAR_CHARACTERISTIC TQYc_Map[9][3] BrkCalVariantCriterion
  /begin VAR_ADDRESS 0x8002017A 0x8002357A 0x8002697A 0x80029D7A 0x8002D17A 0x8003057A 0x8003397A 0x80036D7A /end VAR_ADDRESS
 /end VAR_CHARACTERISTIC
 /begin VAR_CHARACTERISTIC TQYc_Map[9][4] BrkCalVariantCriterion
  /begin VAR_ADDRESS 0x8002017C 0x8002357C 0x8002697C 0x80029D7C 0x8002D17C 0x8003057C 0x8003397C 0x80036D7C /end VAR_ADDRESS
 /end VAR_CHARACTERISTIC
 /begin VAR_CHARACTERISTIC TQYc_Map[9][5] BrkCalVariantCriterion
  /begin VAR_ADDRESS 0x8002017E 0x8002357E 0x8002697E 0x80029D7E 0x8002D17E 0x8003057E 0x8003397E 0x80036D7E /end VAR_ADDRESS
 /end VAR_CHARACTERISTIC
 /begin VAR_CHARACTERISTIC TQYc_Map[9][6] BrkCalVariantCriterion
  /begin VAR_ADDRESS 0x80020180 0x80023580 0x80026980 0x80029D80 0x8002D180 0x80030580 0x80033980 0x80036D80 /end VAR_ADDRESS
 /end VAR_CHARACTERISTIC
 /begin VAR_CHARACTERISTIC TQYc_Map[9][7] BrkCalVariantCriterion
  /begin VAR_ADDRESS 0x80020182 0x80023582 0x80026982 0x80029D82 0x8002D182 0x80030582 0x80033982 0x80036D82 /end VAR_ADDRESS
 /end VAR_CHARACTERISTIC
 /begin VAR_CHARACTERISTIC TQYc_Map[9][8] BrkCalVariantCriterion
  /begin VAR_ADDRESS 0x80020184 0x80023584 0x80026984 0x80029D84 0x8002D184 0x80030584 0x80033984 0x80036D84 /end VAR_ADDRESS
 /end VAR_CHARACTERISTIC
 /begin VAR_CHARACTERISTIC TQYc_Map[9][9] BrkCalVariantCriterion
  /begin VAR_ADDRESS 0x80020186 0x80023586 0x80026986 0x80029D86 0x8002D186 0x80030586 0x80033986 0x80036D86 /end VAR_ADDRESS
 /end VAR_CHARACTERISTIC
 /begin VAR_CHARACTERISTIC TQh_roll BrkCalVariantCriterion
  /begin VAR_ADDRESS 0x80020C30 0x80024030 0x80027430 0x8002A830 0x8002DC30 0x80031030 0x80034430 0x80037830 /end VAR_ADDRESS
 /end VAR_CHARACTERISTIC
 /begin VAR_CHARACTERISTIC TQiix_roll BrkCalVariantCriterion
  /begin VAR_ADDRESS 0x80020C32 0x80024032 0x80027432 0x8002A832 0x8002DC32 0x80031032 0x80034432 0x80037832 /end VAR_ADDRESS
 /end VAR_CHARACTERISTIC
 /begin VAR_CHARACTERISTIC TQmass_roll BrkCalVariantCriterion
  /begin VAR_ADDRESS 0x80020C34 0x80024034 0x80027434 0x8002A834 0x8002DC34 0x80031034 0x80034434 0x80037834 /end VAR_ADDRESS
 /end VAR_CHARACTERISTIC
 /begin VAR_CHARACTERISTIC TQroll_damping BrkCalVariantCriterion
  /begin VAR_ADDRESS 0x80020C36 0x80024036 0x80027436 0x8002A836 0x8002DC36 0x80031036 0x80034436 0x80037836 /end VAR_ADDRESS
 /end VAR_CHARACTERISTIC
 /begin VAR_CHARACTERISTIC TQroll_stiffness BrkCalVariantCriterion
  /begin VAR_ADDRESS 0x80020C38 0x80024038 0x80027438 0x8002A838 0x8002DC38 0x80031038 0x80034438 0x80037838 /end VAR_ADDRESS
 /end VAR_CHARACTERISTIC
 /begin VAR_CHARACTERISTIC U16CircBleedingMotU BrkCalVariantCriterion
  /begin VAR_ADDRESS 0x800214DC 0x800248DC 0x80027CDC 0x8002B0DC 0x8002E4DC 0x800318DC 0x80034CDC 0x800380DC /end VAR_ADDRESS
 /end VAR_CHARACTERISTIC
 /begin VAR_CHARACTERISTIC U16CircBleedingTcVlvCur BrkCalVariantCriterion
  /begin VAR_ADDRESS 0x800214DA 0x800248DA 0x80027CDA 0x8002B0DA 0x8002E4DA 0x800318DA 0x80034CDA 0x800380DA /end VAR_ADDRESS
 /end VAR_CHARACTERISTIC
 /begin VAR_CHARACTERISTIC U16DftCompDutyMotU1 BrkCalVariantCriterion
  /begin VAR_ADDRESS 0x8002149A 0x8002489A 0x80027C9A 0x8002B09A 0x8002E49A 0x8003189A 0x80034C9A 0x8003809A /end VAR_ADDRESS
 /end VAR_CHARACTERISTIC
 /begin VAR_CHARACTERISTIC U16DftCompDutyMotU2 BrkCalVariantCriterion
  /begin VAR_ADDRESS 0x8002149C 0x8002489C 0x80027C9C 0x8002B09C 0x8002E49C 0x8003189C 0x80034C9C 0x8003809C /end VAR_ADDRESS
 /end VAR_CHARACTERISTIC
 /begin VAR_CHARACTERISTIC U16DtrmMstCylP BrkCalVariantCriterion
  /begin VAR_ADDRESS 0x80021258 0x80024658 0x80027A58 0x8002AE58 0x8002E258 0x80031658 0x80034A58 0x80037E58 /end VAR_ADDRESS
 /end VAR_CHARACTERISTIC
 /begin VAR_CHARACTERISTIC U16DtrmTcmfMstCylP BrkCalVariantCriterion
  /begin VAR_ADDRESS 0x8002125E 0x8002465E 0x80027A5E 0x8002AE5E 0x8002E25E 0x8003165E 0x80034A5E 0x80037E5E /end VAR_ADDRESS
 /end VAR_CHARACTERISTIC
 /begin VAR_CHARACTERISTIC U16DtrmTcmpPErr BrkCalVariantCriterion
  /begin VAR_ADDRESS 0x8002125A 0x8002465A 0x80027A5A 0x8002AE5A 0x8002E25A 0x8003165A 0x80034A5A 0x80037E5A /end VAR_ADDRESS
 /end VAR_CHARACTERISTIC
 /begin VAR_CHARACTERISTIC U16EpsiHndlgCtrlEntrAssiAg BrkCalVariantCriterion
  /begin VAR_ADDRESS 0x8002183C 0x80024C3C 0x8002803C 0x8002B43C 0x8002E83C 0x80031C3C 0x8003503C 0x8003843C /end VAR_ADDRESS
 /end VAR_CHARACTERISTIC
 /begin VAR_CHARACTERISTIC U16EpsiHndlgCtrlEntrVehSpd BrkCalVariantCriterion
  /begin VAR_ADDRESS 0x80021838 0x80024C38 0x80028038 0x8002B438 0x8002E838 0x80031C38 0x80035038 0x80038438 /end VAR_ADDRESS
 /end VAR_CHARACTERISTIC
 /begin VAR_CHARACTERISTIC U16EpsiHndlgCtrlHldAssiAg BrkCalVariantCriterion
  /begin VAR_ADDRESS 0x8002183E 0x80024C3E 0x8002803E 0x8002B43E 0x8002E83E 0x80031C3E 0x8003503E 0x8003843E /end VAR_ADDRESS
 /end VAR_CHARACTERISTIC
 /begin VAR_CHARACTERISTIC U16EpsiHndlgCtrlHldVehSpd BrkCalVariantCriterion
  /begin VAR_ADDRESS 0x8002183A 0x80024C3A 0x8002803A 0x8002B43A 0x8002E83A 0x80031C3A 0x8003503A 0x8003843A /end VAR_ADDRESS
 /end VAR_CHARACTERISTIC
 /begin VAR_CHARACTERISTIC U16EpsiHndlgPGainWghtSteerWhlAgGrdt1 BrkCalVariantCriterion
  /begin VAR_ADDRESS 0x80021874 0x80024C74 0x80028074 0x8002B474 0x8002E874 0x80031C74 0x80035074 0x80038474 /end VAR_ADDRESS
 /end VAR_CHARACTERISTIC
 /begin VAR_CHARACTERISTIC U16EpsiHndlgPGainWghtSteerWhlAgGrdt2 BrkCalVariantCriterion
  /begin VAR_ADDRESS 0x80021876 0x80024C76 0x80028076 0x8002B476 0x8002E876 0x80031C76 0x80035076 0x80038476 /end VAR_ADDRESS
 /end VAR_CHARACTERISTIC
 /begin VAR_CHARACTERISTIC U16EpsiHndlgPGainWghtSteerWhlAgGrdt3 BrkCalVariantCriterion
  /begin VAR_ADDRESS 0x80021878 0x80024C78 0x80028078 0x8002B478 0x8002E878 0x80031C78 0x80035078 0x80038478 /end VAR_ADDRESS
 /end VAR_CHARACTERISTIC
 /begin VAR_CHARACTERISTIC U16EpsiHndlgSteerWhlAgGrdtPGainWght1 BrkCalVariantCriterion
  /begin VAR_ADDRESS 0x8002187A 0x80024C7A 0x8002807A 0x8002B47A 0x8002E87A 0x80031C7A 0x8003507A 0x8003847A /end VAR_ADDRESS
 /end VAR_CHARACTERISTIC
 /begin VAR_CHARACTERISTIC U16EpsiHndlgSteerWhlAgGrdtPGainWght2 BrkCalVariantCriterion
  /begin VAR_ADDRESS 0x8002187C 0x80024C7C 0x8002807C 0x8002B47C 0x8002E87C 0x80031C7C 0x8003507C 0x8003847C /end VAR_ADDRESS
 /end VAR_CHARACTERISTIC
 /begin VAR_CHARACTERISTIC U16EpsiHndlgSteerWhlAgGrdtPGainWght3 BrkCalVariantCriterion
  /begin VAR_ADDRESS 0x8002187E 0x80024C7E 0x8002807E 0x8002B47E 0x8002E87E 0x80031C7E 0x8003507E 0x8003847E /end VAR_ADDRESS
 /end VAR_CHARACTERISTIC
 /begin VAR_CHARACTERISTIC U16EpsiHndlgYawAssiAgVehSpdInsdIncDGain1 BrkCalVariantCriterion
  /begin VAR_ADDRESS 0x8002186A 0x80024C6A 0x8002806A 0x8002B46A 0x8002E86A 0x80031C6A 0x8003506A 0x8003846A /end VAR_ADDRESS
 /end VAR_CHARACTERISTIC
 /begin VAR_CHARACTERISTIC U16EpsiHndlgYawAssiAgVehSpdInsdIncDGain2 BrkCalVariantCriterion
  /begin VAR_ADDRESS 0x8002186C 0x80024C6C 0x8002806C 0x8002B46C 0x8002E86C 0x80031C6C 0x8003506C 0x8003846C /end VAR_ADDRESS
 /end VAR_CHARACTERISTIC
 /begin VAR_CHARACTERISTIC U16EpsiHndlgYawAssiAgVehSpdInsdIncDGain3 BrkCalVariantCriterion
  /begin VAR_ADDRESS 0x8002186E 0x80024C6E 0x8002806E 0x8002B46E 0x8002E86E 0x80031C6E 0x8003506E 0x8003846E /end VAR_ADDRESS
 /end VAR_CHARACTERISTIC
 /begin VAR_CHARACTERISTIC U16EpsiHndlgYawAssiAgVehSpdInsdIncDGain4 BrkCalVariantCriterion
  /begin VAR_ADDRESS 0x80021870 0x80024C70 0x80028070 0x8002B470 0x8002E870 0x80031C70 0x80035070 0x80038470 /end VAR_ADDRESS
 /end VAR_CHARACTERISTIC
 /begin VAR_CHARACTERISTIC U16EpsiHndlgYawAssiAgVehSpdInsdIncDGain5 BrkCalVariantCriterion
  /begin VAR_ADDRESS 0x80021872 0x80024C72 0x80028072 0x8002B472 0x8002E872 0x80031C72 0x80035072 0x80038472 /end VAR_ADDRESS
 /end VAR_CHARACTERISTIC
 /begin VAR_CHARACTERISTIC U16EpsiHndlgYawAssiAgVehSpdOutdDecDGain1 BrkCalVariantCriterion
  /begin VAR_ADDRESS 0x80021860 0x80024C60 0x80028060 0x8002B460 0x8002E860 0x80031C60 0x80035060 0x80038460 /end VAR_ADDRESS
 /end VAR_CHARACTERISTIC
 /begin VAR_CHARACTERISTIC U16EpsiHndlgYawAssiAgVehSpdOutdDecDGain2 BrkCalVariantCriterion
  /begin VAR_ADDRESS 0x80021862 0x80024C62 0x80028062 0x8002B462 0x8002E862 0x80031C62 0x80035062 0x80038462 /end VAR_ADDRESS
 /end VAR_CHARACTERISTIC
 /begin VAR_CHARACTERISTIC U16EpsiHndlgYawAssiAgVehSpdOutdDecDGain3 BrkCalVariantCriterion
  /begin VAR_ADDRESS 0x80021864 0x80024C64 0x80028064 0x8002B464 0x8002E864 0x80031C64 0x80035064 0x80038464 /end VAR_ADDRESS
 /end VAR_CHARACTERISTIC
 /begin VAR_CHARACTERISTIC U16EpsiHndlgYawAssiAgVehSpdOutdDecDGain4 BrkCalVariantCriterion
  /begin VAR_ADDRESS 0x80021866 0x80024C66 0x80028066 0x8002B466 0x8002E866 0x80031C66 0x80035066 0x80038466 /end VAR_ADDRESS
 /end VAR_CHARACTERISTIC
 /begin VAR_CHARACTERISTIC U16EpsiHndlgYawAssiAgVehSpdOutdDecDGain5 BrkCalVariantCriterion
  /begin VAR_ADDRESS 0x80021868 0x80024C68 0x80028068 0x8002B468 0x8002E868 0x80031C68 0x80035068 0x80038468 /end VAR_ADDRESS
 /end VAR_CHARACTERISTIC
 /begin VAR_CHARACTERISTIC U16EpsiHndlgYawAssiAgVehSpdOutdDecPGain1 BrkCalVariantCriterion
  /begin VAR_ADDRESS 0x80021856 0x80024C56 0x80028056 0x8002B456 0x8002E856 0x80031C56 0x80035056 0x80038456 /end VAR_ADDRESS
 /end VAR_CHARACTERISTIC
 /begin VAR_CHARACTERISTIC U16EpsiHndlgYawAssiAgVehSpdOutdDecPGain2 BrkCalVariantCriterion
  /begin VAR_ADDRESS 0x80021858 0x80024C58 0x80028058 0x8002B458 0x8002E858 0x80031C58 0x80035058 0x80038458 /end VAR_ADDRESS
 /end VAR_CHARACTERISTIC
 /begin VAR_CHARACTERISTIC U16EpsiHndlgYawAssiAgVehSpdOutdDecPGain3 BrkCalVariantCriterion
  /begin VAR_ADDRESS 0x8002185A 0x80024C5A 0x8002805A 0x8002B45A 0x8002E85A 0x80031C5A 0x8003505A 0x8003845A /end VAR_ADDRESS
 /end VAR_CHARACTERISTIC
 /begin VAR_CHARACTERISTIC U16EpsiHndlgYawAssiAgVehSpdOutdDecPGain4 BrkCalVariantCriterion
  /begin VAR_ADDRESS 0x8002185C 0x80024C5C 0x8002805C 0x8002B45C 0x8002E85C 0x80031C5C 0x8003505C 0x8003845C /end VAR_ADDRESS
 /end VAR_CHARACTERISTIC
 /begin VAR_CHARACTERISTIC U16EpsiHndlgYawAssiAgVehSpdOutdDecPGain5 BrkCalVariantCriterion
  /begin VAR_ADDRESS 0x8002185E 0x80024C5E 0x8002805E 0x8002B45E 0x8002E85E 0x80031C5E 0x8003505E 0x8003845E /end VAR_ADDRESS
 /end VAR_CHARACTERISTIC
 /begin VAR_CHARACTERISTIC U16EpsiHndlgYawAssiAgVehSpdOutdIncDGain1 BrkCalVariantCriterion
  /begin VAR_ADDRESS 0x8002184C 0x80024C4C 0x8002804C 0x8002B44C 0x8002E84C 0x80031C4C 0x8003504C 0x8003844C /end VAR_ADDRESS
 /end VAR_CHARACTERISTIC
 /begin VAR_CHARACTERISTIC U16EpsiHndlgYawAssiAgVehSpdOutdIncDGain2 BrkCalVariantCriterion
  /begin VAR_ADDRESS 0x8002184E 0x80024C4E 0x8002804E 0x8002B44E 0x8002E84E 0x80031C4E 0x8003504E 0x8003844E /end VAR_ADDRESS
 /end VAR_CHARACTERISTIC
 /begin VAR_CHARACTERISTIC U16EpsiHndlgYawAssiAgVehSpdOutdIncDGain3 BrkCalVariantCriterion
  /begin VAR_ADDRESS 0x80021850 0x80024C50 0x80028050 0x8002B450 0x8002E850 0x80031C50 0x80035050 0x80038450 /end VAR_ADDRESS
 /end VAR_CHARACTERISTIC
 /begin VAR_CHARACTERISTIC U16EpsiHndlgYawAssiAgVehSpdOutdIncDGain4 BrkCalVariantCriterion
  /begin VAR_ADDRESS 0x80021852 0x80024C52 0x80028052 0x8002B452 0x8002E852 0x80031C52 0x80035052 0x80038452 /end VAR_ADDRESS
 /end VAR_CHARACTERISTIC
 /begin VAR_CHARACTERISTIC U16EpsiHndlgYawAssiAgVehSpdOutdIncDGain5 BrkCalVariantCriterion
  /begin VAR_ADDRESS 0x80021854 0x80024C54 0x80028054 0x8002B454 0x8002E854 0x80031C54 0x80035054 0x80038454 /end VAR_ADDRESS
 /end VAR_CHARACTERISTIC
 /begin VAR_CHARACTERISTIC U16EpsiHndlgYawAssiAgVehSpdOutdIncPGain1 BrkCalVariantCriterion
  /begin VAR_ADDRESS 0x80021842 0x80024C42 0x80028042 0x8002B442 0x8002E842 0x80031C42 0x80035042 0x80038442 /end VAR_ADDRESS
 /end VAR_CHARACTERISTIC
 /begin VAR_CHARACTERISTIC U16EpsiHndlgYawAssiAgVehSpdOutdIncPGain2 BrkCalVariantCriterion
  /begin VAR_ADDRESS 0x80021844 0x80024C44 0x80028044 0x8002B444 0x8002E844 0x80031C44 0x80035044 0x80038444 /end VAR_ADDRESS
 /end VAR_CHARACTERISTIC
 /begin VAR_CHARACTERISTIC U16EpsiHndlgYawAssiAgVehSpdOutdIncPGain3 BrkCalVariantCriterion
  /begin VAR_ADDRESS 0x80021846 0x80024C46 0x80028046 0x8002B446 0x8002E846 0x80031C46 0x80035046 0x80038446 /end VAR_ADDRESS
 /end VAR_CHARACTERISTIC
 /begin VAR_CHARACTERISTIC U16EpsiHndlgYawAssiAgVehSpdOutdIncPGain4 BrkCalVariantCriterion
  /begin VAR_ADDRESS 0x80021848 0x80024C48 0x80028048 0x8002B448 0x8002E848 0x80031C48 0x80035048 0x80038448 /end VAR_ADDRESS
 /end VAR_CHARACTERISTIC
 /begin VAR_CHARACTERISTIC U16EpsiHndlgYawAssiAgVehSpdOutdIncPGain5 BrkCalVariantCriterion
  /begin VAR_ADDRESS 0x8002184A 0x80024C4A 0x8002804A 0x8002B44A 0x8002E84A 0x80031C4A 0x8003504A 0x8003844A /end VAR_ADDRESS
 /end VAR_CHARACTERISTIC
 /begin VAR_CHARACTERISTIC U16EpsiSplitAgToTqDGain BrkCalVariantCriterion
  /begin VAR_ADDRESS 0x8002181A 0x80024C1A 0x8002801A 0x8002B41A 0x8002E81A 0x80031C1A 0x8003501A 0x8003841A /end VAR_ADDRESS
 /end VAR_CHARACTERISTIC
 /begin VAR_CHARACTERISTIC U16EpsiSplitAgToTqPGain BrkCalVariantCriterion
  /begin VAR_ADDRESS 0x80021818 0x80024C18 0x80028018 0x8002B418 0x8002E818 0x80031C18 0x80035018 0x80038418 /end VAR_ADDRESS
 /end VAR_CHARACTERISTIC
 /begin VAR_CHARACTERISTIC U16EpsiSplitAgToTqVehSpdNegGain1 BrkCalVariantCriterion
  /begin VAR_ADDRESS 0x80021826 0x80024C26 0x80028026 0x8002B426 0x8002E826 0x80031C26 0x80035026 0x80038426 /end VAR_ADDRESS
 /end VAR_CHARACTERISTIC
 /begin VAR_CHARACTERISTIC U16EpsiSplitAgToTqVehSpdNegGain2 BrkCalVariantCriterion
  /begin VAR_ADDRESS 0x80021828 0x80024C28 0x80028028 0x8002B428 0x8002E828 0x80031C28 0x80035028 0x80038428 /end VAR_ADDRESS
 /end VAR_CHARACTERISTIC
 /begin VAR_CHARACTERISTIC U16EpsiSplitAgToTqVehSpdNegGain3 BrkCalVariantCriterion
  /begin VAR_ADDRESS 0x8002182A 0x80024C2A 0x8002802A 0x8002B42A 0x8002E82A 0x80031C2A 0x8003502A 0x8003842A /end VAR_ADDRESS
 /end VAR_CHARACTERISTIC
 /begin VAR_CHARACTERISTIC U16EpsiSplitAgToTqVehSpdNegGain4 BrkCalVariantCriterion
  /begin VAR_ADDRESS 0x8002182C 0x80024C2C 0x8002802C 0x8002B42C 0x8002E82C 0x80031C2C 0x8003502C 0x8003842C /end VAR_ADDRESS
 /end VAR_CHARACTERISTIC
 /begin VAR_CHARACTERISTIC U16EpsiSplitAgToTqVehSpdNegGain5 BrkCalVariantCriterion
  /begin VAR_ADDRESS 0x8002182E 0x80024C2E 0x8002802E 0x8002B42E 0x8002E82E 0x80031C2E 0x8003502E 0x8003842E /end VAR_ADDRESS
 /end VAR_CHARACTERISTIC
 /begin VAR_CHARACTERISTIC U16EpsiSplitAgToTqVehSpdPosGain1 BrkCalVariantCriterion
  /begin VAR_ADDRESS 0x8002181C 0x80024C1C 0x8002801C 0x8002B41C 0x8002E81C 0x80031C1C 0x8003501C 0x8003841C /end VAR_ADDRESS
 /end VAR_CHARACTERISTIC
 /begin VAR_CHARACTERISTIC U16EpsiSplitAgToTqVehSpdPosGain2 BrkCalVariantCriterion
  /begin VAR_ADDRESS 0x8002181E 0x80024C1E 0x8002801E 0x8002B41E 0x8002E81E 0x80031C1E 0x8003501E 0x8003841E /end VAR_ADDRESS
 /end VAR_CHARACTERISTIC
 /begin VAR_CHARACTERISTIC U16EpsiSplitAgToTqVehSpdPosGain3 BrkCalVariantCriterion
  /begin VAR_ADDRESS 0x80021820 0x80024C20 0x80028020 0x8002B420 0x8002E820 0x80031C20 0x80035020 0x80038420 /end VAR_ADDRESS
 /end VAR_CHARACTERISTIC
 /begin VAR_CHARACTERISTIC U16EpsiSplitAgToTqVehSpdPosGain4 BrkCalVariantCriterion
  /begin VAR_ADDRESS 0x80021822 0x80024C22 0x80028022 0x8002B422 0x8002E822 0x80031C22 0x80035022 0x80038422 /end VAR_ADDRESS
 /end VAR_CHARACTERISTIC
 /begin VAR_CHARACTERISTIC U16EpsiSplitAgToTqVehSpdPosGain5 BrkCalVariantCriterion
  /begin VAR_ADDRESS 0x80021824 0x80024C24 0x80028024 0x8002B424 0x8002E824 0x80031C24 0x80035024 0x80038424 /end VAR_ADDRESS
 /end VAR_CHARACTERISTIC
 /begin VAR_CHARACTERISTIC U16EpsiSplitAssiAgEstimdPeakPErr1 BrkCalVariantCriterion
  /begin VAR_ADDRESS 0x800217BA 0x80024BBA 0x80027FBA 0x8002B3BA 0x8002E7BA 0x80031BBA 0x80034FBA 0x800383BA /end VAR_ADDRESS
 /end VAR_CHARACTERISTIC
 /begin VAR_CHARACTERISTIC U16EpsiSplitAssiAgEstimdPeakPErr2 BrkCalVariantCriterion
  /begin VAR_ADDRESS 0x800217BC 0x80024BBC 0x80027FBC 0x8002B3BC 0x8002E7BC 0x80031BBC 0x80034FBC 0x800383BC /end VAR_ADDRESS
 /end VAR_CHARACTERISTIC
 /begin VAR_CHARACTERISTIC U16EpsiSplitAssiAgEstimdPeakPErr3 BrkCalVariantCriterion
  /begin VAR_ADDRESS 0x800217BE 0x80024BBE 0x80027FBE 0x8002B3BE 0x8002E7BE 0x80031BBE 0x80034FBE 0x800383BE /end VAR_ADDRESS
 /end VAR_CHARACTERISTIC
 /begin VAR_CHARACTERISTIC U16EpsiSplitAssiAgEstimdPeakPErr4 BrkCalVariantCriterion
  /begin VAR_ADDRESS 0x800217C0 0x80024BC0 0x80027FC0 0x8002B3C0 0x8002E7C0 0x80031BC0 0x80034FC0 0x800383C0 /end VAR_ADDRESS
 /end VAR_CHARACTERISTIC
 /begin VAR_CHARACTERISTIC U16EpsiSplitAssiAgEstimdPeakPErr5 BrkCalVariantCriterion
  /begin VAR_ADDRESS 0x800217C2 0x80024BC2 0x80027FC2 0x8002B3C2 0x8002E7C2 0x80031BC2 0x80034FC2 0x800383C2 /end VAR_ADDRESS
 /end VAR_CHARACTERISTIC
 /begin VAR_CHARACTERISTIC U16EpsiSplitAssiAgGmaSlipGain BrkCalVariantCriterion
  /begin VAR_ADDRESS 0x800217D8 0x80024BD8 0x80027FD8 0x8002B3D8 0x8002E7D8 0x80031BD8 0x80034FD8 0x800383D8 /end VAR_ADDRESS
 /end VAR_CHARACTERISTIC
 /begin VAR_CHARACTERISTIC U16EpsiSplitAssiAgVehSpdGain1 BrkCalVariantCriterion
  /begin VAR_ADDRESS 0x800217CE 0x80024BCE 0x80027FCE 0x8002B3CE 0x8002E7CE 0x80031BCE 0x80034FCE 0x800383CE /end VAR_ADDRESS
 /end VAR_CHARACTERISTIC
 /begin VAR_CHARACTERISTIC U16EpsiSplitAssiAgVehSpdGain2 BrkCalVariantCriterion
  /begin VAR_ADDRESS 0x800217D0 0x80024BD0 0x80027FD0 0x8002B3D0 0x8002E7D0 0x80031BD0 0x80034FD0 0x800383D0 /end VAR_ADDRESS
 /end VAR_CHARACTERISTIC
 /begin VAR_CHARACTERISTIC U16EpsiSplitAssiAgVehSpdGain3 BrkCalVariantCriterion
  /begin VAR_ADDRESS 0x800217D2 0x80024BD2 0x80027FD2 0x8002B3D2 0x8002E7D2 0x80031BD2 0x80034FD2 0x800383D2 /end VAR_ADDRESS
 /end VAR_CHARACTERISTIC
 /begin VAR_CHARACTERISTIC U16EpsiSplitAssiAgVehSpdGain4 BrkCalVariantCriterion
  /begin VAR_ADDRESS 0x800217D4 0x80024BD4 0x80027FD4 0x8002B3D4 0x8002E7D4 0x80031BD4 0x80034FD4 0x800383D4 /end VAR_ADDRESS
 /end VAR_CHARACTERISTIC
 /begin VAR_CHARACTERISTIC U16EpsiSplitAssiAgVehSpdGain5 BrkCalVariantCriterion
  /begin VAR_ADDRESS 0x800217D6 0x80024BD6 0x80027FD6 0x8002B3D6 0x8002E7D6 0x80031BD6 0x80034FD6 0x800383D6 /end VAR_ADDRESS
 /end VAR_CHARACTERISTIC
 /begin VAR_CHARACTERISTIC U16EpsiSplitCtrlEntrAssiAg BrkCalVariantCriterion
  /begin VAR_ADDRESS 0x800217B6 0x80024BB6 0x80027FB6 0x8002B3B6 0x8002E7B6 0x80031BB6 0x80034FB6 0x800383B6 /end VAR_ADDRESS
 /end VAR_CHARACTERISTIC
 /begin VAR_CHARACTERISTIC U16EpsiSplitCtrlEntrVehSpd BrkCalVariantCriterion
  /begin VAR_ADDRESS 0x800217B2 0x80024BB2 0x80027FB2 0x8002B3B2 0x8002E7B2 0x80031BB2 0x80034FB2 0x800383B2 /end VAR_ADDRESS
 /end VAR_CHARACTERISTIC
 /begin VAR_CHARACTERISTIC U16EpsiSplitCtrlHldAssiAg BrkCalVariantCriterion
  /begin VAR_ADDRESS 0x800217B8 0x80024BB8 0x80027FB8 0x8002B3B8 0x8002E7B8 0x80031BB8 0x80034FB8 0x800383B8 /end VAR_ADDRESS
 /end VAR_CHARACTERISTIC
 /begin VAR_CHARACTERISTIC U16EpsiSplitCtrlHldVehSpd BrkCalVariantCriterion
  /begin VAR_ADDRESS 0x800217B4 0x80024BB4 0x80027FB4 0x8002B3B4 0x8002E7B4 0x80031BB4 0x80034FB4 0x800383B4 /end VAR_ADDRESS
 /end VAR_CHARACTERISTIC
 /begin VAR_CHARACTERISTIC U16EpsiSplitDetALat BrkCalVariantCriterion
  /begin VAR_ADDRESS 0x800217AC 0x80024BAC 0x80027FAC 0x8002B3AC 0x8002E7AC 0x80031BAC 0x80034FAC 0x800383AC /end VAR_ADDRESS
 /end VAR_CHARACTERISTIC
 /begin VAR_CHARACTERISTIC U16EpsiSplitDrvrCoeffDrvrTqMin BrkCalVariantCriterion
  /begin VAR_ADDRESS 0x80021814 0x80024C14 0x80028014 0x8002B414 0x8002E814 0x80031C14 0x80035014 0x80038414 /end VAR_ADDRESS
 /end VAR_CHARACTERISTIC
 /begin VAR_CHARACTERISTIC U16EpsiSplitDrvrCoeffSteerGrdtMin BrkCalVariantCriterion
  /begin VAR_ADDRESS 0x80021816 0x80024C16 0x80028016 0x8002B416 0x8002E816 0x80031C16 0x80035016 0x80038416 /end VAR_ADDRESS
 /end VAR_CHARACTERISTIC
 /begin VAR_CHARACTERISTIC U16EpsiSplitDrvrTqThdSteerGrdt11 BrkCalVariantCriterion
  /begin VAR_ADDRESS 0x800217F4 0x80024BF4 0x80027FF4 0x8002B3F4 0x8002E7F4 0x80031BF4 0x80034FF4 0x800383F4 /end VAR_ADDRESS
 /end VAR_CHARACTERISTIC
 /begin VAR_CHARACTERISTIC U16EpsiSplitDrvrTqThdSteerGrdt12 BrkCalVariantCriterion
  /begin VAR_ADDRESS 0x800217F6 0x80024BF6 0x80027FF6 0x8002B3F6 0x8002E7F6 0x80031BF6 0x80034FF6 0x800383F6 /end VAR_ADDRESS
 /end VAR_CHARACTERISTIC
 /begin VAR_CHARACTERISTIC U16EpsiSplitDrvrTqThdSteerGrdt21 BrkCalVariantCriterion
  /begin VAR_ADDRESS 0x800217FC 0x80024BFC 0x80027FFC 0x8002B3FC 0x8002E7FC 0x80031BFC 0x80034FFC 0x800383FC /end VAR_ADDRESS
 /end VAR_CHARACTERISTIC
 /begin VAR_CHARACTERISTIC U16EpsiSplitDrvrTqThdSteerGrdt22 BrkCalVariantCriterion
  /begin VAR_ADDRESS 0x800217FE 0x80024BFE 0x80027FFE 0x8002B3FE 0x8002E7FE 0x80031BFE 0x80034FFE 0x800383FE /end VAR_ADDRESS
 /end VAR_CHARACTERISTIC
 /begin VAR_CHARACTERISTIC U16EpsiSplitDrvrTqThdSteerGrdt31 BrkCalVariantCriterion
  /begin VAR_ADDRESS 0x80021804 0x80024C04 0x80028004 0x8002B404 0x8002E804 0x80031C04 0x80035004 0x80038404 /end VAR_ADDRESS
 /end VAR_CHARACTERISTIC
 /begin VAR_CHARACTERISTIC U16EpsiSplitDrvrTqThdSteerGrdt32 BrkCalVariantCriterion
  /begin VAR_ADDRESS 0x80021806 0x80024C06 0x80028006 0x8002B406 0x8002E806 0x80031C06 0x80035006 0x80038406 /end VAR_ADDRESS
 /end VAR_CHARACTERISTIC
 /begin VAR_CHARACTERISTIC U16EpsiSplitDrvrTqThdSteerGrdt41 BrkCalVariantCriterion
  /begin VAR_ADDRESS 0x8002180C 0x80024C0C 0x8002800C 0x8002B40C 0x8002E80C 0x80031C0C 0x8003500C 0x8003840C /end VAR_ADDRESS
 /end VAR_CHARACTERISTIC
 /begin VAR_CHARACTERISTIC U16EpsiSplitDrvrTqThdSteerGrdt42 BrkCalVariantCriterion
  /begin VAR_ADDRESS 0x8002180E 0x80024C0E 0x8002800E 0x8002B40E 0x8002E80E 0x80031C0E 0x8003500E 0x8003840E /end VAR_ADDRESS
 /end VAR_CHARACTERISTIC
 /begin VAR_CHARACTERISTIC U16EpsiSplitEstimdPeakPErrAssiAg1 BrkCalVariantCriterion
  /begin VAR_ADDRESS 0x800217C4 0x80024BC4 0x80027FC4 0x8002B3C4 0x8002E7C4 0x80031BC4 0x80034FC4 0x800383C4 /end VAR_ADDRESS
 /end VAR_CHARACTERISTIC
 /begin VAR_CHARACTERISTIC U16EpsiSplitEstimdPeakPErrAssiAg2 BrkCalVariantCriterion
  /begin VAR_ADDRESS 0x800217C6 0x80024BC6 0x80027FC6 0x8002B3C6 0x8002E7C6 0x80031BC6 0x80034FC6 0x800383C6 /end VAR_ADDRESS
 /end VAR_CHARACTERISTIC
 /begin VAR_CHARACTERISTIC U16EpsiSplitEstimdPeakPErrAssiAg3 BrkCalVariantCriterion
  /begin VAR_ADDRESS 0x800217C8 0x80024BC8 0x80027FC8 0x8002B3C8 0x8002E7C8 0x80031BC8 0x80034FC8 0x800383C8 /end VAR_ADDRESS
 /end VAR_CHARACTERISTIC
 /begin VAR_CHARACTERISTIC U16EpsiSplitEstimdPeakPErrAssiAg4 BrkCalVariantCriterion
  /begin VAR_ADDRESS 0x800217CA 0x80024BCA 0x80027FCA 0x8002B3CA 0x8002E7CA 0x80031BCA 0x80034FCA 0x800383CA /end VAR_ADDRESS
 /end VAR_CHARACTERISTIC
 /begin VAR_CHARACTERISTIC U16EpsiSplitEstimdPeakPErrAssiAg5 BrkCalVariantCriterion
  /begin VAR_ADDRESS 0x800217CC 0x80024BCC 0x80027FCC 0x8002B3CC 0x8002E7CC 0x80031BCC 0x80034FCC 0x800383CC /end VAR_ADDRESS
 /end VAR_CHARACTERISTIC
 /begin VAR_CHARACTERISTIC U16EpsiSplitSteerGrdtDrvrTqThd11 BrkCalVariantCriterion
  /begin VAR_ADDRESS 0x800217F8 0x80024BF8 0x80027FF8 0x8002B3F8 0x8002E7F8 0x80031BF8 0x80034FF8 0x800383F8 /end VAR_ADDRESS
 /end VAR_CHARACTERISTIC
 /begin VAR_CHARACTERISTIC U16EpsiSplitSteerGrdtDrvrTqThd12 BrkCalVariantCriterion
  /begin VAR_ADDRESS 0x800217FA 0x80024BFA 0x80027FFA 0x8002B3FA 0x8002E7FA 0x80031BFA 0x80034FFA 0x800383FA /end VAR_ADDRESS
 /end VAR_CHARACTERISTIC
 /begin VAR_CHARACTERISTIC U16EpsiSplitSteerGrdtDrvrTqThd21 BrkCalVariantCriterion
  /begin VAR_ADDRESS 0x80021800 0x80024C00 0x80028000 0x8002B400 0x8002E800 0x80031C00 0x80035000 0x80038400 /end VAR_ADDRESS
 /end VAR_CHARACTERISTIC
 /begin VAR_CHARACTERISTIC U16EpsiSplitSteerGrdtDrvrTqThd22 BrkCalVariantCriterion
  /begin VAR_ADDRESS 0x80021802 0x80024C02 0x80028002 0x8002B402 0x8002E802 0x80031C02 0x80035002 0x80038402 /end VAR_ADDRESS
 /end VAR_CHARACTERISTIC
 /begin VAR_CHARACTERISTIC U16EpsiSplitSteerGrdtDrvrTqThd31 BrkCalVariantCriterion
  /begin VAR_ADDRESS 0x80021808 0x80024C08 0x80028008 0x8002B408 0x8002E808 0x80031C08 0x80035008 0x80038408 /end VAR_ADDRESS
 /end VAR_CHARACTERISTIC
 /begin VAR_CHARACTERISTIC U16EpsiSplitSteerGrdtDrvrTqThd32 BrkCalVariantCriterion
  /begin VAR_ADDRESS 0x8002180A 0x80024C0A 0x8002800A 0x8002B40A 0x8002E80A 0x80031C0A 0x8003500A 0x8003840A /end VAR_ADDRESS
 /end VAR_CHARACTERISTIC
 /begin VAR_CHARACTERISTIC U16EpsiSplitSteerGrdtDrvrTqThd41 BrkCalVariantCriterion
  /begin VAR_ADDRESS 0x80021810 0x80024C10 0x80028010 0x8002B410 0x8002E810 0x80031C10 0x80035010 0x80038410 /end VAR_ADDRESS
 /end VAR_CHARACTERISTIC
 /begin VAR_CHARACTERISTIC U16EpsiSplitSteerGrdtDrvrTqThd42 BrkCalVariantCriterion
  /begin VAR_ADDRESS 0x80021812 0x80024C12 0x80028012 0x8002B412 0x8002E812 0x80031C12 0x80035012 0x80038412 /end VAR_ADDRESS
 /end VAR_CHARACTERISTIC
 /begin VAR_CHARACTERISTIC U16EpsiSplitYawAssiAgVehSpdIGain1 BrkCalVariantCriterion
  /begin VAR_ADDRESS 0x800217E4 0x80024BE4 0x80027FE4 0x8002B3E4 0x8002E7E4 0x80031BE4 0x80034FE4 0x800383E4 /end VAR_ADDRESS
 /end VAR_CHARACTERISTIC
 /begin VAR_CHARACTERISTIC U16EpsiSplitYawAssiAgVehSpdIGain2 BrkCalVariantCriterion
  /begin VAR_ADDRESS 0x800217E6 0x80024BE6 0x80027FE6 0x8002B3E6 0x8002E7E6 0x80031BE6 0x80034FE6 0x800383E6 /end VAR_ADDRESS
 /end VAR_CHARACTERISTIC
 /begin VAR_CHARACTERISTIC U16EpsiSplitYawAssiAgVehSpdIGain3 BrkCalVariantCriterion
  /begin VAR_ADDRESS 0x800217E8 0x80024BE8 0x80027FE8 0x8002B3E8 0x8002E7E8 0x80031BE8 0x80034FE8 0x800383E8 /end VAR_ADDRESS
 /end VAR_CHARACTERISTIC
 /begin VAR_CHARACTERISTIC U16EpsiSplitYawAssiAgVehSpdIGain4 BrkCalVariantCriterion
  /begin VAR_ADDRESS 0x800217EA 0x80024BEA 0x80027FEA 0x8002B3EA 0x8002E7EA 0x80031BEA 0x80034FEA 0x800383EA /end VAR_ADDRESS
 /end VAR_CHARACTERISTIC
 /begin VAR_CHARACTERISTIC U16EpsiSplitYawAssiAgVehSpdIGain5 BrkCalVariantCriterion
  /begin VAR_ADDRESS 0x800217EC 0x80024BEC 0x80027FEC 0x8002B3EC 0x8002E7EC 0x80031BEC 0x80034FEC 0x800383EC /end VAR_ADDRESS
 /end VAR_CHARACTERISTIC
 /begin VAR_CHARACTERISTIC U16EpsiSplitYawAssiAgVehSpdPGain1 BrkCalVariantCriterion
  /begin VAR_ADDRESS 0x800217DA 0x80024BDA 0x80027FDA 0x8002B3DA 0x8002E7DA 0x80031BDA 0x80034FDA 0x800383DA /end VAR_ADDRESS
 /end VAR_CHARACTERISTIC
 /begin VAR_CHARACTERISTIC U16EpsiSplitYawAssiAgVehSpdPGain2 BrkCalVariantCriterion
  /begin VAR_ADDRESS 0x800217DC 0x80024BDC 0x80027FDC 0x8002B3DC 0x8002E7DC 0x80031BDC 0x80034FDC 0x800383DC /end VAR_ADDRESS
 /end VAR_CHARACTERISTIC
 /begin VAR_CHARACTERISTIC U16EpsiSplitYawAssiAgVehSpdPGain3 BrkCalVariantCriterion
  /begin VAR_ADDRESS 0x800217DE 0x80024BDE 0x80027FDE 0x8002B3DE 0x8002E7DE 0x80031BDE 0x80034FDE 0x800383DE /end VAR_ADDRESS
 /end VAR_CHARACTERISTIC
 /begin VAR_CHARACTERISTIC U16EpsiSplitYawAssiAgVehSpdPGain4 BrkCalVariantCriterion
  /begin VAR_ADDRESS 0x800217E0 0x80024BE0 0x80027FE0 0x8002B3E0 0x8002E7E0 0x80031BE0 0x80034FE0 0x800383E0 /end VAR_ADDRESS
 /end VAR_CHARACTERISTIC
 /begin VAR_CHARACTERISTIC U16EpsiSplitYawAssiAgVehSpdPGain5 BrkCalVariantCriterion
  /begin VAR_ADDRESS 0x800217E2 0x80024BE2 0x80027FE2 0x8002B3E2 0x8002E7E2 0x80031BE2 0x80034FE2 0x800383E2 /end VAR_ADDRESS
 /end VAR_CHARACTERISTIC
 /begin VAR_CHARACTERISTIC U16EpsiSplitYawThd BrkCalVariantCriterion
  /begin VAR_ADDRESS 0x800217EE 0x80024BEE 0x80027FEE 0x8002B3EE 0x8002E7EE 0x80031BEE 0x80034FEE 0x800383EE /end VAR_ADDRESS
 /end VAR_CHARACTERISTIC
 /begin VAR_CHARACTERISTIC U16EpsiTqMax BrkCalVariantCriterion
  /begin VAR_ADDRESS 0x800217A0 0x80024BA0 0x80027FA0 0x8002B3A0 0x8002E7A0 0x80031BA0 0x80034FA0 0x800383A0 /end VAR_ADDRESS
 /end VAR_CHARACTERISTIC
 /begin VAR_CHARACTERISTIC U16EpsiVehSpd1 BrkCalVariantCriterion
  /begin VAR_ADDRESS 0x800217A2 0x80024BA2 0x80027FA2 0x8002B3A2 0x8002E7A2 0x80031BA2 0x80034FA2 0x800383A2 /end VAR_ADDRESS
 /end VAR_CHARACTERISTIC
 /begin VAR_CHARACTERISTIC U16EpsiVehSpd2 BrkCalVariantCriterion
  /begin VAR_ADDRESS 0x800217A4 0x80024BA4 0x80027FA4 0x8002B3A4 0x8002E7A4 0x80031BA4 0x80034FA4 0x800383A4 /end VAR_ADDRESS
 /end VAR_CHARACTERISTIC
 /begin VAR_CHARACTERISTIC U16EpsiVehSpd3 BrkCalVariantCriterion
  /begin VAR_ADDRESS 0x800217A6 0x80024BA6 0x80027FA6 0x8002B3A6 0x8002E7A6 0x80031BA6 0x80034FA6 0x800383A6 /end VAR_ADDRESS
 /end VAR_CHARACTERISTIC
 /begin VAR_CHARACTERISTIC U16EpsiVehSpd4 BrkCalVariantCriterion
  /begin VAR_ADDRESS 0x800217A8 0x80024BA8 0x80027FA8 0x8002B3A8 0x8002E7A8 0x80031BA8 0x80034FA8 0x800383A8 /end VAR_ADDRESS
 /end VAR_CHARACTERISTIC
 /begin VAR_CHARACTERISTIC U16EpsiVehSpd5 BrkCalVariantCriterion
  /begin VAR_ADDRESS 0x800217AA 0x80024BAA 0x80027FAA 0x8002B3AA 0x8002E7AA 0x80031BAA 0x80034FAA 0x800383AA /end VAR_ADDRESS
 /end VAR_CHARACTERISTIC
 /begin VAR_CHARACTERISTIC U16EsvVlvActtnTiFctCtrlFinshd BrkCalVariantCriterion
  /begin VAR_ADDRESS 0x800213D0 0x800247D0 0x80027BD0 0x8002AFD0 0x8002E3D0 0x800317D0 0x80034BD0 0x80037FD0 /end VAR_ADDRESS
 /end VAR_CHARACTERISTIC
 /begin VAR_CHARACTERISTIC U16EsvVlvActtnVehSpdFctCtrlFinshd BrkCalVariantCriterion
  /begin VAR_ADDRESS 0x800213CC 0x800247CC 0x80027BCC 0x8002AFCC 0x8002E3CC 0x800317CC 0x80034BCC 0x80037FCC /end VAR_ADDRESS
 /end VAR_CHARACTERISTIC
 /begin VAR_CHARACTERISTIC U16EsvVlvCurPatIniActtnTi BrkCalVariantCriterion
  /begin VAR_ADDRESS 0x800213D4 0x800247D4 0x80027BD4 0x8002AFD4 0x8002E3D4 0x800317D4 0x80034BD4 0x80037FD4 /end VAR_ADDRESS
 /end VAR_CHARACTERISTIC
 /begin VAR_CHARACTERISTIC U16FricMotUAbs1 BrkCalVariantCriterion
  /begin VAR_ADDRESS 0x800213F0 0x800247F0 0x80027BF0 0x8002AFF0 0x8002E3F0 0x800317F0 0x80034BF0 0x80037FF0 /end VAR_ADDRESS
 /end VAR_CHARACTERISTIC
 /begin VAR_CHARACTERISTIC U16FricMotUAbs2 BrkCalVariantCriterion
  /begin VAR_ADDRESS 0x800213F2 0x800247F2 0x80027BF2 0x8002AFF2 0x8002E3F2 0x800317F2 0x80034BF2 0x80037FF2 /end VAR_ADDRESS
 /end VAR_CHARACTERISTIC
 /begin VAR_CHARACTERISTIC U16FricMotUAbs3 BrkCalVariantCriterion
  /begin VAR_ADDRESS 0x800213F4 0x800247F4 0x80027BF4 0x8002AFF4 0x8002E3F4 0x800317F4 0x80034BF4 0x80037FF4 /end VAR_ADDRESS
 /end VAR_CHARACTERISTIC
 /begin VAR_CHARACTERISTIC U16FricMotUWslcDecelComb1 BrkCalVariantCriterion
  /begin VAR_ADDRESS 0x800213FE 0x800247FE 0x80027BFE 0x8002AFFE 0x8002E3FE 0x800317FE 0x80034BFE 0x80037FFE /end VAR_ADDRESS
 /end VAR_CHARACTERISTIC
 /begin VAR_CHARACTERISTIC U16FricMotUWslcDecelComb2 BrkCalVariantCriterion
  /begin VAR_ADDRESS 0x80021400 0x80024800 0x80027C00 0x8002B000 0x8002E400 0x80031800 0x80034C00 0x80038000 /end VAR_ADDRESS
 /end VAR_CHARACTERISTIC
 /begin VAR_CHARACTERISTIC U16FricMotUWslcDecelComb3 BrkCalVariantCriterion
  /begin VAR_ADDRESS 0x80021402 0x80024802 0x80027C02 0x8002B002 0x8002E402 0x80031802 0x80034C02 0x80038002 /end VAR_ADDRESS
 /end VAR_CHARACTERISTIC
 /begin VAR_CHARACTERISTIC U16IniDutyMotU1 BrkCalVariantCriterion
  /begin VAR_ADDRESS 0x80021494 0x80024894 0x80027C94 0x8002B094 0x8002E494 0x80031894 0x80034C94 0x80038094 /end VAR_ADDRESS
 /end VAR_CHARACTERISTIC
 /begin VAR_CHARACTERISTIC U16IniDutyMotU2 BrkCalVariantCriterion
  /begin VAR_ADDRESS 0x80021496 0x80024896 0x80027C96 0x8002B096 0x8002E496 0x80031896 0x80034C96 0x80038096 /end VAR_ADDRESS
 /end VAR_CHARACTERISTIC
 /begin VAR_CHARACTERISTIC U16IniMotUAbsMstCylP1 BrkCalVariantCriterion
  /begin VAR_ADDRESS 0x800213DC 0x800247DC 0x80027BDC 0x8002AFDC 0x8002E3DC 0x800317DC 0x80034BDC 0x80037FDC /end VAR_ADDRESS
 /end VAR_CHARACTERISTIC
 /begin VAR_CHARACTERISTIC U16IniMotUAbsMstCylP2 BrkCalVariantCriterion
  /begin VAR_ADDRESS 0x800213DE 0x800247DE 0x80027BDE 0x8002AFDE 0x8002E3DE 0x800317DE 0x80034BDE 0x80037FDE /end VAR_ADDRESS
 /end VAR_CHARACTERISTIC
 /begin VAR_CHARACTERISTIC U16IniMotUAbsMstCylP3 BrkCalVariantCriterion
  /begin VAR_ADDRESS 0x800213E0 0x800247E0 0x80027BE0 0x8002AFE0 0x8002E3E0 0x800317E0 0x80034BE0 0x80037FE0 /end VAR_ADDRESS
 /end VAR_CHARACTERISTIC
 /begin VAR_CHARACTERISTIC U16IniMotUAbsMstCylP4 BrkCalVariantCriterion
  /begin VAR_ADDRESS 0x800213E2 0x800247E2 0x80027BE2 0x8002AFE2 0x8002E3E2 0x800317E2 0x80034BE2 0x80037FE2 /end VAR_ADDRESS
 /end VAR_CHARACTERISTIC
 /begin VAR_CHARACTERISTIC U16IniTiMotU1 BrkCalVariantCriterion
  /begin VAR_ADDRESS 0x800214A2 0x800248A2 0x80027CA2 0x8002B0A2 0x8002E4A2 0x800318A2 0x80034CA2 0x800380A2 /end VAR_ADDRESS
 /end VAR_CHARACTERISTIC
 /begin VAR_CHARACTERISTIC U16IniTiMotU2 BrkCalVariantCriterion
  /begin VAR_ADDRESS 0x800214A4 0x800248A4 0x80027CA4 0x8002B0A4 0x8002E4A4 0x800318A4 0x80034CA4 0x800380A4 /end VAR_ADDRESS
 /end VAR_CHARACTERISTIC
 /begin VAR_CHARACTERISTIC U16IniTiMotU3 BrkCalVariantCriterion
  /begin VAR_ADDRESS 0x800214A6 0x800248A6 0x80027CA6 0x8002B0A6 0x8002E4A6 0x800318A6 0x80034CA6 0x800380A6 /end VAR_ADDRESS
 /end VAR_CHARACTERISTIC
 /begin VAR_CHARACTERISTIC U16IniTiMotU4 BrkCalVariantCriterion
  /begin VAR_ADDRESS 0x800214A8 0x800248A8 0x80027CA8 0x8002B0A8 0x8002E4A8 0x800318A8 0x80034CA8 0x800380A8 /end VAR_ADDRESS
 /end VAR_CHARACTERISTIC
 /begin VAR_CHARACTERISTIC U16LfcRiseNotSuctnNo1VlvCurPGrdt11 BrkCalVariantCriterion
  /begin VAR_ADDRESS 0x8002128A 0x8002468A 0x80027A8A 0x8002AE8A 0x8002E28A 0x8003168A 0x80034A8A 0x80037E8A /end VAR_ADDRESS
 /end VAR_CHARACTERISTIC
 /begin VAR_CHARACTERISTIC U16LfcRiseNotSuctnNo1VlvCurPGrdt12 BrkCalVariantCriterion
  /begin VAR_ADDRESS 0x8002128C 0x8002468C 0x80027A8C 0x8002AE8C 0x8002E28C 0x8003168C 0x80034A8C 0x80037E8C /end VAR_ADDRESS
 /end VAR_CHARACTERISTIC
 /begin VAR_CHARACTERISTIC U16LfcRiseNotSuctnNo1VlvCurPGrdt13 BrkCalVariantCriterion
  /begin VAR_ADDRESS 0x8002128E 0x8002468E 0x80027A8E 0x8002AE8E 0x8002E28E 0x8003168E 0x80034A8E 0x80037E8E /end VAR_ADDRESS
 /end VAR_CHARACTERISTIC
 /begin VAR_CHARACTERISTIC U16LfcRiseNotSuctnNo1VlvCurPGrdt14 BrkCalVariantCriterion
  /begin VAR_ADDRESS 0x80021290 0x80024690 0x80027A90 0x8002AE90 0x8002E290 0x80031690 0x80034A90 0x80037E90 /end VAR_ADDRESS
 /end VAR_CHARACTERISTIC
 /begin VAR_CHARACTERISTIC U16LfcRiseNotSuctnNo1VlvCurPGrdt15 BrkCalVariantCriterion
  /begin VAR_ADDRESS 0x80021292 0x80024692 0x80027A92 0x8002AE92 0x8002E292 0x80031692 0x80034A92 0x80037E92 /end VAR_ADDRESS
 /end VAR_CHARACTERISTIC
 /begin VAR_CHARACTERISTIC U16LfcRiseNotSuctnNo1VlvCurPGrdt21 BrkCalVariantCriterion
  /begin VAR_ADDRESS 0x8002129E 0x8002469E 0x80027A9E 0x8002AE9E 0x8002E29E 0x8003169E 0x80034A9E 0x80037E9E /end VAR_ADDRESS
 /end VAR_CHARACTERISTIC
 /begin VAR_CHARACTERISTIC U16LfcRiseNotSuctnNo1VlvCurPGrdt22 BrkCalVariantCriterion
  /begin VAR_ADDRESS 0x800212A0 0x800246A0 0x80027AA0 0x8002AEA0 0x8002E2A0 0x800316A0 0x80034AA0 0x80037EA0 /end VAR_ADDRESS
 /end VAR_CHARACTERISTIC
 /begin VAR_CHARACTERISTIC U16LfcRiseNotSuctnNo1VlvCurPGrdt23 BrkCalVariantCriterion
  /begin VAR_ADDRESS 0x800212A2 0x800246A2 0x80027AA2 0x8002AEA2 0x8002E2A2 0x800316A2 0x80034AA2 0x80037EA2 /end VAR_ADDRESS
 /end VAR_CHARACTERISTIC
 /begin VAR_CHARACTERISTIC U16LfcRiseNotSuctnNo1VlvCurPGrdt24 BrkCalVariantCriterion
  /begin VAR_ADDRESS 0x800212A4 0x800246A4 0x80027AA4 0x8002AEA4 0x8002E2A4 0x800316A4 0x80034AA4 0x80037EA4 /end VAR_ADDRESS
 /end VAR_CHARACTERISTIC
 /begin VAR_CHARACTERISTIC U16LfcRiseNotSuctnNo1VlvCurPGrdt25 BrkCalVariantCriterion
  /begin VAR_ADDRESS 0x800212A6 0x800246A6 0x80027AA6 0x8002AEA6 0x8002E2A6 0x800316A6 0x80034AA6 0x80037EA6 /end VAR_ADDRESS
 /end VAR_CHARACTERISTIC
 /begin VAR_CHARACTERISTIC U16LfcRiseNotSuctnNo1VlvCurPGrdt26 BrkCalVariantCriterion
  /begin VAR_ADDRESS 0x800212A8 0x800246A8 0x80027AA8 0x8002AEA8 0x8002E2A8 0x800316A8 0x80034AA8 0x80037EA8 /end VAR_ADDRESS
 /end VAR_CHARACTERISTIC
 /begin VAR_CHARACTERISTIC U16LfcRiseNotSuctnNo1VlvCurPGrdt27 BrkCalVariantCriterion
  /begin VAR_ADDRESS 0x800212AA 0x800246AA 0x80027AAA 0x8002AEAA 0x8002E2AA 0x800316AA 0x80034AAA 0x80037EAA /end VAR_ADDRESS
 /end VAR_CHARACTERISTIC
 /begin VAR_CHARACTERISTIC U16LfcRiseNotSuctnNo1VlvCurPGrdt31 BrkCalVariantCriterion
  /begin VAR_ADDRESS 0x800212BA 0x800246BA 0x80027ABA 0x8002AEBA 0x8002E2BA 0x800316BA 0x80034ABA 0x80037EBA /end VAR_ADDRESS
 /end VAR_CHARACTERISTIC
 /begin VAR_CHARACTERISTIC U16LfcRiseNotSuctnNo1VlvCurPGrdt32 BrkCalVariantCriterion
  /begin VAR_ADDRESS 0x800212BC 0x800246BC 0x80027ABC 0x8002AEBC 0x8002E2BC 0x800316BC 0x80034ABC 0x80037EBC /end VAR_ADDRESS
 /end VAR_CHARACTERISTIC
 /begin VAR_CHARACTERISTIC U16LfcRiseNotSuctnNo1VlvCurPGrdt33 BrkCalVariantCriterion
  /begin VAR_ADDRESS 0x800212BE 0x800246BE 0x80027ABE 0x8002AEBE 0x8002E2BE 0x800316BE 0x80034ABE 0x80037EBE /end VAR_ADDRESS
 /end VAR_CHARACTERISTIC
 /begin VAR_CHARACTERISTIC U16LfcRiseNotSuctnNo1VlvCurPGrdt34 BrkCalVariantCriterion
  /begin VAR_ADDRESS 0x800212C0 0x800246C0 0x80027AC0 0x8002AEC0 0x8002E2C0 0x800316C0 0x80034AC0 0x80037EC0 /end VAR_ADDRESS
 /end VAR_CHARACTERISTIC
 /begin VAR_CHARACTERISTIC U16LfcRiseNotSuctnNo1VlvCurPGrdt35 BrkCalVariantCriterion
  /begin VAR_ADDRESS 0x800212C2 0x800246C2 0x80027AC2 0x8002AEC2 0x8002E2C2 0x800316C2 0x80034AC2 0x80037EC2 /end VAR_ADDRESS
 /end VAR_CHARACTERISTIC
 /begin VAR_CHARACTERISTIC U16LfcRiseNotSuctnNo1VlvCurPGrdt36 BrkCalVariantCriterion
  /begin VAR_ADDRESS 0x800212C4 0x800246C4 0x80027AC4 0x8002AEC4 0x8002E2C4 0x800316C4 0x80034AC4 0x80037EC4 /end VAR_ADDRESS
 /end VAR_CHARACTERISTIC
 /begin VAR_CHARACTERISTIC U16LfcRiseNotSuctnNo1VlvCurPGrdt37 BrkCalVariantCriterion
  /begin VAR_ADDRESS 0x800212C6 0x800246C6 0x80027AC6 0x8002AEC6 0x8002E2C6 0x800316C6 0x80034AC6 0x80037EC6 /end VAR_ADDRESS
 /end VAR_CHARACTERISTIC
 /begin VAR_CHARACTERISTIC U16LfcRiseNotSuctnNo1VlvCurPGrdt38 BrkCalVariantCriterion
  /begin VAR_ADDRESS 0x800212C8 0x800246C8 0x80027AC8 0x8002AEC8 0x8002E2C8 0x800316C8 0x80034AC8 0x80037EC8 /end VAR_ADDRESS
 /end VAR_CHARACTERISTIC
 /begin VAR_CHARACTERISTIC U16LfcRiseNotSuctnNo1VlvCurPGrdt39 BrkCalVariantCriterion
  /begin VAR_ADDRESS 0x800212CA 0x800246CA 0x80027ACA 0x8002AECA 0x8002E2CA 0x800316CA 0x80034ACA 0x80037ECA /end VAR_ADDRESS
 /end VAR_CHARACTERISTIC
 /begin VAR_CHARACTERISTIC U16LfcRiseNotSuctnPErr1 BrkCalVariantCriterion
  /begin VAR_ADDRESS 0x80021284 0x80024684 0x80027A84 0x8002AE84 0x8002E284 0x80031684 0x80034A84 0x80037E84 /end VAR_ADDRESS
 /end VAR_CHARACTERISTIC
 /begin VAR_CHARACTERISTIC U16LfcRiseNotSuctnPErr2 BrkCalVariantCriterion
  /begin VAR_ADDRESS 0x80021286 0x80024686 0x80027A86 0x8002AE86 0x8002E286 0x80031686 0x80034A86 0x80037E86 /end VAR_ADDRESS
 /end VAR_CHARACTERISTIC
 /begin VAR_CHARACTERISTIC U16LfcRiseNotSuctnPErr3 BrkCalVariantCriterion
  /begin VAR_ADDRESS 0x80021288 0x80024688 0x80027A88 0x8002AE88 0x8002E288 0x80031688 0x80034A88 0x80037E88 /end VAR_ADDRESS
 /end VAR_CHARACTERISTIC
 /begin VAR_CHARACTERISTIC U16LfcRiseNotSuctnPGrdtNo1VlvCur11 BrkCalVariantCriterion
  /begin VAR_ADDRESS 0x80021294 0x80024694 0x80027A94 0x8002AE94 0x8002E294 0x80031694 0x80034A94 0x80037E94 /end VAR_ADDRESS
 /end VAR_CHARACTERISTIC
 /begin VAR_CHARACTERISTIC U16LfcRiseNotSuctnPGrdtNo1VlvCur12 BrkCalVariantCriterion
  /begin VAR_ADDRESS 0x80021296 0x80024696 0x80027A96 0x8002AE96 0x8002E296 0x80031696 0x80034A96 0x80037E96 /end VAR_ADDRESS
 /end VAR_CHARACTERISTIC
 /begin VAR_CHARACTERISTIC U16LfcRiseNotSuctnPGrdtNo1VlvCur13 BrkCalVariantCriterion
  /begin VAR_ADDRESS 0x80021298 0x80024698 0x80027A98 0x8002AE98 0x8002E298 0x80031698 0x80034A98 0x80037E98 /end VAR_ADDRESS
 /end VAR_CHARACTERISTIC
 /begin VAR_CHARACTERISTIC U16LfcRiseNotSuctnPGrdtNo1VlvCur14 BrkCalVariantCriterion
  /begin VAR_ADDRESS 0x8002129A 0x8002469A 0x80027A9A 0x8002AE9A 0x8002E29A 0x8003169A 0x80034A9A 0x80037E9A /end VAR_ADDRESS
 /end VAR_CHARACTERISTIC
 /begin VAR_CHARACTERISTIC U16LfcRiseNotSuctnPGrdtNo1VlvCur15 BrkCalVariantCriterion
  /begin VAR_ADDRESS 0x8002129C 0x8002469C 0x80027A9C 0x8002AE9C 0x8002E29C 0x8003169C 0x80034A9C 0x80037E9C /end VAR_ADDRESS
 /end VAR_CHARACTERISTIC
 /begin VAR_CHARACTERISTIC U16LfcRiseNotSuctnPGrdtNo1VlvCur21 BrkCalVariantCriterion
  /begin VAR_ADDRESS 0x800212AC 0x800246AC 0x80027AAC 0x8002AEAC 0x8002E2AC 0x800316AC 0x80034AAC 0x80037EAC /end VAR_ADDRESS
 /end VAR_CHARACTERISTIC
 /begin VAR_CHARACTERISTIC U16LfcRiseNotSuctnPGrdtNo1VlvCur22 BrkCalVariantCriterion
  /begin VAR_ADDRESS 0x800212AE 0x800246AE 0x80027AAE 0x8002AEAE 0x8002E2AE 0x800316AE 0x80034AAE 0x80037EAE /end VAR_ADDRESS
 /end VAR_CHARACTERISTIC
 /begin VAR_CHARACTERISTIC U16LfcRiseNotSuctnPGrdtNo1VlvCur23 BrkCalVariantCriterion
  /begin VAR_ADDRESS 0x800212B0 0x800246B0 0x80027AB0 0x8002AEB0 0x8002E2B0 0x800316B0 0x80034AB0 0x80037EB0 /end VAR_ADDRESS
 /end VAR_CHARACTERISTIC
 /begin VAR_CHARACTERISTIC U16LfcRiseNotSuctnPGrdtNo1VlvCur24 BrkCalVariantCriterion
  /begin VAR_ADDRESS 0x800212B2 0x800246B2 0x80027AB2 0x8002AEB2 0x8002E2B2 0x800316B2 0x80034AB2 0x80037EB2 /end VAR_ADDRESS
 /end VAR_CHARACTERISTIC
 /begin VAR_CHARACTERISTIC U16LfcRiseNotSuctnPGrdtNo1VlvCur25 BrkCalVariantCriterion
  /begin VAR_ADDRESS 0x800212B4 0x800246B4 0x80027AB4 0x8002AEB4 0x8002E2B4 0x800316B4 0x80034AB4 0x80037EB4 /end VAR_ADDRESS
 /end VAR_CHARACTERISTIC
 /begin VAR_CHARACTERISTIC U16LfcRiseNotSuctnPGrdtNo1VlvCur26 BrkCalVariantCriterion
  /begin VAR_ADDRESS 0x800212B6 0x800246B6 0x80027AB6 0x8002AEB6 0x8002E2B6 0x800316B6 0x80034AB6 0x80037EB6 /end VAR_ADDRESS
 /end VAR_CHARACTERISTIC
 /begin VAR_CHARACTERISTIC U16LfcRiseNotSuctnPGrdtNo1VlvCur27 BrkCalVariantCriterion
  /begin VAR_ADDRESS 0x800212B8 0x800246B8 0x80027AB8 0x8002AEB8 0x8002E2B8 0x800316B8 0x80034AB8 0x80037EB8 /end VAR_ADDRESS
 /end VAR_CHARACTERISTIC
 /begin VAR_CHARACTERISTIC U16LfcRiseNotSuctnPGrdtNo1VlvCur31 BrkCalVariantCriterion
  /begin VAR_ADDRESS 0x800212CC 0x800246CC 0x80027ACC 0x8002AECC 0x8002E2CC 0x800316CC 0x80034ACC 0x80037ECC /end VAR_ADDRESS
 /end VAR_CHARACTERISTIC
 /begin VAR_CHARACTERISTIC U16LfcRiseNotSuctnPGrdtNo1VlvCur32 BrkCalVariantCriterion
  /begin VAR_ADDRESS 0x800212CE 0x800246CE 0x80027ACE 0x8002AECE 0x8002E2CE 0x800316CE 0x80034ACE 0x80037ECE /end VAR_ADDRESS
 /end VAR_CHARACTERISTIC
 /begin VAR_CHARACTERISTIC U16LfcRiseNotSuctnPGrdtNo1VlvCur33 BrkCalVariantCriterion
  /begin VAR_ADDRESS 0x800212D0 0x800246D0 0x80027AD0 0x8002AED0 0x8002E2D0 0x800316D0 0x80034AD0 0x80037ED0 /end VAR_ADDRESS
 /end VAR_CHARACTERISTIC
 /begin VAR_CHARACTERISTIC U16LfcRiseNotSuctnPGrdtNo1VlvCur34 BrkCalVariantCriterion
  /begin VAR_ADDRESS 0x800212D2 0x800246D2 0x80027AD2 0x8002AED2 0x8002E2D2 0x800316D2 0x80034AD2 0x80037ED2 /end VAR_ADDRESS
 /end VAR_CHARACTERISTIC
 /begin VAR_CHARACTERISTIC U16LfcRiseNotSuctnPGrdtNo1VlvCur35 BrkCalVariantCriterion
  /begin VAR_ADDRESS 0x800212D4 0x800246D4 0x80027AD4 0x8002AED4 0x8002E2D4 0x800316D4 0x80034AD4 0x80037ED4 /end VAR_ADDRESS
 /end VAR_CHARACTERISTIC
 /begin VAR_CHARACTERISTIC U16LfcRiseNotSuctnPGrdtNo1VlvCur36 BrkCalVariantCriterion
  /begin VAR_ADDRESS 0x800212D6 0x800246D6 0x80027AD6 0x8002AED6 0x8002E2D6 0x800316D6 0x80034AD6 0x80037ED6 /end VAR_ADDRESS
 /end VAR_CHARACTERISTIC
 /begin VAR_CHARACTERISTIC U16LfcRiseNotSuctnPGrdtNo1VlvCur37 BrkCalVariantCriterion
  /begin VAR_ADDRESS 0x800212D8 0x800246D8 0x80027AD8 0x8002AED8 0x8002E2D8 0x800316D8 0x80034AD8 0x80037ED8 /end VAR_ADDRESS
 /end VAR_CHARACTERISTIC
 /begin VAR_CHARACTERISTIC U16LfcRiseNotSuctnPGrdtNo1VlvCur38 BrkCalVariantCriterion
  /begin VAR_ADDRESS 0x800212DA 0x800246DA 0x80027ADA 0x8002AEDA 0x8002E2DA 0x800316DA 0x80034ADA 0x80037EDA /end VAR_ADDRESS
 /end VAR_CHARACTERISTIC
 /begin VAR_CHARACTERISTIC U16LfcRiseNotSuctnPGrdtNo1VlvCur39 BrkCalVariantCriterion
  /begin VAR_ADDRESS 0x800212DC 0x800246DC 0x80027ADC 0x8002AEDC 0x8002E2DC 0x800316DC 0x80034ADC 0x80037EDC /end VAR_ADDRESS
 /end VAR_CHARACTERISTIC
 /begin VAR_CHARACTERISTIC U16LfcRiseSuctnNo1VlvCurPGrdt1 BrkCalVariantCriterion
  /begin VAR_ADDRESS 0x80021268 0x80024668 0x80027A68 0x8002AE68 0x8002E268 0x80031668 0x80034A68 0x80037E68 /end VAR_ADDRESS
 /end VAR_CHARACTERISTIC
 /begin VAR_CHARACTERISTIC U16LfcRiseSuctnNo1VlvCurPGrdt2 BrkCalVariantCriterion
  /begin VAR_ADDRESS 0x8002126A 0x8002466A 0x80027A6A 0x8002AE6A 0x8002E26A 0x8003166A 0x80034A6A 0x80037E6A /end VAR_ADDRESS
 /end VAR_CHARACTERISTIC
 /begin VAR_CHARACTERISTIC U16LfcRiseSuctnNo1VlvCurPGrdt3 BrkCalVariantCriterion
  /begin VAR_ADDRESS 0x8002126C 0x8002466C 0x80027A6C 0x8002AE6C 0x8002E26C 0x8003166C 0x80034A6C 0x80037E6C /end VAR_ADDRESS
 /end VAR_CHARACTERISTIC
 /begin VAR_CHARACTERISTIC U16LfcRiseSuctnNo1VlvCurPGrdt4 BrkCalVariantCriterion
  /begin VAR_ADDRESS 0x8002126E 0x8002466E 0x80027A6E 0x8002AE6E 0x8002E26E 0x8003166E 0x80034A6E 0x80037E6E /end VAR_ADDRESS
 /end VAR_CHARACTERISTIC
 /begin VAR_CHARACTERISTIC U16LfcRiseSuctnNo1VlvCurPGrdt5 BrkCalVariantCriterion
  /begin VAR_ADDRESS 0x80021270 0x80024670 0x80027A70 0x8002AE70 0x8002E270 0x80031670 0x80034A70 0x80037E70 /end VAR_ADDRESS
 /end VAR_CHARACTERISTIC
 /begin VAR_CHARACTERISTIC U16LfcRiseSuctnNo1VlvCurPGrdt6 BrkCalVariantCriterion
  /begin VAR_ADDRESS 0x80021272 0x80024672 0x80027A72 0x8002AE72 0x8002E272 0x80031672 0x80034A72 0x80037E72 /end VAR_ADDRESS
 /end VAR_CHARACTERISTIC
 /begin VAR_CHARACTERISTIC U16LfcRiseSuctnNo1VlvCurPGrdt7 BrkCalVariantCriterion
  /begin VAR_ADDRESS 0x80021274 0x80024674 0x80027A74 0x8002AE74 0x8002E274 0x80031674 0x80034A74 0x80037E74 /end VAR_ADDRESS
 /end VAR_CHARACTERISTIC
 /begin VAR_CHARACTERISTIC U16LfcRiseSuctnPGrdtNo1VlvCur1 BrkCalVariantCriterion
  /begin VAR_ADDRESS 0x80021276 0x80024676 0x80027A76 0x8002AE76 0x8002E276 0x80031676 0x80034A76 0x80037E76 /end VAR_ADDRESS
 /end VAR_CHARACTERISTIC
 /begin VAR_CHARACTERISTIC U16LfcRiseSuctnPGrdtNo1VlvCur2 BrkCalVariantCriterion
  /begin VAR_ADDRESS 0x80021278 0x80024678 0x80027A78 0x8002AE78 0x8002E278 0x80031678 0x80034A78 0x80037E78 /end VAR_ADDRESS
 /end VAR_CHARACTERISTIC
 /begin VAR_CHARACTERISTIC U16LfcRiseSuctnPGrdtNo1VlvCur3 BrkCalVariantCriterion
  /begin VAR_ADDRESS 0x8002127A 0x8002467A 0x80027A7A 0x8002AE7A 0x8002E27A 0x8003167A 0x80034A7A 0x80037E7A /end VAR_ADDRESS
 /end VAR_CHARACTERISTIC
 /begin VAR_CHARACTERISTIC U16LfcRiseSuctnPGrdtNo1VlvCur4 BrkCalVariantCriterion
  /begin VAR_ADDRESS 0x8002127C 0x8002467C 0x80027A7C 0x8002AE7C 0x8002E27C 0x8003167C 0x80034A7C 0x80037E7C /end VAR_ADDRESS
 /end VAR_CHARACTERISTIC
 /begin VAR_CHARACTERISTIC U16LfcRiseSuctnPGrdtNo1VlvCur5 BrkCalVariantCriterion
  /begin VAR_ADDRESS 0x8002127E 0x8002467E 0x80027A7E 0x8002AE7E 0x8002E27E 0x8003167E 0x80034A7E 0x80037E7E /end VAR_ADDRESS
 /end VAR_CHARACTERISTIC
 /begin VAR_CHARACTERISTIC U16LfcRiseSuctnPGrdtNo1VlvCur6 BrkCalVariantCriterion
  /begin VAR_ADDRESS 0x80021280 0x80024680 0x80027A80 0x8002AE80 0x8002E280 0x80031680 0x80034A80 0x80037E80 /end VAR_ADDRESS
 /end VAR_CHARACTERISTIC
 /begin VAR_CHARACTERISTIC U16LfcRiseSuctnPGrdtNo1VlvCur7 BrkCalVariantCriterion
  /begin VAR_ADDRESS 0x80021282 0x80024682 0x80027A82 0x8002AE82 0x8002E282 0x80031682 0x80034A82 0x80037E82 /end VAR_ADDRESS
 /end VAR_CHARACTERISTIC
 /begin VAR_CHARACTERISTIC U16LfcTestIniCur BrkCalVariantCriterion
  /begin VAR_ADDRESS 0x800214D4 0x800248D4 0x80027CD4 0x8002B0D4 0x8002E4D4 0x800318D4 0x80034CD4 0x800380D4 /end VAR_ADDRESS
 /end VAR_CHARACTERISTIC
 /begin VAR_CHARACTERISTIC U16LfcTestIntlCur BrkCalVariantCriterion
  /begin VAR_ADDRESS 0x800214D6 0x800248D6 0x80027CD6 0x8002B0D6 0x8002E4D6 0x800318D6 0x80034CD6 0x800380D6 /end VAR_ADDRESS
 /end VAR_CHARACTERISTIC
 /begin VAR_CHARACTERISTIC U16MotActtnVehWhlSpdAbs BrkCalVariantCriterion
  /begin VAR_ADDRESS 0x800213D8 0x800247D8 0x80027BD8 0x8002AFD8 0x8002E3D8 0x800317D8 0x80034BD8 0x80037FD8 /end VAR_ADDRESS
 /end VAR_CHARACTERISTIC
 /begin VAR_CHARACTERISTIC U16MotUAbsVehSpd BrkCalVariantCriterion
  /begin VAR_ADDRESS 0x800213F6 0x800247F6 0x80027BF6 0x8002AFF6 0x8002E3F6 0x800317F6 0x80034BF6 0x80037FF6 /end VAR_ADDRESS
 /end VAR_CHARACTERISTIC
 /begin VAR_CHARACTERISTIC U16MotUVddU1 BrkCalVariantCriterion
  /begin VAR_ADDRESS 0x80021484 0x80024884 0x80027C84 0x8002B084 0x8002E484 0x80031884 0x80034C84 0x80038084 /end VAR_ADDRESS
 /end VAR_CHARACTERISTIC
 /begin VAR_CHARACTERISTIC U16MotUVddU2 BrkCalVariantCriterion
  /begin VAR_ADDRESS 0x80021486 0x80024886 0x80027C86 0x8002B086 0x8002E486 0x80031886 0x80034C86 0x80038086 /end VAR_ADDRESS
 /end VAR_CHARACTERISTIC
 /begin VAR_CHARACTERISTIC U16MotUWslcLatCombNotSuctn BrkCalVariantCriterion
  /begin VAR_ADDRESS 0x80021406 0x80024806 0x80027C06 0x8002B006 0x8002E406 0x80031806 0x80034C06 0x80038006 /end VAR_ADDRESS
 /end VAR_CHARACTERISTIC
 /begin VAR_CHARACTERISTIC U16MotUWslcLatCombSuctn BrkCalVariantCriterion
  /begin VAR_ADDRESS 0x80021404 0x80024804 0x80027C04 0x8002B004 0x8002E404 0x80031804 0x80034C04 0x80038004 /end VAR_ADDRESS
 /end VAR_CHARACTERISTIC
 /begin VAR_CHARACTERISTIC U16MstCylPIniMotUAbs1 BrkCalVariantCriterion
  /begin VAR_ADDRESS 0x800213E4 0x800247E4 0x80027BE4 0x8002AFE4 0x8002E3E4 0x800317E4 0x80034BE4 0x80037FE4 /end VAR_ADDRESS
 /end VAR_CHARACTERISTIC
 /begin VAR_CHARACTERISTIC U16MstCylPIniMotUAbs2 BrkCalVariantCriterion
  /begin VAR_ADDRESS 0x800213E6 0x800247E6 0x80027BE6 0x8002AFE6 0x8002E3E6 0x800317E6 0x80034BE6 0x80037FE6 /end VAR_ADDRESS
 /end VAR_CHARACTERISTIC
 /begin VAR_CHARACTERISTIC U16MstCylPIniMotUAbs3 BrkCalVariantCriterion
  /begin VAR_ADDRESS 0x800213E8 0x800247E8 0x80027BE8 0x8002AFE8 0x8002E3E8 0x800317E8 0x80034BE8 0x80037FE8 /end VAR_ADDRESS
 /end VAR_CHARACTERISTIC
 /begin VAR_CHARACTERISTIC U16MstCylPIniMotUAbs4 BrkCalVariantCriterion
  /begin VAR_ADDRESS 0x800213EA 0x800247EA 0x80027BEA 0x8002AFEA 0x8002E3EA 0x800317EA 0x80034BEA 0x80037FEA /end VAR_ADDRESS
 /end VAR_CHARACTERISTIC
 /begin VAR_CHARACTERISTIC U16No1VlvCurMax BrkCalVariantCriterion
  /begin VAR_ADDRESS 0x80021262 0x80024662 0x80027A62 0x8002AE62 0x8002E262 0x80031662 0x80034A62 0x80037E62 /end VAR_ADDRESS
 /end VAR_CHARACTERISTIC
 /begin VAR_CHARACTERISTIC U16No1VlvCurMin BrkCalVariantCriterion
  /begin VAR_ADDRESS 0x80021260 0x80024660 0x80027A60 0x8002AE60 0x8002E260 0x80031660 0x80034A60 0x80037E60 /end VAR_ADDRESS
 /end VAR_CHARACTERISTIC
 /begin VAR_CHARACTERISTIC U16No1VlvCurSysMax BrkCalVariantCriterion
  /begin VAR_ADDRESS 0x80021264 0x80024664 0x80027A64 0x8002AE64 0x8002E264 0x80031664 0x80034A64 0x80037E64 /end VAR_ADDRESS
 /end VAR_CHARACTERISTIC
 /begin VAR_CHARACTERISTIC U16No1VlvCurTestActtnTi BrkCalVariantCriterion
  /begin VAR_ADDRESS 0x800214CC 0x800248CC 0x80027CCC 0x8002B0CC 0x8002E4CC 0x800318CC 0x80034CCC 0x800380CC /end VAR_ADDRESS
 /end VAR_CHARACTERISTIC
 /begin VAR_CHARACTERISTIC U16No1VlvCurTestIniCur BrkCalVariantCriterion
  /begin VAR_ADDRESS 0x800214CE 0x800248CE 0x80027CCE 0x8002B0CE 0x8002E4CE 0x800318CE 0x80034CCE 0x800380CE /end VAR_ADDRESS
 /end VAR_CHARACTERISTIC
 /begin VAR_CHARACTERISTIC U16No1VlvCurTestIntlCur BrkCalVariantCriterion
  /begin VAR_ADDRESS 0x800214D0 0x800248D0 0x80027CD0 0x8002B0D0 0x8002E4D0 0x800318D0 0x80034CD0 0x800380D0 /end VAR_ADDRESS
 /end VAR_CHARACTERISTIC
 /begin VAR_CHARACTERISTIC U16No1VlvCurTestMotU BrkCalVariantCriterion
  /begin VAR_ADDRESS 0x800214D2 0x800248D2 0x80027CD2 0x8002B0D2 0x8002E4D2 0x800318D2 0x80034CD2 0x800380D2 /end VAR_ADDRESS
 /end VAR_CHARACTERISTIC
 /begin VAR_CHARACTERISTIC U16PlsDumpPGrdtP1 BrkCalVariantCriterion
  /begin VAR_ADDRESS 0x800212F2 0x800246F2 0x80027AF2 0x8002AEF2 0x8002E2F2 0x800316F2 0x80034AF2 0x80037EF2 /end VAR_ADDRESS
 /end VAR_CHARACTERISTIC
 /begin VAR_CHARACTERISTIC U16PlsDumpPGrdtP2 BrkCalVariantCriterion
  /begin VAR_ADDRESS 0x800212F4 0x800246F4 0x80027AF4 0x8002AEF4 0x8002E2F4 0x800316F4 0x80034AF4 0x80037EF4 /end VAR_ADDRESS
 /end VAR_CHARACTERISTIC
 /begin VAR_CHARACTERISTIC U16PlsDumpPGrdtP3 BrkCalVariantCriterion
  /begin VAR_ADDRESS 0x800212F6 0x800246F6 0x80027AF6 0x8002AEF6 0x8002E2F6 0x800316F6 0x80034AF6 0x80037EF6 /end VAR_ADDRESS
 /end VAR_CHARACTERISTIC
 /begin VAR_CHARACTERISTIC U16PlsDumpPPGrdt1 BrkCalVariantCriterion
  /begin VAR_ADDRESS 0x800212F8 0x800246F8 0x80027AF8 0x8002AEF8 0x8002E2F8 0x800316F8 0x80034AF8 0x80037EF8 /end VAR_ADDRESS
 /end VAR_CHARACTERISTIC
 /begin VAR_CHARACTERISTIC U16PlsDumpPPGrdt2 BrkCalVariantCriterion
  /begin VAR_ADDRESS 0x800212FA 0x800246FA 0x80027AFA 0x8002AEFA 0x8002E2FA 0x800316FA 0x80034AFA 0x80037EFA /end VAR_ADDRESS
 /end VAR_CHARACTERISTIC
 /begin VAR_CHARACTERISTIC U16PlsDumpPPGrdt3 BrkCalVariantCriterion
  /begin VAR_ADDRESS 0x800212FC 0x800246FC 0x80027AFC 0x8002AEFC 0x8002E2FC 0x800316FC 0x80034AFC 0x80037EFC /end VAR_ADDRESS
 /end VAR_CHARACTERISTIC
 /begin VAR_CHARACTERISTIC U16PlsRisePGrdt1 BrkCalVariantCriterion
  /begin VAR_ADDRESS 0x800212E0 0x800246E0 0x80027AE0 0x8002AEE0 0x8002E2E0 0x800316E0 0x80034AE0 0x80037EE0 /end VAR_ADDRESS
 /end VAR_CHARACTERISTIC
 /begin VAR_CHARACTERISTIC U16PlsRisePGrdt2 BrkCalVariantCriterion
  /begin VAR_ADDRESS 0x800212E2 0x800246E2 0x80027AE2 0x8002AEE2 0x8002E2E2 0x800316E2 0x80034AE2 0x80037EE2 /end VAR_ADDRESS
 /end VAR_CHARACTERISTIC
 /begin VAR_CHARACTERISTIC U16PlsRisePGrdt3 BrkCalVariantCriterion
  /begin VAR_ADDRESS 0x800212E4 0x800246E4 0x80027AE4 0x8002AEE4 0x8002E2E4 0x800316E4 0x80034AE4 0x80037EE4 /end VAR_ADDRESS
 /end VAR_CHARACTERISTIC
 /begin VAR_CHARACTERISTIC U16PlsRisePGrdt4 BrkCalVariantCriterion
  /begin VAR_ADDRESS 0x800212E6 0x800246E6 0x80027AE6 0x8002AEE6 0x8002E2E6 0x800316E6 0x80034AE6 0x80037EE6 /end VAR_ADDRESS
 /end VAR_CHARACTERISTIC
 /begin VAR_CHARACTERISTIC U16PlsRisePGrdt5 BrkCalVariantCriterion
  /begin VAR_ADDRESS 0x800212E8 0x800246E8 0x80027AE8 0x8002AEE8 0x8002E2E8 0x800316E8 0x80034AE8 0x80037EE8 /end VAR_ADDRESS
 /end VAR_CHARACTERISTIC
 /begin VAR_CHARACTERISTIC U16PlsRisePGrdt6 BrkCalVariantCriterion
  /begin VAR_ADDRESS 0x800212EA 0x800246EA 0x80027AEA 0x8002AEEA 0x8002E2EA 0x800316EA 0x80034AEA 0x80037EEA /end VAR_ADDRESS
 /end VAR_CHARACTERISTIC
 /begin VAR_CHARACTERISTIC U16RiseRateTestActtnTi1Whl BrkCalVariantCriterion
  /begin VAR_ADDRESS 0x800214B0 0x800248B0 0x80027CB0 0x8002B0B0 0x8002E4B0 0x800318B0 0x80034CB0 0x800380B0 /end VAR_ADDRESS
 /end VAR_CHARACTERISTIC
 /begin VAR_CHARACTERISTIC U16RiseRateTestActtnTi4Whl BrkCalVariantCriterion
  /begin VAR_ADDRESS 0x800214B6 0x800248B6 0x80027CB6 0x8002B0B6 0x8002E4B6 0x800318B6 0x80034CB6 0x800380B6 /end VAR_ADDRESS
 /end VAR_CHARACTERISTIC
 /begin VAR_CHARACTERISTIC U16RiseRateTestMotU1Whl BrkCalVariantCriterion
  /begin VAR_ADDRESS 0x800214B2 0x800248B2 0x80027CB2 0x8002B0B2 0x8002E4B2 0x800318B2 0x80034CB2 0x800380B2 /end VAR_ADDRESS
 /end VAR_CHARACTERISTIC
 /begin VAR_CHARACTERISTIC U16RiseRateTestMotU4Whl BrkCalVariantCriterion
  /begin VAR_ADDRESS 0x800214BA 0x800248BA 0x80027CBA 0x8002B0BA 0x8002E4BA 0x800318BA 0x80034CBA 0x800380BA /end VAR_ADDRESS
 /end VAR_CHARACTERISTIC
 /begin VAR_CHARACTERISTIC U16RiseRateTestMotUPrefill BrkCalVariantCriterion
  /begin VAR_ADDRESS 0x800214B8 0x800248B8 0x80027CB8 0x8002B0B8 0x8002E4B8 0x800318B8 0x80034CB8 0x800380B8 /end VAR_ADDRESS
 /end VAR_CHARACTERISTIC
 /begin VAR_CHARACTERISTIC U16TcVlvCurMapGainPrim BrkCalVariantCriterion
  /begin VAR_ADDRESS 0x800213B8 0x800247B8 0x80027BB8 0x8002AFB8 0x8002E3B8 0x800317B8 0x80034BB8 0x80037FB8 /end VAR_ADDRESS
 /end VAR_CHARACTERISTIC
 /begin VAR_CHARACTERISTIC U16TcVlvCurMapGainSecd BrkCalVariantCriterion
  /begin VAR_ADDRESS 0x800213BA 0x800247BA 0x80027BBA 0x8002AFBA 0x8002E3BA 0x800317BA 0x80034BBA 0x80037FBA /end VAR_ADDRESS
 /end VAR_CHARACTERISTIC
 /begin VAR_CHARACTERISTIC U16TcVlvCurMax BrkCalVariantCriterion
  /begin VAR_ADDRESS 0x80021300 0x80024700 0x80027B00 0x8002AF00 0x8002E300 0x80031700 0x80034B00 0x80037F00 /end VAR_ADDRESS
 /end VAR_CHARACTERISTIC
 /begin VAR_CHARACTERISTIC U16TcVlvCurMin BrkCalVariantCriterion
  /begin VAR_ADDRESS 0x800212FE 0x800246FE 0x80027AFE 0x8002AEFE 0x8002E2FE 0x800316FE 0x80034AFE 0x80037EFE /end VAR_ADDRESS
 /end VAR_CHARACTERISTIC
 /begin VAR_CHARACTERISTIC U16TcVlvCurSysMax BrkCalVariantCriterion
  /begin VAR_ADDRESS 0x80021302 0x80024702 0x80027B02 0x8002AF02 0x8002E302 0x80031702 0x80034B02 0x80037F02 /end VAR_ADDRESS
 /end VAR_CHARACTERISTIC
 /begin VAR_CHARACTERISTIC U16TcVlvCurTestIniCur BrkCalVariantCriterion
  /begin VAR_ADDRESS 0x800214BC 0x800248BC 0x80027CBC 0x8002B0BC 0x8002E4BC 0x800318BC 0x80034CBC 0x800380BC /end VAR_ADDRESS
 /end VAR_CHARACTERISTIC
 /begin VAR_CHARACTERISTIC U16TcVlvCurTestMotU BrkCalVariantCriterion
  /begin VAR_ADDRESS 0x800214CA 0x800248CA 0x80027CCA 0x8002B0CA 0x8002E4CA 0x800318CA 0x80034CCA 0x800380CA /end VAR_ADDRESS
 /end VAR_CHARACTERISTIC
 /begin VAR_CHARACTERISTIC U16TcVlvCurTestReleafCurHldTi BrkCalVariantCriterion
  /begin VAR_ADDRESS 0x800214C8 0x800248C8 0x80027CC8 0x8002B0C8 0x8002E4C8 0x800318C8 0x80034CC8 0x800380C8 /end VAR_ADDRESS
 /end VAR_CHARACTERISTIC
 /begin VAR_CHARACTERISTIC U16TcVlvCurTestReleafCurMax BrkCalVariantCriterion
  /begin VAR_ADDRESS 0x800214C6 0x800248C6 0x80027CC6 0x8002B0C6 0x8002E4C6 0x800318C6 0x80034CC6 0x800380C6 /end VAR_ADDRESS
 /end VAR_CHARACTERISTIC
 /begin VAR_CHARACTERISTIC U16TcVlvCurTestReleafIntlCur BrkCalVariantCriterion
  /begin VAR_ADDRESS 0x800214C4 0x800248C4 0x80027CC4 0x8002B0C4 0x8002E4C4 0x800318C4 0x80034CC4 0x800380C4 /end VAR_ADDRESS
 /end VAR_CHARACTERISTIC
 /begin VAR_CHARACTERISTIC U16TcVlvCurTestUpDwnCurHldTi BrkCalVariantCriterion
  /begin VAR_ADDRESS 0x800214C2 0x800248C2 0x80027CC2 0x8002B0C2 0x8002E4C2 0x800318C2 0x80034CC2 0x800380C2 /end VAR_ADDRESS
 /end VAR_CHARACTERISTIC
 /begin VAR_CHARACTERISTIC U16TcVlvCurTestUpDwnCurMax BrkCalVariantCriterion
  /begin VAR_ADDRESS 0x800214C0 0x800248C0 0x80027CC0 0x8002B0C0 0x8002E4C0 0x800318C0 0x80034CC0 0x800380C0 /end VAR_ADDRESS
 /end VAR_CHARACTERISTIC
 /begin VAR_CHARACTERISTIC U16TcVlvCurTestUpDwnIntlCur BrkCalVariantCriterion
  /begin VAR_ADDRESS 0x800214BE 0x800248BE 0x80027CBE 0x8002B0BE 0x8002E4BE 0x800318BE 0x80034CBE 0x800380BE /end VAR_ADDRESS
 /end VAR_CHARACTERISTIC
 /begin VAR_CHARACTERISTIC U16TcVlvLeakTestHldCur1 BrkCalVariantCriterion
  /begin VAR_ADDRESS 0x800214EE 0x800248EE 0x80027CEE 0x8002B0EE 0x8002E4EE 0x800318EE 0x80034CEE 0x800380EE /end VAR_ADDRESS
 /end VAR_CHARACTERISTIC
 /begin VAR_CHARACTERISTIC U16TcVlvLeakTestHldCur2 BrkCalVariantCriterion
  /begin VAR_ADDRESS 0x800214F0 0x800248F0 0x80027CF0 0x8002B0F0 0x8002E4F0 0x800318F0 0x80034CF0 0x800380F0 /end VAR_ADDRESS
 /end VAR_CHARACTERISTIC
 /begin VAR_CHARACTERISTIC U16TcVlvLeakTestIniHldEndCur1 BrkCalVariantCriterion
  /begin VAR_ADDRESS 0x800214EA 0x800248EA 0x80027CEA 0x8002B0EA 0x8002E4EA 0x800318EA 0x80034CEA 0x800380EA /end VAR_ADDRESS
 /end VAR_CHARACTERISTIC
 /begin VAR_CHARACTERISTIC U16TcVlvLeakTestIniHldEndCur2 BrkCalVariantCriterion
  /begin VAR_ADDRESS 0x800214EC 0x800248EC 0x80027CEC 0x8002B0EC 0x8002E4EC 0x800318EC 0x80034CEC 0x800380EC /end VAR_ADDRESS
 /end VAR_CHARACTERISTIC
 /begin VAR_CHARACTERISTIC U16TcVlvLeakTestIniHldPeakCur BrkCalVariantCriterion
  /begin VAR_ADDRESS 0x800214E8 0x800248E8 0x80027CE8 0x8002B0E8 0x8002E4E8 0x800318E8 0x80034CE8 0x800380E8 /end VAR_ADDRESS
 /end VAR_CHARACTERISTIC
 /begin VAR_CHARACTERISTIC U16TcVlvLeakTestIniHldStrtCur BrkCalVariantCriterion
  /begin VAR_ADDRESS 0x800214E6 0x800248E6 0x80027CE6 0x8002B0E6 0x8002E4E6 0x800318E6 0x80034CE6 0x800380E6 /end VAR_ADDRESS
 /end VAR_CHARACTERISTIC
 /begin VAR_CHARACTERISTIC U16TcmfCmpHldIncTcVlvCurDyn BrkCalVariantCriterion
  /begin VAR_ADDRESS 0x8002135A 0x8002475A 0x80027B5A 0x8002AF5A 0x8002E35A 0x8003175A 0x80034B5A 0x80037F5A /end VAR_ADDRESS
 /end VAR_CHARACTERISTIC
 /begin VAR_CHARACTERISTIC U16TcmfCmpHldIncTcVlvCurSsm BrkCalVariantCriterion
  /begin VAR_ADDRESS 0x80021358 0x80024758 0x80027B58 0x8002AF58 0x8002E358 0x80031758 0x80034B58 0x80037F58 /end VAR_ADDRESS
 /end VAR_CHARACTERISTIC
 /begin VAR_CHARACTERISTIC U16TcmfDumpDecTcVlvCurPGrdt1 BrkCalVariantCriterion
  /begin VAR_ADDRESS 0x8002135E 0x8002475E 0x80027B5E 0x8002AF5E 0x8002E35E 0x8003175E 0x80034B5E 0x80037F5E /end VAR_ADDRESS
 /end VAR_CHARACTERISTIC
 /begin VAR_CHARACTERISTIC U16TcmfDumpDecTcVlvCurPGrdt2 BrkCalVariantCriterion
  /begin VAR_ADDRESS 0x80021360 0x80024760 0x80027B60 0x8002AF60 0x8002E360 0x80031760 0x80034B60 0x80037F60 /end VAR_ADDRESS
 /end VAR_CHARACTERISTIC
 /begin VAR_CHARACTERISTIC U16TcmfDumpDecTcVlvCurPGrdt3 BrkCalVariantCriterion
  /begin VAR_ADDRESS 0x80021362 0x80024762 0x80027B62 0x8002AF62 0x8002E362 0x80031762 0x80034B62 0x80037F62 /end VAR_ADDRESS
 /end VAR_CHARACTERISTIC
 /begin VAR_CHARACTERISTIC U16TcmfFbDecPErrTcVlvCur1 BrkCalVariantCriterion
  /begin VAR_ADDRESS 0x800213C4 0x800247C4 0x80027BC4 0x8002AFC4 0x8002E3C4 0x800317C4 0x80034BC4 0x80037FC4 /end VAR_ADDRESS
 /end VAR_CHARACTERISTIC
 /begin VAR_CHARACTERISTIC U16TcmfFbDecPErrTcVlvCur2 BrkCalVariantCriterion
  /begin VAR_ADDRESS 0x800213C6 0x800247C6 0x80027BC6 0x8002AFC6 0x8002E3C6 0x800317C6 0x80034BC6 0x80037FC6 /end VAR_ADDRESS
 /end VAR_CHARACTERISTIC
 /begin VAR_CHARACTERISTIC U16TcmfFbIncPErrTcVlvCur1 BrkCalVariantCriterion
  /begin VAR_ADDRESS 0x800213C0 0x800247C0 0x80027BC0 0x8002AFC0 0x8002E3C0 0x800317C0 0x80034BC0 0x80037FC0 /end VAR_ADDRESS
 /end VAR_CHARACTERISTIC
 /begin VAR_CHARACTERISTIC U16TcmfFbIncPErrTcVlvCur2 BrkCalVariantCriterion
  /begin VAR_ADDRESS 0x800213C2 0x800247C2 0x80027BC2 0x8002AFC2 0x8002E3C2 0x800317C2 0x80034BC2 0x80037FC2 /end VAR_ADDRESS
 /end VAR_CHARACTERISTIC
 /begin VAR_CHARACTERISTIC U16TcmfFbMotUPErr1 BrkCalVariantCriterion
  /begin VAR_ADDRESS 0x8002148C 0x8002488C 0x80027C8C 0x8002B08C 0x8002E48C 0x8003188C 0x80034C8C 0x8003808C /end VAR_ADDRESS
 /end VAR_CHARACTERISTIC
 /begin VAR_CHARACTERISTIC U16TcmfFbMotUPErr2 BrkCalVariantCriterion
  /begin VAR_ADDRESS 0x8002148E 0x8002488E 0x80027C8E 0x8002B08E 0x8002E48E 0x8003188E 0x80034C8E 0x8003808E /end VAR_ADDRESS
 /end VAR_CHARACTERISTIC
 /begin VAR_CHARACTERISTIC U16TcmfFbPErrMotU1 BrkCalVariantCriterion
  /begin VAR_ADDRESS 0x80021490 0x80024890 0x80027C90 0x8002B090 0x8002E490 0x80031890 0x80034C90 0x80038090 /end VAR_ADDRESS
 /end VAR_CHARACTERISTIC
 /begin VAR_CHARACTERISTIC U16TcmfFbPErrMotU2 BrkCalVariantCriterion
  /begin VAR_ADDRESS 0x80021492 0x80024892 0x80027C92 0x8002B092 0x8002E492 0x80031892 0x80034C92 0x80038092 /end VAR_ADDRESS
 /end VAR_CHARACTERISTIC
 /begin VAR_CHARACTERISTIC U16TcmfFbTcVlvCurPErr1 BrkCalVariantCriterion
  /begin VAR_ADDRESS 0x800213BC 0x800247BC 0x80027BBC 0x8002AFBC 0x8002E3BC 0x800317BC 0x80034BBC 0x80037FBC /end VAR_ADDRESS
 /end VAR_CHARACTERISTIC
 /begin VAR_CHARACTERISTIC U16TcmfFbTcVlvCurPErr2 BrkCalVariantCriterion
  /begin VAR_ADDRESS 0x800213BE 0x800247BE 0x80027BBE 0x8002AFBE 0x8002E3BE 0x800317BE 0x80034BBE 0x80037FBE /end VAR_ADDRESS
 /end VAR_CHARACTERISTIC
 /begin VAR_CHARACTERISTIC U16TcmfHldDumpMotUP1 BrkCalVariantCriterion
  /begin VAR_ADDRESS 0x80021478 0x80024878 0x80027C78 0x8002B078 0x8002E478 0x80031878 0x80034C78 0x80038078 /end VAR_ADDRESS
 /end VAR_CHARACTERISTIC
 /begin VAR_CHARACTERISTIC U16TcmfHldDumpMotUP2 BrkCalVariantCriterion
  /begin VAR_ADDRESS 0x8002147A 0x8002487A 0x80027C7A 0x8002B07A 0x8002E47A 0x8003187A 0x80034C7A 0x8003807A /end VAR_ADDRESS
 /end VAR_CHARACTERISTIC
 /begin VAR_CHARACTERISTIC U16TcmfHldDumpMotUP3 BrkCalVariantCriterion
  /begin VAR_ADDRESS 0x8002147C 0x8002487C 0x80027C7C 0x8002B07C 0x8002E47C 0x8003187C 0x80034C7C 0x8003807C /end VAR_ADDRESS
 /end VAR_CHARACTERISTIC
 /begin VAR_CHARACTERISTIC U16TcmfHldDumpPMotU1 BrkCalVariantCriterion
  /begin VAR_ADDRESS 0x8002147E 0x8002487E 0x80027C7E 0x8002B07E 0x8002E47E 0x8003187E 0x80034C7E 0x8003807E /end VAR_ADDRESS
 /end VAR_CHARACTERISTIC
 /begin VAR_CHARACTERISTIC U16TcmfHldDumpPMotU2 BrkCalVariantCriterion
  /begin VAR_ADDRESS 0x80021480 0x80024880 0x80027C80 0x8002B080 0x8002E480 0x80031880 0x80034C80 0x80038080 /end VAR_ADDRESS
 /end VAR_CHARACTERISTIC
 /begin VAR_CHARACTERISTIC U16TcmfHldDumpPMotU3 BrkCalVariantCriterion
  /begin VAR_ADDRESS 0x80021482 0x80024882 0x80027C82 0x8002B082 0x8002E482 0x80031882 0x80034C82 0x80038082 /end VAR_ADDRESS
 /end VAR_CHARACTERISTIC
 /begin VAR_CHARACTERISTIC U16TcmfIniHldPeakCur BrkCalVariantCriterion
  /begin VAR_ADDRESS 0x8002132E 0x8002472E 0x80027B2E 0x8002AF2E 0x8002E32E 0x8003172E 0x80034B2E 0x80037F2E /end VAR_ADDRESS
 /end VAR_CHARACTERISTIC
 /begin VAR_CHARACTERISTIC U16TcmfIniHldStrtCur BrkCalVariantCriterion
  /begin VAR_ADDRESS 0x8002132C 0x8002472C 0x80027B2C 0x8002AF2C 0x8002E32C 0x8003172C 0x80034B2C 0x80037F2C /end VAR_ADDRESS
 /end VAR_CHARACTERISTIC
 /begin VAR_CHARACTERISTIC U16TcmfIniRiseInhbTiP1 BrkCalVariantCriterion
  /begin VAR_ADDRESS 0x80021322 0x80024722 0x80027B22 0x8002AF22 0x8002E322 0x80031722 0x80034B22 0x80037F22 /end VAR_ADDRESS
 /end VAR_CHARACTERISTIC
 /begin VAR_CHARACTERISTIC U16TcmfIniRiseInhbTiP2 BrkCalVariantCriterion
  /begin VAR_ADDRESS 0x80021324 0x80024724 0x80027B24 0x8002AF24 0x8002E324 0x80031724 0x80034B24 0x80037F24 /end VAR_ADDRESS
 /end VAR_CHARACTERISTIC
 /begin VAR_CHARACTERISTIC U16TcmfIniRiseInhbTiP3 BrkCalVariantCriterion
  /begin VAR_ADDRESS 0x80021326 0x80024726 0x80027B26 0x8002AF26 0x8002E326 0x80031726 0x80034B26 0x80037F26 /end VAR_ADDRESS
 /end VAR_CHARACTERISTIC
 /begin VAR_CHARACTERISTIC U16TcmfIniRiseMotUPGrdtFrnt01 BrkCalVariantCriterion
  /begin VAR_ADDRESS 0x80021408 0x80024808 0x80027C08 0x8002B008 0x8002E408 0x80031808 0x80034C08 0x80038008 /end VAR_ADDRESS
 /end VAR_CHARACTERISTIC
 /begin VAR_CHARACTERISTIC U16TcmfIniRiseMotUPGrdtFrnt02 BrkCalVariantCriterion
  /begin VAR_ADDRESS 0x8002140A 0x8002480A 0x80027C0A 0x8002B00A 0x8002E40A 0x8003180A 0x80034C0A 0x8003800A /end VAR_ADDRESS
 /end VAR_CHARACTERISTIC
 /begin VAR_CHARACTERISTIC U16TcmfIniRiseMotUPGrdtFrnt03 BrkCalVariantCriterion
  /begin VAR_ADDRESS 0x8002140C 0x8002480C 0x80027C0C 0x8002B00C 0x8002E40C 0x8003180C 0x80034C0C 0x8003800C /end VAR_ADDRESS
 /end VAR_CHARACTERISTIC
 /begin VAR_CHARACTERISTIC U16TcmfIniRiseMotUPGrdtFrnt04 BrkCalVariantCriterion
  /begin VAR_ADDRESS 0x8002140E 0x8002480E 0x80027C0E 0x8002B00E 0x8002E40E 0x8003180E 0x80034C0E 0x8003800E /end VAR_ADDRESS
 /end VAR_CHARACTERISTIC
 /begin VAR_CHARACTERISTIC U16TcmfIniRiseMotUPGrdtFrnt05 BrkCalVariantCriterion
  /begin VAR_ADDRESS 0x80021410 0x80024810 0x80027C10 0x8002B010 0x8002E410 0x80031810 0x80034C10 0x80038010 /end VAR_ADDRESS
 /end VAR_CHARACTERISTIC
 /begin VAR_CHARACTERISTIC U16TcmfIniRiseMotUPGrdtFrnt06 BrkCalVariantCriterion
  /begin VAR_ADDRESS 0x80021412 0x80024812 0x80027C12 0x8002B012 0x8002E412 0x80031812 0x80034C12 0x80038012 /end VAR_ADDRESS
 /end VAR_CHARACTERISTIC
 /begin VAR_CHARACTERISTIC U16TcmfIniRiseMotUPGrdtFrnt07 BrkCalVariantCriterion
  /begin VAR_ADDRESS 0x80021414 0x80024814 0x80027C14 0x8002B014 0x8002E414 0x80031814 0x80034C14 0x80038014 /end VAR_ADDRESS
 /end VAR_CHARACTERISTIC
 /begin VAR_CHARACTERISTIC U16TcmfIniRiseMotUPGrdtFrnt08 BrkCalVariantCriterion
  /begin VAR_ADDRESS 0x80021416 0x80024816 0x80027C16 0x8002B016 0x8002E416 0x80031816 0x80034C16 0x80038016 /end VAR_ADDRESS
 /end VAR_CHARACTERISTIC
 /begin VAR_CHARACTERISTIC U16TcmfIniRiseMotUPGrdtFrnt09 BrkCalVariantCriterion
  /begin VAR_ADDRESS 0x80021418 0x80024818 0x80027C18 0x8002B018 0x8002E418 0x80031818 0x80034C18 0x80038018 /end VAR_ADDRESS
 /end VAR_CHARACTERISTIC
 /begin VAR_CHARACTERISTIC U16TcmfIniRiseMotUPGrdtFrnt10 BrkCalVariantCriterion
  /begin VAR_ADDRESS 0x8002141A 0x8002481A 0x80027C1A 0x8002B01A 0x8002E41A 0x8003181A 0x80034C1A 0x8003801A /end VAR_ADDRESS
 /end VAR_CHARACTERISTIC
 /begin VAR_CHARACTERISTIC U16TcmfIniRiseMotUPGrdtFrnt11 BrkCalVariantCriterion
  /begin VAR_ADDRESS 0x8002141C 0x8002481C 0x80027C1C 0x8002B01C 0x8002E41C 0x8003181C 0x80034C1C 0x8003801C /end VAR_ADDRESS
 /end VAR_CHARACTERISTIC
 /begin VAR_CHARACTERISTIC U16TcmfIniRiseMotUPGrdtFrnt12 BrkCalVariantCriterion
  /begin VAR_ADDRESS 0x8002141E 0x8002481E 0x80027C1E 0x8002B01E 0x8002E41E 0x8003181E 0x80034C1E 0x8003801E /end VAR_ADDRESS
 /end VAR_CHARACTERISTIC
 /begin VAR_CHARACTERISTIC U16TcmfIniRiseMotUPGrdtFrnt13 BrkCalVariantCriterion
  /begin VAR_ADDRESS 0x80021420 0x80024820 0x80027C20 0x8002B020 0x8002E420 0x80031820 0x80034C20 0x80038020 /end VAR_ADDRESS
 /end VAR_CHARACTERISTIC
 /begin VAR_CHARACTERISTIC U16TcmfIniRiseMotUPGrdtFrnt14 BrkCalVariantCriterion
  /begin VAR_ADDRESS 0x80021422 0x80024822 0x80027C22 0x8002B022 0x8002E422 0x80031822 0x80034C22 0x80038022 /end VAR_ADDRESS
 /end VAR_CHARACTERISTIC
 /begin VAR_CHARACTERISTIC U16TcmfIniRiseMotUPGrdtRe01 BrkCalVariantCriterion
  /begin VAR_ADDRESS 0x80021424 0x80024824 0x80027C24 0x8002B024 0x8002E424 0x80031824 0x80034C24 0x80038024 /end VAR_ADDRESS
 /end VAR_CHARACTERISTIC
 /begin VAR_CHARACTERISTIC U16TcmfIniRiseMotUPGrdtRe02 BrkCalVariantCriterion
  /begin VAR_ADDRESS 0x80021426 0x80024826 0x80027C26 0x8002B026 0x8002E426 0x80031826 0x80034C26 0x80038026 /end VAR_ADDRESS
 /end VAR_CHARACTERISTIC
 /begin VAR_CHARACTERISTIC U16TcmfIniRiseMotUPGrdtRe03 BrkCalVariantCriterion
  /begin VAR_ADDRESS 0x80021428 0x80024828 0x80027C28 0x8002B028 0x8002E428 0x80031828 0x80034C28 0x80038028 /end VAR_ADDRESS
 /end VAR_CHARACTERISTIC
 /begin VAR_CHARACTERISTIC U16TcmfIniRiseMotUPGrdtRe04 BrkCalVariantCriterion
  /begin VAR_ADDRESS 0x8002142A 0x8002482A 0x80027C2A 0x8002B02A 0x8002E42A 0x8003182A 0x80034C2A 0x8003802A /end VAR_ADDRESS
 /end VAR_CHARACTERISTIC
 /begin VAR_CHARACTERISTIC U16TcmfIniRiseMotUPGrdtRe05 BrkCalVariantCriterion
  /begin VAR_ADDRESS 0x8002142C 0x8002482C 0x80027C2C 0x8002B02C 0x8002E42C 0x8003182C 0x80034C2C 0x8003802C /end VAR_ADDRESS
 /end VAR_CHARACTERISTIC
 /begin VAR_CHARACTERISTIC U16TcmfIniRiseMotUPGrdtRe06 BrkCalVariantCriterion
  /begin VAR_ADDRESS 0x8002142E 0x8002482E 0x80027C2E 0x8002B02E 0x8002E42E 0x8003182E 0x80034C2E 0x8003802E /end VAR_ADDRESS
 /end VAR_CHARACTERISTIC
 /begin VAR_CHARACTERISTIC U16TcmfIniRiseMotUPGrdtRe07 BrkCalVariantCriterion
  /begin VAR_ADDRESS 0x80021430 0x80024830 0x80027C30 0x8002B030 0x8002E430 0x80031830 0x80034C30 0x80038030 /end VAR_ADDRESS
 /end VAR_CHARACTERISTIC
 /begin VAR_CHARACTERISTIC U16TcmfIniRiseMotUPGrdtRe08 BrkCalVariantCriterion
  /begin VAR_ADDRESS 0x80021432 0x80024832 0x80027C32 0x8002B032 0x8002E432 0x80031832 0x80034C32 0x80038032 /end VAR_ADDRESS
 /end VAR_CHARACTERISTIC
 /begin VAR_CHARACTERISTIC U16TcmfIniRiseMotUPGrdtRe09 BrkCalVariantCriterion
  /begin VAR_ADDRESS 0x80021434 0x80024834 0x80027C34 0x8002B034 0x8002E434 0x80031834 0x80034C34 0x80038034 /end VAR_ADDRESS
 /end VAR_CHARACTERISTIC
 /begin VAR_CHARACTERISTIC U16TcmfIniRiseMotUPGrdtRe10 BrkCalVariantCriterion
  /begin VAR_ADDRESS 0x80021436 0x80024836 0x80027C36 0x8002B036 0x8002E436 0x80031836 0x80034C36 0x80038036 /end VAR_ADDRESS
 /end VAR_CHARACTERISTIC
 /begin VAR_CHARACTERISTIC U16TcmfIniRiseMotUPGrdtRe11 BrkCalVariantCriterion
  /begin VAR_ADDRESS 0x80021438 0x80024838 0x80027C38 0x8002B038 0x8002E438 0x80031838 0x80034C38 0x80038038 /end VAR_ADDRESS
 /end VAR_CHARACTERISTIC
 /begin VAR_CHARACTERISTIC U16TcmfIniRiseMotUPGrdtRe12 BrkCalVariantCriterion
  /begin VAR_ADDRESS 0x8002143A 0x8002483A 0x80027C3A 0x8002B03A 0x8002E43A 0x8003183A 0x80034C3A 0x8003803A /end VAR_ADDRESS
 /end VAR_CHARACTERISTIC
 /begin VAR_CHARACTERISTIC U16TcmfIniRiseMotUPGrdtRe13 BrkCalVariantCriterion
  /begin VAR_ADDRESS 0x8002143C 0x8002483C 0x80027C3C 0x8002B03C 0x8002E43C 0x8003183C 0x80034C3C 0x8003803C /end VAR_ADDRESS
 /end VAR_CHARACTERISTIC
 /begin VAR_CHARACTERISTIC U16TcmfIniRiseMotUPGrdtRe14 BrkCalVariantCriterion
  /begin VAR_ADDRESS 0x8002143E 0x8002483E 0x80027C3E 0x8002B03E 0x8002E43E 0x8003183E 0x80034C3E 0x8003803E /end VAR_ADDRESS
 /end VAR_CHARACTERISTIC
 /begin VAR_CHARACTERISTIC U16TcmfPTcVlvCur01 BrkCalVariantCriterion
  /begin VAR_ADDRESS 0x80021390 0x80024790 0x80027B90 0x8002AF90 0x8002E390 0x80031790 0x80034B90 0x80037F90 /end VAR_ADDRESS
 /end VAR_CHARACTERISTIC
 /begin VAR_CHARACTERISTIC U16TcmfPTcVlvCur02 BrkCalVariantCriterion
  /begin VAR_ADDRESS 0x80021392 0x80024792 0x80027B92 0x8002AF92 0x8002E392 0x80031792 0x80034B92 0x80037F92 /end VAR_ADDRESS
 /end VAR_CHARACTERISTIC
 /begin VAR_CHARACTERISTIC U16TcmfPTcVlvCur03 BrkCalVariantCriterion
  /begin VAR_ADDRESS 0x80021394 0x80024794 0x80027B94 0x8002AF94 0x8002E394 0x80031794 0x80034B94 0x80037F94 /end VAR_ADDRESS
 /end VAR_CHARACTERISTIC
 /begin VAR_CHARACTERISTIC U16TcmfPTcVlvCur04 BrkCalVariantCriterion
  /begin VAR_ADDRESS 0x80021396 0x80024796 0x80027B96 0x8002AF96 0x8002E396 0x80031796 0x80034B96 0x80037F96 /end VAR_ADDRESS
 /end VAR_CHARACTERISTIC
 /begin VAR_CHARACTERISTIC U16TcmfPTcVlvCur05 BrkCalVariantCriterion
  /begin VAR_ADDRESS 0x80021398 0x80024798 0x80027B98 0x8002AF98 0x8002E398 0x80031798 0x80034B98 0x80037F98 /end VAR_ADDRESS
 /end VAR_CHARACTERISTIC
 /begin VAR_CHARACTERISTIC U16TcmfPTcVlvCur06 BrkCalVariantCriterion
  /begin VAR_ADDRESS 0x8002139A 0x8002479A 0x80027B9A 0x8002AF9A 0x8002E39A 0x8003179A 0x80034B9A 0x80037F9A /end VAR_ADDRESS
 /end VAR_CHARACTERISTIC
 /begin VAR_CHARACTERISTIC U16TcmfPTcVlvCur07 BrkCalVariantCriterion
  /begin VAR_ADDRESS 0x8002139C 0x8002479C 0x80027B9C 0x8002AF9C 0x8002E39C 0x8003179C 0x80034B9C 0x80037F9C /end VAR_ADDRESS
 /end VAR_CHARACTERISTIC
 /begin VAR_CHARACTERISTIC U16TcmfPTcVlvCur08 BrkCalVariantCriterion
  /begin VAR_ADDRESS 0x8002139E 0x8002479E 0x80027B9E 0x8002AF9E 0x8002E39E 0x8003179E 0x80034B9E 0x80037F9E /end VAR_ADDRESS
 /end VAR_CHARACTERISTIC
 /begin VAR_CHARACTERISTIC U16TcmfPTcVlvCur09 BrkCalVariantCriterion
  /begin VAR_ADDRESS 0x800213A0 0x800247A0 0x80027BA0 0x8002AFA0 0x8002E3A0 0x800317A0 0x80034BA0 0x80037FA0 /end VAR_ADDRESS
 /end VAR_CHARACTERISTIC
 /begin VAR_CHARACTERISTIC U16TcmfPTcVlvCur10 BrkCalVariantCriterion
  /begin VAR_ADDRESS 0x800213A2 0x800247A2 0x80027BA2 0x8002AFA2 0x8002E3A2 0x800317A2 0x80034BA2 0x80037FA2 /end VAR_ADDRESS
 /end VAR_CHARACTERISTIC
 /begin VAR_CHARACTERISTIC U16TcmfPTcVlvCur11 BrkCalVariantCriterion
  /begin VAR_ADDRESS 0x800213A4 0x800247A4 0x80027BA4 0x8002AFA4 0x8002E3A4 0x800317A4 0x80034BA4 0x80037FA4 /end VAR_ADDRESS
 /end VAR_CHARACTERISTIC
 /begin VAR_CHARACTERISTIC U16TcmfPTcVlvCur12 BrkCalVariantCriterion
  /begin VAR_ADDRESS 0x800213A6 0x800247A6 0x80027BA6 0x8002AFA6 0x8002E3A6 0x800317A6 0x80034BA6 0x80037FA6 /end VAR_ADDRESS
 /end VAR_CHARACTERISTIC
 /begin VAR_CHARACTERISTIC U16TcmfPTcVlvCur13 BrkCalVariantCriterion
  /begin VAR_ADDRESS 0x800213A8 0x800247A8 0x80027BA8 0x8002AFA8 0x8002E3A8 0x800317A8 0x80034BA8 0x80037FA8 /end VAR_ADDRESS
 /end VAR_CHARACTERISTIC
 /begin VAR_CHARACTERISTIC U16TcmfPTcVlvCur14 BrkCalVariantCriterion
  /begin VAR_ADDRESS 0x800213AA 0x800247AA 0x80027BAA 0x8002AFAA 0x8002E3AA 0x800317AA 0x80034BAA 0x80037FAA /end VAR_ADDRESS
 /end VAR_CHARACTERISTIC
 /begin VAR_CHARACTERISTIC U16TcmfPTcVlvCur15 BrkCalVariantCriterion
  /begin VAR_ADDRESS 0x800213AC 0x800247AC 0x80027BAC 0x8002AFAC 0x8002E3AC 0x800317AC 0x80034BAC 0x80037FAC /end VAR_ADDRESS
 /end VAR_CHARACTERISTIC
 /begin VAR_CHARACTERISTIC U16TcmfPTcVlvCur16 BrkCalVariantCriterion
  /begin VAR_ADDRESS 0x800213AE 0x800247AE 0x80027BAE 0x8002AFAE 0x8002E3AE 0x800317AE 0x80034BAE 0x80037FAE /end VAR_ADDRESS
 /end VAR_CHARACTERISTIC
 /begin VAR_CHARACTERISTIC U16TcmfPTcVlvCur17 BrkCalVariantCriterion
  /begin VAR_ADDRESS 0x800213B0 0x800247B0 0x80027BB0 0x8002AFB0 0x8002E3B0 0x800317B0 0x80034BB0 0x80037FB0 /end VAR_ADDRESS
 /end VAR_CHARACTERISTIC
 /begin VAR_CHARACTERISTIC U16TcmfPTcVlvCur18 BrkCalVariantCriterion
  /begin VAR_ADDRESS 0x800213B2 0x800247B2 0x80027BB2 0x8002AFB2 0x8002E3B2 0x800317B2 0x80034BB2 0x80037FB2 /end VAR_ADDRESS
 /end VAR_CHARACTERISTIC
 /begin VAR_CHARACTERISTIC U16TcmfPTcVlvCur19 BrkCalVariantCriterion
  /begin VAR_ADDRESS 0x800213B4 0x800247B4 0x80027BB4 0x8002AFB4 0x8002E3B4 0x800317B4 0x80034BB4 0x80037FB4 /end VAR_ADDRESS
 /end VAR_CHARACTERISTIC
 /begin VAR_CHARACTERISTIC U16TcmfPTcVlvCur20 BrkCalVariantCriterion
  /begin VAR_ADDRESS 0x800213B6 0x800247B6 0x80027BB6 0x8002AFB6 0x8002E3B6 0x800317B6 0x80034BB6 0x80037FB6 /end VAR_ADDRESS
 /end VAR_CHARACTERISTIC
 /begin VAR_CHARACTERISTIC U16TcmfRiseIncTcVlvCurPGrdt1 BrkCalVariantCriterion
  /begin VAR_ADDRESS 0x8002134C 0x8002474C 0x80027B4C 0x8002AF4C 0x8002E34C 0x8003174C 0x80034B4C 0x80037F4C /end VAR_ADDRESS
 /end VAR_CHARACTERISTIC
 /begin VAR_CHARACTERISTIC U16TcmfRiseIncTcVlvCurPGrdt2 BrkCalVariantCriterion
  /begin VAR_ADDRESS 0x8002134E 0x8002474E 0x80027B4E 0x8002AF4E 0x8002E34E 0x8003174E 0x80034B4E 0x80037F4E /end VAR_ADDRESS
 /end VAR_CHARACTERISTIC
 /begin VAR_CHARACTERISTIC U16TcmfRiseIncTcVlvCurPGrdt3 BrkCalVariantCriterion
  /begin VAR_ADDRESS 0x80021350 0x80024750 0x80027B50 0x8002AF50 0x8002E350 0x80031750 0x80034B50 0x80037F50 /end VAR_ADDRESS
 /end VAR_CHARACTERISTIC
 /begin VAR_CHARACTERISTIC U16TcmfRiseMotUPGrdtFrnt01 BrkCalVariantCriterion
  /begin VAR_ADDRESS 0x80021440 0x80024840 0x80027C40 0x8002B040 0x8002E440 0x80031840 0x80034C40 0x80038040 /end VAR_ADDRESS
 /end VAR_CHARACTERISTIC
 /begin VAR_CHARACTERISTIC U16TcmfRiseMotUPGrdtFrnt02 BrkCalVariantCriterion
  /begin VAR_ADDRESS 0x80021442 0x80024842 0x80027C42 0x8002B042 0x8002E442 0x80031842 0x80034C42 0x80038042 /end VAR_ADDRESS
 /end VAR_CHARACTERISTIC
 /begin VAR_CHARACTERISTIC U16TcmfRiseMotUPGrdtFrnt03 BrkCalVariantCriterion
  /begin VAR_ADDRESS 0x80021444 0x80024844 0x80027C44 0x8002B044 0x8002E444 0x80031844 0x80034C44 0x80038044 /end VAR_ADDRESS
 /end VAR_CHARACTERISTIC
 /begin VAR_CHARACTERISTIC U16TcmfRiseMotUPGrdtFrnt04 BrkCalVariantCriterion
  /begin VAR_ADDRESS 0x80021446 0x80024846 0x80027C46 0x8002B046 0x8002E446 0x80031846 0x80034C46 0x80038046 /end VAR_ADDRESS
 /end VAR_CHARACTERISTIC
 /begin VAR_CHARACTERISTIC U16TcmfRiseMotUPGrdtFrnt05 BrkCalVariantCriterion
  /begin VAR_ADDRESS 0x80021448 0x80024848 0x80027C48 0x8002B048 0x8002E448 0x80031848 0x80034C48 0x80038048 /end VAR_ADDRESS
 /end VAR_CHARACTERISTIC
 /begin VAR_CHARACTERISTIC U16TcmfRiseMotUPGrdtFrnt06 BrkCalVariantCriterion
  /begin VAR_ADDRESS 0x8002144A 0x8002484A 0x80027C4A 0x8002B04A 0x8002E44A 0x8003184A 0x80034C4A 0x8003804A /end VAR_ADDRESS
 /end VAR_CHARACTERISTIC
 /begin VAR_CHARACTERISTIC U16TcmfRiseMotUPGrdtFrnt07 BrkCalVariantCriterion
  /begin VAR_ADDRESS 0x8002144C 0x8002484C 0x80027C4C 0x8002B04C 0x8002E44C 0x8003184C 0x80034C4C 0x8003804C /end VAR_ADDRESS
 /end VAR_CHARACTERISTIC
 /begin VAR_CHARACTERISTIC U16TcmfRiseMotUPGrdtFrnt08 BrkCalVariantCriterion
  /begin VAR_ADDRESS 0x8002144E 0x8002484E 0x80027C4E 0x8002B04E 0x8002E44E 0x8003184E 0x80034C4E 0x8003804E /end VAR_ADDRESS
 /end VAR_CHARACTERISTIC
 /begin VAR_CHARACTERISTIC U16TcmfRiseMotUPGrdtFrnt09 BrkCalVariantCriterion
  /begin VAR_ADDRESS 0x80021450 0x80024850 0x80027C50 0x8002B050 0x8002E450 0x80031850 0x80034C50 0x80038050 /end VAR_ADDRESS
 /end VAR_CHARACTERISTIC
 /begin VAR_CHARACTERISTIC U16TcmfRiseMotUPGrdtFrnt10 BrkCalVariantCriterion
  /begin VAR_ADDRESS 0x80021452 0x80024852 0x80027C52 0x8002B052 0x8002E452 0x80031852 0x80034C52 0x80038052 /end VAR_ADDRESS
 /end VAR_CHARACTERISTIC
 /begin VAR_CHARACTERISTIC U16TcmfRiseMotUPGrdtFrnt11 BrkCalVariantCriterion
  /begin VAR_ADDRESS 0x80021454 0x80024854 0x80027C54 0x8002B054 0x8002E454 0x80031854 0x80034C54 0x80038054 /end VAR_ADDRESS
 /end VAR_CHARACTERISTIC
 /begin VAR_CHARACTERISTIC U16TcmfRiseMotUPGrdtFrnt12 BrkCalVariantCriterion
  /begin VAR_ADDRESS 0x80021456 0x80024856 0x80027C56 0x8002B056 0x8002E456 0x80031856 0x80034C56 0x80038056 /end VAR_ADDRESS
 /end VAR_CHARACTERISTIC
 /begin VAR_CHARACTERISTIC U16TcmfRiseMotUPGrdtFrnt13 BrkCalVariantCriterion
  /begin VAR_ADDRESS 0x80021458 0x80024858 0x80027C58 0x8002B058 0x8002E458 0x80031858 0x80034C58 0x80038058 /end VAR_ADDRESS
 /end VAR_CHARACTERISTIC
 /begin VAR_CHARACTERISTIC U16TcmfRiseMotUPGrdtFrnt14 BrkCalVariantCriterion
  /begin VAR_ADDRESS 0x8002145A 0x8002485A 0x80027C5A 0x8002B05A 0x8002E45A 0x8003185A 0x80034C5A 0x8003805A /end VAR_ADDRESS
 /end VAR_CHARACTERISTIC
 /begin VAR_CHARACTERISTIC U16TcmfRiseMotUPGrdtRe01 BrkCalVariantCriterion
  /begin VAR_ADDRESS 0x8002145C 0x8002485C 0x80027C5C 0x8002B05C 0x8002E45C 0x8003185C 0x80034C5C 0x8003805C /end VAR_ADDRESS
 /end VAR_CHARACTERISTIC
 /begin VAR_CHARACTERISTIC U16TcmfRiseMotUPGrdtRe02 BrkCalVariantCriterion
  /begin VAR_ADDRESS 0x8002145E 0x8002485E 0x80027C5E 0x8002B05E 0x8002E45E 0x8003185E 0x80034C5E 0x8003805E /end VAR_ADDRESS
 /end VAR_CHARACTERISTIC
 /begin VAR_CHARACTERISTIC U16TcmfRiseMotUPGrdtRe03 BrkCalVariantCriterion
  /begin VAR_ADDRESS 0x80021460 0x80024860 0x80027C60 0x8002B060 0x8002E460 0x80031860 0x80034C60 0x80038060 /end VAR_ADDRESS
 /end VAR_CHARACTERISTIC
 /begin VAR_CHARACTERISTIC U16TcmfRiseMotUPGrdtRe04 BrkCalVariantCriterion
  /begin VAR_ADDRESS 0x80021462 0x80024862 0x80027C62 0x8002B062 0x8002E462 0x80031862 0x80034C62 0x80038062 /end VAR_ADDRESS
 /end VAR_CHARACTERISTIC
 /begin VAR_CHARACTERISTIC U16TcmfRiseMotUPGrdtRe05 BrkCalVariantCriterion
  /begin VAR_ADDRESS 0x80021464 0x80024864 0x80027C64 0x8002B064 0x8002E464 0x80031864 0x80034C64 0x80038064 /end VAR_ADDRESS
 /end VAR_CHARACTERISTIC
 /begin VAR_CHARACTERISTIC U16TcmfRiseMotUPGrdtRe06 BrkCalVariantCriterion
  /begin VAR_ADDRESS 0x80021466 0x80024866 0x80027C66 0x8002B066 0x8002E466 0x80031866 0x80034C66 0x80038066 /end VAR_ADDRESS
 /end VAR_CHARACTERISTIC
 /begin VAR_CHARACTERISTIC U16TcmfRiseMotUPGrdtRe07 BrkCalVariantCriterion
  /begin VAR_ADDRESS 0x80021468 0x80024868 0x80027C68 0x8002B068 0x8002E468 0x80031868 0x80034C68 0x80038068 /end VAR_ADDRESS
 /end VAR_CHARACTERISTIC
 /begin VAR_CHARACTERISTIC U16TcmfRiseMotUPGrdtRe08 BrkCalVariantCriterion
  /begin VAR_ADDRESS 0x8002146A 0x8002486A 0x80027C6A 0x8002B06A 0x8002E46A 0x8003186A 0x80034C6A 0x8003806A /end VAR_ADDRESS
 /end VAR_CHARACTERISTIC
 /begin VAR_CHARACTERISTIC U16TcmfRiseMotUPGrdtRe09 BrkCalVariantCriterion
  /begin VAR_ADDRESS 0x8002146C 0x8002486C 0x80027C6C 0x8002B06C 0x8002E46C 0x8003186C 0x80034C6C 0x8003806C /end VAR_ADDRESS
 /end VAR_CHARACTERISTIC
 /begin VAR_CHARACTERISTIC U16TcmfRiseMotUPGrdtRe10 BrkCalVariantCriterion
  /begin VAR_ADDRESS 0x8002146E 0x8002486E 0x80027C6E 0x8002B06E 0x8002E46E 0x8003186E 0x80034C6E 0x8003806E /end VAR_ADDRESS
 /end VAR_CHARACTERISTIC
 /begin VAR_CHARACTERISTIC U16TcmfRiseMotUPGrdtRe11 BrkCalVariantCriterion
  /begin VAR_ADDRESS 0x80021470 0x80024870 0x80027C70 0x8002B070 0x8002E470 0x80031870 0x80034C70 0x80038070 /end VAR_ADDRESS
 /end VAR_CHARACTERISTIC
 /begin VAR_CHARACTERISTIC U16TcmfRiseMotUPGrdtRe12 BrkCalVariantCriterion
  /begin VAR_ADDRESS 0x80021472 0x80024872 0x80027C72 0x8002B072 0x8002E472 0x80031872 0x80034C72 0x80038072 /end VAR_ADDRESS
 /end VAR_CHARACTERISTIC
 /begin VAR_CHARACTERISTIC U16TcmfRiseMotUPGrdtRe13 BrkCalVariantCriterion
  /begin VAR_ADDRESS 0x80021474 0x80024874 0x80027C74 0x8002B074 0x8002E474 0x80031874 0x80034C74 0x80038074 /end VAR_ADDRESS
 /end VAR_CHARACTERISTIC
 /begin VAR_CHARACTERISTIC U16TcmfRiseMotUPGrdtRe14 BrkCalVariantCriterion
  /begin VAR_ADDRESS 0x80021476 0x80024876 0x80027C76 0x8002B076 0x8002E476 0x80031876 0x80034C76 0x80038076 /end VAR_ADDRESS
 /end VAR_CHARACTERISTIC
 /begin VAR_CHARACTERISTIC U16TcmfRisePatCur BrkCalVariantCriterion
  /begin VAR_ADDRESS 0x8002134A 0x8002474A 0x80027B4A 0x8002AF4A 0x8002E34A 0x8003174A 0x80034B4A 0x80037F4A /end VAR_ADDRESS
 /end VAR_CHARACTERISTIC
 /begin VAR_CHARACTERISTIC U16TcmfRisePatPGrdtFrnt1 BrkCalVariantCriterion
  /begin VAR_ADDRESS 0x80021332 0x80024732 0x80027B32 0x8002AF32 0x8002E332 0x80031732 0x80034B32 0x80037F32 /end VAR_ADDRESS
 /end VAR_CHARACTERISTIC
 /begin VAR_CHARACTERISTIC U16TcmfRisePatPGrdtFrnt2 BrkCalVariantCriterion
  /begin VAR_ADDRESS 0x80021334 0x80024734 0x80027B34 0x8002AF34 0x8002E334 0x80031734 0x80034B34 0x80037F34 /end VAR_ADDRESS
 /end VAR_CHARACTERISTIC
 /begin VAR_CHARACTERISTIC U16TcmfRisePatPGrdtFrnt3 BrkCalVariantCriterion
  /begin VAR_ADDRESS 0x80021336 0x80024736 0x80027B36 0x8002AF36 0x8002E336 0x80031736 0x80034B36 0x80037F36 /end VAR_ADDRESS
 /end VAR_CHARACTERISTIC
 /begin VAR_CHARACTERISTIC U16TcmfRisePatPGrdtRe1 BrkCalVariantCriterion
  /begin VAR_ADDRESS 0x8002133E 0x8002473E 0x80027B3E 0x8002AF3E 0x8002E33E 0x8003173E 0x80034B3E 0x80037F3E /end VAR_ADDRESS
 /end VAR_CHARACTERISTIC
 /begin VAR_CHARACTERISTIC U16TcmfRisePatPGrdtRe2 BrkCalVariantCriterion
  /begin VAR_ADDRESS 0x80021340 0x80024740 0x80027B40 0x8002AF40 0x8002E340 0x80031740 0x80034B40 0x80037F40 /end VAR_ADDRESS
 /end VAR_CHARACTERISTIC
 /begin VAR_CHARACTERISTIC U16TcmfRisePatPGrdtRe3 BrkCalVariantCriterion
  /begin VAR_ADDRESS 0x80021342 0x80024742 0x80027B42 0x8002AF42 0x8002E342 0x80031742 0x80034B42 0x80037F42 /end VAR_ADDRESS
 /end VAR_CHARACTERISTIC
 /begin VAR_CHARACTERISTIC U16TcmfTcVlvCurP01 BrkCalVariantCriterion
  /begin VAR_ADDRESS 0x80021368 0x80024768 0x80027B68 0x8002AF68 0x8002E368 0x80031768 0x80034B68 0x80037F68 /end VAR_ADDRESS
 /end VAR_CHARACTERISTIC
 /begin VAR_CHARACTERISTIC U16TcmfTcVlvCurP02 BrkCalVariantCriterion
  /begin VAR_ADDRESS 0x8002136A 0x8002476A 0x80027B6A 0x8002AF6A 0x8002E36A 0x8003176A 0x80034B6A 0x80037F6A /end VAR_ADDRESS
 /end VAR_CHARACTERISTIC
 /begin VAR_CHARACTERISTIC U16TcmfTcVlvCurP03 BrkCalVariantCriterion
  /begin VAR_ADDRESS 0x8002136C 0x8002476C 0x80027B6C 0x8002AF6C 0x8002E36C 0x8003176C 0x80034B6C 0x80037F6C /end VAR_ADDRESS
 /end VAR_CHARACTERISTIC
 /begin VAR_CHARACTERISTIC U16TcmfTcVlvCurP04 BrkCalVariantCriterion
  /begin VAR_ADDRESS 0x8002136E 0x8002476E 0x80027B6E 0x8002AF6E 0x8002E36E 0x8003176E 0x80034B6E 0x80037F6E /end VAR_ADDRESS
 /end VAR_CHARACTERISTIC
 /begin VAR_CHARACTERISTIC U16TcmfTcVlvCurP05 BrkCalVariantCriterion
  /begin VAR_ADDRESS 0x80021370 0x80024770 0x80027B70 0x8002AF70 0x8002E370 0x80031770 0x80034B70 0x80037F70 /end VAR_ADDRESS
 /end VAR_CHARACTERISTIC
 /begin VAR_CHARACTERISTIC U16TcmfTcVlvCurP06 BrkCalVariantCriterion
  /begin VAR_ADDRESS 0x80021372 0x80024772 0x80027B72 0x8002AF72 0x8002E372 0x80031772 0x80034B72 0x80037F72 /end VAR_ADDRESS
 /end VAR_CHARACTERISTIC
 /begin VAR_CHARACTERISTIC U16TcmfTcVlvCurP07 BrkCalVariantCriterion
  /begin VAR_ADDRESS 0x80021374 0x80024774 0x80027B74 0x8002AF74 0x8002E374 0x80031774 0x80034B74 0x80037F74 /end VAR_ADDRESS
 /end VAR_CHARACTERISTIC
 /begin VAR_CHARACTERISTIC U16TcmfTcVlvCurP08 BrkCalVariantCriterion
  /begin VAR_ADDRESS 0x80021376 0x80024776 0x80027B76 0x8002AF76 0x8002E376 0x80031776 0x80034B76 0x80037F76 /end VAR_ADDRESS
 /end VAR_CHARACTERISTIC
 /begin VAR_CHARACTERISTIC U16TcmfTcVlvCurP09 BrkCalVariantCriterion
  /begin VAR_ADDRESS 0x80021378 0x80024778 0x80027B78 0x8002AF78 0x8002E378 0x80031778 0x80034B78 0x80037F78 /end VAR_ADDRESS
 /end VAR_CHARACTERISTIC
 /begin VAR_CHARACTERISTIC U16TcmfTcVlvCurP10 BrkCalVariantCriterion
  /begin VAR_ADDRESS 0x8002137A 0x8002477A 0x80027B7A 0x8002AF7A 0x8002E37A 0x8003177A 0x80034B7A 0x80037F7A /end VAR_ADDRESS
 /end VAR_CHARACTERISTIC
 /begin VAR_CHARACTERISTIC U16TcmfTcVlvCurP11 BrkCalVariantCriterion
  /begin VAR_ADDRESS 0x8002137C 0x8002477C 0x80027B7C 0x8002AF7C 0x8002E37C 0x8003177C 0x80034B7C 0x80037F7C /end VAR_ADDRESS
 /end VAR_CHARACTERISTIC
 /begin VAR_CHARACTERISTIC U16TcmfTcVlvCurP12 BrkCalVariantCriterion
  /begin VAR_ADDRESS 0x8002137E 0x8002477E 0x80027B7E 0x8002AF7E 0x8002E37E 0x8003177E 0x80034B7E 0x80037F7E /end VAR_ADDRESS
 /end VAR_CHARACTERISTIC
 /begin VAR_CHARACTERISTIC U16TcmfTcVlvCurP13 BrkCalVariantCriterion
  /begin VAR_ADDRESS 0x80021380 0x80024780 0x80027B80 0x8002AF80 0x8002E380 0x80031780 0x80034B80 0x80037F80 /end VAR_ADDRESS
 /end VAR_CHARACTERISTIC
 /begin VAR_CHARACTERISTIC U16TcmfTcVlvCurP14 BrkCalVariantCriterion
  /begin VAR_ADDRESS 0x80021382 0x80024782 0x80027B82 0x8002AF82 0x8002E382 0x80031782 0x80034B82 0x80037F82 /end VAR_ADDRESS
 /end VAR_CHARACTERISTIC
 /begin VAR_CHARACTERISTIC U16TcmfTcVlvCurP15 BrkCalVariantCriterion
  /begin VAR_ADDRESS 0x80021384 0x80024784 0x80027B84 0x8002AF84 0x8002E384 0x80031784 0x80034B84 0x80037F84 /end VAR_ADDRESS
 /end VAR_CHARACTERISTIC
 /begin VAR_CHARACTERISTIC U16TcmfTcVlvCurP16 BrkCalVariantCriterion
  /begin VAR_ADDRESS 0x80021386 0x80024786 0x80027B86 0x8002AF86 0x8002E386 0x80031786 0x80034B86 0x80037F86 /end VAR_ADDRESS
 /end VAR_CHARACTERISTIC
 /begin VAR_CHARACTERISTIC U16TcmfTcVlvCurP17 BrkCalVariantCriterion
  /begin VAR_ADDRESS 0x80021388 0x80024788 0x80027B88 0x8002AF88 0x8002E388 0x80031788 0x80034B88 0x80037F88 /end VAR_ADDRESS
 /end VAR_CHARACTERISTIC
 /begin VAR_CHARACTERISTIC U16TcmfTcVlvCurP18 BrkCalVariantCriterion
  /begin VAR_ADDRESS 0x8002138A 0x8002478A 0x80027B8A 0x8002AF8A 0x8002E38A 0x8003178A 0x80034B8A 0x80037F8A /end VAR_ADDRESS
 /end VAR_CHARACTERISTIC
 /begin VAR_CHARACTERISTIC U16TcmfTcVlvCurP19 BrkCalVariantCriterion
  /begin VAR_ADDRESS 0x8002138C 0x8002478C 0x80027B8C 0x8002AF8C 0x8002E38C 0x8003178C 0x80034B8C 0x80037F8C /end VAR_ADDRESS
 /end VAR_CHARACTERISTIC
 /begin VAR_CHARACTERISTIC U16TcmfTcVlvCurP20 BrkCalVariantCriterion
  /begin VAR_ADDRESS 0x8002138E 0x8002478E 0x80027B8E 0x8002AF8E 0x8002E38E 0x8003178E 0x80034B8E 0x80037F8E /end VAR_ADDRESS
 /end VAR_CHARACTERISTIC
 /begin VAR_CHARACTERISTIC U16TireCircumferenceFrnt BrkCalVariantCriterion
  /begin VAR_ADDRESS 0x80020018 0x80023418 0x80026818 0x80029C18 0x8002D018 0x80030418 0x80033818 0x80036C18 /end VAR_ADDRESS
 /end VAR_CHARACTERISTIC
 /begin VAR_CHARACTERISTIC U16TireCircumferenceRe BrkCalVariantCriterion
  /begin VAR_ADDRESS 0x8002001A 0x8002341A 0x8002681A 0x80029C1A 0x8002D01A 0x8003041A 0x8003381A 0x80036C1A /end VAR_ADDRESS
 /end VAR_CHARACTERISTIC
 /begin VAR_CHARACTERISTIC U16TqToPGainFrnt BrkCalVariantCriterion
  /begin VAR_ADDRESS 0x80020010 0x80023410 0x80026810 0x80029C10 0x8002D010 0x80030410 0x80033810 0x80036C10 /end VAR_ADDRESS
 /end VAR_CHARACTERISTIC
 /begin VAR_CHARACTERISTIC U16TqToPGainRe BrkCalVariantCriterion
  /begin VAR_ADDRESS 0x80020012 0x80023412 0x80026812 0x80029C12 0x8002D012 0x80030412 0x80033812 0x80036C12 /end VAR_ADDRESS
 /end VAR_CHARACTERISTIC
 /begin VAR_CHARACTERISTIC U16TrackWidthFrnt BrkCalVariantCriterion
  /begin VAR_ADDRESS 0x80020014 0x80023414 0x80026814 0x80029C14 0x8002D014 0x80030414 0x80033814 0x80036C14 /end VAR_ADDRESS
 /end VAR_CHARACTERISTIC
 /begin VAR_CHARACTERISTIC U16TrackWidthRe BrkCalVariantCriterion
  /begin VAR_ADDRESS 0x80020016 0x80023416 0x80026816 0x80029C16 0x8002D016 0x80030416 0x80033816 0x80036C16 /end VAR_ADDRESS
 /end VAR_CHARACTERISTIC
 /begin VAR_CHARACTERISTIC U16VddUMotU1 BrkCalVariantCriterion
  /begin VAR_ADDRESS 0x80021488 0x80024888 0x80027C88 0x8002B088 0x8002E488 0x80031888 0x80034C88 0x80038088 /end VAR_ADDRESS
 /end VAR_CHARACTERISTIC
 /begin VAR_CHARACTERISTIC U16VddUMotU2 BrkCalVariantCriterion
  /begin VAR_ADDRESS 0x8002148A 0x8002488A 0x80027C8A 0x8002B08A 0x8002E48A 0x8003188A 0x80034C8A 0x8003808A /end VAR_ADDRESS
 /end VAR_CHARACTERISTIC
 /begin VAR_CHARACTERISTIC U16VehSpdMotUAbs BrkCalVariantCriterion
  /begin VAR_ADDRESS 0x800213F8 0x800247F8 0x80027BF8 0x8002AFF8 0x8002E3F8 0x800317F8 0x80034BF8 0x80037FF8 /end VAR_ADDRESS
 /end VAR_CHARACTERISTIC
 /begin VAR_CHARACTERISTIC U16WhlTiStampResl BrkCalVariantCriterion
  /begin VAR_ADDRESS 0x8002001E 0x8002341E 0x8002681E 0x80029C1E 0x8002D01E 0x8003041E 0x8003381E 0x80036C1E /end VAR_ADDRESS
 /end VAR_CHARACTERISTIC
 /begin VAR_CHARACTERISTIC U16WslcNo1VlvDutyMax BrkCalVariantCriterion
  /begin VAR_ADDRESS 0x80021266 0x80024666 0x80027A66 0x8002AE66 0x8002E266 0x80031666 0x80034A66 0x80037E66 /end VAR_ADDRESS
 /end VAR_CHARACTERISTIC
 /begin VAR_CHARACTERISTIC U16_ACC_BRK_INIT_CTRL_TIME BrkCalVariantCriterion
  /begin VAR_ADDRESS 0x80021036 0x80024436 0x80027836 0x8002AC36 0x8002E036 0x80031436 0x80034836 0x80037C36 /end VAR_ADDRESS
 /end VAR_CHARACTERISTIC
 /begin VAR_CHARACTERISTIC U16_ACC_BRK_TQ_GRDT_MAX BrkCalVariantCriterion
  /begin VAR_ADDRESS 0x80021044 0x80024444 0x80027844 0x8002AC44 0x8002E044 0x80031444 0x80034844 0x80037C44 /end VAR_ADDRESS
 /end VAR_CHARACTERISTIC
 /begin VAR_CHARACTERISTIC U16_ACC_BRK_TQ_RATE_1 BrkCalVariantCriterion
  /begin VAR_ADDRESS 0x80021038 0x80024438 0x80027838 0x8002AC38 0x8002E038 0x80031438 0x80034838 0x80037C38 /end VAR_ADDRESS
 /end VAR_CHARACTERISTIC
 /begin VAR_CHARACTERISTIC U16_ACC_BRK_TQ_RATE_2 BrkCalVariantCriterion
  /begin VAR_ADDRESS 0x8002103A 0x8002443A 0x8002783A 0x8002AC3A 0x8002E03A 0x8003143A 0x8003483A 0x80037C3A /end VAR_ADDRESS
 /end VAR_CHARACTERISTIC
 /begin VAR_CHARACTERISTIC U16_ACC_BRK_TQ_RATE_TIME_1 BrkCalVariantCriterion
  /begin VAR_ADDRESS 0x8002103C 0x8002443C 0x8002783C 0x8002AC3C 0x8002E03C 0x8003143C 0x8003483C 0x80037C3C /end VAR_ADDRESS
 /end VAR_CHARACTERISTIC
 /begin VAR_CHARACTERISTIC U16_ACC_BRK_TQ_RATE_TIME_2 BrkCalVariantCriterion
  /begin VAR_ADDRESS 0x8002103E 0x8002443E 0x8002783E 0x8002AC3E 0x8002E03E 0x8003143E 0x8003483E 0x80037C3E /end VAR_ADDRESS
 /end VAR_CHARACTERISTIC
 /begin VAR_CHARACTERISTIC U16_ACC_INIT_ADD_BRK_TQ_GRDT_MAX BrkCalVariantCriterion
  /begin VAR_ADDRESS 0x80021042 0x80024442 0x80027842 0x8002AC42 0x8002E042 0x80031442 0x80034842 0x80037C42 /end VAR_ADDRESS
 /end VAR_CHARACTERISTIC
 /begin VAR_CHARACTERISTIC U16_ACC_INIT_ADD_BRK_TQ_GRDT_MIN BrkCalVariantCriterion
  /begin VAR_ADDRESS 0x80021040 0x80024440 0x80027840 0x8002AC40 0x8002E040 0x80031440 0x80034840 0x80037C40 /end VAR_ADDRESS
 /end VAR_CHARACTERISTIC
 /begin VAR_CHARACTERISTIC U16_ACC_I_ERROR_LEVEL_H EngCalVariantCriterion
  /begin VAR_ADDRESS 0x8003A8FE 0x8003B6FE 0x8003C4FE 0x8003D2FE 0x8003E0FE 0x8003EEFE 0x8003FCFE 0x80040AFE 0x800418FE 0x800426FE 0x800434FE 0x800442FE 0x800450FE 0x80045EFE 0x80046CFE 0x80047AFE 0x800488FE 0x800496FE 0x8004A4FE 0x8004B2FE 0x8004C0FE 0x8004CEFE 0x8004DCFE 0x8004EAFE /end VAR_ADDRESS
 /end VAR_CHARACTERISTIC
 /begin VAR_CHARACTERISTIC U16_ACC_I_ERROR_LEVEL_S EngCalVariantCriterion
  /begin VAR_ADDRESS 0x8003A900 0x8003B700 0x8003C500 0x8003D300 0x8003E100 0x8003EF00 0x8003FD00 0x80040B00 0x80041900 0x80042700 0x80043500 0x80044300 0x80045100 0x80045F00 0x80046D00 0x80047B00 0x80048900 0x80049700 0x8004A500 0x8004B300 0x8004C100 0x8004CF00 0x8004DD00 0x8004EB00 /end VAR_ADDRESS
 /end VAR_CHARACTERISTIC
 /begin VAR_CHARACTERISTIC U16_AEB_BRK_INIT_CTRL_TIME BrkCalVariantCriterion
  /begin VAR_ADDRESS 0x80021054 0x80024454 0x80027854 0x8002AC54 0x8002E054 0x80031454 0x80034854 0x80037C54 /end VAR_ADDRESS
 /end VAR_CHARACTERISTIC
 /begin VAR_CHARACTERISTIC U16_AEB_BRK_TQ_GRDT_MAX BrkCalVariantCriterion
  /begin VAR_ADDRESS 0x8002105A 0x8002445A 0x8002785A 0x8002AC5A 0x8002E05A 0x8003145A 0x8003485A 0x80037C5A /end VAR_ADDRESS
 /end VAR_CHARACTERISTIC
 /begin VAR_CHARACTERISTIC U16_AEB_INIT_ADD_BRK_TQ_GRDT_MAX BrkCalVariantCriterion
  /begin VAR_ADDRESS 0x80021056 0x80024456 0x80027856 0x8002AC56 0x8002E056 0x80031456 0x80034856 0x80037C56 /end VAR_ADDRESS
 /end VAR_CHARACTERISTIC
 /begin VAR_CHARACTERISTIC U16_AEB_INIT_ADD_BRK_TQ_GRDT_MIN BrkCalVariantCriterion
  /begin VAR_ADDRESS 0x80021058 0x80024458 0x80027858 0x8002AC58 0x8002E058 0x80031458 0x80034858 0x80037C58 /end VAR_ADDRESS
 /end VAR_CHARACTERISTIC
 /begin VAR_CHARACTERISTIC U16_DPB_CTRL_PERIOD_MAX BrkCalVariantCriterion
  /begin VAR_ADDRESS 0x8002106C 0x8002446C 0x8002786C 0x8002AC6C 0x8002E06C 0x8003146C 0x8003486C 0x80037C6C /end VAR_ADDRESS
 /end VAR_CHARACTERISTIC
 /begin VAR_CHARACTERISTIC U16_DPB_CTRL_PERIOD_MAX_A_ABS BrkCalVariantCriterion
  /begin VAR_ADDRESS 0x80021070 0x80024470 0x80027870 0x8002AC70 0x8002E070 0x80031470 0x80034870 0x80037C70 /end VAR_ADDRESS
 /end VAR_CHARACTERISTIC
 /begin VAR_CHARACTERISTIC U16_DPB_CTRL_PERIOD_MIN BrkCalVariantCriterion
  /begin VAR_ADDRESS 0x8002106E 0x8002446E 0x8002786E 0x8002AC6E 0x8002E06E 0x8003146E 0x8003486E 0x80037C6E /end VAR_ADDRESS
 /end VAR_CHARACTERISTIC
 /begin VAR_CHARACTERISTIC U16_DPB_CTRL_PERIOD_MIN_A_ABS BrkCalVariantCriterion
  /begin VAR_ADDRESS 0x80021072 0x80024472 0x80027872 0x8002AC72 0x8002E072 0x80031472 0x80034872 0x80037C72 /end VAR_ADDRESS
 /end VAR_CHARACTERISTIC
 /begin VAR_CHARACTERISTIC U16_DPB_FF_CTRL_RISE_STEP BrkCalVariantCriterion
  /begin VAR_ADDRESS 0x80021068 0x80024468 0x80027868 0x8002AC68 0x8002E068 0x80031468 0x80034868 0x80037C68 /end VAR_ADDRESS
 /end VAR_CHARACTERISTIC
 /begin VAR_CHARACTERISTIC U16_DPB_FF_MAX_TIME BrkCalVariantCriterion
  /begin VAR_ADDRESS 0x80021088 0x80024488 0x80027888 0x8002AC88 0x8002E088 0x80031488 0x80034888 0x80037C88 /end VAR_ADDRESS
 /end VAR_CHARACTERISTIC
 /begin VAR_CHARACTERISTIC U16_DPB_FF_TQ_GRD_INIT_TIME BrkCalVariantCriterion
  /begin VAR_ADDRESS 0x80021086 0x80024486 0x80027886 0x8002AC86 0x8002E086 0x80031486 0x80034886 0x80037C86 /end VAR_ADDRESS
 /end VAR_CHARACTERISTIC
 /begin VAR_CHARACTERISTIC U16_DPB_SMOOTHCLOSING_CTRL_TIME BrkCalVariantCriterion
  /begin VAR_ADDRESS 0x8002106A 0x8002446A 0x8002786A 0x8002AC6A 0x8002E06A 0x8003146A 0x8003486A 0x80037C6A /end VAR_ADDRESS
 /end VAR_CHARACTERISTIC
 /begin VAR_CHARACTERISTIC U16_SIGPROCR_AX_OFFSET_CHECK_ENG_DRAG_1 EngCalVariantCriterion
  /begin VAR_ADDRESS 0x8003A032 0x8003AE32 0x8003BC32 0x8003CA32 0x8003D832 0x8003E632 0x8003F432 0x80040232 0x80041032 0x80041E32 0x80042C32 0x80043A32 0x80044832 0x80045632 0x80046432 0x80047232 0x80048032 0x80048E32 0x80049C32 0x8004AA32 0x8004B832 0x8004C632 0x8004D432 0x8004E232 /end VAR_ADDRESS
 /end VAR_CHARACTERISTIC
 /begin VAR_CHARACTERISTIC U16_VLC_DISK_TEMP_ERROR_RESET_THRES EngCalVariantCriterion
  /begin VAR_ADDRESS 0x8003A8AC 0x8003B6AC 0x8003C4AC 0x8003D2AC 0x8003E0AC 0x8003EEAC 0x8003FCAC 0x80040AAC 0x800418AC 0x800426AC 0x800434AC 0x800442AC 0x800450AC 0x80045EAC 0x80046CAC 0x80047AAC 0x800488AC 0x800496AC 0x8004A4AC 0x8004B2AC 0x8004C0AC 0x8004CEAC 0x8004DCAC 0x8004EAAC /end VAR_ADDRESS
 /end VAR_CHARACTERISTIC
 /begin VAR_CHARACTERISTIC U16_VLC_DISK_TEMP_ERROR_SET_THRES EngCalVariantCriterion
  /begin VAR_ADDRESS 0x8003A8AE 0x8003B6AE 0x8003C4AE 0x8003D2AE 0x8003E0AE 0x8003EEAE 0x8003FCAE 0x80040AAE 0x800418AE 0x800426AE 0x800434AE 0x800442AE 0x800450AE 0x80045EAE 0x80046CAE 0x80047AAE 0x800488AE 0x800496AE 0x8004A4AE 0x8004B2AE 0x8004C0AE 0x8004CEAE 0x8004DCAE 0x8004EAAE /end VAR_ADDRESS
 /end VAR_CHARACTERISTIC
 /begin VAR_CHARACTERISTIC U16_VLC_Gear_1 EngCalVariantCriterion
  /begin VAR_ADDRESS 0x8003A8B0 0x8003B6B0 0x8003C4B0 0x8003D2B0 0x8003E0B0 0x8003EEB0 0x8003FCB0 0x80040AB0 0x800418B0 0x800426B0 0x800434B0 0x800442B0 0x800450B0 0x80045EB0 0x80046CB0 0x80047AB0 0x800488B0 0x800496B0 0x8004A4B0 0x8004B2B0 0x8004C0B0 0x8004CEB0 0x8004DCB0 0x8004EAB0 /end VAR_ADDRESS
 /end VAR_CHARACTERISTIC
 /begin VAR_CHARACTERISTIC U16_VLC_Gear_10 EngCalVariantCriterion
  /begin VAR_ADDRESS 0x8003A8C2 0x8003B6C2 0x8003C4C2 0x8003D2C2 0x8003E0C2 0x8003EEC2 0x8003FCC2 0x80040AC2 0x800418C2 0x800426C2 0x800434C2 0x800442C2 0x800450C2 0x80045EC2 0x80046CC2 0x80047AC2 0x800488C2 0x800496C2 0x8004A4C2 0x8004B2C2 0x8004C0C2 0x8004CEC2 0x8004DCC2 0x8004EAC2 /end VAR_ADDRESS
 /end VAR_CHARACTERISTIC
 /begin VAR_CHARACTERISTIC U16_VLC_Gear_2 EngCalVariantCriterion
  /begin VAR_ADDRESS 0x8003A8B2 0x8003B6B2 0x8003C4B2 0x8003D2B2 0x8003E0B2 0x8003EEB2 0x8003FCB2 0x80040AB2 0x800418B2 0x800426B2 0x800434B2 0x800442B2 0x800450B2 0x80045EB2 0x80046CB2 0x80047AB2 0x800488B2 0x800496B2 0x8004A4B2 0x8004B2B2 0x8004C0B2 0x8004CEB2 0x8004DCB2 0x8004EAB2 /end VAR_ADDRESS
 /end VAR_CHARACTERISTIC
 /begin VAR_CHARACTERISTIC U16_VLC_Gear_3 EngCalVariantCriterion
  /begin VAR_ADDRESS 0x8003A8B4 0x8003B6B4 0x8003C4B4 0x8003D2B4 0x8003E0B4 0x8003EEB4 0x8003FCB4 0x80040AB4 0x800418B4 0x800426B4 0x800434B4 0x800442B4 0x800450B4 0x80045EB4 0x80046CB4 0x80047AB4 0x800488B4 0x800496B4 0x8004A4B4 0x8004B2B4 0x8004C0B4 0x8004CEB4 0x8004DCB4 0x8004EAB4 /end VAR_ADDRESS
 /end VAR_CHARACTERISTIC
 /begin VAR_CHARACTERISTIC U16_VLC_Gear_4 EngCalVariantCriterion
  /begin VAR_ADDRESS 0x8003A8B6 0x8003B6B6 0x8003C4B6 0x8003D2B6 0x8003E0B6 0x8003EEB6 0x8003FCB6 0x80040AB6 0x800418B6 0x800426B6 0x800434B6 0x800442B6 0x800450B6 0x80045EB6 0x80046CB6 0x80047AB6 0x800488B6 0x800496B6 0x8004A4B6 0x8004B2B6 0x8004C0B6 0x8004CEB6 0x8004DCB6 0x8004EAB6 /end VAR_ADDRESS
 /end VAR_CHARACTERISTIC
 /begin VAR_CHARACTERISTIC U16_VLC_Gear_5 EngCalVariantCriterion
  /begin VAR_ADDRESS 0x8003A8B8 0x8003B6B8 0x8003C4B8 0x8003D2B8 0x8003E0B8 0x8003EEB8 0x8003FCB8 0x80040AB8 0x800418B8 0x800426B8 0x800434B8 0x800442B8 0x800450B8 0x80045EB8 0x80046CB8 0x80047AB8 0x800488B8 0x800496B8 0x8004A4B8 0x8004B2B8 0x8004C0B8 0x8004CEB8 0x8004DCB8 0x8004EAB8 /end VAR_ADDRESS
 /end VAR_CHARACTERISTIC
 /begin VAR_CHARACTERISTIC U16_VLC_Gear_6 EngCalVariantCriterion
  /begin VAR_ADDRESS 0x8003A8BA 0x8003B6BA 0x8003C4BA 0x8003D2BA 0x8003E0BA 0x8003EEBA 0x8003FCBA 0x80040ABA 0x800418BA 0x800426BA 0x800434BA 0x800442BA 0x800450BA 0x80045EBA 0x80046CBA 0x80047ABA 0x800488BA 0x800496BA 0x8004A4BA 0x8004B2BA 0x8004C0BA 0x8004CEBA 0x8004DCBA 0x8004EABA /end VAR_ADDRESS
 /end VAR_CHARACTERISTIC
 /begin VAR_CHARACTERISTIC U16_VLC_Gear_7 EngCalVariantCriterion
  /begin VAR_ADDRESS 0x8003A8BC 0x8003B6BC 0x8003C4BC 0x8003D2BC 0x8003E0BC 0x8003EEBC 0x8003FCBC 0x80040ABC 0x800418BC 0x800426BC 0x800434BC 0x800442BC 0x800450BC 0x80045EBC 0x80046CBC 0x80047ABC 0x800488BC 0x800496BC 0x8004A4BC 0x8004B2BC 0x8004C0BC 0x8004CEBC 0x8004DCBC 0x8004EABC /end VAR_ADDRESS
 /end VAR_CHARACTERISTIC
 /begin VAR_CHARACTERISTIC U16_VLC_Gear_8 EngCalVariantCriterion
  /begin VAR_ADDRESS 0x8003A8BE 0x8003B6BE 0x8003C4BE 0x8003D2BE 0x8003E0BE 0x8003EEBE 0x8003FCBE 0x80040ABE 0x800418BE 0x800426BE 0x800434BE 0x800442BE 0x800450BE 0x80045EBE 0x80046CBE 0x80047ABE 0x800488BE 0x800496BE 0x8004A4BE 0x8004B2BE 0x8004C0BE 0x8004CEBE 0x8004DCBE 0x8004EABE /end VAR_ADDRESS
 /end VAR_CHARACTERISTIC
 /begin VAR_CHARACTERISTIC U16_VLC_Gear_9 EngCalVariantCriterion
  /begin VAR_ADDRESS 0x8003A8C0 0x8003B6C0 0x8003C4C0 0x8003D2C0 0x8003E0C0 0x8003EEC0 0x8003FCC0 0x80040AC0 0x800418C0 0x800426C0 0x800434C0 0x800442C0 0x800450C0 0x80045EC0 0x80046CC0 0x80047AC0 0x800488C0 0x800496C0 0x8004A4C0 0x8004B2C0 0x8004C0C0 0x8004CEC0 0x8004DCC0 0x8004EAC0 /end VAR_ADDRESS
 /end VAR_CHARACTERISTIC
 /begin VAR_CHARACTERISTIC U16_VLC_Gear_R EngCalVariantCriterion
  /begin VAR_ADDRESS 0x8003A8C4 0x8003B6C4 0x8003C4C4 0x8003D2C4 0x8003E0C4 0x8003EEC4 0x8003FCC4 0x80040AC4 0x800418C4 0x800426C4 0x800434C4 0x800442C4 0x800450C4 0x80045EC4 0x80046CC4 0x80047AC4 0x800488C4 0x800496C4 0x8004A4C4 0x8004B2C4 0x8004C0C4 0x8004CEC4 0x8004DCC4 0x8004EAC4 /end VAR_ADDRESS
 /end VAR_CHARACTERISTIC
 /begin VAR_CHARACTERISTIC U32TcVlvLeakTestActtnTi BrkCalVariantCriterion
  /begin VAR_ADDRESS 0x800214E0 0x800248E0 0x80027CE0 0x8002B0E0 0x8002E4E0 0x800318E0 0x80034CE0 0x800380E0 /end VAR_ADDRESS
 /end VAR_CHARACTERISTIC
 /begin VAR_CHARACTERISTIC U8CircBleedingTcVlvClsTi BrkCalVariantCriterion
  /begin VAR_ADDRESS 0x800214D9 0x800248D9 0x80027CD9 0x8002B0D9 0x8002E4D9 0x800318D9 0x80034CD9 0x800380D9 /end VAR_ADDRESS
 /end VAR_CHARACTERISTIC
 /begin VAR_CHARACTERISTIC U8CircBleedingTcVlvOpenTi BrkCalVariantCriterion
  /begin VAR_ADDRESS 0x800214D8 0x800248D8 0x80027CD8 0x8002B0D8 0x8002E4D8 0x800318D8 0x80034CD8 0x800380D8 /end VAR_ADDRESS
 /end VAR_CHARACTERISTIC
 /begin VAR_CHARACTERISTIC U8DftCompDecMotUDuty1 BrkCalVariantCriterion
  /begin VAR_ADDRESS 0x800214A0 0x800248A0 0x80027CA0 0x8002B0A0 0x8002E4A0 0x800318A0 0x80034CA0 0x800380A0 /end VAR_ADDRESS
 /end VAR_CHARACTERISTIC
 /begin VAR_CHARACTERISTIC U8DftCompDecMotUDuty2 BrkCalVariantCriterion
  /begin VAR_ADDRESS 0x800214A1 0x800248A1 0x80027CA1 0x8002B0A1 0x8002E4A1 0x800318A1 0x80034CA1 0x800380A1 /end VAR_ADDRESS
 /end VAR_CHARACTERISTIC
 /begin VAR_CHARACTERISTIC U8DftCompIncMotUDuty1 BrkCalVariantCriterion
  /begin VAR_ADDRESS 0x8002149E 0x8002489E 0x80027C9E 0x8002B09E 0x8002E49E 0x8003189E 0x80034C9E 0x8003809E /end VAR_ADDRESS
 /end VAR_CHARACTERISTIC
 /begin VAR_CHARACTERISTIC U8DftCompIncMotUDuty2 BrkCalVariantCriterion
  /begin VAR_ADDRESS 0x8002149F 0x8002489F 0x80027C9F 0x8002B09F 0x8002E49F 0x8003189F 0x80034C9F 0x8003809F /end VAR_ADDRESS
 /end VAR_CHARACTERISTIC
 /begin VAR_CHARACTERISTIC U8DtrmTcmfModPErr BrkCalVariantCriterion
  /begin VAR_ADDRESS 0x8002125C 0x8002465C 0x80027A5C 0x8002AE5C 0x8002E25C 0x8003165C 0x80034A5C 0x80037E5C /end VAR_ADDRESS
 /end VAR_CHARACTERISTIC
 /begin VAR_CHARACTERISTIC U8EpsiHndlgAgToTqGain BrkCalVariantCriterion
  /begin VAR_ADDRESS 0x80021880 0x80024C80 0x80028080 0x8002B480 0x8002E880 0x80031C80 0x80035080 0x80038480 /end VAR_ADDRESS
 /end VAR_CHARACTERISTIC
 /begin VAR_CHARACTERISTIC U8EpsiHndlgDampgTqGainDrvrTqIdxSum1 BrkCalVariantCriterion
  /begin VAR_ADDRESS 0x8002188B 0x80024C8B 0x8002808B 0x8002B48B 0x8002E88B 0x80031C8B 0x8003508B 0x8003848B /end VAR_ADDRESS
 /end VAR_CHARACTERISTIC
 /begin VAR_CHARACTERISTIC U8EpsiHndlgDampgTqGainDrvrTqIdxSum2 BrkCalVariantCriterion
  /begin VAR_ADDRESS 0x8002188C 0x80024C8C 0x8002808C 0x8002B48C 0x8002E88C 0x80031C8C 0x8003508C 0x8003848C /end VAR_ADDRESS
 /end VAR_CHARACTERISTIC
 /begin VAR_CHARACTERISTIC U8EpsiHndlgDampgTqGainDrvrTqIdxSum3 BrkCalVariantCriterion
  /begin VAR_ADDRESS 0x8002188D 0x80024C8D 0x8002808D 0x8002B48D 0x8002E88D 0x80031C8D 0x8003508D 0x8003848D /end VAR_ADDRESS
 /end VAR_CHARACTERISTIC
 /begin VAR_CHARACTERISTIC U8EpsiHndlgDampgTqVehSpdGain1 BrkCalVariantCriterion
  /begin VAR_ADDRESS 0x80021891 0x80024C91 0x80028091 0x8002B491 0x8002E891 0x80031C91 0x80035091 0x80038491 /end VAR_ADDRESS
 /end VAR_CHARACTERISTIC
 /begin VAR_CHARACTERISTIC U8EpsiHndlgDampgTqVehSpdGain2 BrkCalVariantCriterion
  /begin VAR_ADDRESS 0x80021892 0x80024C92 0x80028092 0x8002B492 0x8002E892 0x80031C92 0x80035092 0x80038492 /end VAR_ADDRESS
 /end VAR_CHARACTERISTIC
 /begin VAR_CHARACTERISTIC U8EpsiHndlgDampgTqVehSpdGain3 BrkCalVariantCriterion
  /begin VAR_ADDRESS 0x80021893 0x80024C93 0x80028093 0x8002B493 0x8002E893 0x80031C93 0x80035093 0x80038493 /end VAR_ADDRESS
 /end VAR_CHARACTERISTIC
 /begin VAR_CHARACTERISTIC U8EpsiHndlgDampgTqVehSpdGain4 BrkCalVariantCriterion
  /begin VAR_ADDRESS 0x80021894 0x80024C94 0x80028094 0x8002B494 0x8002E894 0x80031C94 0x80035094 0x80038494 /end VAR_ADDRESS
 /end VAR_CHARACTERISTIC
 /begin VAR_CHARACTERISTIC U8EpsiHndlgDampgTqVehSpdGain5 BrkCalVariantCriterion
  /begin VAR_ADDRESS 0x80021895 0x80024C95 0x80028095 0x8002B495 0x8002E895 0x80031C95 0x80035095 0x80038495 /end VAR_ADDRESS
 /end VAR_CHARACTERISTIC
 /begin VAR_CHARACTERISTIC U8EpsiHndlgDrvrTqIdxSumDampgTqGain1 BrkCalVariantCriterion
  /begin VAR_ADDRESS 0x8002188E 0x80024C8E 0x8002808E 0x8002B48E 0x8002E88E 0x80031C8E 0x8003508E 0x8003848E /end VAR_ADDRESS
 /end VAR_CHARACTERISTIC
 /begin VAR_CHARACTERISTIC U8EpsiHndlgDrvrTqIdxSumDampgTqGain2 BrkCalVariantCriterion
  /begin VAR_ADDRESS 0x8002188F 0x80024C8F 0x8002808F 0x8002B48F 0x8002E88F 0x80031C8F 0x8003508F 0x8003848F /end VAR_ADDRESS
 /end VAR_CHARACTERISTIC
 /begin VAR_CHARACTERISTIC U8EpsiHndlgDrvrTqIdxSumDampgTqGain3 BrkCalVariantCriterion
  /begin VAR_ADDRESS 0x80021890 0x80024C90 0x80028090 0x8002B490 0x8002E890 0x80031C90 0x80035090 0x80038490 /end VAR_ADDRESS
 /end VAR_CHARACTERISTIC
 /begin VAR_CHARACTERISTIC U8EpsiHndlgFadeOutTi BrkCalVariantCriterion
  /begin VAR_ADDRESS 0x80021896 0x80024C96 0x80028096 0x8002B496 0x8002E896 0x80031C96 0x80035096 0x80038496 /end VAR_ADDRESS
 /end VAR_CHARACTERISTIC
 /begin VAR_CHARACTERISTIC U8EpsiHndlgFadeOutTq BrkCalVariantCriterion
  /begin VAR_ADDRESS 0x80021897 0x80024C97 0x80028097 0x8002B497 0x8002E897 0x80031C97 0x80035097 0x80038497 /end VAR_ADDRESS
 /end VAR_CHARACTERISTIC
 /begin VAR_CHARACTERISTIC U8EpsiHndlgRoadFricAgToTqGain1 BrkCalVariantCriterion
  /begin VAR_ADDRESS 0x80021888 0x80024C88 0x80028088 0x8002B488 0x8002E888 0x80031C88 0x80035088 0x80038488 /end VAR_ADDRESS
 /end VAR_CHARACTERISTIC
 /begin VAR_CHARACTERISTIC U8EpsiHndlgRoadFricAgToTqGain2 BrkCalVariantCriterion
  /begin VAR_ADDRESS 0x80021889 0x80024C89 0x80028089 0x8002B489 0x8002E889 0x80031C89 0x80035089 0x80038489 /end VAR_ADDRESS
 /end VAR_CHARACTERISTIC
 /begin VAR_CHARACTERISTIC U8EpsiHndlgRoadFricAgToTqGain3 BrkCalVariantCriterion
  /begin VAR_ADDRESS 0x8002188A 0x80024C8A 0x8002808A 0x8002B48A 0x8002E88A 0x80031C8A 0x8003508A 0x8003848A /end VAR_ADDRESS
 /end VAR_CHARACTERISTIC
 /begin VAR_CHARACTERISTIC U8EpsiSplitCtrlEntrRoadFricThd1 BrkCalVariantCriterion
  /begin VAR_ADDRESS 0x800217AE 0x80024BAE 0x80027FAE 0x8002B3AE 0x8002E7AE 0x80031BAE 0x80034FAE 0x800383AE /end VAR_ADDRESS
 /end VAR_CHARACTERISTIC
 /begin VAR_CHARACTERISTIC U8EpsiSplitCtrlEntrRoadFricThd2 BrkCalVariantCriterion
  /begin VAR_ADDRESS 0x800217AF 0x80024BAF 0x80027FAF 0x8002B3AF 0x8002E7AF 0x80031BAF 0x80034FAF 0x800383AF /end VAR_ADDRESS
 /end VAR_CHARACTERISTIC
 /begin VAR_CHARACTERISTIC U8EpsiSplitCtrlHldRoadFricThd1 BrkCalVariantCriterion
  /begin VAR_ADDRESS 0x800217B0 0x80024BB0 0x80027FB0 0x8002B3B0 0x8002E7B0 0x80031BB0 0x80034FB0 0x800383B0 /end VAR_ADDRESS
 /end VAR_CHARACTERISTIC
 /begin VAR_CHARACTERISTIC U8EpsiSplitCtrlHldRoadFricThd2 BrkCalVariantCriterion
  /begin VAR_ADDRESS 0x800217B1 0x80024BB1 0x80027FB1 0x8002B3B1 0x8002E7B1 0x80031BB1 0x80034FB1 0x800383B1 /end VAR_ADDRESS
 /end VAR_CHARACTERISTIC
 /begin VAR_CHARACTERISTIC U8EpsiSplitDampgTqVehSpdGain1 BrkCalVariantCriterion
  /begin VAR_ADDRESS 0x80021830 0x80024C30 0x80028030 0x8002B430 0x8002E830 0x80031C30 0x80035030 0x80038430 /end VAR_ADDRESS
 /end VAR_CHARACTERISTIC
 /begin VAR_CHARACTERISTIC U8EpsiSplitDampgTqVehSpdGain2 BrkCalVariantCriterion
  /begin VAR_ADDRESS 0x80021831 0x80024C31 0x80028031 0x8002B431 0x8002E831 0x80031C31 0x80035031 0x80038431 /end VAR_ADDRESS
 /end VAR_CHARACTERISTIC
 /begin VAR_CHARACTERISTIC U8EpsiSplitDampgTqVehSpdGain3 BrkCalVariantCriterion
  /begin VAR_ADDRESS 0x80021832 0x80024C32 0x80028032 0x8002B432 0x8002E832 0x80031C32 0x80035032 0x80038432 /end VAR_ADDRESS
 /end VAR_CHARACTERISTIC
 /begin VAR_CHARACTERISTIC U8EpsiSplitDampgTqVehSpdGain4 BrkCalVariantCriterion
  /begin VAR_ADDRESS 0x80021833 0x80024C33 0x80028033 0x8002B433 0x8002E833 0x80031C33 0x80035033 0x80038433 /end VAR_ADDRESS
 /end VAR_CHARACTERISTIC
 /begin VAR_CHARACTERISTIC U8EpsiSplitDampgTqVehSpdGain5 BrkCalVariantCriterion
  /begin VAR_ADDRESS 0x80021834 0x80024C34 0x80028034 0x8002B434 0x8002E834 0x80031C34 0x80035034 0x80038434 /end VAR_ADDRESS
 /end VAR_CHARACTERISTIC
 /begin VAR_CHARACTERISTIC U8EpsiSplitDrvrTqCoeff1 BrkCalVariantCriterion
  /begin VAR_ADDRESS 0x800217F0 0x80024BF0 0x80027FF0 0x8002B3F0 0x8002E7F0 0x80031BF0 0x80034FF0 0x800383F0 /end VAR_ADDRESS
 /end VAR_CHARACTERISTIC
 /begin VAR_CHARACTERISTIC U8EpsiSplitDrvrTqCoeff2 BrkCalVariantCriterion
  /begin VAR_ADDRESS 0x800217F1 0x80024BF1 0x80027FF1 0x8002B3F1 0x8002E7F1 0x80031BF1 0x80034FF1 0x800383F1 /end VAR_ADDRESS
 /end VAR_CHARACTERISTIC
 /begin VAR_CHARACTERISTIC U8EpsiSplitDrvrTqCoeff3 BrkCalVariantCriterion
  /begin VAR_ADDRESS 0x800217F2 0x80024BF2 0x80027FF2 0x8002B3F2 0x8002E7F2 0x80031BF2 0x80034FF2 0x800383F2 /end VAR_ADDRESS
 /end VAR_CHARACTERISTIC
 /begin VAR_CHARACTERISTIC U8EpsiSplitDrvrTqCoeff4 BrkCalVariantCriterion
  /begin VAR_ADDRESS 0x800217F3 0x80024BF3 0x80027FF3 0x8002B3F3 0x8002E7F3 0x80031BF3 0x80034FF3 0x800383F3 /end VAR_ADDRESS
 /end VAR_CHARACTERISTIC
 /begin VAR_CHARACTERISTIC U8EpsiSplitFadeOutTi BrkCalVariantCriterion
  /begin VAR_ADDRESS 0x80021835 0x80024C35 0x80028035 0x8002B435 0x8002E835 0x80031C35 0x80035035 0x80038435 /end VAR_ADDRESS
 /end VAR_CHARACTERISTIC
 /begin VAR_CHARACTERISTIC U8EpsiSplitFadeOutTq BrkCalVariantCriterion
  /begin VAR_ADDRESS 0x80021836 0x80024C36 0x80028036 0x8002B436 0x8002E836 0x80031C36 0x80035036 0x80038436 /end VAR_ADDRESS
 /end VAR_CHARACTERISTIC
 /begin VAR_CHARACTERISTIC U8EpsiYawRateErrThdGain BrkCalVariantCriterion
  /begin VAR_ADDRESS 0x80021841 0x80024C41 0x80028041 0x8002B441 0x8002E841 0x80031C41 0x80035041 0x80038441 /end VAR_ADDRESS
 /end VAR_CHARACTERISTIC
 /begin VAR_CHARACTERISTIC U8EpsiYawRateErrThdRoughRoadGain BrkCalVariantCriterion
  /begin VAR_ADDRESS 0x80021840 0x80024C40 0x80028040 0x8002B440 0x8002E840 0x80031C40 0x80035040 0x80038440 /end VAR_ADDRESS
 /end VAR_CHARACTERISTIC
 /begin VAR_CHARACTERISTIC U8EsvVlvActtnIntlTiFctCtrlFinshd BrkCalVariantCriterion
  /begin VAR_ADDRESS 0x800213D2 0x800247D2 0x80027BD2 0x8002AFD2 0x8002E3D2 0x800317D2 0x80034BD2 0x80037FD2 /end VAR_ADDRESS
 /end VAR_CHARACTERISTIC
 /begin VAR_CHARACTERISTIC U8EsvVlvActtnStrtTiFctCtrlFinshd BrkCalVariantCriterion
  /begin VAR_ADDRESS 0x800213CE 0x800247CE 0x80027BCE 0x8002AFCE 0x8002E3CE 0x800317CE 0x80034BCE 0x80037FCE /end VAR_ADDRESS
 /end VAR_CHARACTERISTIC
 /begin VAR_CHARACTERISTIC U8EsvVlvActtnTiWslcBac BrkCalVariantCriterion
  /begin VAR_ADDRESS 0x800213D6 0x800247D6 0x80027BD6 0x8002AFD6 0x8002E3D6 0x800317D6 0x80034BD6 0x80037FD6 /end VAR_ADDRESS
 /end VAR_CHARACTERISTIC
 /begin VAR_CHARACTERISTIC U8EsvVlvCurMax BrkCalVariantCriterion
  /begin VAR_ADDRESS 0x800213CA 0x800247CA 0x80027BCA 0x8002AFCA 0x8002E3CA 0x800317CA 0x80034BCA 0x80037FCA /end VAR_ADDRESS
 /end VAR_CHARACTERISTIC
 /begin VAR_CHARACTERISTIC U8EsvVlvCurMaxPatActtnTi BrkCalVariantCriterion
  /begin VAR_ADDRESS 0x800213D3 0x800247D3 0x80027BD3 0x8002AFD3 0x8002E3D3 0x800317D3 0x80034BD3 0x80037FD3 /end VAR_ADDRESS
 /end VAR_CHARACTERISTIC
 /begin VAR_CHARACTERISTIC U8EsvVlvCurSysMax BrkCalVariantCriterion
  /begin VAR_ADDRESS 0x800213CB 0x800247CB 0x80027BCB 0x8002AFCB 0x8002E3CB 0x800317CB 0x80034BCB 0x80037FCB /end VAR_ADDRESS
 /end VAR_CHARACTERISTIC
 /begin VAR_CHARACTERISTIC U8EsvVlvHldCurMin BrkCalVariantCriterion
  /begin VAR_ADDRESS 0x800213C8 0x800247C8 0x80027BC8 0x8002AFC8 0x8002E3C8 0x800317C8 0x80034BC8 0x80037FC8 /end VAR_ADDRESS
 /end VAR_CHARACTERISTIC
 /begin VAR_CHARACTERISTIC U8EsvVlvOpenCurMin BrkCalVariantCriterion
  /begin VAR_ADDRESS 0x800213C9 0x800247C9 0x80027BC9 0x8002AFC9 0x8002E3C9 0x800317C9 0x80034BC9 0x80037FC9 /end VAR_ADDRESS
 /end VAR_CHARACTERISTIC
 /begin VAR_CHARACTERISTIC U8HwTestMod BrkCalVariantCriterion
  /begin VAR_ADDRESS 0x800214AE 0x800248AE 0x80027CAE 0x8002B0AE 0x8002E4AE 0x800318AE 0x80034CAE 0x800380AE /end VAR_ADDRESS
 /end VAR_CHARACTERISTIC
 /begin VAR_CHARACTERISTIC U8IniMotActtnTiAbs BrkCalVariantCriterion
  /begin VAR_ADDRESS 0x800213DA 0x800247DA 0x80027BDA 0x8002AFDA 0x8002E3DA 0x800317DA 0x80034BDA 0x80037FDA /end VAR_ADDRESS
 /end VAR_CHARACTERISTIC
 /begin VAR_CHARACTERISTIC U8IniMotUDuty1 BrkCalVariantCriterion
  /begin VAR_ADDRESS 0x80021498 0x80024898 0x80027C98 0x8002B098 0x8002E498 0x80031898 0x80034C98 0x80038098 /end VAR_ADDRESS
 /end VAR_CHARACTERISTIC
 /begin VAR_CHARACTERISTIC U8IniMotUDuty2 BrkCalVariantCriterion
  /begin VAR_ADDRESS 0x80021499 0x80024899 0x80027C99 0x8002B099 0x8002E499 0x80031899 0x80034C99 0x80038099 /end VAR_ADDRESS
 /end VAR_CHARACTERISTIC
 /begin VAR_CHARACTERISTIC U8LfcRiseFbPErrToNo1VlvCurGain BrkCalVariantCriterion
  /begin VAR_ADDRESS 0x800212DE 0x800246DE 0x80027ADE 0x8002AEDE 0x8002E2DE 0x800316DE 0x80034ADE 0x80037EDE /end VAR_ADDRESS
 /end VAR_CHARACTERISTIC
 /begin VAR_CHARACTERISTIC U8MotUAbsFric1 BrkCalVariantCriterion
  /begin VAR_ADDRESS 0x800213EC 0x800247EC 0x80027BEC 0x8002AFEC 0x8002E3EC 0x800317EC 0x80034BEC 0x80037FEC /end VAR_ADDRESS
 /end VAR_CHARACTERISTIC
 /begin VAR_CHARACTERISTIC U8MotUAbsFric2 BrkCalVariantCriterion
  /begin VAR_ADDRESS 0x800213ED 0x800247ED 0x80027BED 0x8002AFED 0x8002E3ED 0x800317ED 0x80034BED 0x80037FED /end VAR_ADDRESS
 /end VAR_CHARACTERISTIC
 /begin VAR_CHARACTERISTIC U8MotUAbsFric3 BrkCalVariantCriterion
  /begin VAR_ADDRESS 0x800213EE 0x800247EE 0x80027BEE 0x8002AFEE 0x8002E3EE 0x800317EE 0x80034BEE 0x80037FEE /end VAR_ADDRESS
 /end VAR_CHARACTERISTIC
 /begin VAR_CHARACTERISTIC U8MotUIniTi1 BrkCalVariantCriterion
  /begin VAR_ADDRESS 0x800214AA 0x800248AA 0x80027CAA 0x8002B0AA 0x8002E4AA 0x800318AA 0x80034CAA 0x800380AA /end VAR_ADDRESS
 /end VAR_CHARACTERISTIC
 /begin VAR_CHARACTERISTIC U8MotUIniTi2 BrkCalVariantCriterion
  /begin VAR_ADDRESS 0x800214AB 0x800248AB 0x80027CAB 0x8002B0AB 0x8002E4AB 0x800318AB 0x80034CAB 0x800380AB /end VAR_ADDRESS
 /end VAR_CHARACTERISTIC
 /begin VAR_CHARACTERISTIC U8MotUIniTi3 BrkCalVariantCriterion
  /begin VAR_ADDRESS 0x800214AC 0x800248AC 0x80027CAC 0x8002B0AC 0x8002E4AC 0x800318AC 0x80034CAC 0x800380AC /end VAR_ADDRESS
 /end VAR_CHARACTERISTIC
 /begin VAR_CHARACTERISTIC U8MotUIniTi4 BrkCalVariantCriterion
  /begin VAR_ADDRESS 0x800214AD 0x800248AD 0x80027CAD 0x8002B0AD 0x8002E4AD 0x800318AD 0x80034CAD 0x800380AD /end VAR_ADDRESS
 /end VAR_CHARACTERISTIC
 /begin VAR_CHARACTERISTIC U8MotUWslcDecelCombFric1 BrkCalVariantCriterion
  /begin VAR_ADDRESS 0x800213FA 0x800247FA 0x80027BFA 0x8002AFFA 0x8002E3FA 0x800317FA 0x80034BFA 0x80037FFA /end VAR_ADDRESS
 /end VAR_CHARACTERISTIC
 /begin VAR_CHARACTERISTIC U8MotUWslcDecelCombFric2 BrkCalVariantCriterion
  /begin VAR_ADDRESS 0x800213FB 0x800247FB 0x80027BFB 0x8002AFFB 0x8002E3FB 0x800317FB 0x80034BFB 0x80037FFB /end VAR_ADDRESS
 /end VAR_CHARACTERISTIC
 /begin VAR_CHARACTERISTIC U8MotUWslcDecelCombFric3 BrkCalVariantCriterion
  /begin VAR_ADDRESS 0x800213FC 0x800247FC 0x80027BFC 0x8002AFFC 0x8002E3FC 0x800317FC 0x80034BFC 0x80037FFC /end VAR_ADDRESS
 /end VAR_CHARACTERISTIC
 /begin VAR_CHARACTERISTIC U8NcVlvCurMax BrkCalVariantCriterion
  /begin VAR_ADDRESS 0x800212EE 0x800246EE 0x80027AEE 0x8002AEEE 0x8002E2EE 0x800316EE 0x80034AEE 0x80037EEE /end VAR_ADDRESS
 /end VAR_CHARACTERISTIC
 /begin VAR_CHARACTERISTIC U8NcVlvCurMaxPatActtnTi BrkCalVariantCriterion
  /begin VAR_ADDRESS 0x800212F0 0x800246F0 0x80027AF0 0x8002AEF0 0x8002E2F0 0x800316F0 0x80034AF0 0x80037EF0 /end VAR_ADDRESS
 /end VAR_CHARACTERISTIC
 /begin VAR_CHARACTERISTIC U8NcVlvCurSysMax BrkCalVariantCriterion
  /begin VAR_ADDRESS 0x800212EF 0x800246EF 0x80027AEF 0x8002AEEF 0x8002E2EF 0x800316EF 0x80034AEF 0x80037EEF /end VAR_ADDRESS
 /end VAR_CHARACTERISTIC
 /begin VAR_CHARACTERISTIC U8NcVlvHldCurMin BrkCalVariantCriterion
  /begin VAR_ADDRESS 0x800212EC 0x800246EC 0x80027AEC 0x8002AEEC 0x8002E2EC 0x800316EC 0x80034AEC 0x80037EEC /end VAR_ADDRESS
 /end VAR_CHARACTERISTIC
 /begin VAR_CHARACTERISTIC U8NcVlvOpenCurMin BrkCalVariantCriterion
  /begin VAR_ADDRESS 0x800212ED 0x800246ED 0x80027AED 0x8002AEED 0x8002E2ED 0x800316ED 0x80034AED 0x80037EED /end VAR_ADDRESS
 /end VAR_CHARACTERISTIC
 /begin VAR_CHARACTERISTIC U8RiseRateTestActtnTiPreFill BrkCalVariantCriterion
  /begin VAR_ADDRESS 0x800214B4 0x800248B4 0x80027CB4 0x8002B0B4 0x8002E4B4 0x800318B4 0x80034CB4 0x800380B4 /end VAR_ADDRESS
 /end VAR_CHARACTERISTIC
 /begin VAR_CHARACTERISTIC U8TcVlvLeakTestFadeOutTi BrkCalVariantCriterion
  /begin VAR_ADDRESS 0x800214E4 0x800248E4 0x80027CE4 0x8002B0E4 0x8002E4E4 0x800318E4 0x80034CE4 0x800380E4 /end VAR_ADDRESS
 /end VAR_CHARACTERISTIC
 /begin VAR_CHARACTERISTIC U8TcVlvLeakTestIniHldFirstTi BrkCalVariantCriterion
  /begin VAR_ADDRESS 0x800214DE 0x800248DE 0x80027CDE 0x8002B0DE 0x8002E4DE 0x800318DE 0x80034CDE 0x800380DE /end VAR_ADDRESS
 /end VAR_CHARACTERISTIC
 /begin VAR_CHARACTERISTIC U8TcVlvLeakTestIniHldSecTi BrkCalVariantCriterion
  /begin VAR_ADDRESS 0x800214DF 0x800248DF 0x80027CDF 0x8002B0DF 0x8002E4DF 0x800318DF 0x80034CDF 0x800380DF /end VAR_ADDRESS
 /end VAR_CHARACTERISTIC
 /begin VAR_CHARACTERISTIC U8TcmfCmpDumpDecTcVlvCur BrkCalVariantCriterion
  /begin VAR_ADDRESS 0x8002135C 0x8002475C 0x80027B5C 0x8002AF5C 0x8002E35C 0x8003175C 0x80034B5C 0x80037F5C /end VAR_ADDRESS
 /end VAR_CHARACTERISTIC
 /begin VAR_CHARACTERISTIC U8TcmfDumpPGrdtDecTcVlvCur1 BrkCalVariantCriterion
  /begin VAR_ADDRESS 0x80021364 0x80024764 0x80027B64 0x8002AF64 0x8002E364 0x80031764 0x80034B64 0x80037F64 /end VAR_ADDRESS
 /end VAR_CHARACTERISTIC
 /begin VAR_CHARACTERISTIC U8TcmfDumpPGrdtDecTcVlvCur2 BrkCalVariantCriterion
  /begin VAR_ADDRESS 0x80021365 0x80024765 0x80027B65 0x8002AF65 0x8002E365 0x80031765 0x80034B65 0x80037F65 /end VAR_ADDRESS
 /end VAR_CHARACTERISTIC
 /begin VAR_CHARACTERISTIC U8TcmfDumpPGrdtDecTcVlvCur3 BrkCalVariantCriterion
  /begin VAR_ADDRESS 0x80021366 0x80024766 0x80027B66 0x8002AF66 0x8002E366 0x80031766 0x80034B66 0x80037F66 /end VAR_ADDRESS
 /end VAR_CHARACTERISTIC
 /begin VAR_CHARACTERISTIC U8TcmfIniHldFirstTi BrkCalVariantCriterion
  /begin VAR_ADDRESS 0x80021330 0x80024730 0x80027B30 0x8002AF30 0x8002E330 0x80031730 0x80034B30 0x80037F30 /end VAR_ADDRESS
 /end VAR_CHARACTERISTIC
 /begin VAR_CHARACTERISTIC U8TcmfIniHldSecTi BrkCalVariantCriterion
  /begin VAR_ADDRESS 0x80021331 0x80024731 0x80027B31 0x8002AF31 0x8002E331 0x80031731 0x80034B31 0x80037F31 /end VAR_ADDRESS
 /end VAR_CHARACTERISTIC
 /begin VAR_CHARACTERISTIC U8TcmfIniRiseChgPGrdt BrkCalVariantCriterion
  /begin VAR_ADDRESS 0x80021304 0x80024704 0x80027B04 0x8002AF04 0x8002E304 0x80031704 0x80034B04 0x80037F04 /end VAR_ADDRESS
 /end VAR_CHARACTERISTIC
 /begin VAR_CHARACTERISTIC U8TcmfIniRiseInhbPTi1 BrkCalVariantCriterion
  /begin VAR_ADDRESS 0x80021328 0x80024728 0x80027B28 0x8002AF28 0x8002E328 0x80031728 0x80034B28 0x80037F28 /end VAR_ADDRESS
 /end VAR_CHARACTERISTIC
 /begin VAR_CHARACTERISTIC U8TcmfIniRiseInhbPTi2 BrkCalVariantCriterion
  /begin VAR_ADDRESS 0x80021329 0x80024729 0x80027B29 0x8002AF29 0x8002E329 0x80031729 0x80034B29 0x80037F29 /end VAR_ADDRESS
 /end VAR_CHARACTERISTIC
 /begin VAR_CHARACTERISTIC U8TcmfIniRiseInhbPTi3 BrkCalVariantCriterion
  /begin VAR_ADDRESS 0x8002132A 0x8002472A 0x80027B2A 0x8002AF2A 0x8002E32A 0x8003172A 0x80034B2A 0x80037F2A /end VAR_ADDRESS
 /end VAR_CHARACTERISTIC
 /begin VAR_CHARACTERISTIC U8TcmfIniRisePGrdtTiFrnt01 BrkCalVariantCriterion
  /begin VAR_ADDRESS 0x80021305 0x80024705 0x80027B05 0x8002AF05 0x8002E305 0x80031705 0x80034B05 0x80037F05 /end VAR_ADDRESS
 /end VAR_CHARACTERISTIC
 /begin VAR_CHARACTERISTIC U8TcmfIniRisePGrdtTiFrnt02 BrkCalVariantCriterion
  /begin VAR_ADDRESS 0x80021306 0x80024706 0x80027B06 0x8002AF06 0x8002E306 0x80031706 0x80034B06 0x80037F06 /end VAR_ADDRESS
 /end VAR_CHARACTERISTIC
 /begin VAR_CHARACTERISTIC U8TcmfIniRisePGrdtTiFrnt03 BrkCalVariantCriterion
  /begin VAR_ADDRESS 0x80021307 0x80024707 0x80027B07 0x8002AF07 0x8002E307 0x80031707 0x80034B07 0x80037F07 /end VAR_ADDRESS
 /end VAR_CHARACTERISTIC
 /begin VAR_CHARACTERISTIC U8TcmfIniRisePGrdtTiFrnt04 BrkCalVariantCriterion
  /begin VAR_ADDRESS 0x80021308 0x80024708 0x80027B08 0x8002AF08 0x8002E308 0x80031708 0x80034B08 0x80037F08 /end VAR_ADDRESS
 /end VAR_CHARACTERISTIC
 /begin VAR_CHARACTERISTIC U8TcmfIniRisePGrdtTiFrnt05 BrkCalVariantCriterion
  /begin VAR_ADDRESS 0x80021309 0x80024709 0x80027B09 0x8002AF09 0x8002E309 0x80031709 0x80034B09 0x80037F09 /end VAR_ADDRESS
 /end VAR_CHARACTERISTIC
 /begin VAR_CHARACTERISTIC U8TcmfIniRisePGrdtTiFrnt06 BrkCalVariantCriterion
  /begin VAR_ADDRESS 0x8002130A 0x8002470A 0x80027B0A 0x8002AF0A 0x8002E30A 0x8003170A 0x80034B0A 0x80037F0A /end VAR_ADDRESS
 /end VAR_CHARACTERISTIC
 /begin VAR_CHARACTERISTIC U8TcmfIniRisePGrdtTiFrnt07 BrkCalVariantCriterion
  /begin VAR_ADDRESS 0x8002130B 0x8002470B 0x80027B0B 0x8002AF0B 0x8002E30B 0x8003170B 0x80034B0B 0x80037F0B /end VAR_ADDRESS
 /end VAR_CHARACTERISTIC
 /begin VAR_CHARACTERISTIC U8TcmfIniRisePGrdtTiFrnt08 BrkCalVariantCriterion
  /begin VAR_ADDRESS 0x8002130C 0x8002470C 0x80027B0C 0x8002AF0C 0x8002E30C 0x8003170C 0x80034B0C 0x80037F0C /end VAR_ADDRESS
 /end VAR_CHARACTERISTIC
 /begin VAR_CHARACTERISTIC U8TcmfIniRisePGrdtTiFrnt09 BrkCalVariantCriterion
  /begin VAR_ADDRESS 0x8002130D 0x8002470D 0x80027B0D 0x8002AF0D 0x8002E30D 0x8003170D 0x80034B0D 0x80037F0D /end VAR_ADDRESS
 /end VAR_CHARACTERISTIC
 /begin VAR_CHARACTERISTIC U8TcmfIniRisePGrdtTiFrnt10 BrkCalVariantCriterion
  /begin VAR_ADDRESS 0x8002130E 0x8002470E 0x80027B0E 0x8002AF0E 0x8002E30E 0x8003170E 0x80034B0E 0x80037F0E /end VAR_ADDRESS
 /end VAR_CHARACTERISTIC
 /begin VAR_CHARACTERISTIC U8TcmfIniRisePGrdtTiFrnt11 BrkCalVariantCriterion
  /begin VAR_ADDRESS 0x8002130F 0x8002470F 0x80027B0F 0x8002AF0F 0x8002E30F 0x8003170F 0x80034B0F 0x80037F0F /end VAR_ADDRESS
 /end VAR_CHARACTERISTIC
 /begin VAR_CHARACTERISTIC U8TcmfIniRisePGrdtTiFrnt12 BrkCalVariantCriterion
  /begin VAR_ADDRESS 0x80021310 0x80024710 0x80027B10 0x8002AF10 0x8002E310 0x80031710 0x80034B10 0x80037F10 /end VAR_ADDRESS
 /end VAR_CHARACTERISTIC
 /begin VAR_CHARACTERISTIC U8TcmfIniRisePGrdtTiFrnt13 BrkCalVariantCriterion
  /begin VAR_ADDRESS 0x80021311 0x80024711 0x80027B11 0x8002AF11 0x8002E311 0x80031711 0x80034B11 0x80037F11 /end VAR_ADDRESS
 /end VAR_CHARACTERISTIC
 /begin VAR_CHARACTERISTIC U8TcmfIniRisePGrdtTiFrnt14 BrkCalVariantCriterion
  /begin VAR_ADDRESS 0x80021312 0x80024712 0x80027B12 0x8002AF12 0x8002E312 0x80031712 0x80034B12 0x80037F12 /end VAR_ADDRESS
 /end VAR_CHARACTERISTIC
 /begin VAR_CHARACTERISTIC U8TcmfIniRisePGrdtTiRe01 BrkCalVariantCriterion
  /begin VAR_ADDRESS 0x80021313 0x80024713 0x80027B13 0x8002AF13 0x8002E313 0x80031713 0x80034B13 0x80037F13 /end VAR_ADDRESS
 /end VAR_CHARACTERISTIC
 /begin VAR_CHARACTERISTIC U8TcmfIniRisePGrdtTiRe02 BrkCalVariantCriterion
  /begin VAR_ADDRESS 0x80021314 0x80024714 0x80027B14 0x8002AF14 0x8002E314 0x80031714 0x80034B14 0x80037F14 /end VAR_ADDRESS
 /end VAR_CHARACTERISTIC
 /begin VAR_CHARACTERISTIC U8TcmfIniRisePGrdtTiRe03 BrkCalVariantCriterion
  /begin VAR_ADDRESS 0x80021315 0x80024715 0x80027B15 0x8002AF15 0x8002E315 0x80031715 0x80034B15 0x80037F15 /end VAR_ADDRESS
 /end VAR_CHARACTERISTIC
 /begin VAR_CHARACTERISTIC U8TcmfIniRisePGrdtTiRe04 BrkCalVariantCriterion
  /begin VAR_ADDRESS 0x80021316 0x80024716 0x80027B16 0x8002AF16 0x8002E316 0x80031716 0x80034B16 0x80037F16 /end VAR_ADDRESS
 /end VAR_CHARACTERISTIC
 /begin VAR_CHARACTERISTIC U8TcmfIniRisePGrdtTiRe05 BrkCalVariantCriterion
  /begin VAR_ADDRESS 0x80021317 0x80024717 0x80027B17 0x8002AF17 0x8002E317 0x80031717 0x80034B17 0x80037F17 /end VAR_ADDRESS
 /end VAR_CHARACTERISTIC
 /begin VAR_CHARACTERISTIC U8TcmfIniRisePGrdtTiRe06 BrkCalVariantCriterion
  /begin VAR_ADDRESS 0x80021318 0x80024718 0x80027B18 0x8002AF18 0x8002E318 0x80031718 0x80034B18 0x80037F18 /end VAR_ADDRESS
 /end VAR_CHARACTERISTIC
 /begin VAR_CHARACTERISTIC U8TcmfIniRisePGrdtTiRe07 BrkCalVariantCriterion
  /begin VAR_ADDRESS 0x80021319 0x80024719 0x80027B19 0x8002AF19 0x8002E319 0x80031719 0x80034B19 0x80037F19 /end VAR_ADDRESS
 /end VAR_CHARACTERISTIC
 /begin VAR_CHARACTERISTIC U8TcmfIniRisePGrdtTiRe08 BrkCalVariantCriterion
  /begin VAR_ADDRESS 0x8002131A 0x8002471A 0x80027B1A 0x8002AF1A 0x8002E31A 0x8003171A 0x80034B1A 0x80037F1A /end VAR_ADDRESS
 /end VAR_CHARACTERISTIC
 /begin VAR_CHARACTERISTIC U8TcmfIniRisePGrdtTiRe09 BrkCalVariantCriterion
  /begin VAR_ADDRESS 0x8002131B 0x8002471B 0x80027B1B 0x8002AF1B 0x8002E31B 0x8003171B 0x80034B1B 0x80037F1B /end VAR_ADDRESS
 /end VAR_CHARACTERISTIC
 /begin VAR_CHARACTERISTIC U8TcmfIniRisePGrdtTiRe10 BrkCalVariantCriterion
  /begin VAR_ADDRESS 0x8002131C 0x8002471C 0x80027B1C 0x8002AF1C 0x8002E31C 0x8003171C 0x80034B1C 0x80037F1C /end VAR_ADDRESS
 /end VAR_CHARACTERISTIC
 /begin VAR_CHARACTERISTIC U8TcmfIniRisePGrdtTiRe11 BrkCalVariantCriterion
  /begin VAR_ADDRESS 0x8002131D 0x8002471D 0x80027B1D 0x8002AF1D 0x8002E31D 0x8003171D 0x80034B1D 0x80037F1D /end VAR_ADDRESS
 /end VAR_CHARACTERISTIC
 /begin VAR_CHARACTERISTIC U8TcmfIniRisePGrdtTiRe12 BrkCalVariantCriterion
  /begin VAR_ADDRESS 0x8002131E 0x8002471E 0x80027B1E 0x8002AF1E 0x8002E31E 0x8003171E 0x80034B1E 0x80037F1E /end VAR_ADDRESS
 /end VAR_CHARACTERISTIC
 /begin VAR_CHARACTERISTIC U8TcmfIniRisePGrdtTiRe13 BrkCalVariantCriterion
  /begin VAR_ADDRESS 0x8002131F 0x8002471F 0x80027B1F 0x8002AF1F 0x8002E31F 0x8003171F 0x80034B1F 0x80037F1F /end VAR_ADDRESS
 /end VAR_CHARACTERISTIC
 /begin VAR_CHARACTERISTIC U8TcmfIniRisePGrdtTiRe14 BrkCalVariantCriterion
  /begin VAR_ADDRESS 0x80021320 0x80024720 0x80027B20 0x8002AF20 0x8002E320 0x80031720 0x80034B20 0x80037F20 /end VAR_ADDRESS
 /end VAR_CHARACTERISTIC
 /begin VAR_CHARACTERISTIC U8TcmfRiseAftCompPatTiFrnt1 BrkCalVariantCriterion
  /begin VAR_ADDRESS 0x8002133B 0x8002473B 0x80027B3B 0x8002AF3B 0x8002E33B 0x8003173B 0x80034B3B 0x80037F3B /end VAR_ADDRESS
 /end VAR_CHARACTERISTIC
 /begin VAR_CHARACTERISTIC U8TcmfRiseAftCompPatTiFrnt2 BrkCalVariantCriterion
  /begin VAR_ADDRESS 0x8002133C 0x8002473C 0x80027B3C 0x8002AF3C 0x8002E33C 0x8003173C 0x80034B3C 0x80037F3C /end VAR_ADDRESS
 /end VAR_CHARACTERISTIC
 /begin VAR_CHARACTERISTIC U8TcmfRiseAftCompPatTiFrnt3 BrkCalVariantCriterion
  /begin VAR_ADDRESS 0x8002133D 0x8002473D 0x80027B3D 0x8002AF3D 0x8002E33D 0x8003173D 0x80034B3D 0x80037F3D /end VAR_ADDRESS
 /end VAR_CHARACTERISTIC
 /begin VAR_CHARACTERISTIC U8TcmfRiseAftCompPatTiRe1 BrkCalVariantCriterion
  /begin VAR_ADDRESS 0x80021347 0x80024747 0x80027B47 0x8002AF47 0x8002E347 0x80031747 0x80034B47 0x80037F47 /end VAR_ADDRESS
 /end VAR_CHARACTERISTIC
 /begin VAR_CHARACTERISTIC U8TcmfRiseAftCompPatTiRe2 BrkCalVariantCriterion
  /begin VAR_ADDRESS 0x80021348 0x80024748 0x80027B48 0x8002AF48 0x8002E348 0x80031748 0x80034B48 0x80037F48 /end VAR_ADDRESS
 /end VAR_CHARACTERISTIC
 /begin VAR_CHARACTERISTIC U8TcmfRiseAftCompPatTiRe3 BrkCalVariantCriterion
  /begin VAR_ADDRESS 0x80021349 0x80024749 0x80027B49 0x8002AF49 0x8002E349 0x80031749 0x80034B49 0x80037F49 /end VAR_ADDRESS
 /end VAR_CHARACTERISTIC
 /begin VAR_CHARACTERISTIC U8TcmfRisePGrdtIncTcVlvCurFrnt1 BrkCalVariantCriterion
  /begin VAR_ADDRESS 0x80021352 0x80024752 0x80027B52 0x8002AF52 0x8002E352 0x80031752 0x80034B52 0x80037F52 /end VAR_ADDRESS
 /end VAR_CHARACTERISTIC
 /begin VAR_CHARACTERISTIC U8TcmfRisePGrdtIncTcVlvCurFrnt2 BrkCalVariantCriterion
  /begin VAR_ADDRESS 0x80021353 0x80024753 0x80027B53 0x8002AF53 0x8002E353 0x80031753 0x80034B53 0x80037F53 /end VAR_ADDRESS
 /end VAR_CHARACTERISTIC
 /begin VAR_CHARACTERISTIC U8TcmfRisePGrdtIncTcVlvCurFrnt3 BrkCalVariantCriterion
  /begin VAR_ADDRESS 0x80021354 0x80024754 0x80027B54 0x8002AF54 0x8002E354 0x80031754 0x80034B54 0x80037F54 /end VAR_ADDRESS
 /end VAR_CHARACTERISTIC
 /begin VAR_CHARACTERISTIC U8TcmfRisePGrdtIncTcVlvCurRe1 BrkCalVariantCriterion
  /begin VAR_ADDRESS 0x80021355 0x80024755 0x80027B55 0x8002AF55 0x8002E355 0x80031755 0x80034B55 0x80037F55 /end VAR_ADDRESS
 /end VAR_CHARACTERISTIC
 /begin VAR_CHARACTERISTIC U8TcmfRisePGrdtIncTcVlvCurRe2 BrkCalVariantCriterion
  /begin VAR_ADDRESS 0x80021356 0x80024756 0x80027B56 0x8002AF56 0x8002E356 0x80031756 0x80034B56 0x80037F56 /end VAR_ADDRESS
 /end VAR_CHARACTERISTIC
 /begin VAR_CHARACTERISTIC U8TcmfRisePGrdtIncTcVlvCurRe3 BrkCalVariantCriterion
  /begin VAR_ADDRESS 0x80021357 0x80024757 0x80027B57 0x8002AF57 0x8002E357 0x80031757 0x80034B57 0x80037F57 /end VAR_ADDRESS
 /end VAR_CHARACTERISTIC
 /begin VAR_CHARACTERISTIC U8TcmfRisePatTiFrnt1 BrkCalVariantCriterion
  /begin VAR_ADDRESS 0x80021338 0x80024738 0x80027B38 0x8002AF38 0x8002E338 0x80031738 0x80034B38 0x80037F38 /end VAR_ADDRESS
 /end VAR_CHARACTERISTIC
 /begin VAR_CHARACTERISTIC U8TcmfRisePatTiFrnt2 BrkCalVariantCriterion
  /begin VAR_ADDRESS 0x80021339 0x80024739 0x80027B39 0x8002AF39 0x8002E339 0x80031739 0x80034B39 0x80037F39 /end VAR_ADDRESS
 /end VAR_CHARACTERISTIC
 /begin VAR_CHARACTERISTIC U8TcmfRisePatTiFrnt3 BrkCalVariantCriterion
  /begin VAR_ADDRESS 0x8002133A 0x8002473A 0x80027B3A 0x8002AF3A 0x8002E33A 0x8003173A 0x80034B3A 0x80037F3A /end VAR_ADDRESS
 /end VAR_CHARACTERISTIC
 /begin VAR_CHARACTERISTIC U8TcmfRisePatTiRe1 BrkCalVariantCriterion
  /begin VAR_ADDRESS 0x80021344 0x80024744 0x80027B44 0x8002AF44 0x8002E344 0x80031744 0x80034B44 0x80037F44 /end VAR_ADDRESS
 /end VAR_CHARACTERISTIC
 /begin VAR_CHARACTERISTIC U8TcmfRisePatTiRe2 BrkCalVariantCriterion
  /begin VAR_ADDRESS 0x80021345 0x80024745 0x80027B45 0x8002AF45 0x8002E345 0x80031745 0x80034B45 0x80037F45 /end VAR_ADDRESS
 /end VAR_CHARACTERISTIC
 /begin VAR_CHARACTERISTIC U8TcmfRisePatTiRe3 BrkCalVariantCriterion
  /begin VAR_ADDRESS 0x80021346 0x80024746 0x80027B46 0x8002AF46 0x8002E346 0x80031746 0x80034B46 0x80037F46 /end VAR_ADDRESS
 /end VAR_CHARACTERISTIC
 /begin VAR_CHARACTERISTIC U8WhlTeethFrnt BrkCalVariantCriterion
  /begin VAR_ADDRESS 0x8002001C 0x8002341C 0x8002681C 0x80029C1C 0x8002D01C 0x8003041C 0x8003381C 0x80036C1C /end VAR_ADDRESS
 /end VAR_CHARACTERISTIC
 /begin VAR_CHARACTERISTIC U8WhlTeethRe BrkCalVariantCriterion
  /begin VAR_ADDRESS 0x8002001D 0x8002341D 0x8002681D 0x80029C1D 0x8002D01D 0x8003041D 0x8003381D 0x80036C1D /end VAR_ADDRESS
 /end VAR_CHARACTERISTIC
 /begin VAR_CHARACTERISTIC U8_ACC_ENGTORQSLOPE_G1_MAX EngCalVariantCriterion
  /begin VAR_ADDRESS 0x8003A8F6 0x8003B6F6 0x8003C4F6 0x8003D2F6 0x8003E0F6 0x8003EEF6 0x8003FCF6 0x80040AF6 0x800418F6 0x800426F6 0x800434F6 0x800442F6 0x800450F6 0x80045EF6 0x80046CF6 0x80047AF6 0x800488F6 0x800496F6 0x8004A4F6 0x8004B2F6 0x8004C0F6 0x8004CEF6 0x8004DCF6 0x8004EAF6 /end VAR_ADDRESS
 /end VAR_CHARACTERISTIC
 /begin VAR_CHARACTERISTIC U8_ACC_ENGTORQSLOPE_G1_MIN EngCalVariantCriterion
  /begin VAR_ADDRESS 0x8003A8F7 0x8003B6F7 0x8003C4F7 0x8003D2F7 0x8003E0F7 0x8003EEF7 0x8003FCF7 0x80040AF7 0x800418F7 0x800426F7 0x800434F7 0x800442F7 0x800450F7 0x80045EF7 0x80046CF7 0x80047AF7 0x800488F7 0x800496F7 0x8004A4F7 0x8004B2F7 0x8004C0F7 0x8004CEF7 0x8004DCF7 0x8004EAF7 /end VAR_ADDRESS
 /end VAR_CHARACTERISTIC
 /begin VAR_CHARACTERISTIC U8_ACC_ENGTORQSLOPE_MAX EngCalVariantCriterion
  /begin VAR_ADDRESS 0x8003A8F8 0x8003B6F8 0x8003C4F8 0x8003D2F8 0x8003E0F8 0x8003EEF8 0x8003FCF8 0x80040AF8 0x800418F8 0x800426F8 0x800434F8 0x800442F8 0x800450F8 0x80045EF8 0x80046CF8 0x80047AF8 0x800488F8 0x800496F8 0x8004A4F8 0x8004B2F8 0x8004C0F8 0x8004CEF8 0x8004DCF8 0x8004EAF8 /end VAR_ADDRESS
 /end VAR_CHARACTERISTIC
 /begin VAR_CHARACTERISTIC U8_ACC_ENGTORQSLOPE_MIN EngCalVariantCriterion
  /begin VAR_ADDRESS 0x8003A8F9 0x8003B6F9 0x8003C4F9 0x8003D2F9 0x8003E0F9 0x8003EEF9 0x8003FCF9 0x80040AF9 0x800418F9 0x800426F9 0x800434F9 0x800442F9 0x800450F9 0x80045EF9 0x80046CF9 0x80047AF9 0x800488F9 0x800496F9 0x8004A4F9 0x8004B2F9 0x8004C0F9 0x8004CEF9 0x8004DCF9 0x8004EAF9 /end VAR_ADDRESS
 /end VAR_CHARACTERISTIC
 /begin VAR_CHARACTERISTIC U8_ACC_ENGTORQ_OFFSET_HIGHSPD EngCalVariantCriterion
  /begin VAR_ADDRESS 0x8003A8FA 0x8003B6FA 0x8003C4FA 0x8003D2FA 0x8003E0FA 0x8003EEFA 0x8003FCFA 0x80040AFA 0x800418FA 0x800426FA 0x800434FA 0x800442FA 0x800450FA 0x80045EFA 0x80046CFA 0x80047AFA 0x800488FA 0x800496FA 0x8004A4FA 0x8004B2FA 0x8004C0FA 0x8004CEFA 0x8004DCFA 0x8004EAFA /end VAR_ADDRESS
 /end VAR_CHARACTERISTIC
 /begin VAR_CHARACTERISTIC U8_ACC_ENGTORQ_OFFSET_LOWSPD EngCalVariantCriterion
  /begin VAR_ADDRESS 0x8003A8FB 0x8003B6FB 0x8003C4FB 0x8003D2FB 0x8003E0FB 0x8003EEFB 0x8003FCFB 0x80040AFB 0x800418FB 0x800426FB 0x800434FB 0x800442FB 0x800450FB 0x80045EFB 0x80046CFB 0x80047AFB 0x800488FB 0x800496FB 0x8004A4FB 0x8004B2FB 0x8004C0FB 0x8004CEFB 0x8004DCFB 0x8004EAFB /end VAR_ADDRESS
 /end VAR_CHARACTERISTIC
 /begin VAR_CHARACTERISTIC U8_ACC_ENG_FADEOUT_SLOPE EngCalVariantCriterion
  /begin VAR_ADDRESS 0x8003A8FC 0x8003B6FC 0x8003C4FC 0x8003D2FC 0x8003E0FC 0x8003EEFC 0x8003FCFC 0x80040AFC 0x800418FC 0x800426FC 0x800434FC 0x800442FC 0x800450FC 0x80045EFC 0x80046CFC 0x80047AFC 0x800488FC 0x800496FC 0x8004A4FC 0x8004B2FC 0x8004C0FC 0x8004CEFC 0x8004DCFC 0x8004EAFC /end VAR_ADDRESS
 /end VAR_CHARACTERISTIC
 /begin VAR_CHARACTERISTIC U8_ACC_FF_DEC_FACTOR_NEG_G EngCalVariantCriterion
  /begin VAR_ADDRESS 0x8003A8E4 0x8003B6E4 0x8003C4E4 0x8003D2E4 0x8003E0E4 0x8003EEE4 0x8003FCE4 0x80040AE4 0x800418E4 0x800426E4 0x800434E4 0x800442E4 0x800450E4 0x80045EE4 0x80046CE4 0x80047AE4 0x800488E4 0x800496E4 0x8004A4E4 0x8004B2E4 0x8004C0E4 0x8004CEE4 0x8004DCE4 0x8004EAE4 /end VAR_ADDRESS
 /end VAR_CHARACTERISTIC
 /begin VAR_CHARACTERISTIC U8_ACC_FF_DEC_FACTOR_POS_G EngCalVariantCriterion
  /begin VAR_ADDRESS 0x8003A8D2 0x8003B6D2 0x8003C4D2 0x8003D2D2 0x8003E0D2 0x8003EED2 0x8003FCD2 0x80040AD2 0x800418D2 0x800426D2 0x800434D2 0x800442D2 0x800450D2 0x80045ED2 0x80046CD2 0x80047AD2 0x800488D2 0x800496D2 0x8004A4D2 0x8004B2D2 0x8004C0D2 0x8004CED2 0x8004DCD2 0x8004EAD2 /end VAR_ADDRESS
 /end VAR_CHARACTERISTIC
 /begin VAR_CHARACTERISTIC U8_ACC_FF_HILL_FACTOR_NEG_G EngCalVariantCriterion
  /begin VAR_ADDRESS 0x8003A8D3 0x8003B6D3 0x8003C4D3 0x8003D2D3 0x8003E0D3 0x8003EED3 0x8003FCD3 0x80040AD3 0x800418D3 0x800426D3 0x800434D3 0x800442D3 0x800450D3 0x80045ED3 0x80046CD3 0x80047AD3 0x800488D3 0x800496D3 0x8004A4D3 0x8004B2D3 0x8004C0D3 0x8004CED3 0x8004DCD3 0x8004EAD3 /end VAR_ADDRESS
 /end VAR_CHARACTERISTIC
 /begin VAR_CHARACTERISTIC U8_ACC_FF_ROLLING_RESIST_FACTOR EngCalVariantCriterion
  /begin VAR_ADDRESS 0x8003A8D4 0x8003B6D4 0x8003C4D4 0x8003D2D4 0x8003E0D4 0x8003EED4 0x8003FCD4 0x80040AD4 0x800418D4 0x800426D4 0x800434D4 0x800442D4 0x800450D4 0x80045ED4 0x80046CD4 0x80047AD4 0x800488D4 0x800496D4 0x8004A4D4 0x8004B2D4 0x8004C0D4 0x8004CED4 0x8004DCD4 0x8004EAD4 /end VAR_ADDRESS
 /end VAR_CHARACTERISTIC
 /begin VAR_CHARACTERISTIC U8_ACC_FF_VREF_FACTOR EngCalVariantCriterion
  /begin VAR_ADDRESS 0x8003A8D1 0x8003B6D1 0x8003C4D1 0x8003D2D1 0x8003E0D1 0x8003EED1 0x8003FCD1 0x80040AD1 0x800418D1 0x800426D1 0x800434D1 0x800442D1 0x800450D1 0x80045ED1 0x80046CD1 0x80047AD1 0x800488D1 0x800496D1 0x8004A4D1 0x8004B2D1 0x8004C0D1 0x8004CED1 0x8004DCD1 0x8004EAD1 /end VAR_ADDRESS
 /end VAR_CHARACTERISTIC
 /begin VAR_CHARACTERISTIC U8_ACC_G_SLOPE_HILLUP_STOP BrkCalVariantCriterion
  /begin VAR_ADDRESS 0x80021030 0x80024430 0x80027830 0x8002AC30 0x8002E030 0x80031430 0x80034830 0x80037C30 /end VAR_ADDRESS
 /end VAR_CHARACTERISTIC
 /begin VAR_CHARACTERISTIC U8_ACC_G_SLOPE_HILL_STOP BrkCalVariantCriterion
  /begin VAR_ADDRESS 0x80021031 0x80024431 0x80027831 0x8002AC31 0x8002E031 0x80031431 0x80034831 0x80037C31 /end VAR_ADDRESS
 /end VAR_CHARACTERISTIC
 /begin VAR_CHARACTERISTIC U8_ACC_G_SLOPE_STOP BrkCalVariantCriterion
  /begin VAR_ADDRESS 0x80021032 0x80024432 0x80027832 0x8002AC32 0x8002E032 0x80031432 0x80034832 0x80037C32 /end VAR_ADDRESS
 /end VAR_CHARACTERISTIC
 /begin VAR_CHARACTERISTIC U8_ACC_G_SLOPE_STOP_CNT BrkCalVariantCriterion
  /begin VAR_ADDRESS 0x80021033 0x80024433 0x80027833 0x8002AC33 0x8002E033 0x80031433 0x80034833 0x80037C33 /end VAR_ADDRESS
 /end VAR_CHARACTERISTIC
 /begin VAR_CHARACTERISTIC U8_ACC_I_GAIN_AMP_BRK_HILL EngCalVariantCriterion
  /begin VAR_ADDRESS 0x8003A8E1 0x8003B6E1 0x8003C4E1 0x8003D2E1 0x8003E0E1 0x8003EEE1 0x8003FCE1 0x80040AE1 0x800418E1 0x800426E1 0x800434E1 0x800442E1 0x800450E1 0x80045EE1 0x80046CE1 0x80047AE1 0x800488E1 0x800496E1 0x8004A4E1 0x8004B2E1 0x8004C0E1 0x8004CEE1 0x8004DCE1 0x8004EAE1 /end VAR_ADDRESS
 /end VAR_CHARACTERISTIC
 /begin VAR_CHARACTERISTIC U8_ACC_I_GAIN_AMP_ENG_HILL EngCalVariantCriterion
  /begin VAR_ADDRESS 0x8003A8E2 0x8003B6E2 0x8003C4E2 0x8003D2E2 0x8003E0E2 0x8003EEE2 0x8003FCE2 0x80040AE2 0x800418E2 0x800426E2 0x800434E2 0x800442E2 0x800450E2 0x80045EE2 0x80046CE2 0x80047AE2 0x800488E2 0x800496E2 0x8004A4E2 0x8004B2E2 0x8004C0E2 0x8004CEE2 0x8004DCE2 0x8004EAE2 /end VAR_ADDRESS
 /end VAR_CHARACTERISTIC
 /begin VAR_CHARACTERISTIC U8_ACC_I_PSEUDO_GAIN_ERROR_BRAKE_H EngCalVariantCriterion
  /begin VAR_ADDRESS 0x8003A902 0x8003B702 0x8003C502 0x8003D302 0x8003E102 0x8003EF02 0x8003FD02 0x80040B02 0x80041902 0x80042702 0x80043502 0x80044302 0x80045102 0x80045F02 0x80046D02 0x80047B02 0x80048902 0x80049702 0x8004A502 0x8004B302 0x8004C102 0x8004CF02 0x8004DD02 0x8004EB02 /end VAR_ADDRESS
 /end VAR_CHARACTERISTIC
 /begin VAR_CHARACTERISTIC U8_ACC_I_PSEUDO_GAIN_ERROR_BRAKE_S EngCalVariantCriterion
  /begin VAR_ADDRESS 0x8003A903 0x8003B703 0x8003C503 0x8003D303 0x8003E103 0x8003EF03 0x8003FD03 0x80040B03 0x80041903 0x80042703 0x80043503 0x80044303 0x80045103 0x80045F03 0x80046D03 0x80047B03 0x80048903 0x80049703 0x8004A503 0x8004B303 0x8004C103 0x8004CF03 0x8004DD03 0x8004EB03 /end VAR_ADDRESS
 /end VAR_CHARACTERISTIC
 /begin VAR_CHARACTERISTIC U8_ACC_I_PSEUDO_GAIN_ERROR_NEG_H EngCalVariantCriterion
  /begin VAR_ADDRESS 0x8003A904 0x8003B704 0x8003C504 0x8003D304 0x8003E104 0x8003EF04 0x8003FD04 0x80040B04 0x80041904 0x80042704 0x80043504 0x80044304 0x80045104 0x80045F04 0x80046D04 0x80047B04 0x80048904 0x80049704 0x8004A504 0x8004B304 0x8004C104 0x8004CF04 0x8004DD04 0x8004EB04 /end VAR_ADDRESS
 /end VAR_CHARACTERISTIC
 /begin VAR_CHARACTERISTIC U8_ACC_I_PSEUDO_GAIN_ERROR_NEG_S EngCalVariantCriterion
  /begin VAR_ADDRESS 0x8003A905 0x8003B705 0x8003C505 0x8003D305 0x8003E105 0x8003EF05 0x8003FD05 0x80040B05 0x80041905 0x80042705 0x80043505 0x80044305 0x80045105 0x80045F05 0x80046D05 0x80047B05 0x80048905 0x80049705 0x8004A505 0x8004B305 0x8004C105 0x8004CF05 0x8004DD05 0x8004EB05 /end VAR_ADDRESS
 /end VAR_CHARACTERISTIC
 /begin VAR_CHARACTERISTIC U8_ACC_I_PSEUDO_GAIN_ERROR_POS_H EngCalVariantCriterion
  /begin VAR_ADDRESS 0x8003A906 0x8003B706 0x8003C506 0x8003D306 0x8003E106 0x8003EF06 0x8003FD06 0x80040B06 0x80041906 0x80042706 0x80043506 0x80044306 0x80045106 0x80045F06 0x80046D06 0x80047B06 0x80048906 0x80049706 0x8004A506 0x8004B306 0x8004C106 0x8004CF06 0x8004DD06 0x8004EB06 /end VAR_ADDRESS
 /end VAR_CHARACTERISTIC
 /begin VAR_CHARACTERISTIC U8_ACC_I_PSEUDO_GAIN_ERROR_POS_S EngCalVariantCriterion
  /begin VAR_ADDRESS 0x8003A907 0x8003B707 0x8003C507 0x8003D307 0x8003E107 0x8003EF07 0x8003FD07 0x80040B07 0x80041907 0x80042707 0x80043507 0x80044307 0x80045107 0x80045F07 0x80046D07 0x80047B07 0x80048907 0x80049707 0x8004A507 0x8004B307 0x8004C107 0x8004CF07 0x8004DD07 0x8004EB07 /end VAR_ADDRESS
 /end VAR_CHARACTERISTIC
 /begin VAR_CHARACTERISTIC U8_ACC_PIDHOLD_MAXSPD BrkCalVariantCriterion
  /begin VAR_ADDRESS 0x80021034 0x80024434 0x80027834 0x8002AC34 0x8002E034 0x80031434 0x80034834 0x80037C34 /end VAR_ADDRESS
 /end VAR_CHARACTERISTIC
 /begin VAR_CHARACTERISTIC U8_ACC_PID_GAIN_DIV_ENG_HILL EngCalVariantCriterion
  /begin VAR_ADDRESS 0x8003A8E3 0x8003B6E3 0x8003C4E3 0x8003D2E3 0x8003E0E3 0x8003EEE3 0x8003FCE3 0x80040AE3 0x800418E3 0x800426E3 0x800434E3 0x800442E3 0x800450E3 0x80045EE3 0x80046CE3 0x80047AE3 0x800488E3 0x800496E3 0x8004A4E3 0x8004B2E3 0x8004C0E3 0x8004CEE3 0x8004DCE3 0x8004EAE3 /end VAR_ADDRESS
 /end VAR_CHARACTERISTIC
 /begin VAR_CHARACTERISTIC U8_ACC_PRESS_RESET_THD BrkCalVariantCriterion
  /begin VAR_ADDRESS 0x8002102C 0x8002442C 0x8002782C 0x8002AC2C 0x8002E02C 0x8003142C 0x8003482C 0x80037C2C /end VAR_ADDRESS
 /end VAR_CHARACTERISTIC
 /begin VAR_CHARACTERISTIC U8_ACC_PRESS_SET_THD BrkCalVariantCriterion
  /begin VAR_ADDRESS 0x8002102D 0x8002442D 0x8002782D 0x8002AC2D 0x8002E02D 0x8003142D 0x8003482D 0x80037C2D /end VAR_ADDRESS
 /end VAR_CHARACTERISTIC
 /begin VAR_CHARACTERISTIC U8_ACC_SLOPE_STOP_FACTOR BrkCalVariantCriterion
  /begin VAR_ADDRESS 0x80021035 0x80024435 0x80027835 0x8002AC35 0x8002E035 0x80031435 0x80034835 0x80037C35 /end VAR_ADDRESS
 /end VAR_CHARACTERISTIC
 /begin VAR_CHARACTERISTIC U8_ACC_TARGET_ENGTQ_MAX EngCalVariantCriterion
  /begin VAR_ADDRESS 0x8003A8D0 0x8003B6D0 0x8003C4D0 0x8003D2D0 0x8003E0D0 0x8003EED0 0x8003FCD0 0x80040AD0 0x800418D0 0x800426D0 0x800434D0 0x800442D0 0x800450D0 0x80045ED0 0x80046CD0 0x80047AD0 0x800488D0 0x800496D0 0x8004A4D0 0x8004B2D0 0x8004C0D0 0x8004CED0 0x8004DCD0 0x8004EAD0 /end VAR_ADDRESS
 /end VAR_CHARACTERISTIC
 /begin VAR_CHARACTERISTIC U8_ACC_TARGET_TQ_MIN_STOP EngCalVariantCriterion
  /begin VAR_ADDRESS 0x8003A908 0x8003B708 0x8003C508 0x8003D308 0x8003E108 0x8003EF08 0x8003FD08 0x80040B08 0x80041908 0x80042708 0x80043508 0x80044308 0x80045108 0x80045F08 0x80046D08 0x80047B08 0x80048908 0x80049708 0x8004A508 0x8004B308 0x8004C108 0x8004CF08 0x8004DD08 0x8004EB08 /end VAR_ADDRESS
 /end VAR_CHARACTERISTIC
 /begin VAR_CHARACTERISTIC U8_ACC_TARGET_TQ_MIN_STOP_HILL_DOWN EngCalVariantCriterion
  /begin VAR_ADDRESS 0x8003A909 0x8003B709 0x8003C509 0x8003D309 0x8003E109 0x8003EF09 0x8003FD09 0x80040B09 0x80041909 0x80042709 0x80043509 0x80044309 0x80045109 0x80045F09 0x80046D09 0x80047B09 0x80048909 0x80049709 0x8004A509 0x8004B309 0x8004C109 0x8004CF09 0x8004DD09 0x8004EB09 /end VAR_ADDRESS
 /end VAR_CHARACTERISTIC
 /begin VAR_CHARACTERISTIC U8_ACC_TARGET_TQ_MIN_STOP_HILL_UP EngCalVariantCriterion
  /begin VAR_ADDRESS 0x8003A90A 0x8003B70A 0x8003C50A 0x8003D30A 0x8003E10A 0x8003EF0A 0x8003FD0A 0x80040B0A 0x8004190A 0x8004270A 0x8004350A 0x8004430A 0x8004510A 0x80045F0A 0x80046D0A 0x80047B0A 0x8004890A 0x8004970A 0x8004A50A 0x8004B30A 0x8004C10A 0x8004CF0A 0x8004DD0A 0x8004EB0A /end VAR_ADDRESS
 /end VAR_CHARACTERISTIC
 /begin VAR_CHARACTERISTIC U8_ACC_TEMP_01 BrkCalVariantCriterion
  /begin VAR_ADDRESS 0x80021046 0x80024446 0x80027846 0x8002AC46 0x8002E046 0x80031446 0x80034846 0x80037C46 /end VAR_ADDRESS
 /end VAR_CHARACTERISTIC
 /begin VAR_CHARACTERISTIC U8_ACC_TEMP_02 BrkCalVariantCriterion
  /begin VAR_ADDRESS 0x80021047 0x80024447 0x80027847 0x8002AC47 0x8002E047 0x80031447 0x80034847 0x80037C47 /end VAR_ADDRESS
 /end VAR_CHARACTERISTIC
 /begin VAR_CHARACTERISTIC U8_ACC_TEMP_03 BrkCalVariantCriterion
  /begin VAR_ADDRESS 0x80021048 0x80024448 0x80027848 0x8002AC48 0x8002E048 0x80031448 0x80034848 0x80037C48 /end VAR_ADDRESS
 /end VAR_CHARACTERISTIC
 /begin VAR_CHARACTERISTIC U8_ACC_TEMP_04 BrkCalVariantCriterion
  /begin VAR_ADDRESS 0x80021049 0x80024449 0x80027849 0x8002AC49 0x8002E049 0x80031449 0x80034849 0x80037C49 /end VAR_ADDRESS
 /end VAR_CHARACTERISTIC
 /begin VAR_CHARACTERISTIC U8_AEB_FF_DEC_FACTOR_NEG_G EngCalVariantCriterion
  /begin VAR_ADDRESS 0x8003A929 0x8003B729 0x8003C529 0x8003D329 0x8003E129 0x8003EF29 0x8003FD29 0x80040B29 0x80041929 0x80042729 0x80043529 0x80044329 0x80045129 0x80045F29 0x80046D29 0x80047B29 0x80048929 0x80049729 0x8004A529 0x8004B329 0x8004C129 0x8004CF29 0x8004DD29 0x8004EB29 /end VAR_ADDRESS
 /end VAR_CHARACTERISTIC
 /begin VAR_CHARACTERISTIC U8_AEB_FF_DEC_FACTOR_POS_G EngCalVariantCriterion
  /begin VAR_ADDRESS 0x8003A928 0x8003B728 0x8003C528 0x8003D328 0x8003E128 0x8003EF28 0x8003FD28 0x80040B28 0x80041928 0x80042728 0x80043528 0x80044328 0x80045128 0x80045F28 0x80046D28 0x80047B28 0x80048928 0x80049728 0x8004A528 0x8004B328 0x8004C128 0x8004CF28 0x8004DD28 0x8004EB28 /end VAR_ADDRESS
 /end VAR_CHARACTERISTIC
 /begin VAR_CHARACTERISTIC U8_AEB_FF_HILL_FACTOR_NEG_G EngCalVariantCriterion
  /begin VAR_ADDRESS 0x8003A926 0x8003B726 0x8003C526 0x8003D326 0x8003E126 0x8003EF26 0x8003FD26 0x80040B26 0x80041926 0x80042726 0x80043526 0x80044326 0x80045126 0x80045F26 0x80046D26 0x80047B26 0x80048926 0x80049726 0x8004A526 0x8004B326 0x8004C126 0x8004CF26 0x8004DD26 0x8004EB26 /end VAR_ADDRESS
 /end VAR_CHARACTERISTIC
 /begin VAR_CHARACTERISTIC U8_AEB_FF_LIMIT_NEG_G EngCalVariantCriterion
  /begin VAR_ADDRESS 0x8003A92B 0x8003B72B 0x8003C52B 0x8003D32B 0x8003E12B 0x8003EF2B 0x8003FD2B 0x80040B2B 0x8004192B 0x8004272B 0x8004352B 0x8004432B 0x8004512B 0x80045F2B 0x80046D2B 0x80047B2B 0x8004892B 0x8004972B 0x8004A52B 0x8004B32B 0x8004C12B 0x8004CF2B 0x8004DD2B 0x8004EB2B /end VAR_ADDRESS
 /end VAR_CHARACTERISTIC
 /begin VAR_CHARACTERISTIC U8_AEB_FF_LIMIT_POS_G EngCalVariantCriterion
  /begin VAR_ADDRESS 0x8003A92A 0x8003B72A 0x8003C52A 0x8003D32A 0x8003E12A 0x8003EF2A 0x8003FD2A 0x80040B2A 0x8004192A 0x8004272A 0x8004352A 0x8004432A 0x8004512A 0x80045F2A 0x80046D2A 0x80047B2A 0x8004892A 0x8004972A 0x8004A52A 0x8004B32A 0x8004C12A 0x8004CF2A 0x8004DD2A 0x8004EB2A /end VAR_ADDRESS
 /end VAR_CHARACTERISTIC
 /begin VAR_CHARACTERISTIC U8_AEB_FF_ROLLING_RESIST_FACTOR EngCalVariantCriterion
  /begin VAR_ADDRESS 0x8003A927 0x8003B727 0x8003C527 0x8003D327 0x8003E127 0x8003EF27 0x8003FD27 0x80040B27 0x80041927 0x80042727 0x80043527 0x80044327 0x80045127 0x80045F27 0x80046D27 0x80047B27 0x80048927 0x80049727 0x8004A527 0x8004B327 0x8004C127 0x8004CF27 0x8004DD27 0x8004EB27 /end VAR_ADDRESS
 /end VAR_CHARACTERISTIC
 /begin VAR_CHARACTERISTIC U8_AEB_FF_VREF_FACTOR EngCalVariantCriterion
  /begin VAR_ADDRESS 0x8003A925 0x8003B725 0x8003C525 0x8003D325 0x8003E125 0x8003EF25 0x8003FD25 0x80040B25 0x80041925 0x80042725 0x80043525 0x80044325 0x80045125 0x80045F25 0x80046D25 0x80047B25 0x80048925 0x80049725 0x8004A525 0x8004B325 0x8004C125 0x8004CF25 0x8004DD25 0x8004EB25 /end VAR_ADDRESS
 /end VAR_CHARACTERISTIC
 /begin VAR_CHARACTERISTIC U8_AEB_G_SLOPE_STOP BrkCalVariantCriterion
  /begin VAR_ADDRESS 0x8002104E 0x8002444E 0x8002784E 0x8002AC4E 0x8002E04E 0x8003144E 0x8003484E 0x80037C4E /end VAR_ADDRESS
 /end VAR_CHARACTERISTIC
 /begin VAR_CHARACTERISTIC U8_AEB_I_PSEUDO_GAIN_BRAKE EngCalVariantCriterion
  /begin VAR_ADDRESS 0x8003A924 0x8003B724 0x8003C524 0x8003D324 0x8003E124 0x8003EF24 0x8003FD24 0x80040B24 0x80041924 0x80042724 0x80043524 0x80044324 0x80045124 0x80045F24 0x80046D24 0x80047B24 0x80048924 0x80049724 0x8004A524 0x8004B324 0x8004C124 0x8004CF24 0x8004DD24 0x8004EB24 /end VAR_ADDRESS
 /end VAR_CHARACTERISTIC
 /begin VAR_CHARACTERISTIC U8_AEB_TEMP_01 BrkCalVariantCriterion
  /begin VAR_ADDRESS 0x8002105C 0x8002445C 0x8002785C 0x8002AC5C 0x8002E05C 0x8003145C 0x8003485C 0x80037C5C /end VAR_ADDRESS
 /end VAR_CHARACTERISTIC
 /begin VAR_CHARACTERISTIC U8_AEB_TEMP_02 BrkCalVariantCriterion
  /begin VAR_ADDRESS 0x8002105D 0x8002445D 0x8002785D 0x8002AC5D 0x8002E05D 0x8003145D 0x8003485D 0x80037C5D /end VAR_ADDRESS
 /end VAR_CHARACTERISTIC
 /begin VAR_CHARACTERISTIC U8_AEB_TEMP_03 BrkCalVariantCriterion
  /begin VAR_ADDRESS 0x8002105E 0x8002445E 0x8002785E 0x8002AC5E 0x8002E05E 0x8003145E 0x8003485E 0x80037C5E /end VAR_ADDRESS
 /end VAR_CHARACTERISTIC
 /begin VAR_CHARACTERISTIC U8_DPB_FF_CTRL_DECEL_ERROR_PER BrkCalVariantCriterion
  /begin VAR_ADDRESS 0x80021066 0x80024466 0x80027866 0x8002AC66 0x8002E066 0x80031466 0x80034866 0x80037C66 /end VAR_ADDRESS
 /end VAR_CHARACTERISTIC
 /begin VAR_CHARACTERISTIC U8_DPB_FF_DEC_FACTOR_NEG_G EngCalVariantCriterion
  /begin VAR_ADDRESS 0x8003A934 0x8003B734 0x8003C534 0x8003D334 0x8003E134 0x8003EF34 0x8003FD34 0x80040B34 0x80041934 0x80042734 0x80043534 0x80044334 0x80045134 0x80045F34 0x80046D34 0x80047B34 0x80048934 0x80049734 0x8004A534 0x8004B334 0x8004C134 0x8004CF34 0x8004DD34 0x8004EB34 /end VAR_ADDRESS
 /end VAR_CHARACTERISTIC
 /begin VAR_CHARACTERISTIC U8_DPB_FF_DEC_FACTOR_POS_G EngCalVariantCriterion
  /begin VAR_ADDRESS 0x8003A933 0x8003B733 0x8003C533 0x8003D333 0x8003E133 0x8003EF33 0x8003FD33 0x80040B33 0x80041933 0x80042733 0x80043533 0x80044333 0x80045133 0x80045F33 0x80046D33 0x80047B33 0x80048933 0x80049733 0x8004A533 0x8004B333 0x8004C133 0x8004CF33 0x8004DD33 0x8004EB33 /end VAR_ADDRESS
 /end VAR_CHARACTERISTIC
 /begin VAR_CHARACTERISTIC U8_DPB_FF_HILL_FACTOR_NEG_G EngCalVariantCriterion
  /begin VAR_ADDRESS 0x8003A931 0x8003B731 0x8003C531 0x8003D331 0x8003E131 0x8003EF31 0x8003FD31 0x80040B31 0x80041931 0x80042731 0x80043531 0x80044331 0x80045131 0x80045F31 0x80046D31 0x80047B31 0x80048931 0x80049731 0x8004A531 0x8004B331 0x8004C131 0x8004CF31 0x8004DD31 0x8004EB31 /end VAR_ADDRESS
 /end VAR_CHARACTERISTIC
 /begin VAR_CHARACTERISTIC U8_DPB_FF_LIMIT_NEG_G EngCalVariantCriterion
  /begin VAR_ADDRESS 0x8003A936 0x8003B736 0x8003C536 0x8003D336 0x8003E136 0x8003EF36 0x8003FD36 0x80040B36 0x80041936 0x80042736 0x80043536 0x80044336 0x80045136 0x80045F36 0x80046D36 0x80047B36 0x80048936 0x80049736 0x8004A536 0x8004B336 0x8004C136 0x8004CF36 0x8004DD36 0x8004EB36 /end VAR_ADDRESS
 /end VAR_CHARACTERISTIC
 /begin VAR_CHARACTERISTIC U8_DPB_FF_LIMIT_POS_G EngCalVariantCriterion
  /begin VAR_ADDRESS 0x8003A935 0x8003B735 0x8003C535 0x8003D335 0x8003E135 0x8003EF35 0x8003FD35 0x80040B35 0x80041935 0x80042735 0x80043535 0x80044335 0x80045135 0x80045F35 0x80046D35 0x80047B35 0x80048935 0x80049735 0x8004A535 0x8004B335 0x8004C135 0x8004CF35 0x8004DD35 0x8004EB35 /end VAR_ADDRESS
 /end VAR_CHARACTERISTIC
 /begin VAR_CHARACTERISTIC U8_DPB_FF_RollingResist_FACTOR EngCalVariantCriterion
  /begin VAR_ADDRESS 0x8003A932 0x8003B732 0x8003C532 0x8003D332 0x8003E132 0x8003EF32 0x8003FD32 0x80040B32 0x80041932 0x80042732 0x80043532 0x80044332 0x80045132 0x80045F32 0x80046D32 0x80047B32 0x80048932 0x80049732 0x8004A532 0x8004B332 0x8004C132 0x8004CF32 0x8004DD32 0x8004EB32 /end VAR_ADDRESS
 /end VAR_CHARACTERISTIC
 /begin VAR_CHARACTERISTIC U8_DPB_FF_Vref_FACTOR EngCalVariantCriterion
  /begin VAR_ADDRESS 0x8003A930 0x8003B730 0x8003C530 0x8003D330 0x8003E130 0x8003EF30 0x8003FD30 0x80040B30 0x80041930 0x80042730 0x80043530 0x80044330 0x80045130 0x80045F30 0x80046D30 0x80047B30 0x80048930 0x80049730 0x8004A530 0x8004B330 0x8004C130 0x8004CF30 0x8004DD30 0x8004EB30 /end VAR_ADDRESS
 /end VAR_CHARACTERISTIC
 /begin VAR_CHARACTERISTIC U8_DPB_I_PSEUDO_GAIN_BRAKE EngCalVariantCriterion
  /begin VAR_ADDRESS 0x8003A950 0x8003B750 0x8003C550 0x8003D350 0x8003E150 0x8003EF50 0x8003FD50 0x80040B50 0x80041950 0x80042750 0x80043550 0x80044350 0x80045150 0x80045F50 0x80046D50 0x80047B50 0x80048950 0x80049750 0x8004A550 0x8004B350 0x8004C150 0x8004CF50 0x8004DD50 0x8004EB50 /end VAR_ADDRESS
 /end VAR_CHARACTERISTIC
 /begin VAR_CHARACTERISTIC U8_SIGPROCR_AX_OFFSET_CHECK_DYN_FLAT BrkCalVariantCriterion
  /begin VAR_ADDRESS 0x80020207 0x80023607 0x80026A07 0x80029E07 0x8002D207 0x80030607 0x80033A07 0x80036E07 /end VAR_ADDRESS
 /end VAR_CHARACTERISTIC
 /begin VAR_CHARACTERISTIC U8_SIGPROCR_AX_OFFSET_CHECK_ENG_DRAG_2 EngCalVariantCriterion
  /begin VAR_ADDRESS 0x8003A034 0x8003AE34 0x8003BC34 0x8003CA34 0x8003D834 0x8003E634 0x8003F434 0x80040234 0x80041034 0x80041E34 0x80042C34 0x80043A34 0x80044834 0x80045634 0x80046434 0x80047234 0x80048034 0x80048E34 0x80049C34 0x8004AA34 0x8004B834 0x8004C634 0x8004D434 0x8004E234 /end VAR_ADDRESS
 /end VAR_CHARACTERISTIC
 /begin VAR_CHARACTERISTIC U8_SIGPROCR_AX_OFFSET_CHECK_KIN_FLAT_1 BrkCalVariantCriterion
  /begin VAR_ADDRESS 0x80020208 0x80023608 0x80026A08 0x80029E08 0x8002D208 0x80030608 0x80033A08 0x80036E08 /end VAR_ADDRESS
 /end VAR_CHARACTERISTIC
 /begin VAR_CHARACTERISTIC U8_SIGPROCR_AX_OFFSET_CHECK_KIN_FLAT_2 BrkCalVariantCriterion
  /begin VAR_ADDRESS 0x80020209 0x80023609 0x80026A09 0x80029E09 0x8002D209 0x80030609 0x80033A09 0x80036E09 /end VAR_ADDRESS
 /end VAR_CHARACTERISTIC
 /begin VAR_CHARACTERISTIC U8_SIGPROCR_AX_OFFSET_MODEL_AIR_AREA BrkCalVariantCriterion
  /begin VAR_ADDRESS 0x80020206 0x80023606 0x80026A06 0x80029E06 0x8002D206 0x80030606 0x80033A06 0x80036E06 /end VAR_ADDRESS
 /end VAR_CHARACTERISTIC
 /begin VAR_CHARACTERISTIC U8_SIGPROCR_AX_OFFSET_MODEL_AIR_CD BrkCalVariantCriterion
  /begin VAR_ADDRESS 0x80020204 0x80023604 0x80026A04 0x80029E04 0x8002D204 0x80030604 0x80033A04 0x80036E04 /end VAR_ADDRESS
 /end VAR_CHARACTERISTIC
 /begin VAR_CHARACTERISTIC U8_SIGPROCR_AX_OFFSET_MODEL_AIR_RO BrkCalVariantCriterion
  /begin VAR_ADDRESS 0x80020205 0x80023605 0x80026A05 0x80029E05 0x8002D205 0x80030605 0x80033A05 0x80036E05 /end VAR_ADDRESS
 /end VAR_CHARACTERISTIC
 /begin VAR_CHARACTERISTIC U8_SIGPROCR_AX_OFFSET_MODEL_ENG_ETA_1 EngCalVariantCriterion
  /begin VAR_ADDRESS 0x8003A02C 0x8003AE2C 0x8003BC2C 0x8003CA2C 0x8003D82C 0x8003E62C 0x8003F42C 0x8004022C 0x8004102C 0x80041E2C 0x80042C2C 0x80043A2C 0x8004482C 0x8004562C 0x8004642C 0x8004722C 0x8004802C 0x80048E2C 0x80049C2C 0x8004AA2C 0x8004B82C 0x8004C62C 0x8004D42C 0x8004E22C /end VAR_ADDRESS
 /end VAR_CHARACTERISTIC
 /begin VAR_CHARACTERISTIC U8_SIGPROCR_AX_OFFSET_MODEL_ENG_ETA_2 EngCalVariantCriterion
  /begin VAR_ADDRESS 0x8003A02D 0x8003AE2D 0x8003BC2D 0x8003CA2D 0x8003D82D 0x8003E62D 0x8003F42D 0x8004022D 0x8004102D 0x80041E2D 0x80042C2D 0x80043A2D 0x8004482D 0x8004562D 0x8004642D 0x8004722D 0x8004802D 0x80048E2D 0x80049C2D 0x8004AA2D 0x8004B82D 0x8004C62D 0x8004D42D 0x8004E22D /end VAR_ADDRESS
 /end VAR_CHARACTERISTIC
 /begin VAR_CHARACTERISTIC U8_SIGPROCR_AX_OFFSET_MODEL_ENG_ETA_3 EngCalVariantCriterion
  /begin VAR_ADDRESS 0x8003A02E 0x8003AE2E 0x8003BC2E 0x8003CA2E 0x8003D82E 0x8003E62E 0x8003F42E 0x8004022E 0x8004102E 0x80041E2E 0x80042C2E 0x80043A2E 0x8004482E 0x8004562E 0x8004642E 0x8004722E 0x8004802E 0x80048E2E 0x80049C2E 0x8004AA2E 0x8004B82E 0x8004C62E 0x8004D42E 0x8004E22E /end VAR_ADDRESS
 /end VAR_CHARACTERISTIC
 /begin VAR_CHARACTERISTIC U8_SIGPROCR_AX_OFFSET_MODEL_ENG_ETA_4 EngCalVariantCriterion
  /begin VAR_ADDRESS 0x8003A02F 0x8003AE2F 0x8003BC2F 0x8003CA2F 0x8003D82F 0x8003E62F 0x8003F42F 0x8004022F 0x8004102F 0x80041E2F 0x80042C2F 0x80043A2F 0x8004482F 0x8004562F 0x8004642F 0x8004722F 0x8004802F 0x80048E2F 0x80049C2F 0x8004AA2F 0x8004B82F 0x8004C62F 0x8004D42F 0x8004E22F /end VAR_ADDRESS
 /end VAR_CHARACTERISTIC
 /begin VAR_CHARACTERISTIC U8_SIGPROCR_AX_OFFSET_MODEL_ENG_ETA_5 EngCalVariantCriterion
  /begin VAR_ADDRESS 0x8003A030 0x8003AE30 0x8003BC30 0x8003CA30 0x8003D830 0x8003E630 0x8003F430 0x80040230 0x80041030 0x80041E30 0x80042C30 0x80043A30 0x80044830 0x80045630 0x80046430 0x80047230 0x80048030 0x80048E30 0x80049C30 0x8004AA30 0x8004B830 0x8004C630 0x8004D430 0x8004E230 /end VAR_ADDRESS
 /end VAR_CHARACTERISTIC
 /begin VAR_CHARACTERISTIC U8_SIGPROCR_AX_OFFSET_MODEL_ENG_ETA_6 EngCalVariantCriterion
  /begin VAR_ADDRESS 0x8003A031 0x8003AE31 0x8003BC31 0x8003CA31 0x8003D831 0x8003E631 0x8003F431 0x80040231 0x80041031 0x80041E31 0x80042C31 0x80043A31 0x80044831 0x80045631 0x80046431 0x80047231 0x80048031 0x80048E31 0x80049C31 0x8004AA31 0x8004B831 0x8004C631 0x8004D431 0x8004E231 /end VAR_ADDRESS
 /end VAR_CHARACTERISTIC
 /begin VAR_CHARACTERISTIC U8_SIGPROCR_AX_OFFSET_MODEL_ENG_RESIST_1 EngCalVariantCriterion
  /begin VAR_ADDRESS 0x8003A035 0x8003AE35 0x8003BC35 0x8003CA35 0x8003D835 0x8003E635 0x8003F435 0x80040235 0x80041035 0x80041E35 0x80042C35 0x80043A35 0x80044835 0x80045635 0x80046435 0x80047235 0x80048035 0x80048E35 0x80049C35 0x8004AA35 0x8004B835 0x8004C635 0x8004D435 0x8004E235 /end VAR_ADDRESS
 /end VAR_CHARACTERISTIC
 /begin VAR_CHARACTERISTIC U8_SIGPROCR_AX_OFFSET_MODEL_ENG_RESIST_2 EngCalVariantCriterion
  /begin VAR_ADDRESS 0x8003A036 0x8003AE36 0x8003BC36 0x8003CA36 0x8003D836 0x8003E636 0x8003F436 0x80040236 0x80041036 0x80041E36 0x80042C36 0x80043A36 0x80044836 0x80045636 0x80046436 0x80047236 0x80048036 0x80048E36 0x80049C36 0x8004AA36 0x8004B836 0x8004C636 0x8004D436 0x8004E236 /end VAR_ADDRESS
 /end VAR_CHARACTERISTIC
 /begin VAR_CHARACTERISTIC U8_SIGPROCR_AX_OFFSET_MODEL_ENG_RESIST_3 EngCalVariantCriterion
  /begin VAR_ADDRESS 0x8003A037 0x8003AE37 0x8003BC37 0x8003CA37 0x8003D837 0x8003E637 0x8003F437 0x80040237 0x80041037 0x80041E37 0x80042C37 0x80043A37 0x80044837 0x80045637 0x80046437 0x80047237 0x80048037 0x80048E37 0x80049C37 0x8004AA37 0x8004B837 0x8004C637 0x8004D437 0x8004E237 /end VAR_ADDRESS
 /end VAR_CHARACTERISTIC
 /begin VAR_CHARACTERISTIC U8_SIGPROCR_AX_OFFSET_MODEL_ENG_RESIST_4 EngCalVariantCriterion
  /begin VAR_ADDRESS 0x8003A038 0x8003AE38 0x8003BC38 0x8003CA38 0x8003D838 0x8003E638 0x8003F438 0x80040238 0x80041038 0x80041E38 0x80042C38 0x80043A38 0x80044838 0x80045638 0x80046438 0x80047238 0x80048038 0x80048E38 0x80049C38 0x8004AA38 0x8004B838 0x8004C638 0x8004D438 0x8004E238 /end VAR_ADDRESS
 /end VAR_CHARACTERISTIC
 /begin VAR_CHARACTERISTIC U8_SIGPROCR_AX_OFFSET_MODEL_ENG_RESIST_5 EngCalVariantCriterion
  /begin VAR_ADDRESS 0x8003A039 0x8003AE39 0x8003BC39 0x8003CA39 0x8003D839 0x8003E639 0x8003F439 0x80040239 0x80041039 0x80041E39 0x80042C39 0x80043A39 0x80044839 0x80045639 0x80046439 0x80047239 0x80048039 0x80048E39 0x80049C39 0x8004AA39 0x8004B839 0x8004C639 0x8004D439 0x8004E239 /end VAR_ADDRESS
 /end VAR_CHARACTERISTIC
 /begin VAR_CHARACTERISTIC U8_SIGPROCR_AX_OFFSET_MODEL_ENG_RESIST_6 EngCalVariantCriterion
  /begin VAR_ADDRESS 0x8003A03A 0x8003AE3A 0x8003BC3A 0x8003CA3A 0x8003D83A 0x8003E63A 0x8003F43A 0x8004023A 0x8004103A 0x80041E3A 0x80042C3A 0x80043A3A 0x8004483A 0x8004563A 0x8004643A 0x8004723A 0x8004803A 0x80048E3A 0x80049C3A 0x8004AA3A 0x8004B83A 0x8004C63A 0x8004D43A 0x8004E23A /end VAR_ADDRESS
 /end VAR_CHARACTERISTIC
 /begin VAR_CHARACTERISTIC U8_SIGPROCR_AX_OFFSET_MODEL_ROLL_TOTAL BrkCalVariantCriterion
  /begin VAR_ADDRESS 0x8002020A 0x8002360A 0x80026A0A 0x80029E0A 0x8002D20A 0x8003060A 0x80033A0A 0x80036E0A /end VAR_ADDRESS
 /end VAR_CHARACTERISTIC
 /begin VAR_CHARACTERISTIC U8_VLC_BRKLAMPOFF_PRESS EngCalVariantCriterion
  /begin VAR_ADDRESS 0x8003A8C8 0x8003B6C8 0x8003C4C8 0x8003D2C8 0x8003E0C8 0x8003EEC8 0x8003FCC8 0x80040AC8 0x800418C8 0x800426C8 0x800434C8 0x800442C8 0x800450C8 0x80045EC8 0x80046CC8 0x80047AC8 0x800488C8 0x800496C8 0x8004A4C8 0x8004B2C8 0x8004C0C8 0x8004CEC8 0x8004DCC8 0x8004EAC8 /end VAR_ADDRESS
 /end VAR_CHARACTERISTIC
 /begin VAR_CHARACTERISTIC U8_VLC_BRKLAMPON_PRESS EngCalVariantCriterion
  /begin VAR_ADDRESS 0x8003A8C9 0x8003B6C9 0x8003C4C9 0x8003D2C9 0x8003E0C9 0x8003EEC9 0x8003FCC9 0x80040AC9 0x800418C9 0x800426C9 0x800434C9 0x800442C9 0x800450C9 0x80045EC9 0x80046CC9 0x80047AC9 0x800488C9 0x800496C9 0x8004A4C9 0x8004B2C9 0x8004C0C9 0x8004CEC9 0x8004DCC9 0x8004EAC9 /end VAR_ADDRESS
 /end VAR_CHARACTERISTIC
 /begin VAR_CHARACTERISTIC U8_VLC_MASS EngCalVariantCriterion
  /begin VAR_ADDRESS 0x8003A8C6 0x8003B6C6 0x8003C4C6 0x8003D2C6 0x8003E0C6 0x8003EEC6 0x8003FCC6 0x80040AC6 0x800418C6 0x800426C6 0x800434C6 0x800442C6 0x800450C6 0x80045EC6 0x80046CC6 0x80047AC6 0x800488C6 0x800496C6 0x8004A4C6 0x8004B2C6 0x8004C0C6 0x8004CEC6 0x8004DCC6 0x8004EAC6 /end VAR_ADDRESS
 /end VAR_CHARACTERISTIC
 /begin VAR_CHARACTERISTIC U8_VLC_SLOPE_MAX_THD EngCalVariantCriterion
  /begin VAR_ADDRESS 0x8003A8CA 0x8003B6CA 0x8003C4CA 0x8003D2CA 0x8003E0CA 0x8003EECA 0x8003FCCA 0x80040ACA 0x800418CA 0x800426CA 0x800434CA 0x800442CA 0x800450CA 0x80045ECA 0x80046CCA 0x80047ACA 0x800488CA 0x800496CA 0x8004A4CA 0x8004B2CA 0x8004C0CA 0x8004CECA 0x8004DCCA 0x8004EACA /end VAR_ADDRESS
 /end VAR_CHARACTERISTIC
 /begin VAR_CHARACTERISTIC U8_VLC_SLOPE_THD EngCalVariantCriterion
  /begin VAR_ADDRESS 0x8003A8CB 0x8003B6CB 0x8003C4CB 0x8003D2CB 0x8003E0CB 0x8003EECB 0x8003FCCB 0x80040ACB 0x800418CB 0x800426CB 0x800434CB 0x800442CB 0x800450CB 0x80045ECB 0x80046CCB 0x80047ACB 0x800488CB 0x800496CB 0x8004A4CB 0x8004B2CB 0x8004C0CB 0x8004CECB 0x8004DCCB 0x8004EACB /end VAR_ADDRESS
 /end VAR_CHARACTERISTIC
 /begin VAR_CHARACTERISTIC U8_VLC_TIRE_R EngCalVariantCriterion
  /begin VAR_ADDRESS 0x8003A8C7 0x8003B6C7 0x8003C4C7 0x8003D2C7 0x8003E0C7 0x8003EEC7 0x8003FCC7 0x80040AC7 0x800418C7 0x800426C7 0x800434C7 0x800442C7 0x800450C7 0x80045EC7 0x80046CC7 0x80047AC7 0x800488C7 0x800496C7 0x8004A4C7 0x8004B2C7 0x8004C0C7 0x8004CEC7 0x8004DCC7 0x8004EAC7 /end VAR_ADDRESS
 /end VAR_CHARACTERISTIC
 /begin VAR_CHARACTERISTIC U8_WPE_LFC_ESC_MP_Rise_Duty_f_1st BrkCalVariantCriterion
  /begin VAR_ADDRESS 0x8002174A 0x80024B4A 0x80027F4A 0x8002B34A 0x8002E74A 0x80031B4A 0x80034F4A 0x8003834A /end VAR_ADDRESS
 /end VAR_CHARACTERISTIC
 /begin VAR_CHARACTERISTIC U8_WPE_LFC_ESC_MP_Rise_Duty_f_2nd BrkCalVariantCriterion
  /begin VAR_ADDRESS 0x8002174B 0x80024B4B 0x80027F4B 0x8002B34B 0x8002E74B 0x80031B4B 0x80034F4B 0x8003834B /end VAR_ADDRESS
 /end VAR_CHARACTERISTIC
 /begin VAR_CHARACTERISTIC U8_WPE_LFC_ESC_MP_Rise_Duty_f_3rd BrkCalVariantCriterion
  /begin VAR_ADDRESS 0x8002174C 0x80024B4C 0x80027F4C 0x8002B34C 0x8002E74C 0x80031B4C 0x80034F4C 0x8003834C /end VAR_ADDRESS
 /end VAR_CHARACTERISTIC
 /begin VAR_CHARACTERISTIC U8_WPE_LFC_ESC_MP_Rise_Duty_f_4th BrkCalVariantCriterion
  /begin VAR_ADDRESS 0x8002174D 0x80024B4D 0x80027F4D 0x8002B34D 0x8002E74D 0x80031B4D 0x80034F4D 0x8003834D /end VAR_ADDRESS
 /end VAR_CHARACTERISTIC
 /begin VAR_CHARACTERISTIC U8_WPE_LFC_ESC_MP_Rise_Duty_f_5th BrkCalVariantCriterion
  /begin VAR_ADDRESS 0x8002174E 0x80024B4E 0x80027F4E 0x8002B34E 0x8002E74E 0x80031B4E 0x80034F4E 0x8003834E /end VAR_ADDRESS
 /end VAR_CHARACTERISTIC
 /begin VAR_CHARACTERISTIC U8_WPE_LFC_ESC_MP_Rise_Duty_f_6th BrkCalVariantCriterion
  /begin VAR_ADDRESS 0x8002174F 0x80024B4F 0x80027F4F 0x8002B34F 0x8002E74F 0x80031B4F 0x80034F4F 0x8003834F /end VAR_ADDRESS
 /end VAR_CHARACTERISTIC
 /begin VAR_CHARACTERISTIC U8_WPE_LFC_ESC_MP_Rise_Duty_r_1st BrkCalVariantCriterion
  /begin VAR_ADDRESS 0x8002175C 0x80024B5C 0x80027F5C 0x8002B35C 0x8002E75C 0x80031B5C 0x80034F5C 0x8003835C /end VAR_ADDRESS
 /end VAR_CHARACTERISTIC
 /begin VAR_CHARACTERISTIC U8_WPE_LFC_ESC_MP_Rise_Duty_r_2nd BrkCalVariantCriterion
  /begin VAR_ADDRESS 0x8002175D 0x80024B5D 0x80027F5D 0x8002B35D 0x8002E75D 0x80031B5D 0x80034F5D 0x8003835D /end VAR_ADDRESS
 /end VAR_CHARACTERISTIC
 /begin VAR_CHARACTERISTIC U8_WPE_LFC_ESC_MP_Rise_Duty_r_3rd BrkCalVariantCriterion
  /begin VAR_ADDRESS 0x8002175E 0x80024B5E 0x80027F5E 0x8002B35E 0x8002E75E 0x80031B5E 0x80034F5E 0x8003835E /end VAR_ADDRESS
 /end VAR_CHARACTERISTIC
 /begin VAR_CHARACTERISTIC U8_WPE_LFC_ESC_MP_Rise_Duty_r_4th BrkCalVariantCriterion
  /begin VAR_ADDRESS 0x8002175F 0x80024B5F 0x80027F5F 0x8002B35F 0x8002E75F 0x80031B5F 0x80034F5F 0x8003835F /end VAR_ADDRESS
 /end VAR_CHARACTERISTIC
 /begin VAR_CHARACTERISTIC U8_WPE_LFC_ESC_MP_Rise_Duty_r_5th BrkCalVariantCriterion
  /begin VAR_ADDRESS 0x80021760 0x80024B60 0x80027F60 0x8002B360 0x8002E760 0x80031B60 0x80034F60 0x80038360 /end VAR_ADDRESS
 /end VAR_CHARACTERISTIC
 /begin VAR_CHARACTERISTIC U8_WPE_LFC_ESC_MP_Rise_Duty_r_6th BrkCalVariantCriterion
  /begin VAR_ADDRESS 0x80021761 0x80024B61 0x80027F61 0x8002B361 0x8002E761 0x80031B61 0x80034F61 0x80038361 /end VAR_ADDRESS
 /end VAR_CHARACTERISTIC
 /begin VAR_CHARACTERISTIC U8_WPE_LFC_ESC_Rise_Duty_f_1st BrkCalVariantCriterion
  /begin VAR_ADDRESS 0x800216F6 0x80024AF6 0x80027EF6 0x8002B2F6 0x8002E6F6 0x80031AF6 0x80034EF6 0x800382F6 /end VAR_ADDRESS
 /end VAR_CHARACTERISTIC
 /begin VAR_CHARACTERISTIC U8_WPE_LFC_ESC_Rise_Duty_f_2nd BrkCalVariantCriterion
  /begin VAR_ADDRESS 0x800216F7 0x80024AF7 0x80027EF7 0x8002B2F7 0x8002E6F7 0x80031AF7 0x80034EF7 0x800382F7 /end VAR_ADDRESS
 /end VAR_CHARACTERISTIC
 /begin VAR_CHARACTERISTIC U8_WPE_LFC_ESC_Rise_Duty_f_3rd BrkCalVariantCriterion
  /begin VAR_ADDRESS 0x800216F8 0x80024AF8 0x80027EF8 0x8002B2F8 0x8002E6F8 0x80031AF8 0x80034EF8 0x800382F8 /end VAR_ADDRESS
 /end VAR_CHARACTERISTIC
 /begin VAR_CHARACTERISTIC U8_WPE_LFC_ESC_Rise_Duty_f_4th BrkCalVariantCriterion
  /begin VAR_ADDRESS 0x800216F9 0x80024AF9 0x80027EF9 0x8002B2F9 0x8002E6F9 0x80031AF9 0x80034EF9 0x800382F9 /end VAR_ADDRESS
 /end VAR_CHARACTERISTIC
 /begin VAR_CHARACTERISTIC U8_WPE_LFC_ESC_Rise_Duty_f_5th BrkCalVariantCriterion
  /begin VAR_ADDRESS 0x800216FA 0x80024AFA 0x80027EFA 0x8002B2FA 0x8002E6FA 0x80031AFA 0x80034EFA 0x800382FA /end VAR_ADDRESS
 /end VAR_CHARACTERISTIC
 /begin VAR_CHARACTERISTIC U8_WPE_LFC_ESC_Rise_Duty_f_6th BrkCalVariantCriterion
  /begin VAR_ADDRESS 0x800216FB 0x80024AFB 0x80027EFB 0x8002B2FB 0x8002E6FB 0x80031AFB 0x80034EFB 0x800382FB /end VAR_ADDRESS
 /end VAR_CHARACTERISTIC
 /begin VAR_CHARACTERISTIC U8_WPE_LFC_ESC_Rise_Duty_r_1st BrkCalVariantCriterion
  /begin VAR_ADDRESS 0x80021708 0x80024B08 0x80027F08 0x8002B308 0x8002E708 0x80031B08 0x80034F08 0x80038308 /end VAR_ADDRESS
 /end VAR_CHARACTERISTIC
 /begin VAR_CHARACTERISTIC U8_WPE_LFC_ESC_Rise_Duty_r_2nd BrkCalVariantCriterion
  /begin VAR_ADDRESS 0x80021709 0x80024B09 0x80027F09 0x8002B309 0x8002E709 0x80031B09 0x80034F09 0x80038309 /end VAR_ADDRESS
 /end VAR_CHARACTERISTIC
 /begin VAR_CHARACTERISTIC U8_WPE_LFC_ESC_Rise_Duty_r_3rd BrkCalVariantCriterion
  /begin VAR_ADDRESS 0x8002170A 0x80024B0A 0x80027F0A 0x8002B30A 0x8002E70A 0x80031B0A 0x80034F0A 0x8003830A /end VAR_ADDRESS
 /end VAR_CHARACTERISTIC
 /begin VAR_CHARACTERISTIC U8_WPE_LFC_ESC_Rise_Duty_r_4th BrkCalVariantCriterion
  /begin VAR_ADDRESS 0x8002170B 0x80024B0B 0x80027F0B 0x8002B30B 0x8002E70B 0x80031B0B 0x80034F0B 0x8003830B /end VAR_ADDRESS
 /end VAR_CHARACTERISTIC
 /begin VAR_CHARACTERISTIC U8_WPE_LFC_ESC_Rise_Duty_r_5th BrkCalVariantCriterion
  /begin VAR_ADDRESS 0x8002170C 0x80024B0C 0x80027F0C 0x8002B30C 0x8002E70C 0x80031B0C 0x80034F0C 0x8003830C /end VAR_ADDRESS
 /end VAR_CHARACTERISTIC
 /begin VAR_CHARACTERISTIC U8_WPE_LFC_ESC_Rise_Duty_r_6th BrkCalVariantCriterion
  /begin VAR_ADDRESS 0x8002170D 0x80024B0D 0x80027F0D 0x8002B30D 0x8002E70D 0x80031B0D 0x80034F0D 0x8003830D /end VAR_ADDRESS
 /end VAR_CHARACTERISTIC
 /begin VAR_CHARACTERISTIC U8_WPE_LFC_Hold_Duty_f_10th BrkCalVariantCriterion
  /begin VAR_ADDRESS 0x8002165B 0x80024A5B 0x80027E5B 0x8002B25B 0x8002E65B 0x80031A5B 0x80034E5B 0x8003825B /end VAR_ADDRESS
 /end VAR_CHARACTERISTIC
 /begin VAR_CHARACTERISTIC U8_WPE_LFC_Hold_Duty_f_11th BrkCalVariantCriterion
  /begin VAR_ADDRESS 0x8002165C 0x80024A5C 0x80027E5C 0x8002B25C 0x8002E65C 0x80031A5C 0x80034E5C 0x8003825C /end VAR_ADDRESS
 /end VAR_CHARACTERISTIC
 /begin VAR_CHARACTERISTIC U8_WPE_LFC_Hold_Duty_f_12th BrkCalVariantCriterion
  /begin VAR_ADDRESS 0x8002165D 0x80024A5D 0x80027E5D 0x8002B25D 0x8002E65D 0x80031A5D 0x80034E5D 0x8003825D /end VAR_ADDRESS
 /end VAR_CHARACTERISTIC
 /begin VAR_CHARACTERISTIC U8_WPE_LFC_Hold_Duty_f_13th BrkCalVariantCriterion
  /begin VAR_ADDRESS 0x8002165E 0x80024A5E 0x80027E5E 0x8002B25E 0x8002E65E 0x80031A5E 0x80034E5E 0x8003825E /end VAR_ADDRESS
 /end VAR_CHARACTERISTIC
 /begin VAR_CHARACTERISTIC U8_WPE_LFC_Hold_Duty_f_14th BrkCalVariantCriterion
  /begin VAR_ADDRESS 0x8002165F 0x80024A5F 0x80027E5F 0x8002B25F 0x8002E65F 0x80031A5F 0x80034E5F 0x8003825F /end VAR_ADDRESS
 /end VAR_CHARACTERISTIC
 /begin VAR_CHARACTERISTIC U8_WPE_LFC_Hold_Duty_f_15th BrkCalVariantCriterion
  /begin VAR_ADDRESS 0x80021660 0x80024A60 0x80027E60 0x8002B260 0x8002E660 0x80031A60 0x80034E60 0x80038260 /end VAR_ADDRESS
 /end VAR_CHARACTERISTIC
 /begin VAR_CHARACTERISTIC U8_WPE_LFC_Hold_Duty_f_16th BrkCalVariantCriterion
  /begin VAR_ADDRESS 0x80021661 0x80024A61 0x80027E61 0x8002B261 0x8002E661 0x80031A61 0x80034E61 0x80038261 /end VAR_ADDRESS
 /end VAR_CHARACTERISTIC
 /begin VAR_CHARACTERISTIC U8_WPE_LFC_Hold_Duty_f_1st BrkCalVariantCriterion
  /begin VAR_ADDRESS 0x80021652 0x80024A52 0x80027E52 0x8002B252 0x8002E652 0x80031A52 0x80034E52 0x80038252 /end VAR_ADDRESS
 /end VAR_CHARACTERISTIC
 /begin VAR_CHARACTERISTIC U8_WPE_LFC_Hold_Duty_f_2nd BrkCalVariantCriterion
  /begin VAR_ADDRESS 0x80021653 0x80024A53 0x80027E53 0x8002B253 0x8002E653 0x80031A53 0x80034E53 0x80038253 /end VAR_ADDRESS
 /end VAR_CHARACTERISTIC
 /begin VAR_CHARACTERISTIC U8_WPE_LFC_Hold_Duty_f_3rd BrkCalVariantCriterion
  /begin VAR_ADDRESS 0x80021654 0x80024A54 0x80027E54 0x8002B254 0x8002E654 0x80031A54 0x80034E54 0x80038254 /end VAR_ADDRESS
 /end VAR_CHARACTERISTIC
 /begin VAR_CHARACTERISTIC U8_WPE_LFC_Hold_Duty_f_4th BrkCalVariantCriterion
  /begin VAR_ADDRESS 0x80021655 0x80024A55 0x80027E55 0x8002B255 0x8002E655 0x80031A55 0x80034E55 0x80038255 /end VAR_ADDRESS
 /end VAR_CHARACTERISTIC
 /begin VAR_CHARACTERISTIC U8_WPE_LFC_Hold_Duty_f_5th BrkCalVariantCriterion
  /begin VAR_ADDRESS 0x80021656 0x80024A56 0x80027E56 0x8002B256 0x8002E656 0x80031A56 0x80034E56 0x80038256 /end VAR_ADDRESS
 /end VAR_CHARACTERISTIC
 /begin VAR_CHARACTERISTIC U8_WPE_LFC_Hold_Duty_f_6th BrkCalVariantCriterion
  /begin VAR_ADDRESS 0x80021657 0x80024A57 0x80027E57 0x8002B257 0x8002E657 0x80031A57 0x80034E57 0x80038257 /end VAR_ADDRESS
 /end VAR_CHARACTERISTIC
 /begin VAR_CHARACTERISTIC U8_WPE_LFC_Hold_Duty_f_7th BrkCalVariantCriterion
  /begin VAR_ADDRESS 0x80021658 0x80024A58 0x80027E58 0x8002B258 0x8002E658 0x80031A58 0x80034E58 0x80038258 /end VAR_ADDRESS
 /end VAR_CHARACTERISTIC
 /begin VAR_CHARACTERISTIC U8_WPE_LFC_Hold_Duty_f_8th BrkCalVariantCriterion
  /begin VAR_ADDRESS 0x80021659 0x80024A59 0x80027E59 0x8002B259 0x8002E659 0x80031A59 0x80034E59 0x80038259 /end VAR_ADDRESS
 /end VAR_CHARACTERISTIC
 /begin VAR_CHARACTERISTIC U8_WPE_LFC_Hold_Duty_f_9th BrkCalVariantCriterion
  /begin VAR_ADDRESS 0x8002165A 0x80024A5A 0x80027E5A 0x8002B25A 0x8002E65A 0x80031A5A 0x80034E5A 0x8003825A /end VAR_ADDRESS
 /end VAR_CHARACTERISTIC
 /begin VAR_CHARACTERISTIC U8_WPE_LFC_Hold_Duty_r_10th BrkCalVariantCriterion
  /begin VAR_ADDRESS 0x8002168B 0x80024A8B 0x80027E8B 0x8002B28B 0x8002E68B 0x80031A8B 0x80034E8B 0x8003828B /end VAR_ADDRESS
 /end VAR_CHARACTERISTIC
 /begin VAR_CHARACTERISTIC U8_WPE_LFC_Hold_Duty_r_11th BrkCalVariantCriterion
  /begin VAR_ADDRESS 0x8002168C 0x80024A8C 0x80027E8C 0x8002B28C 0x8002E68C 0x80031A8C 0x80034E8C 0x8003828C /end VAR_ADDRESS
 /end VAR_CHARACTERISTIC
 /begin VAR_CHARACTERISTIC U8_WPE_LFC_Hold_Duty_r_12th BrkCalVariantCriterion
  /begin VAR_ADDRESS 0x8002168D 0x80024A8D 0x80027E8D 0x8002B28D 0x8002E68D 0x80031A8D 0x80034E8D 0x8003828D /end VAR_ADDRESS
 /end VAR_CHARACTERISTIC
 /begin VAR_CHARACTERISTIC U8_WPE_LFC_Hold_Duty_r_13th BrkCalVariantCriterion
  /begin VAR_ADDRESS 0x8002168E 0x80024A8E 0x80027E8E 0x8002B28E 0x8002E68E 0x80031A8E 0x80034E8E 0x8003828E /end VAR_ADDRESS
 /end VAR_CHARACTERISTIC
 /begin VAR_CHARACTERISTIC U8_WPE_LFC_Hold_Duty_r_14th BrkCalVariantCriterion
  /begin VAR_ADDRESS 0x8002168F 0x80024A8F 0x80027E8F 0x8002B28F 0x8002E68F 0x80031A8F 0x80034E8F 0x8003828F /end VAR_ADDRESS
 /end VAR_CHARACTERISTIC
 /begin VAR_CHARACTERISTIC U8_WPE_LFC_Hold_Duty_r_15th BrkCalVariantCriterion
  /begin VAR_ADDRESS 0x80021690 0x80024A90 0x80027E90 0x8002B290 0x8002E690 0x80031A90 0x80034E90 0x80038290 /end VAR_ADDRESS
 /end VAR_CHARACTERISTIC
 /begin VAR_CHARACTERISTIC U8_WPE_LFC_Hold_Duty_r_16th BrkCalVariantCriterion
  /begin VAR_ADDRESS 0x80021691 0x80024A91 0x80027E91 0x8002B291 0x8002E691 0x80031A91 0x80034E91 0x80038291 /end VAR_ADDRESS
 /end VAR_CHARACTERISTIC
 /begin VAR_CHARACTERISTIC U8_WPE_LFC_Hold_Duty_r_1st BrkCalVariantCriterion
  /begin VAR_ADDRESS 0x80021682 0x80024A82 0x80027E82 0x8002B282 0x8002E682 0x80031A82 0x80034E82 0x80038282 /end VAR_ADDRESS
 /end VAR_CHARACTERISTIC
 /begin VAR_CHARACTERISTIC U8_WPE_LFC_Hold_Duty_r_2nd BrkCalVariantCriterion
  /begin VAR_ADDRESS 0x80021683 0x80024A83 0x80027E83 0x8002B283 0x8002E683 0x80031A83 0x80034E83 0x80038283 /end VAR_ADDRESS
 /end VAR_CHARACTERISTIC
 /begin VAR_CHARACTERISTIC U8_WPE_LFC_Hold_Duty_r_3rd BrkCalVariantCriterion
  /begin VAR_ADDRESS 0x80021684 0x80024A84 0x80027E84 0x8002B284 0x8002E684 0x80031A84 0x80034E84 0x80038284 /end VAR_ADDRESS
 /end VAR_CHARACTERISTIC
 /begin VAR_CHARACTERISTIC U8_WPE_LFC_Hold_Duty_r_4th BrkCalVariantCriterion
  /begin VAR_ADDRESS 0x80021685 0x80024A85 0x80027E85 0x8002B285 0x8002E685 0x80031A85 0x80034E85 0x80038285 /end VAR_ADDRESS
 /end VAR_CHARACTERISTIC
 /begin VAR_CHARACTERISTIC U8_WPE_LFC_Hold_Duty_r_5th BrkCalVariantCriterion
  /begin VAR_ADDRESS 0x80021686 0x80024A86 0x80027E86 0x8002B286 0x8002E686 0x80031A86 0x80034E86 0x80038286 /end VAR_ADDRESS
 /end VAR_CHARACTERISTIC
 /begin VAR_CHARACTERISTIC U8_WPE_LFC_Hold_Duty_r_6th BrkCalVariantCriterion
  /begin VAR_ADDRESS 0x80021687 0x80024A87 0x80027E87 0x8002B287 0x8002E687 0x80031A87 0x80034E87 0x80038287 /end VAR_ADDRESS
 /end VAR_CHARACTERISTIC
 /begin VAR_CHARACTERISTIC U8_WPE_LFC_Hold_Duty_r_7th BrkCalVariantCriterion
  /begin VAR_ADDRESS 0x80021688 0x80024A88 0x80027E88 0x8002B288 0x8002E688 0x80031A88 0x80034E88 0x80038288 /end VAR_ADDRESS
 /end VAR_CHARACTERISTIC
 /begin VAR_CHARACTERISTIC U8_WPE_LFC_Hold_Duty_r_8th BrkCalVariantCriterion
  /begin VAR_ADDRESS 0x80021689 0x80024A89 0x80027E89 0x8002B289 0x8002E689 0x80031A89 0x80034E89 0x80038289 /end VAR_ADDRESS
 /end VAR_CHARACTERISTIC
 /begin VAR_CHARACTERISTIC U8_WPE_LFC_Hold_Duty_r_9th BrkCalVariantCriterion
  /begin VAR_ADDRESS 0x8002168A 0x80024A8A 0x80027E8A 0x8002B28A 0x8002E68A 0x80031A8A 0x80034E8A 0x8003828A /end VAR_ADDRESS
 /end VAR_CHARACTERISTIC
 /begin VAR_CHARACTERISTIC U8_WPE_LFC_Rise_Duty_f_10th BrkCalVariantCriterion
  /begin VAR_ADDRESS 0x800216BB 0x80024ABB 0x80027EBB 0x8002B2BB 0x8002E6BB 0x80031ABB 0x80034EBB 0x800382BB /end VAR_ADDRESS
 /end VAR_CHARACTERISTIC
 /begin VAR_CHARACTERISTIC U8_WPE_LFC_Rise_Duty_f_11th BrkCalVariantCriterion
  /begin VAR_ADDRESS 0x800216BC 0x80024ABC 0x80027EBC 0x8002B2BC 0x8002E6BC 0x80031ABC 0x80034EBC 0x800382BC /end VAR_ADDRESS
 /end VAR_CHARACTERISTIC
 /begin VAR_CHARACTERISTIC U8_WPE_LFC_Rise_Duty_f_1st BrkCalVariantCriterion
  /begin VAR_ADDRESS 0x800216B2 0x80024AB2 0x80027EB2 0x8002B2B2 0x8002E6B2 0x80031AB2 0x80034EB2 0x800382B2 /end VAR_ADDRESS
 /end VAR_CHARACTERISTIC
 /begin VAR_CHARACTERISTIC U8_WPE_LFC_Rise_Duty_f_2nd BrkCalVariantCriterion
  /begin VAR_ADDRESS 0x800216B3 0x80024AB3 0x80027EB3 0x8002B2B3 0x8002E6B3 0x80031AB3 0x80034EB3 0x800382B3 /end VAR_ADDRESS
 /end VAR_CHARACTERISTIC
 /begin VAR_CHARACTERISTIC U8_WPE_LFC_Rise_Duty_f_3rd BrkCalVariantCriterion
  /begin VAR_ADDRESS 0x800216B4 0x80024AB4 0x80027EB4 0x8002B2B4 0x8002E6B4 0x80031AB4 0x80034EB4 0x800382B4 /end VAR_ADDRESS
 /end VAR_CHARACTERISTIC
 /begin VAR_CHARACTERISTIC U8_WPE_LFC_Rise_Duty_f_4th BrkCalVariantCriterion
  /begin VAR_ADDRESS 0x800216B5 0x80024AB5 0x80027EB5 0x8002B2B5 0x8002E6B5 0x80031AB5 0x80034EB5 0x800382B5 /end VAR_ADDRESS
 /end VAR_CHARACTERISTIC
 /begin VAR_CHARACTERISTIC U8_WPE_LFC_Rise_Duty_f_5th BrkCalVariantCriterion
  /begin VAR_ADDRESS 0x800216B6 0x80024AB6 0x80027EB6 0x8002B2B6 0x8002E6B6 0x80031AB6 0x80034EB6 0x800382B6 /end VAR_ADDRESS
 /end VAR_CHARACTERISTIC
 /begin VAR_CHARACTERISTIC U8_WPE_LFC_Rise_Duty_f_6th BrkCalVariantCriterion
  /begin VAR_ADDRESS 0x800216B7 0x80024AB7 0x80027EB7 0x8002B2B7 0x8002E6B7 0x80031AB7 0x80034EB7 0x800382B7 /end VAR_ADDRESS
 /end VAR_CHARACTERISTIC
 /begin VAR_CHARACTERISTIC U8_WPE_LFC_Rise_Duty_f_7th BrkCalVariantCriterion
  /begin VAR_ADDRESS 0x800216B8 0x80024AB8 0x80027EB8 0x8002B2B8 0x8002E6B8 0x80031AB8 0x80034EB8 0x800382B8 /end VAR_ADDRESS
 /end VAR_CHARACTERISTIC
 /begin VAR_CHARACTERISTIC U8_WPE_LFC_Rise_Duty_f_8th BrkCalVariantCriterion
  /begin VAR_ADDRESS 0x800216B9 0x80024AB9 0x80027EB9 0x8002B2B9 0x8002E6B9 0x80031AB9 0x80034EB9 0x800382B9 /end VAR_ADDRESS
 /end VAR_CHARACTERISTIC
 /begin VAR_CHARACTERISTIC U8_WPE_LFC_Rise_Duty_f_9th BrkCalVariantCriterion
  /begin VAR_ADDRESS 0x800216BA 0x80024ABA 0x80027EBA 0x8002B2BA 0x8002E6BA 0x80031ABA 0x80034EBA 0x800382BA /end VAR_ADDRESS
 /end VAR_CHARACTERISTIC
 /begin VAR_CHARACTERISTIC U8_WPE_LFC_Rise_Duty_r_10th BrkCalVariantCriterion
  /begin VAR_ADDRESS 0x800216DD 0x80024ADD 0x80027EDD 0x8002B2DD 0x8002E6DD 0x80031ADD 0x80034EDD 0x800382DD /end VAR_ADDRESS
 /end VAR_CHARACTERISTIC
 /begin VAR_CHARACTERISTIC U8_WPE_LFC_Rise_Duty_r_11th BrkCalVariantCriterion
  /begin VAR_ADDRESS 0x800216DE 0x80024ADE 0x80027EDE 0x8002B2DE 0x8002E6DE 0x80031ADE 0x80034EDE 0x800382DE /end VAR_ADDRESS
 /end VAR_CHARACTERISTIC
 /begin VAR_CHARACTERISTIC U8_WPE_LFC_Rise_Duty_r_1st BrkCalVariantCriterion
  /begin VAR_ADDRESS 0x800216D4 0x80024AD4 0x80027ED4 0x8002B2D4 0x8002E6D4 0x80031AD4 0x80034ED4 0x800382D4 /end VAR_ADDRESS
 /end VAR_CHARACTERISTIC
 /begin VAR_CHARACTERISTIC U8_WPE_LFC_Rise_Duty_r_2nd BrkCalVariantCriterion
  /begin VAR_ADDRESS 0x800216D5 0x80024AD5 0x80027ED5 0x8002B2D5 0x8002E6D5 0x80031AD5 0x80034ED5 0x800382D5 /end VAR_ADDRESS
 /end VAR_CHARACTERISTIC
 /begin VAR_CHARACTERISTIC U8_WPE_LFC_Rise_Duty_r_3rd BrkCalVariantCriterion
  /begin VAR_ADDRESS 0x800216D6 0x80024AD6 0x80027ED6 0x8002B2D6 0x8002E6D6 0x80031AD6 0x80034ED6 0x800382D6 /end VAR_ADDRESS
 /end VAR_CHARACTERISTIC
 /begin VAR_CHARACTERISTIC U8_WPE_LFC_Rise_Duty_r_4th BrkCalVariantCriterion
  /begin VAR_ADDRESS 0x800216D7 0x80024AD7 0x80027ED7 0x8002B2D7 0x8002E6D7 0x80031AD7 0x80034ED7 0x800382D7 /end VAR_ADDRESS
 /end VAR_CHARACTERISTIC
 /begin VAR_CHARACTERISTIC U8_WPE_LFC_Rise_Duty_r_5th BrkCalVariantCriterion
  /begin VAR_ADDRESS 0x800216D8 0x80024AD8 0x80027ED8 0x8002B2D8 0x8002E6D8 0x80031AD8 0x80034ED8 0x800382D8 /end VAR_ADDRESS
 /end VAR_CHARACTERISTIC
 /begin VAR_CHARACTERISTIC U8_WPE_LFC_Rise_Duty_r_6th BrkCalVariantCriterion
  /begin VAR_ADDRESS 0x800216D9 0x80024AD9 0x80027ED9 0x8002B2D9 0x8002E6D9 0x80031AD9 0x80034ED9 0x800382D9 /end VAR_ADDRESS
 /end VAR_CHARACTERISTIC
 /begin VAR_CHARACTERISTIC U8_WPE_LFC_Rise_Duty_r_7th BrkCalVariantCriterion
  /begin VAR_ADDRESS 0x800216DA 0x80024ADA 0x80027EDA 0x8002B2DA 0x8002E6DA 0x80031ADA 0x80034EDA 0x800382DA /end VAR_ADDRESS
 /end VAR_CHARACTERISTIC
 /begin VAR_CHARACTERISTIC U8_WPE_LFC_Rise_Duty_r_8th BrkCalVariantCriterion
  /begin VAR_ADDRESS 0x800216DB 0x80024ADB 0x80027EDB 0x8002B2DB 0x8002E6DB 0x80031ADB 0x80034EDB 0x800382DB /end VAR_ADDRESS
 /end VAR_CHARACTERISTIC
 /begin VAR_CHARACTERISTIC U8_WPE_LFC_Rise_Duty_r_9th BrkCalVariantCriterion
  /begin VAR_ADDRESS 0x800216DC 0x80024ADC 0x80027EDC 0x8002B2DC 0x8002E6DC 0x80031ADC 0x80034EDC 0x800382DC /end VAR_ADDRESS
 /end VAR_CHARACTERISTIC
 /begin VAR_CHARACTERISTIC U8_WPE_Motor_Eccentricity BrkCalVariantCriterion
  /begin VAR_ADDRESS 0x8002154F 0x8002494F 0x80027D4F 0x8002B14F 0x8002E54F 0x8003194F 0x80034D4F 0x8003814F /end VAR_ADDRESS
 /end VAR_CHARACTERISTIC
 /begin VAR_CHARACTERISTIC U8_WPE_Motor_K_Torque_Current BrkCalVariantCriterion
  /begin VAR_ADDRESS 0x80021550 0x80024950 0x80027D50 0x8002B150 0x8002E550 0x80031950 0x80034D50 0x80038150 /end VAR_ADDRESS
 /end VAR_CHARACTERISTIC
 /begin VAR_CHARACTERISTIC U8_WPE_Motor_Resistance BrkCalVariantCriterion
  /begin VAR_ADDRESS 0x80021551 0x80024951 0x80027D51 0x8002B151 0x8002E551 0x80031951 0x80034D51 0x80038151 /end VAR_ADDRESS
 /end VAR_CHARACTERISTIC
 /begin VAR_CHARACTERISTIC U8_WPE_Motor_Volt_RPM BrkCalVariantCriterion
  /begin VAR_ADDRESS 0x80021552 0x80024952 0x80027D52 0x8002B152 0x8002E552 0x80031952 0x80034D52 0x80038152 /end VAR_ADDRESS
 /end VAR_CHARACTERISTIC
 /begin VAR_CHARACTERISTIC U8_WPE_Piston_Diameter BrkCalVariantCriterion
  /begin VAR_ADDRESS 0x8002154E 0x8002494E 0x80027D4E 0x8002B14E 0x8002E54E 0x8003194E 0x80034D4E 0x8003814E /end VAR_ADDRESS
 /end VAR_CHARACTERISTIC
 /begin VAR_CHARACTERISTIC U8_WPE_Pump_Efficiency_High_P BrkCalVariantCriterion
  /begin VAR_ADDRESS 0x80021533 0x80024933 0x80027D33 0x8002B133 0x8002E533 0x80031933 0x80034D33 0x80038133 /end VAR_ADDRESS
 /end VAR_CHARACTERISTIC
 /begin VAR_CHARACTERISTIC U8_WPE_Pump_Efficiency_Low_P BrkCalVariantCriterion
  /begin VAR_ADDRESS 0x80021532 0x80024932 0x80027D32 0x8002B132 0x8002E532 0x80031932 0x80034D32 0x80038132 /end VAR_ADDRESS
 /end VAR_CHARACTERISTIC
 /begin VAR_CHARACTERISTIC U8_WPE_WPE_ESC_Rise_Hold_Comp_1st BrkCalVariantCriterion
  /begin VAR_ADDRESS 0x8002161F 0x80024A1F 0x80027E1F 0x8002B21F 0x8002E61F 0x80031A1F 0x80034E1F 0x8003821F /end VAR_ADDRESS
 /end VAR_CHARACTERISTIC
 /begin VAR_CHARACTERISTIC U8_WPE_WPE_ESC_Rise_Hold_Comp_2nd BrkCalVariantCriterion
  /begin VAR_ADDRESS 0x80021620 0x80024A20 0x80027E20 0x8002B220 0x8002E620 0x80031A20 0x80034E20 0x80038220 /end VAR_ADDRESS
 /end VAR_CHARACTERISTIC
 /begin VAR_CHARACTERISTIC U8_WPE_WPE_ESC_Rise_Hold_Thres_1st BrkCalVariantCriterion
  /begin VAR_ADDRESS 0x8002161C 0x80024A1C 0x80027E1C 0x8002B21C 0x8002E61C 0x80031A1C 0x80034E1C 0x8003821C /end VAR_ADDRESS
 /end VAR_CHARACTERISTIC
 /begin VAR_CHARACTERISTIC U8_WPE_WPE_ESC_Rise_Hold_Thres_2nd BrkCalVariantCriterion
  /begin VAR_ADDRESS 0x8002161D 0x80024A1D 0x80027E1D 0x8002B21D 0x8002E61D 0x80031A1D 0x80034E1D 0x8003821D /end VAR_ADDRESS
 /end VAR_CHARACTERISTIC
 /begin VAR_CHARACTERISTIC U8_WPE_WPE_ESC_Rise_Hold_Thres_3rd BrkCalVariantCriterion
  /begin VAR_ADDRESS 0x8002161E 0x80024A1E 0x80027E1E 0x8002B21E 0x8002E61E 0x80031A1E 0x80034E1E 0x8003821E /end VAR_ADDRESS
 /end VAR_CHARACTERISTIC
 /begin VAR_CHARACTERISTIC U8_WPE_WPE_Straight_Cont_Comp_T BrkCalVariantCriterion
  /begin VAR_ADDRESS 0x80021553 0x80024953 0x80027D53 0x8002B153 0x8002E553 0x80031953 0x80034D53 0x80038153 /end VAR_ADDRESS
 /end VAR_CHARACTERISTIC
 /begin VAR_CHARACTERISTIC U8_WPE_WPE_Straight_Cont_Comp_f BrkCalVariantCriterion
  /begin VAR_ADDRESS 0x80021554 0x80024954 0x80027D54 0x8002B154 0x8002E554 0x80031954 0x80034D54 0x80038154 /end VAR_ADDRESS
 /end VAR_CHARACTERISTIC
 /begin VAR_CHARACTERISTIC U8_WPE_WPE_Straight_Cont_Comp_r BrkCalVariantCriterion
  /begin VAR_ADDRESS 0x80021555 0x80024955 0x80027D55 0x8002B155 0x8002E555 0x80031955 0x80034D55 0x80038155 /end VAR_ADDRESS
 /end VAR_CHARACTERISTIC
/end VARIANT_CODING
/end MODULE
/end PROJECT
