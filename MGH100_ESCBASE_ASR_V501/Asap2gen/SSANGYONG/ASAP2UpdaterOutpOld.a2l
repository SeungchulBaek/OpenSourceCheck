ASAP2_VERSION 1 60
/begin PROJECT Master ""
/begin MODULE CPP ""
/begin MOD_COMMON "" BYTE_ORDER MSB_LAST ALIGNMENT_BYTE 1 ALIGNMENT_WORD 1 ALIGNMENT_LONG 1 ALIGNMENT_FLOAT32_IEEE 1 ALIGNMENT_FLOAT64_IEEE 1 ALIGNMENT_INT64 1 /end MOD_COMMON
/begin CHARACTERISTIC LPC_S16_EBP_TARGET_PRESS "" VALUE 0x80020FB2 CalPrmLoPCoorrBrk_SWORD 0 P34 -3276.8 3276.7 SYMBOL_LINK "CalPrmLowPCoorrBrk01.LPC_S16_EBP_TARGET_PRESS" 0 /end CHARACTERISTIC
/begin CHARACTERISTIC LPC_U8_EBP_APPLY_TIME "" VALUE 0x80020FB1 CalPrmLoPCoorrBrk_UBYTE 0 Ti21 0 2.55 SYMBOL_LINK "CalPrmLowPCoorrBrk01.LPC_U8_EBP_APPLY_TIME" 0 /end CHARACTERISTIC
/begin CHARACTERISTIC LPC_U8_EBP_ENABLE_TIME_THR "" VALUE 0x80020FB0 CalPrmLoPCoorrBrk_UBYTE 0 Ti21 0 2.55 SYMBOL_LINK "CalPrmLowPCoorrBrk01.LPC_U8_EBP_ENABLE_TIME_THR" 0 /end CHARACTERISTIC
/begin CHARACTERISTIC LPC_U8_EBP_ENTER_MPRESS "" VALUE 0x80020FB4 CalPrmLoPCoorrBrk_UBYTE 0 P34 0 25.5 SYMBOL_LINK "CalPrmLowPCoorrBrk01.LPC_U8_EBP_ENTER_MPRESS" 0 /end CHARACTERISTIC
/begin CHARACTERISTIC LPC_U8_EBP_ENTER_SPEED "" VALUE 0x80020FB5 CalPrmLoPCoorrBrk_UBYTE 0 P34 0 25.5 SYMBOL_LINK "CalPrmLowPCoorrBrk01.LPC_U8_EBP_ENTER_SPEED" 0 /end CHARACTERISTIC
/begin CHARACTERISTIC LPC_U8_EBP_EXIT_MPRESS "" VALUE 0x80020FB9 CalPrmLoPCoorrBrk_UBYTE 0 P34 0 25.5 SYMBOL_LINK "CalPrmLowPCoorrBrk01.LPC_U8_EBP_EXIT_MPRESS" 0 /end CHARACTERISTIC
/begin CHARACTERISTIC LPC_U8_EBP_EXIT_MTP "" VALUE 0x80020FBA CalPrmLoPCoorrBrk_UBYTE 0 Perc6 0 255 SYMBOL_LINK "CalPrmLowPCoorrBrk01.LPC_U8_EBP_EXIT_MTP" 0 /end CHARACTERISTIC
/begin CHARACTERISTIC LPC_U8_EBP_MTP_DIFF_LV1 "" VALUE 0x80020FB6 CalPrmLoPCoorrBrk_UBYTE 0 Perc6 0 255 SYMBOL_LINK "CalPrmLowPCoorrBrk01.LPC_U8_EBP_MTP_DIFF_LV1" 0 /end CHARACTERISTIC
/begin CHARACTERISTIC LPC_U8_EBP_MTP_DIFF_LV2 "" VALUE 0x80020FB7 CalPrmLoPCoorrBrk_UBYTE 0 Perc6 0 255 SYMBOL_LINK "CalPrmLowPCoorrBrk01.LPC_U8_EBP_MTP_DIFF_LV2" 0 /end CHARACTERISTIC
/begin CHARACTERISTIC LPC_U8_EBP_MTP_DIFF_LV3 "" VALUE 0x80020FB8 CalPrmLoPCoorrBrk_UBYTE 0 Perc6 0 255 SYMBOL_LINK "CalPrmLowPCoorrBrk01.LPC_U8_EBP_MTP_DIFF_LV3" 0 /end CHARACTERISTIC
/begin CHARACTERISTIC S16_WPE_Caliper_Model_Volume_No_f "Temp" VALUE 0x80021556 CalPrmBrkTqCtrlrBrk_SWORD 0 Gain -32768 32767 SYMBOL_LINK "CalPrmBrkTqCtrlrBrk01.S16_WPE_Caliper_Model_Volume_No_f" 0 /end CHARACTERISTIC
/begin CHARACTERISTIC S16_WPE_Caliper_Model_Volume_f_1 "Temp" VALUE 0x8002157A CalPrmBrkTqCtrlrBrk_SWORD 0 Gain -32768 32767 SYMBOL_LINK "CalPrmBrkTqCtrlrBrk01.S16_WPE_Caliper_Model_Volume_f_1" 0 /end CHARACTERISTIC
/begin CHARACTERISTIC S16_WPE_Caliper_Model_Volume_f_10 "Temp" VALUE 0x8002158C CalPrmBrkTqCtrlrBrk_SWORD 0 Gain -32768 32767 SYMBOL_LINK "CalPrmBrkTqCtrlrBrk01.S16_WPE_Caliper_Model_Volume_f_10" 0 /end CHARACTERISTIC
/begin CHARACTERISTIC S16_WPE_Caliper_Model_Volume_f_11 "Temp" VALUE 0x8002158E CalPrmBrkTqCtrlrBrk_SWORD 0 Gain -32768 32767 SYMBOL_LINK "CalPrmBrkTqCtrlrBrk01.S16_WPE_Caliper_Model_Volume_f_11" 0 /end CHARACTERISTIC
/begin CHARACTERISTIC S16_WPE_Caliper_Model_Volume_f_12 "Temp" VALUE 0x80021590 CalPrmBrkTqCtrlrBrk_SWORD 0 Gain -32768 32767 SYMBOL_LINK "CalPrmBrkTqCtrlrBrk01.S16_WPE_Caliper_Model_Volume_f_12" 0 /end CHARACTERISTIC
/begin CHARACTERISTIC S16_WPE_Caliper_Model_Volume_f_13 "Temp" VALUE 0x80021592 CalPrmBrkTqCtrlrBrk_SWORD 0 Gain -32768 32767 SYMBOL_LINK "CalPrmBrkTqCtrlrBrk01.S16_WPE_Caliper_Model_Volume_f_13" 0 /end CHARACTERISTIC
/begin CHARACTERISTIC S16_WPE_Caliper_Model_Volume_f_14 "Temp" VALUE 0x80021594 CalPrmBrkTqCtrlrBrk_SWORD 0 Gain -32768 32767 SYMBOL_LINK "CalPrmBrkTqCtrlrBrk01.S16_WPE_Caliper_Model_Volume_f_14" 0 /end CHARACTERISTIC
/begin CHARACTERISTIC S16_WPE_Caliper_Model_Volume_f_15 "Temp" VALUE 0x80021596 CalPrmBrkTqCtrlrBrk_SWORD 0 Gain -32768 32767 SYMBOL_LINK "CalPrmBrkTqCtrlrBrk01.S16_WPE_Caliper_Model_Volume_f_15" 0 /end CHARACTERISTIC
/begin CHARACTERISTIC S16_WPE_Caliper_Model_Volume_f_16 "Temp" VALUE 0x80021598 CalPrmBrkTqCtrlrBrk_SWORD 0 Gain -32768 32767 SYMBOL_LINK "CalPrmBrkTqCtrlrBrk01.S16_WPE_Caliper_Model_Volume_f_16" 0 /end CHARACTERISTIC
/begin CHARACTERISTIC S16_WPE_Caliper_Model_Volume_f_2 "Temp" VALUE 0x8002157C CalPrmBrkTqCtrlrBrk_SWORD 0 Gain -32768 32767 SYMBOL_LINK "CalPrmBrkTqCtrlrBrk01.S16_WPE_Caliper_Model_Volume_f_2" 0 /end CHARACTERISTIC
/begin CHARACTERISTIC S16_WPE_Caliper_Model_Volume_f_3 "Temp" VALUE 0x8002157E CalPrmBrkTqCtrlrBrk_SWORD 0 Gain -32768 32767 SYMBOL_LINK "CalPrmBrkTqCtrlrBrk01.S16_WPE_Caliper_Model_Volume_f_3" 0 /end CHARACTERISTIC
/begin CHARACTERISTIC S16_WPE_Caliper_Model_Volume_f_4 "Temp" VALUE 0x80021580 CalPrmBrkTqCtrlrBrk_SWORD 0 Gain -32768 32767 SYMBOL_LINK "CalPrmBrkTqCtrlrBrk01.S16_WPE_Caliper_Model_Volume_f_4" 0 /end CHARACTERISTIC
/begin CHARACTERISTIC S16_WPE_Caliper_Model_Volume_f_5 "Temp" VALUE 0x80021582 CalPrmBrkTqCtrlrBrk_SWORD 0 Gain -32768 32767 SYMBOL_LINK "CalPrmBrkTqCtrlrBrk01.S16_WPE_Caliper_Model_Volume_f_5" 0 /end CHARACTERISTIC
/begin CHARACTERISTIC S16_WPE_Caliper_Model_Volume_f_6 "Temp" VALUE 0x80021584 CalPrmBrkTqCtrlrBrk_SWORD 0 Gain -32768 32767 SYMBOL_LINK "CalPrmBrkTqCtrlrBrk01.S16_WPE_Caliper_Model_Volume_f_6" 0 /end CHARACTERISTIC
/begin CHARACTERISTIC S16_WPE_Caliper_Model_Volume_f_7 "Temp" VALUE 0x80021586 CalPrmBrkTqCtrlrBrk_SWORD 0 Gain -32768 32767 SYMBOL_LINK "CalPrmBrkTqCtrlrBrk01.S16_WPE_Caliper_Model_Volume_f_7" 0 /end CHARACTERISTIC
/begin CHARACTERISTIC S16_WPE_Caliper_Model_Volume_f_8 "Temp" VALUE 0x80021588 CalPrmBrkTqCtrlrBrk_SWORD 0 Gain -32768 32767 SYMBOL_LINK "CalPrmBrkTqCtrlrBrk01.S16_WPE_Caliper_Model_Volume_f_8" 0 /end CHARACTERISTIC
/begin CHARACTERISTIC S16_WPE_Caliper_Model_Volume_f_9 "Temp" VALUE 0x8002158A CalPrmBrkTqCtrlrBrk_SWORD 0 Gain -32768 32767 SYMBOL_LINK "CalPrmBrkTqCtrlrBrk01.S16_WPE_Caliper_Model_Volume_f_9" 0 /end CHARACTERISTIC
/begin CHARACTERISTIC S16_WPE_LFC_ESC_MP_Rise_Gain_f_1st "Temp" VALUE 0x80021750 CalPrmBrkTqCtrlrBrk_SWORD 0 Perc6 -32768 32767 SYMBOL_LINK "CalPrmBrkTqCtrlrBrk01.S16_WPE_LFC_ESC_MP_Rise_Gain_f_1st" 0 /end CHARACTERISTIC
/begin CHARACTERISTIC S16_WPE_LFC_ESC_MP_Rise_Gain_f_2nd "Temp" VALUE 0x80021752 CalPrmBrkTqCtrlrBrk_SWORD 0 Perc6 -32768 32767 SYMBOL_LINK "CalPrmBrkTqCtrlrBrk01.S16_WPE_LFC_ESC_MP_Rise_Gain_f_2nd" 0 /end CHARACTERISTIC
/begin CHARACTERISTIC S16_WPE_LFC_ESC_MP_Rise_Gain_f_3rd "Temp" VALUE 0x80021754 CalPrmBrkTqCtrlrBrk_SWORD 0 Perc6 -32768 32767 SYMBOL_LINK "CalPrmBrkTqCtrlrBrk01.S16_WPE_LFC_ESC_MP_Rise_Gain_f_3rd" 0 /end CHARACTERISTIC
/begin CHARACTERISTIC S16_WPE_LFC_ESC_MP_Rise_Gain_f_4th "Temp" VALUE 0x80021756 CalPrmBrkTqCtrlrBrk_SWORD 0 Perc6 -32768 32767 SYMBOL_LINK "CalPrmBrkTqCtrlrBrk01.S16_WPE_LFC_ESC_MP_Rise_Gain_f_4th" 0 /end CHARACTERISTIC
/begin CHARACTERISTIC S16_WPE_LFC_ESC_MP_Rise_Gain_f_5th "Temp" VALUE 0x80021758 CalPrmBrkTqCtrlrBrk_SWORD 0 Perc6 -32768 32767 SYMBOL_LINK "CalPrmBrkTqCtrlrBrk01.S16_WPE_LFC_ESC_MP_Rise_Gain_f_5th" 0 /end CHARACTERISTIC
/begin CHARACTERISTIC S16_WPE_LFC_ESC_MP_Rise_Gain_f_6th "Temp" VALUE 0x8002175A CalPrmBrkTqCtrlrBrk_SWORD 0 Perc6 -32768 32767 SYMBOL_LINK "CalPrmBrkTqCtrlrBrk01.S16_WPE_LFC_ESC_MP_Rise_Gain_f_6th" 0 /end CHARACTERISTIC
/begin CHARACTERISTIC S16_WPE_LFC_ESC_MP_Rise_Gain_r_1st "Temp" VALUE 0x80021762 CalPrmBrkTqCtrlrBrk_SWORD 0 Perc6 -32768 32767 SYMBOL_LINK "CalPrmBrkTqCtrlrBrk01.S16_WPE_LFC_ESC_MP_Rise_Gain_r_1st" 0 /end CHARACTERISTIC
/begin CHARACTERISTIC S16_WPE_LFC_ESC_MP_Rise_Gain_r_2nd "Temp" VALUE 0x80021764 CalPrmBrkTqCtrlrBrk_SWORD 0 Perc6 -32768 32767 SYMBOL_LINK "CalPrmBrkTqCtrlrBrk01.S16_WPE_LFC_ESC_MP_Rise_Gain_r_2nd" 0 /end CHARACTERISTIC
/begin CHARACTERISTIC S16_WPE_LFC_ESC_MP_Rise_Gain_r_3rd "Temp" VALUE 0x80021766 CalPrmBrkTqCtrlrBrk_SWORD 0 Perc6 -32768 32767 SYMBOL_LINK "CalPrmBrkTqCtrlrBrk01.S16_WPE_LFC_ESC_MP_Rise_Gain_r_3rd" 0 /end CHARACTERISTIC
/begin CHARACTERISTIC S16_WPE_LFC_ESC_MP_Rise_Gain_r_4th "Temp" VALUE 0x80021768 CalPrmBrkTqCtrlrBrk_SWORD 0 Perc6 -32768 32767 SYMBOL_LINK "CalPrmBrkTqCtrlrBrk01.S16_WPE_LFC_ESC_MP_Rise_Gain_r_4th" 0 /end CHARACTERISTIC
/begin CHARACTERISTIC S16_WPE_LFC_ESC_MP_Rise_Gain_r_5th "Temp" VALUE 0x8002176A CalPrmBrkTqCtrlrBrk_SWORD 0 Perc6 -32768 32767 SYMBOL_LINK "CalPrmBrkTqCtrlrBrk01.S16_WPE_LFC_ESC_MP_Rise_Gain_r_5th" 0 /end CHARACTERISTIC
/begin CHARACTERISTIC S16_WPE_LFC_ESC_MP_Rise_Gain_r_6th "Temp" VALUE 0x8002176C CalPrmBrkTqCtrlrBrk_SWORD 0 Perc6 -32768 32767 SYMBOL_LINK "CalPrmBrkTqCtrlrBrk01.S16_WPE_LFC_ESC_MP_Rise_Gain_r_6th" 0 /end CHARACTERISTIC
/begin CHARACTERISTIC S16_WPE_NC_Dump_Gain_Press_f_1st "Temp" VALUE 0x8002176E CalPrmBrkTqCtrlrBrk_SWORD 0 P34 -3276.8 3276.7 SYMBOL_LINK "CalPrmBrkTqCtrlrBrk01.S16_WPE_NC_Dump_Gain_Press_f_1st" 0 /end CHARACTERISTIC
/begin CHARACTERISTIC S16_WPE_NC_Dump_Gain_Press_f_2nd "Temp" VALUE 0x80021770 CalPrmBrkTqCtrlrBrk_SWORD 0 P34 -3276.8 3276.7 SYMBOL_LINK "CalPrmBrkTqCtrlrBrk01.S16_WPE_NC_Dump_Gain_Press_f_2nd" 0 /end CHARACTERISTIC
/begin CHARACTERISTIC S16_WPE_NC_Dump_Gain_Press_f_3rd "Temp" VALUE 0x80021772 CalPrmBrkTqCtrlrBrk_SWORD 0 P34 -3276.8 3276.7 SYMBOL_LINK "CalPrmBrkTqCtrlrBrk01.S16_WPE_NC_Dump_Gain_Press_f_3rd" 0 /end CHARACTERISTIC
/begin CHARACTERISTIC S16_WPE_NC_Dump_Gain_Press_f_4th "Temp" VALUE 0x80021774 CalPrmBrkTqCtrlrBrk_SWORD 0 P34 -3276.8 3276.7 SYMBOL_LINK "CalPrmBrkTqCtrlrBrk01.S16_WPE_NC_Dump_Gain_Press_f_4th" 0 /end CHARACTERISTIC
/begin CHARACTERISTIC S16_WPE_NC_Dump_Gain_Press_f_5th "Temp" VALUE 0x80021776 CalPrmBrkTqCtrlrBrk_SWORD 0 P34 -3276.8 3276.7 SYMBOL_LINK "CalPrmBrkTqCtrlrBrk01.S16_WPE_NC_Dump_Gain_Press_f_5th" 0 /end CHARACTERISTIC
/begin CHARACTERISTIC S16_WPE_NC_Dump_Gain_Press_f_6th "Temp" VALUE 0x80021778 CalPrmBrkTqCtrlrBrk_SWORD 0 P34 -3276.8 3276.7 SYMBOL_LINK "CalPrmBrkTqCtrlrBrk01.S16_WPE_NC_Dump_Gain_Press_f_6th" 0 /end CHARACTERISTIC
/begin CHARACTERISTIC S16_WPE_NC_Dump_Gain_f_1st "Temp" VALUE 0x8002177A CalPrmBrkTqCtrlrBrk_SWORD 0 Perc6 -32768 32767 SYMBOL_LINK "CalPrmBrkTqCtrlrBrk01.S16_WPE_NC_Dump_Gain_f_1st" 0 /end CHARACTERISTIC
/begin CHARACTERISTIC S16_WPE_NC_Dump_Gain_f_2nd "Temp" VALUE 0x8002177C CalPrmBrkTqCtrlrBrk_SWORD 0 Perc6 -32768 32767 SYMBOL_LINK "CalPrmBrkTqCtrlrBrk01.S16_WPE_NC_Dump_Gain_f_2nd" 0 /end CHARACTERISTIC
/begin CHARACTERISTIC S16_WPE_NC_Dump_Gain_f_3rd "Temp" VALUE 0x8002177E CalPrmBrkTqCtrlrBrk_SWORD 0 Perc6 -32768 32767 SYMBOL_LINK "CalPrmBrkTqCtrlrBrk01.S16_WPE_NC_Dump_Gain_f_3rd" 0 /end CHARACTERISTIC
/begin CHARACTERISTIC S16_WPE_NC_Dump_Gain_f_4th "Temp" VALUE 0x80021780 CalPrmBrkTqCtrlrBrk_SWORD 0 Perc6 -32768 32767 SYMBOL_LINK "CalPrmBrkTqCtrlrBrk01.S16_WPE_NC_Dump_Gain_f_4th" 0 /end CHARACTERISTIC
/begin CHARACTERISTIC S16_WPE_NC_Dump_Gain_f_5th "Temp" VALUE 0x80021782 CalPrmBrkTqCtrlrBrk_SWORD 0 Perc6 -32768 32767 SYMBOL_LINK "CalPrmBrkTqCtrlrBrk01.S16_WPE_NC_Dump_Gain_f_5th" 0 /end CHARACTERISTIC
/begin CHARACTERISTIC S16_WPE_NC_Dump_Gain_f_6th "Temp" VALUE 0x80021784 CalPrmBrkTqCtrlrBrk_SWORD 0 Perc6 -32768 32767 SYMBOL_LINK "CalPrmBrkTqCtrlrBrk01.S16_WPE_NC_Dump_Gain_f_6th" 0 /end CHARACTERISTIC
/begin CHARACTERISTIC S16_WPE_TC_Dump_Gain_Press_f_1st "Temp" VALUE 0x800215EA CalPrmBrkTqCtrlrBrk_SWORD 0 P34 -3276.8 3276.7 SYMBOL_LINK "CalPrmBrkTqCtrlrBrk01.S16_WPE_TC_Dump_Gain_Press_f_1st" 0 /end CHARACTERISTIC
/begin CHARACTERISTIC S16_WPE_TC_Dump_Gain_Press_f_2nd "Temp" VALUE 0x800215EC CalPrmBrkTqCtrlrBrk_SWORD 0 P34 -3276.8 3276.7 SYMBOL_LINK "CalPrmBrkTqCtrlrBrk01.S16_WPE_TC_Dump_Gain_Press_f_2nd" 0 /end CHARACTERISTIC
/begin CHARACTERISTIC S16_WPE_TC_Dump_Gain_Press_f_3rd "Temp" VALUE 0x800215EE CalPrmBrkTqCtrlrBrk_SWORD 0 P34 -3276.8 3276.7 SYMBOL_LINK "CalPrmBrkTqCtrlrBrk01.S16_WPE_TC_Dump_Gain_Press_f_3rd" 0 /end CHARACTERISTIC
/begin CHARACTERISTIC S16_WPE_TC_Dump_Gain_Press_f_4th "Temp" VALUE 0x800215F0 CalPrmBrkTqCtrlrBrk_SWORD 0 P34 -3276.8 3276.7 SYMBOL_LINK "CalPrmBrkTqCtrlrBrk01.S16_WPE_TC_Dump_Gain_Press_f_4th" 0 /end CHARACTERISTIC
/begin CHARACTERISTIC S16_WPE_TC_Dump_Gain_Press_f_5th "Temp" VALUE 0x800215F2 CalPrmBrkTqCtrlrBrk_SWORD 0 P34 -3276.8 3276.7 SYMBOL_LINK "CalPrmBrkTqCtrlrBrk01.S16_WPE_TC_Dump_Gain_Press_f_5th" 0 /end CHARACTERISTIC
/begin CHARACTERISTIC S16_WPE_TC_Dump_Gain_Press_f_6th "Temp" VALUE 0x800215F4 CalPrmBrkTqCtrlrBrk_SWORD 0 P34 -3276.8 3276.7 SYMBOL_LINK "CalPrmBrkTqCtrlrBrk01.S16_WPE_TC_Dump_Gain_Press_f_6th" 0 /end CHARACTERISTIC
/begin CHARACTERISTIC S16_WPE_TC_Dump_Gain_f_1st "Temp" VALUE 0x800215F6 CalPrmBrkTqCtrlrBrk_SWORD 0 Perc6 -32768 32767 SYMBOL_LINK "CalPrmBrkTqCtrlrBrk01.S16_WPE_TC_Dump_Gain_f_1st" 0 /end CHARACTERISTIC
/begin CHARACTERISTIC S16_WPE_TC_Dump_Gain_f_2nd "Temp" VALUE 0x800215F8 CalPrmBrkTqCtrlrBrk_SWORD 0 Perc6 -32768 32767 SYMBOL_LINK "CalPrmBrkTqCtrlrBrk01.S16_WPE_TC_Dump_Gain_f_2nd" 0 /end CHARACTERISTIC
/begin CHARACTERISTIC S16_WPE_TC_Dump_Gain_f_3rd "Temp" VALUE 0x800215FA CalPrmBrkTqCtrlrBrk_SWORD 0 Perc6 -32768 32767 SYMBOL_LINK "CalPrmBrkTqCtrlrBrk01.S16_WPE_TC_Dump_Gain_f_3rd" 0 /end CHARACTERISTIC
/begin CHARACTERISTIC S16_WPE_TC_Dump_Gain_f_4th "Temp" VALUE 0x800215FC CalPrmBrkTqCtrlrBrk_SWORD 0 Perc6 -32768 32767 SYMBOL_LINK "CalPrmBrkTqCtrlrBrk01.S16_WPE_TC_Dump_Gain_f_4th" 0 /end CHARACTERISTIC
/begin CHARACTERISTIC S16_WPE_TC_Dump_Gain_f_5th "Temp" VALUE 0x800215FE CalPrmBrkTqCtrlrBrk_SWORD 0 Perc6 -32768 32767 SYMBOL_LINK "CalPrmBrkTqCtrlrBrk01.S16_WPE_TC_Dump_Gain_f_5th" 0 /end CHARACTERISTIC
/begin CHARACTERISTIC S16_WPE_TC_Dump_Gain_f_6th "Temp" VALUE 0x80021600 CalPrmBrkTqCtrlrBrk_SWORD 0 Perc6 -32768 32767 SYMBOL_LINK "CalPrmBrkTqCtrlrBrk01.S16_WPE_TC_Dump_Gain_f_6th" 0 /end CHARACTERISTIC
/begin CHARACTERISTIC SSM_S16_ADD_ACT_TIME_NO_ACT_EPB "" VALUE 0x80020FE8 CalPrmSsmBrk_SWORD 0 Ti11 -32768 32767 SYMBOL_LINK "CalPrmSsmBrk01.SSM_S16_ADD_ACT_TIME_NO_ACT_EPB" 0 /end CHARACTERISTIC
/begin CHARACTERISTIC SSM_S16_AUTO_PAUSE_TIME "" VALUE 0x80020FEA CalPrmSsmBrk_SWORD 0 Ti11 -32768 32767 SYMBOL_LINK "CalPrmSsmBrk01.SSM_S16_AUTO_PAUSE_TIME" 0 /end CHARACTERISTIC
/begin CHARACTERISTIC SSM_S16_AVH_ABNORMAL_HOLD_TIME "" VALUE 0x80021016 CalPrmSsmBrk_SWORD 0 Ti21 -327.68 327.67 SYMBOL_LINK "CalPrmSsmBrk01.SSM_S16_AVH_ABNORMAL_HOLD_TIME" 0 /end CHARACTERISTIC
/begin CHARACTERISTIC SSM_S16_AVH_ALARM_TIME_EPB_OK "" VALUE 0x80021010 CalPrmSsmBrk_SWORD 0 Ti21 -327.68 327.67 SYMBOL_LINK "CalPrmSsmBrk01.SSM_S16_AVH_ALARM_TIME_EPB_OK" 0 /end CHARACTERISTIC
/begin CHARACTERISTIC SSM_S16_AVH_ALARM_TIME_INBIT_SW_OFF "" VALUE 0x80021012 CalPrmSsmBrk_SWORD 0 Ti21 -327.68 327.67 SYMBOL_LINK "CalPrmSsmBrk01.SSM_S16_AVH_ALARM_TIME_INBIT_SW_OFF" 0 /end CHARACTERISTIC
/begin CHARACTERISTIC SSM_S16_AVH_ALARM_TIME_INBIT_SW_ON "" VALUE 0x80021014 CalPrmSsmBrk_SWORD 0 Ti21 -327.68 327.67 SYMBOL_LINK "CalPrmSsmBrk01.SSM_S16_AVH_ALARM_TIME_INBIT_SW_ON" 0 /end CHARACTERISTIC
/begin CHARACTERISTIC SSM_S16_AVH_APPLY_TIME_1ST_REF_P "" VALUE 0x80020FFC CalPrmSsmBrk_SWORD 0 P34 -3276.8 3276.7 SYMBOL_LINK "CalPrmSsmBrk01.SSM_S16_AVH_APPLY_TIME_1ST_REF_P" 0 /end CHARACTERISTIC
/begin CHARACTERISTIC SSM_S16_AVH_APPLY_TIME_2ND_REF_P "" VALUE 0x80020FFE CalPrmSsmBrk_SWORD 0 P34 -3276.8 3276.7 SYMBOL_LINK "CalPrmSsmBrk01.SSM_S16_AVH_APPLY_TIME_2ND_REF_P" 0 /end CHARACTERISTIC
/begin CHARACTERISTIC SSM_S16_AVH_APPLY_TIME_3RD_REF_P "" VALUE 0x80021000 CalPrmSsmBrk_SWORD 0 P34 -3276.8 3276.7 SYMBOL_LINK "CalPrmSsmBrk01.SSM_S16_AVH_APPLY_TIME_3RD_REF_P" 0 /end CHARACTERISTIC
/begin CHARACTERISTIC SSM_S16_AVH_APPLY_TIME_4TH_REF_P "" VALUE 0x80021002 CalPrmSsmBrk_SWORD 0 P34 -3276.8 3276.7 SYMBOL_LINK "CalPrmSsmBrk01.SSM_S16_AVH_APPLY_TIME_4TH_REF_P" 0 /end CHARACTERISTIC
/begin CHARACTERISTIC SSM_S16_AVH_APPLY_TIME_5TH_REF_P "" VALUE 0x80021004 CalPrmSsmBrk_SWORD 0 P34 -3276.8 3276.7 SYMBOL_LINK "CalPrmSsmBrk01.SSM_S16_AVH_APPLY_TIME_5TH_REF_P" 0 /end CHARACTERISTIC
/begin CHARACTERISTIC SSM_S16_AVH_FAST_EXIT_MTP_TH "" VALUE 0x80021018 CalPrmSsmBrk_SWORD 0 Perc6 -32768 32767 SYMBOL_LINK "CalPrmSsmBrk01.SSM_S16_AVH_FAST_EXIT_MTP_TH" 0 /end CHARACTERISTIC
/begin CHARACTERISTIC SSM_S16_AVH_IGN_DECOUNT_CYCLE "" VALUE 0x80020FEC CalPrmSsmBrk_SWORD 0 Ti21 -327.68 327.67 SYMBOL_LINK "CalPrmSsmBrk01.SSM_S16_AVH_IGN_DECOUNT_CYCLE" 0 /end CHARACTERISTIC
/begin CHARACTERISTIC SSM_S16_AVH_RECOVERY_IGN_CNT_REF "" VALUE 0x80020FEE CalPrmSsmBrk_SWORD 0 Ti11 -32768 32767 SYMBOL_LINK "CalPrmSsmBrk01.SSM_S16_AVH_RECOVERY_IGN_CNT_REF" 0 /end CHARACTERISTIC
/begin CHARACTERISTIC SSM_S16_EPB_ACT_DELAY_MAXHILL "" VALUE 0x80020FF8 CalPrmSsmBrk_SWORD 0 Ti11 -32768 32767 SYMBOL_LINK "CalPrmSsmBrk01.SSM_S16_EPB_ACT_DELAY_MAXHILL" 0 /end CHARACTERISTIC
/begin CHARACTERISTIC SSM_S16_MAX_ON_TIME_ONE_CYCLE "" VALUE 0x80020FF0 CalPrmSsmBrk_SWORD 0 Ti11 -32768 32767 SYMBOL_LINK "CalPrmSsmBrk01.SSM_S16_MAX_ON_TIME_ONE_CYCLE" 0 /end CHARACTERISTIC
/begin CHARACTERISTIC SSM_S16_MAX_ON_TIME_ONE_CYCLE_AUTO "" VALUE 0x80020FF2 CalPrmSsmBrk_SWORD 0 Ti11 -32768 32767 SYMBOL_LINK "CalPrmSsmBrk01.SSM_S16_MAX_ON_TIME_ONE_CYCLE_AUTO" 0 /end CHARACTERISTIC
/begin CHARACTERISTIC SSM_S16_MAX_ON_TIME_ONE_IGN "" VALUE 0x80020FF4 CalPrmSsmBrk_SWORD 0 Ti11 -32768 32767 SYMBOL_LINK "CalPrmSsmBrk01.SSM_S16_MAX_ON_TIME_ONE_IGN" 0 /end CHARACTERISTIC
/begin CHARACTERISTIC SSM_S16_MAX_ON_TIME_ONE_IGN_AUTO "" VALUE 0x80020FF6 CalPrmSsmBrk_SWORD 0 Ti11 -32768 32767 SYMBOL_LINK "CalPrmSsmBrk01.SSM_S16_MAX_ON_TIME_ONE_IGN_AUTO" 0 /end CHARACTERISTIC
/begin CHARACTERISTIC SSM_S16_ROLL_RISE_PRESSURE "" VALUE 0x80020FE4 CalPrmSsmBrk_SWORD 0 P34 -3276.8 3276.7 SYMBOL_LINK "CalPrmSsmBrk01.SSM_S16_ROLL_RISE_PRESSURE" 0 /end CHARACTERISTIC
/begin CHARACTERISTIC SSM_S16_SSM_ACC_PEDAL_ON_MIN_TH "" VALUE 0x8003A740 CalPrmSsmEng_SWORD 0 Perc6 -32768 32767 SYMBOL_LINK "CalPrmSsmEng01.SSM_S16_SSM_ACC_PEDAL_ON_MIN_TH" 0 /end CHARACTERISTIC
/begin CHARACTERISTIC SSM_S16_SSM_AX_DIFF_FOR_DIVE_DETECT "" VALUE 0x8003A77C CalPrmSsmEng_SWORD 0 A48 -3.2768 3.2767 SYMBOL_LINK "CalPrmSsmEng01.SSM_S16_SSM_AX_DIFF_FOR_DIVE_DETECT" 0 /end CHARACTERISTIC
/begin CHARACTERISTIC SSM_S16_SSM_AX_DIFF_LOW_REF "" VALUE 0x8003A772 CalPrmSsmEng_SWORD 0 A48 -3.2768 3.2767 SYMBOL_LINK "CalPrmSsmEng01.SSM_S16_SSM_AX_DIFF_LOW_REF" 0 /end CHARACTERISTIC
/begin CHARACTERISTIC SSM_S16_SSM_AX_DIFF_MAX_REF "" VALUE 0x8003A776 CalPrmSsmEng_SWORD 0 A48 -3.2768 3.2767 SYMBOL_LINK "CalPrmSsmEng01.SSM_S16_SSM_AX_DIFF_MAX_REF" 0 /end CHARACTERISTIC
/begin CHARACTERISTIC SSM_S16_SSM_AX_DIFF_MED_REF "" VALUE 0x8003A774 CalPrmSsmEng_SWORD 0 A48 -3.2768 3.2767 SYMBOL_LINK "CalPrmSsmEng01.SSM_S16_SSM_AX_DIFF_MED_REF" 0 /end CHARACTERISTIC
/begin CHARACTERISTIC SSM_S16_SSM_HOLD_PRESS_SAFETY_MARGIN "" VALUE 0x8003A744 CalPrmSsmEng_SWORD 0 P34 -3276.8 3276.7 SYMBOL_LINK "CalPrmSsmEng01.SSM_S16_SSM_HOLD_PRESS_SAFETY_MARGIN" 0 /end CHARACTERISTIC
/begin CHARACTERISTIC SSM_S16_SSM_MAX_EXIT_TORQUE "" VALUE 0x8003A78C CalPrmSsmEng_SWORD 0 Tq51 -3276.8 3276.7 SYMBOL_LINK "CalPrmSsmEng01.SSM_S16_SSM_MAX_EXIT_TORQUE" 0 /end CHARACTERISTIC
/begin CHARACTERISTIC SSM_S16_SSM_MAX_MP_OFFSET_BLS_FAIL "" VALUE 0x8003A73E CalPrmSsmEng_SWORD 0 P34 -3276.8 3276.7 SYMBOL_LINK "CalPrmSsmEng01.SSM_S16_SSM_MAX_MP_OFFSET_BLS_FAIL" 0 /end CHARACTERISTIC
/begin CHARACTERISTIC SSM_S16_SSM_MAX_PRESS_SLOP "" VALUE 0x8003A768 CalPrmSsmEng_SWORD 0 PGrdt13 -3276.8 3276.7 SYMBOL_LINK "CalPrmSsmEng01.SSM_S16_SSM_MAX_PRESS_SLOP" 0 /end CHARACTERISTIC
/begin CHARACTERISTIC SSM_S16_SSM_MIN_CTRL_PRESS "" VALUE 0x8003A742 CalPrmSsmEng_SWORD 0 P34 -3276.8 3276.7 SYMBOL_LINK "CalPrmSsmEng01.SSM_S16_SSM_MIN_CTRL_PRESS" 0 /end CHARACTERISTIC
/begin CHARACTERISTIC SSM_S16_SSM_MIN_CTRL_PRESS_F_N_HM "" VALUE 0x8003A74E CalPrmSsmEng_SWORD 0 P34 -3276.8 3276.7 SYMBOL_LINK "CalPrmSsmEng01.SSM_S16_SSM_MIN_CTRL_PRESS_F_N_HM" 0 /end CHARACTERISTIC
/begin CHARACTERISTIC SSM_S16_SSM_MIN_CTRL_PRESS_F_N_LM "" VALUE 0x8003A74C CalPrmSsmEng_SWORD 0 P34 -3276.8 3276.7 SYMBOL_LINK "CalPrmSsmEng01.SSM_S16_SSM_MIN_CTRL_PRESS_F_N_LM" 0 /end CHARACTERISTIC
/begin CHARACTERISTIC SSM_S16_SSM_MIN_CTRL_PRESS_F_N_MAX "" VALUE 0x8003A750 CalPrmSsmEng_SWORD 0 P34 -3276.8 3276.7 SYMBOL_LINK "CalPrmSsmEng01.SSM_S16_SSM_MIN_CTRL_PRESS_F_N_MAX" 0 /end CHARACTERISTIC
/begin CHARACTERISTIC SSM_S16_SSM_MIN_CTRL_PRESS_F_P_HM "" VALUE 0x8003A748 CalPrmSsmEng_SWORD 0 P34 -3276.8 3276.7 SYMBOL_LINK "CalPrmSsmEng01.SSM_S16_SSM_MIN_CTRL_PRESS_F_P_HM" 0 /end CHARACTERISTIC
/begin CHARACTERISTIC SSM_S16_SSM_MIN_CTRL_PRESS_F_P_LM "" VALUE 0x8003A746 CalPrmSsmEng_SWORD 0 P34 -3276.8 3276.7 SYMBOL_LINK "CalPrmSsmEng01.SSM_S16_SSM_MIN_CTRL_PRESS_F_P_LM" 0 /end CHARACTERISTIC
/begin CHARACTERISTIC SSM_S16_SSM_MIN_CTRL_PRESS_F_P_MAX "" VALUE 0x8003A74A CalPrmSsmEng_SWORD 0 P34 -3276.8 3276.7 SYMBOL_LINK "CalPrmSsmEng01.SSM_S16_SSM_MIN_CTRL_PRESS_F_P_MAX" 0 /end CHARACTERISTIC
/begin CHARACTERISTIC SSM_S16_SSM_MIN_CTRL_PRESS_HM "" VALUE 0x8003A760 CalPrmSsmEng_SWORD 0 P34 -3276.8 3276.7 SYMBOL_LINK "CalPrmSsmEng01.SSM_S16_SSM_MIN_CTRL_PRESS_HM" 0 /end CHARACTERISTIC
/begin CHARACTERISTIC SSM_S16_SSM_MIN_CTRL_PRESS_LM "" VALUE 0x8003A75E CalPrmSsmEng_SWORD 0 P34 -3276.8 3276.7 SYMBOL_LINK "CalPrmSsmEng01.SSM_S16_SSM_MIN_CTRL_PRESS_LM" 0 /end CHARACTERISTIC
/begin CHARACTERISTIC SSM_S16_SSM_MIN_CTRL_PRESS_MAX "" VALUE 0x8003A762 CalPrmSsmEng_SWORD 0 P34 -3276.8 3276.7 SYMBOL_LINK "CalPrmSsmEng01.SSM_S16_SSM_MIN_CTRL_PRESS_MAX" 0 /end CHARACTERISTIC
/begin CHARACTERISTIC SSM_S16_SSM_MIN_CTRL_PRESS_R_N_HM "" VALUE 0x8003A75A CalPrmSsmEng_SWORD 0 P34 -3276.8 3276.7 SYMBOL_LINK "CalPrmSsmEng01.SSM_S16_SSM_MIN_CTRL_PRESS_R_N_HM" 0 /end CHARACTERISTIC
/begin CHARACTERISTIC SSM_S16_SSM_MIN_CTRL_PRESS_R_N_LM "" VALUE 0x8003A758 CalPrmSsmEng_SWORD 0 P34 -3276.8 3276.7 SYMBOL_LINK "CalPrmSsmEng01.SSM_S16_SSM_MIN_CTRL_PRESS_R_N_LM" 0 /end CHARACTERISTIC
/begin CHARACTERISTIC SSM_S16_SSM_MIN_CTRL_PRESS_R_N_MAX "" VALUE 0x8003A75C CalPrmSsmEng_SWORD 0 P34 -3276.8 3276.7 SYMBOL_LINK "CalPrmSsmEng01.SSM_S16_SSM_MIN_CTRL_PRESS_R_N_MAX" 0 /end CHARACTERISTIC
/begin CHARACTERISTIC SSM_S16_SSM_MIN_CTRL_PRESS_R_P_HM "" VALUE 0x8003A754 CalPrmSsmEng_SWORD 0 P34 -3276.8 3276.7 SYMBOL_LINK "CalPrmSsmEng01.SSM_S16_SSM_MIN_CTRL_PRESS_R_P_HM" 0 /end CHARACTERISTIC
/begin CHARACTERISTIC SSM_S16_SSM_MIN_CTRL_PRESS_R_P_LM "" VALUE 0x8003A752 CalPrmSsmEng_SWORD 0 P34 -3276.8 3276.7 SYMBOL_LINK "CalPrmSsmEng01.SSM_S16_SSM_MIN_CTRL_PRESS_R_P_LM" 0 /end CHARACTERISTIC
/begin CHARACTERISTIC SSM_S16_SSM_MIN_CTRL_PRESS_R_P_MAX "" VALUE 0x8003A756 CalPrmSsmEng_SWORD 0 P34 -3276.8 3276.7 SYMBOL_LINK "CalPrmSsmEng01.SSM_S16_SSM_MIN_CTRL_PRESS_R_P_MAX" 0 /end CHARACTERISTIC
/begin CHARACTERISTIC SSM_S16_SSM_MIN_PRESS_SLOP "" VALUE 0x8003A766 CalPrmSsmEng_SWORD 0 PGrdt13 -3276.8 3276.7 SYMBOL_LINK "CalPrmSsmEng01.SSM_S16_SSM_MIN_PRESS_SLOP" 0 /end CHARACTERISTIC
/begin CHARACTERISTIC SSM_S16_SSM_MIN_WH_SPEED "" VALUE 0x8003A780 CalPrmSsmEng_SWORD 0 Spd12 -4096 4095.875 SYMBOL_LINK "CalPrmSsmEng01.SSM_S16_SSM_MIN_WH_SPEED" 0 /end CHARACTERISTIC
/begin CHARACTERISTIC SSM_S16_SSM_MOVING_DETECT_CYCLE "" VALUE 0x8003A782 CalPrmSsmEng_SWORD 0 Ti21 -327.68 327.67 SYMBOL_LINK "CalPrmSsmEng01.SSM_S16_SSM_MOVING_DETECT_CYCLE" 0 /end CHARACTERISTIC
/begin CHARACTERISTIC SSM_S16_SSM_REBRAKE_DCT_THRESHOLD "" VALUE 0x8003A770 CalPrmSsmEng_SWORD 0 P34 -3276.8 3276.7 SYMBOL_LINK "CalPrmSsmEng01.SSM_S16_SSM_REBRAKE_DCT_THRESHOLD" 0 /end CHARACTERISTIC
/begin CHARACTERISTIC SSM_S16_SSM_SPIN_DETECTION_TH "" VALUE 0x8003A784 CalPrmSsmEng_SWORD 0 A21 -8192 8191.75 SYMBOL_LINK "CalPrmSsmEng01.SSM_S16_SSM_SPIN_DETECTION_TH" 0 /end CHARACTERISTIC
/begin CHARACTERISTIC SSM_S16_SSM_STOP_DETECT_MAX_SPD "" VALUE 0x8003A786 CalPrmSsmEng_SWORD 0 Spd12 -4096 4095.875 SYMBOL_LINK "CalPrmSsmEng01.SSM_S16_SSM_STOP_DETECT_MAX_SPD" 0 /end CHARACTERISTIC
/begin CHARACTERISTIC SSM_S16_SSM_VV_ACT_COMP_MAX_P_SLP "" VALUE 0x8003A76C CalPrmSsmEng_SWORD 0 P34 -3276.8 3276.7 SYMBOL_LINK "CalPrmSsmEng01.SSM_S16_SSM_VV_ACT_COMP_MAX_P_SLP" 0 /end CHARACTERISTIC
/begin CHARACTERISTIC SSM_S16_SSM_VV_ACT_COMP_MIN_P_SLP "" VALUE 0x8003A76A CalPrmSsmEng_SWORD 0 P34 -3276.8 3276.7 SYMBOL_LINK "CalPrmSsmEng01.SSM_S16_SSM_VV_ACT_COMP_MIN_P_SLP" 0 /end CHARACTERISTIC
/begin CHARACTERISTIC SSM_S8_AVH_ACT_MAX_GRADE_DW "" VALUE 0x80020FFA CalPrmSsmBrk_SBYTE 0 A42 -1.28 1.27 SYMBOL_LINK "CalPrmSsmBrk01.SSM_S8_AVH_ACT_MAX_GRADE_DW" 0 /end CHARACTERISTIC
/begin CHARACTERISTIC SSM_U16_SSM_WHEEL_RADIUS "" VALUE 0x8003A76E CalPrmSsmEng_UBYTE 0 Len21 0 25.5 SYMBOL_LINK "CalPrmSsmEng01.SSM_U16_SSM_WHEEL_RADIUS" 0 /end CHARACTERISTIC
/begin CHARACTERISTIC SSM_U8_AVH_ACT_MAX_GRADE "" VALUE 0x80020FFB CalPrmSsmBrk_UBYTE 0 A42 0 2.55 SYMBOL_LINK "CalPrmSsmBrk01.SSM_U8_AVH_ACT_MAX_GRADE" 0 /end CHARACTERISTIC
/begin CHARACTERISTIC SSM_U8_AVH_APPLY_TIME_1ST "" VALUE 0x80021006 CalPrmSsmBrk_UBYTE 0 Ti61 0 127.5 SYMBOL_LINK "CalPrmSsmBrk01.SSM_U8_AVH_APPLY_TIME_1ST" 0 /end CHARACTERISTIC
/begin CHARACTERISTIC SSM_U8_AVH_APPLY_TIME_1ST_MIN "" VALUE 0x80021007 CalPrmSsmBrk_UBYTE 0 Ti61 0 127.5 SYMBOL_LINK "CalPrmSsmBrk01.SSM_U8_AVH_APPLY_TIME_1ST_MIN" 0 /end CHARACTERISTIC
/begin CHARACTERISTIC SSM_U8_AVH_APPLY_TIME_2ND "" VALUE 0x80021008 CalPrmSsmBrk_UBYTE 0 Ti61 0 127.5 SYMBOL_LINK "CalPrmSsmBrk01.SSM_U8_AVH_APPLY_TIME_2ND" 0 /end CHARACTERISTIC
/begin CHARACTERISTIC SSM_U8_AVH_APPLY_TIME_2ND_MIN "" VALUE 0x80021009 CalPrmSsmBrk_UBYTE 0 Ti61 0 127.5 SYMBOL_LINK "CalPrmSsmBrk01.SSM_U8_AVH_APPLY_TIME_2ND_MIN" 0 /end CHARACTERISTIC
/begin CHARACTERISTIC SSM_U8_AVH_APPLY_TIME_3RD "" VALUE 0x8002100A CalPrmSsmBrk_UBYTE 0 Ti61 0 127.5 SYMBOL_LINK "CalPrmSsmBrk01.SSM_U8_AVH_APPLY_TIME_3RD" 0 /end CHARACTERISTIC
/begin CHARACTERISTIC SSM_U8_AVH_APPLY_TIME_3RD_MIN "" VALUE 0x8002100B CalPrmSsmBrk_UBYTE 0 Ti61 0 127.5 SYMBOL_LINK "CalPrmSsmBrk01.SSM_U8_AVH_APPLY_TIME_3RD_MIN" 0 /end CHARACTERISTIC
/begin CHARACTERISTIC SSM_U8_AVH_APPLY_TIME_4TH "" VALUE 0x8002100C CalPrmSsmBrk_UBYTE 0 Ti61 0 127.5 SYMBOL_LINK "CalPrmSsmBrk01.SSM_U8_AVH_APPLY_TIME_4TH" 0 /end CHARACTERISTIC
/begin CHARACTERISTIC SSM_U8_AVH_APPLY_TIME_4TH_MIN "" VALUE 0x8002100D CalPrmSsmBrk_UBYTE 0 Ti61 0 127.5 SYMBOL_LINK "CalPrmSsmBrk01.SSM_U8_AVH_APPLY_TIME_4TH_MIN" 0 /end CHARACTERISTIC
/begin CHARACTERISTIC SSM_U8_AVH_APPLY_TIME_5TH "" VALUE 0x8002100E CalPrmSsmBrk_UBYTE 0 Ti61 0 127.5 SYMBOL_LINK "CalPrmSsmBrk01.SSM_U8_AVH_APPLY_TIME_5TH" 0 /end CHARACTERISTIC
/begin CHARACTERISTIC SSM_U8_AVH_APPLY_TIME_5TH_MIN "" VALUE 0x8002100F CalPrmSsmBrk_UBYTE 0 Ti61 0 127.5 SYMBOL_LINK "CalPrmSsmBrk01.SSM_U8_AVH_APPLY_TIME_5TH_MIN" 0 /end CHARACTERISTIC
/begin CHARACTERISTIC SSM_U8_MAX_ROLL_RISE_ATTEMPT "" VALUE 0x80020FE6 CalPrmSsmBrk_UBYTE 0 Nr2 0 255 SYMBOL_LINK "CalPrmSsmBrk01.SSM_U8_MAX_ROLL_RISE_ATTEMPT" 0 /end CHARACTERISTIC
/begin CHARACTERISTIC SSM_U8_ROLL_RISE_TIME "" VALUE 0x80020FE7 CalPrmSsmBrk_UBYTE 0 Ti21 0 2.55 SYMBOL_LINK "CalPrmSsmBrk01.SSM_U8_ROLL_RISE_TIME" 0 /end CHARACTERISTIC
/begin CHARACTERISTIC SSM_U8_SSM_AT_PARK_GEAR_DELAY_TIME "" VALUE 0x8003A77E CalPrmSsmEng_UBYTE 0 Ti41 0 1.275 SYMBOL_LINK "CalPrmSsmEng01.SSM_U8_SSM_AT_PARK_GEAR_DELAY_TIME" 0 /end CHARACTERISTIC
/begin CHARACTERISTIC SSM_U8_SSM_AX_AVG_VALID_TH_LOW_DIF "" VALUE 0x8003A778 CalPrmSsmEng_UBYTE 0 Ti21 0 2.55 SYMBOL_LINK "CalPrmSsmEng01.SSM_U8_SSM_AX_AVG_VALID_TH_LOW_DIF" 0 /end CHARACTERISTIC
/begin CHARACTERISTIC SSM_U8_SSM_AX_AVG_VALID_TH_MAX_DIF "" VALUE 0x8003A77A CalPrmSsmEng_UBYTE 0 Ti21 0 2.55 SYMBOL_LINK "CalPrmSsmEng01.SSM_U8_SSM_AX_AVG_VALID_TH_MAX_DIF" 0 /end CHARACTERISTIC
/begin CHARACTERISTIC SSM_U8_SSM_AX_AVG_VALID_TH_MID_DIF "" VALUE 0x8003A779 CalPrmSsmEng_UBYTE 0 Ti21 0 2.55 SYMBOL_LINK "CalPrmSsmEng01.SSM_U8_SSM_AX_AVG_VALID_TH_MID_DIF" 0 /end CHARACTERISTIC
/begin CHARACTERISTIC SSM_U8_SSM_AX_IGNORE_TIME_TM_SHIFT "" VALUE 0x8003A77F CalPrmSsmEng_UBYTE 0 Ti41 0 1.275 SYMBOL_LINK "CalPrmSsmEng01.SSM_U8_SSM_AX_IGNORE_TIME_TM_SHIFT" 0 /end CHARACTERISTIC
/begin CHARACTERISTIC SSM_U8_SSM_CALC_MIN_PRESS_METHOD "" VALUE 0x8003A764 CalPrmSsmEng_UBYTE 0 OnOff1 0 255 SYMBOL_LINK "CalPrmSsmEng01.SSM_U8_SSM_CALC_MIN_PRESS_METHOD" 0 /end CHARACTERISTIC
/begin CHARACTERISTIC SSM_U8_SSM_DLY_ROLL_DET_TIME "" VALUE 0x8003A788 CalPrmSsmEng_UBYTE 0 Ti21 0 2.55 SYMBOL_LINK "CalPrmSsmEng01.SSM_U8_SSM_DLY_ROLL_DET_TIME" 0 /end CHARACTERISTIC
/begin CHARACTERISTIC SSM_U8_SSM_EXIT_DRV_TQ_GAIN "" VALUE 0x8003A78E CalPrmSsmEng_UBYTE 0 Gain21 0 2550 SYMBOL_LINK "CalPrmSsmEng01.SSM_U8_SSM_EXIT_DRV_TQ_GAIN" 0 /end CHARACTERISTIC
/begin CHARACTERISTIC SSM_U8_SSM_HIGH_MID_SLOP "" VALUE 0x8003A7A1 CalPrmSsmEng_UBYTE 0 A42 0 2.55 SYMBOL_LINK "CalPrmSsmEng01.SSM_U8_SSM_HIGH_MID_SLOP" 0 /end CHARACTERISTIC
/begin CHARACTERISTIC SSM_U8_SSM_H_M_ACC_POSITION "" VALUE 0x8003A795 CalPrmSsmEng_UBYTE 0 Perc6 0 255 SYMBOL_LINK "CalPrmSsmEng01.SSM_U8_SSM_H_M_ACC_POSITION" 0 /end CHARACTERISTIC
/begin CHARACTERISTIC SSM_U8_SSM_H_M_ACC_RELS_TIME_DWN "" VALUE 0x8003A799 CalPrmSsmEng_UBYTE 0 Ti21 0 2.55 SYMBOL_LINK "CalPrmSsmEng01.SSM_U8_SSM_H_M_ACC_RELS_TIME_DWN" 0 /end CHARACTERISTIC
/begin CHARACTERISTIC SSM_U8_SSM_H_M_ACC_RELS_TIME_UP "" VALUE 0x8003A79D CalPrmSsmEng_UBYTE 0 Ti21 0 2.55 SYMBOL_LINK "CalPrmSsmEng01.SSM_U8_SSM_H_M_ACC_RELS_TIME_UP" 0 /end CHARACTERISTIC
/begin CHARACTERISTIC SSM_U8_SSM_H_M_SLOP_RELEASE_TIME "" VALUE 0x8003A791 CalPrmSsmEng_UBYTE 0 Ti21 0 2.55 SYMBOL_LINK "CalPrmSsmEng01.SSM_U8_SSM_H_M_SLOP_RELEASE_TIME" 0 /end CHARACTERISTIC
/begin CHARACTERISTIC SSM_U8_SSM_LOW_MID_SLOP "" VALUE 0x8003A7A0 CalPrmSsmEng_UBYTE 0 A42 0 2.55 SYMBOL_LINK "CalPrmSsmEng01.SSM_U8_SSM_LOW_MID_SLOP" 0 /end CHARACTERISTIC
/begin CHARACTERISTIC SSM_U8_SSM_L_M_ACC_POSITION "" VALUE 0x8003A794 CalPrmSsmEng_UBYTE 0 Perc6 0 255 SYMBOL_LINK "CalPrmSsmEng01.SSM_U8_SSM_L_M_ACC_POSITION" 0 /end CHARACTERISTIC
/begin CHARACTERISTIC SSM_U8_SSM_L_M_ACC_RELS_TIME_DWN "" VALUE 0x8003A798 CalPrmSsmEng_UBYTE 0 Ti21 0 2.55 SYMBOL_LINK "CalPrmSsmEng01.SSM_U8_SSM_L_M_ACC_RELS_TIME_DWN" 0 /end CHARACTERISTIC
/begin CHARACTERISTIC SSM_U8_SSM_L_M_ACC_RELS_TIME_UP "" VALUE 0x8003A79C CalPrmSsmEng_UBYTE 0 Ti21 0 2.55 SYMBOL_LINK "CalPrmSsmEng01.SSM_U8_SSM_L_M_ACC_RELS_TIME_UP" 0 /end CHARACTERISTIC
/begin CHARACTERISTIC SSM_U8_SSM_L_M_SLOP_RELEASE_TIME "" VALUE 0x8003A790 CalPrmSsmEng_UBYTE 0 Ti21 0 2.55 SYMBOL_LINK "CalPrmSsmEng01.SSM_U8_SSM_L_M_SLOP_RELEASE_TIME" 0 /end CHARACTERISTIC
/begin CHARACTERISTIC SSM_U8_SSM_MAX_ACC_POSITION "" VALUE 0x8003A796 CalPrmSsmEng_UBYTE 0 Perc6 0 255 SYMBOL_LINK "CalPrmSsmEng01.SSM_U8_SSM_MAX_ACC_POSITION" 0 /end CHARACTERISTIC
/begin CHARACTERISTIC SSM_U8_SSM_MAX_ACC_RELS_TIME_DWN "" VALUE 0x8003A79A CalPrmSsmEng_UBYTE 0 Ti21 0 2.55 SYMBOL_LINK "CalPrmSsmEng01.SSM_U8_SSM_MAX_ACC_RELS_TIME_DWN" 0 /end CHARACTERISTIC
/begin CHARACTERISTIC SSM_U8_SSM_MAX_ACC_RELS_TIME_UP "" VALUE 0x8003A79E CalPrmSsmEng_UBYTE 0 Ti21 0 2.55 SYMBOL_LINK "CalPrmSsmEng01.SSM_U8_SSM_MAX_ACC_RELS_TIME_UP" 0 /end CHARACTERISTIC
/begin CHARACTERISTIC SSM_U8_SSM_MAX_SLOP "" VALUE 0x8003A7A2 CalPrmSsmEng_UBYTE 0 A42 0 2.55 SYMBOL_LINK "CalPrmSsmEng01.SSM_U8_SSM_MAX_SLOP" 0 /end CHARACTERISTIC
/begin CHARACTERISTIC SSM_U8_SSM_MAX_SLOP_RELEASE_TIME "" VALUE 0x8003A792 CalPrmSsmEng_UBYTE 0 Ti21 0 2.55 SYMBOL_LINK "CalPrmSsmEng01.SSM_U8_SSM_MAX_SLOP_RELEASE_TIME" 0 /end CHARACTERISTIC
/begin CHARACTERISTIC SSM_U8_SSM_MIN_ACC_POSITION "" VALUE 0x8003A793 CalPrmSsmEng_UBYTE 0 Perc6 0 255 SYMBOL_LINK "CalPrmSsmEng01.SSM_U8_SSM_MIN_ACC_POSITION" 0 /end CHARACTERISTIC
/begin CHARACTERISTIC SSM_U8_SSM_MIN_ACC_RELS_TIME_DWN "" VALUE 0x8003A797 CalPrmSsmEng_UBYTE 0 Ti21 0 2.55 SYMBOL_LINK "CalPrmSsmEng01.SSM_U8_SSM_MIN_ACC_RELS_TIME_DWN" 0 /end CHARACTERISTIC
/begin CHARACTERISTIC SSM_U8_SSM_MIN_ACC_RELS_TIME_UP "" VALUE 0x8003A79B CalPrmSsmEng_UBYTE 0 Ti21 0 2.55 SYMBOL_LINK "CalPrmSsmEng01.SSM_U8_SSM_MIN_ACC_RELS_TIME_UP" 0 /end CHARACTERISTIC
/begin CHARACTERISTIC SSM_U8_SSM_MIN_SLOP "" VALUE 0x8003A79F CalPrmSsmEng_UBYTE 0 A42 0 2.55 SYMBOL_LINK "CalPrmSsmEng01.SSM_U8_SSM_MIN_SLOP" 0 /end CHARACTERISTIC
/begin CHARACTERISTIC SSM_U8_SSM_MIN_SLOP_RELEASE_TIME "" VALUE 0x8003A78F CalPrmSsmEng_UBYTE 0 Ti21 0 2.55 SYMBOL_LINK "CalPrmSsmEng01.SSM_U8_SSM_MIN_SLOP_RELEASE_TIME" 0 /end CHARACTERISTIC
/begin CHARACTERISTIC SSM_U8_SSM_ROLL_TH_FOR_EPB_ACT "" VALUE 0x8003A78A CalPrmSsmEng_UBYTE 0 Len81 0 25.5 SYMBOL_LINK "CalPrmSsmEng01.SSM_U8_SSM_ROLL_TH_FOR_EPB_ACT" 0 /end CHARACTERISTIC
/begin CHARACTERISTIC SSM_U8_SSM_ROLL_TH_FOR_RISE "" VALUE 0x8003A789 CalPrmSsmEng_UBYTE 0 Len81 0 25.5 SYMBOL_LINK "CalPrmSsmEng01.SSM_U8_SSM_ROLL_TH_FOR_RISE" 0 /end CHARACTERISTIC
/begin CHARACTERISTIC TP_S16FFBrkTorqReduce4Vibration "" VALUE 0x8003A174 CalPrmWspcEng_SWORD 0 A42 -327.68 327.67 SYMBOL_LINK "CalPrmWspcEng01.TP_S16FFBrkTorqReduce4Vibration" 0 /end CHARACTERISTIC
/begin CHARACTERISTIC TP_S16TCSCpBrkCtlTrqAddInVIB "" VALUE 0x8003A184 CalPrmWspcEng_SWORD 0 Tq2 -32768 32767 SYMBOL_LINK "CalPrmWspcEng01.TP_S16TCSCpBrkCtlTrqAddInVIB" 0 /end CHARACTERISTIC
/begin CHARACTERISTIC TP_S16TCSCpFadeOutCtrlHghPreSTTh_RA "" VALUE 0x8003A1D4 CalPrmWspcEng_SWORD 0 P34 -3276.8 3276.7 SYMBOL_LINK "CalPrmWspcEng01.TP_S16TCSCpFadeOutCtrlHghPreSTTh_RA" 0 /end CHARACTERISTIC
/begin CHARACTERISTIC TP_S16TCSCpFadeOutCtrlLowPreSTTh_RA "" VALUE 0x8003A1DC CalPrmWspcEng_SWORD 0 P34 -3276.8 3276.7 SYMBOL_LINK "CalPrmWspcEng01.TP_S16TCSCpFadeOutCtrlLowPreSTTh_RA" 0 /end CHARACTERISTIC
/begin CHARACTERISTIC TP_S16TCSCpFadeOutDecTQ4HghPreST_RA "" VALUE 0x8003A1E4 CalPrmWspcEng_SWORD 0 TqGrdt10 -32768 32767 SYMBOL_LINK "CalPrmWspcEng01.TP_S16TCSCpFadeOutDecTQ4HghPreST_RA" 0 /end CHARACTERISTIC
/begin CHARACTERISTIC TP_S16TCSCpFadeOutDecTQ4LowPreST_RA "" VALUE 0x8003A1EC CalPrmWspcEng_SWORD 0 TqGrdt10 -32768 32767 SYMBOL_LINK "CalPrmWspcEng01.TP_S16TCSCpFadeOutDecTQ4LowPreST_RA" 0 /end CHARACTERISTIC
/begin CHARACTERISTIC TP_S16TCSCpThOfWhlSpnDiffDPInSt[0] "" VALUE 0x8003A216 CalPrmWspcEng_SWORD 0 Spd12 -4096 4095.875 SYMBOL_LINK "CalPrmWspcEng01.TP_S16TCSCpThOfWhlSpnDiffDPInSt[0]" 0 /end CHARACTERISTIC
/begin CHARACTERISTIC TP_S16TCSCpThOfWhlSpnDiffDPInSt[1] "" VALUE 0x8003A218 CalPrmWspcEng_SWORD 0 Spd12 -4096 4095.875 SYMBOL_LINK "CalPrmWspcEng01.TP_S16TCSCpThOfWhlSpnDiffDPInSt[1]" 0 /end CHARACTERISTIC
/begin CHARACTERISTIC TP_S16TCSCpThOfWhlSpnDiffDPInSt[2] "" VALUE 0x8003A21A CalPrmWspcEng_SWORD 0 Spd12 -4096 4095.875 SYMBOL_LINK "CalPrmWspcEng01.TP_S16TCSCpThOfWhlSpnDiffDPInSt[2]" 0 /end CHARACTERISTIC
/begin CHARACTERISTIC TP_S16TCSCpThOfWhlSpnDiffDPInSt[3] "" VALUE 0x8003A21C CalPrmWspcEng_SWORD 0 Spd12 -4096 4095.875 SYMBOL_LINK "CalPrmWspcEng01.TP_S16TCSCpThOfWhlSpnDiffDPInSt[3]" 0 /end CHARACTERISTIC
/begin CHARACTERISTIC TP_S16TCSCpThOfWhlSpnDiffDPInSt[4] "" VALUE 0x8003A21E CalPrmWspcEng_SWORD 0 Spd12 -4096 4095.875 SYMBOL_LINK "CalPrmWspcEng01.TP_S16TCSCpThOfWhlSpnDiffDPInSt[4]" 0 /end CHARACTERISTIC
/begin CHARACTERISTIC TP_S16_CBC_ALAT_EXIT "Ay level for CBC exit condition" VALUE 0x80020762 CalPrmWslcBrk_SWORD 0 A41 -32.768 32.767 SYMBOL_LINK "CalPrmWslcBrk01.TP_S16_CBC_ALAT_EXIT" 0 /end CHARACTERISTIC
/begin CHARACTERISTIC TP_S16_CBC_ALAT_EXIT_ABS "Ay level for CBC exit condition" VALUE 0x800206F2 CalPrmWslcBrk_SWORD 0 A41 -32.768 32.767 SYMBOL_LINK "CalPrmWslcBrk01.TP_S16_CBC_ALAT_EXIT_ABS" 0 /end CHARACTERISTIC
/begin CHARACTERISTIC TP_S16_CBC_AY_ERROR_CHECK_TIME "Min. time for checking error or suspect condition of estimated Ay, default 10sec." VALUE 0x80020724 CalPrmWslcBrk_SWORD 0 Ti21 -327.68 327.67 SYMBOL_LINK "CalPrmWslcBrk01.TP_S16_CBC_AY_ERROR_CHECK_TIME" 0 /end CHARACTERISTIC
/begin CHARACTERISTIC TP_S16_CBC_AY_ERROR_DET_LEVEL "Min. Ay difference level between two models for detecting error condition of estimated Ay" VALUE 0x80020726 CalPrmWslcBrk_SWORD 0 A41 -32.768 32.767 SYMBOL_LINK "CalPrmWslcBrk01.TP_S16_CBC_AY_ERROR_DET_LEVEL" 0 /end CHARACTERISTIC
/begin CHARACTERISTIC TP_S16_CBC_AY_ERROR_SUS_LEVEL "Min. Ay difference level between two models for detecting suspect condition of estimated Ay" VALUE 0x80020728 CalPrmWslcBrk_SWORD 0 A41 -32.768 32.767 SYMBOL_LINK "CalPrmWslcBrk01.TP_S16_CBC_AY_ERROR_SUS_LEVEL" 0 /end CHARACTERISTIC
/begin CHARACTERISTIC TP_S16_CBC_AY_OK_CHECK_TIME "Min. time for checking initial reliability of estimated Ay, default 10sec." VALUE 0x8002072A CalPrmWslcBrk_SWORD 0 Ti21 -327.68 327.67 SYMBOL_LINK "CalPrmWslcBrk01.TP_S16_CBC_AY_OK_CHECK_TIME" 0 /end CHARACTERISTIC
/begin CHARACTERISTIC TP_S16_CBC_MPRESS_EXIT "Mpress level for CBC exit condition" VALUE 0x80020764 CalPrmWslcBrk_SWORD 0 P34 -3276.8 3276.7 SYMBOL_LINK "CalPrmWslcBrk01.TP_S16_CBC_MPRESS_EXIT" 0 /end CHARACTERISTIC
/begin CHARACTERISTIC TP_S16_CBC_MPRESS_EXIT_ABS "Estimated mpress level for CBC exit condition" VALUE 0x800206F4 CalPrmWslcBrk_SWORD 0 P34 -3276.8 3276.7 SYMBOL_LINK "CalPrmWslcBrk01.TP_S16_CBC_MPRESS_EXIT_ABS" 0 /end CHARACTERISTIC
/begin CHARACTERISTIC TP_S16_CBC_STEADY_MAX_ACCEL "Max. acceleration level for detection of steady state driving condition, default 0.15g" VALUE 0x8002071E CalPrmWslcBrk_SWORD 0 A41 -32.768 32.767 SYMBOL_LINK "CalPrmWslcBrk01.TP_S16_CBC_STEADY_MAX_ACCEL" 0 /end CHARACTERISTIC
/begin CHARACTERISTIC TP_S16_CBC_STEADY_MAX_DECEL "Max. deceleration level for detection of steady state driving condition, default 0.1g" VALUE 0x80020720 CalPrmWslcBrk_SWORD 0 A41 -32.768 32.767 SYMBOL_LINK "CalPrmWslcBrk01.TP_S16_CBC_STEADY_MAX_DECEL" 0 /end CHARACTERISTIC
/begin CHARACTERISTIC TP_S16_DEFAULT_TARGET_dYAW_SPEED_H "Target Delta-Yaw at High Speed in Normal Mu Condition, default 5 deg/sec" VALUE 0x800204D4 CalPrmWslcBrk_SWORD 0 AgSpd31 -327.68 327.67 SYMBOL_LINK "CalPrmWslcBrk01.TP_S16_DEFAULT_TARGET_dYAW_SPEED_H" 0 /end CHARACTERISTIC
/begin CHARACTERISTIC TP_S16_DEFAULT_TARGET_dYAW_SPEED_L "Target Delta-Yaw at Low Speed in Normal Mu Condition, default 7 deg/sec" VALUE 0x800204D6 CalPrmWslcBrk_SWORD 0 AgSpd31 -327.68 327.67 SYMBOL_LINK "CalPrmWslcBrk01.TP_S16_DEFAULT_TARGET_dYAW_SPEED_L" 0 /end CHARACTERISTIC
/begin CHARACTERISTIC TP_S16_DEFAULT_TARGET_dYAW_SPEED_M "Target Delta-Yaw at Med Speed in Normal Mu Condition, default 5 deg/sec" VALUE 0x800204D8 CalPrmWslcBrk_SWORD 0 AgSpd31 -327.68 327.67 SYMBOL_LINK "CalPrmWslcBrk01.TP_S16_DEFAULT_TARGET_dYAW_SPEED_M" 0 /end CHARACTERISTIC
/begin CHARACTERISTIC TP_S16_Decel_Gain_BFAFZOK_100_150_R "Decel Gain, Before AFZ OK, 100-150kph, Decel State, Rear Wheels" VALUE 0x80020300 CalPrmWslcBrk_SWORD 0 Gain -32768 32767 SYMBOL_LINK "CalPrmWslcBrk01.TP_S16_Decel_Gain_BFAFZOK_100_150_R" 0 /end CHARACTERISTIC
/begin CHARACTERISTIC TP_S16_Decel_Gain_BFAFZOK_10_20_R "Decel Gain, Before AFZ OK, 10-20kph, Decel State, Rear Wheels" VALUE 0x80020302 CalPrmWslcBrk_SWORD 0 Gain -32768 32767 SYMBOL_LINK "CalPrmWslcBrk01.TP_S16_Decel_Gain_BFAFZOK_10_20_R" 0 /end CHARACTERISTIC
/begin CHARACTERISTIC TP_S16_Decel_Gain_BFAFZOK_20_40_R "Decel Gain, Before AFZ OK, 20-40kph, Decel State, Rear Wheels" VALUE 0x80020304 CalPrmWslcBrk_SWORD 0 Gain -32768 32767 SYMBOL_LINK "CalPrmWslcBrk01.TP_S16_Decel_Gain_BFAFZOK_20_40_R" 0 /end CHARACTERISTIC
/begin CHARACTERISTIC TP_S16_Decel_Gain_BFAFZOK_40_60_R "Decel Gain, Before AFZ OK, 40-60kph, Decel State, Rear Wheels" VALUE 0x80020306 CalPrmWslcBrk_SWORD 0 Gain -32768 32767 SYMBOL_LINK "CalPrmWslcBrk01.TP_S16_Decel_Gain_BFAFZOK_40_60_R" 0 /end CHARACTERISTIC
/begin CHARACTERISTIC TP_S16_Decel_Gain_BFAFZOK_60_100_R "Decel Gain, Before AFZ OK, 60-100kph, Decel State, Rear Wheels" VALUE 0x80020308 CalPrmWslcBrk_SWORD 0 Gain -32768 32767 SYMBOL_LINK "CalPrmWslcBrk01.TP_S16_Decel_Gain_BFAFZOK_60_100_R" 0 /end CHARACTERISTIC
/begin CHARACTERISTIC TP_S16_Decel_Gain_BFAFZOK_Ab_150_R "Decel Gain, Before AFZ OK, Above 150kph, Decel State, Rear Wheels" VALUE 0x8002030A CalPrmWslcBrk_SWORD 0 Gain -32768 32767 SYMBOL_LINK "CalPrmWslcBrk01.TP_S16_Decel_Gain_BFAFZOK_Ab_150_R" 0 /end CHARACTERISTIC
/begin CHARACTERISTIC TP_S16_Decel_Gain_BFAFZOK_B_10_R "Decel Gain, Before AFZ OK, Below 10kph, Decel State, Rear Wheels" VALUE 0x8002030C CalPrmWslcBrk_SWORD 0 Gain -32768 32767 SYMBOL_LINK "CalPrmWslcBrk01.TP_S16_Decel_Gain_BFAFZOK_B_10_R" 0 /end CHARACTERISTIC
/begin CHARACTERISTIC TP_S16_EBD_Dump_HDF_ref "Ref. High dump factor to EBD dump entrance" VALUE 0x800206D8 CalPrmWslcBrk_SWORD 0 Gain -32768 32767 SYMBOL_LINK "CalPrmWslcBrk01.TP_S16_EBD_Dump_HDF_ref" 0 /end CHARACTERISTIC
/begin CHARACTERISTIC TP_S16_EBD_Hold_Dump_ref "Add High dump factor threshold to EBD_Dump_HDF_ref, additional EBD dump entrance" VALUE 0x800206DA CalPrmWslcBrk_SWORD 0 Gain -32768 32767 SYMBOL_LINK "CalPrmWslcBrk01.TP_S16_EBD_Hold_Dump_ref" 0 /end CHARACTERISTIC
/begin CHARACTERISTIC TP_S16_GMA_ALLOWED_LIMIT_SPEED "GMA minimum Entrance Speed, default 20KPH ,max 40KPH" VALUE 0x80020602 CalPrmWslcBrk_SWORD 0 Spd12 -4096 4095.875 SYMBOL_LINK "CalPrmWslcBrk01.TP_S16_GMA_ALLOWED_LIMIT_SPEED" 0 /end CHARACTERISTIC
/begin CHARACTERISTIC TP_S16_GMA_DCT_SPEED_DIFF_0_50KPH "Ref. Speed difference of Front Wheels for GMA detection, In ABS, Below 50kph" VALUE 0x800205F6 CalPrmWslcBrk_SWORD 0 Spd12 -4096 4095.875 SYMBOL_LINK "CalPrmWslcBrk01.TP_S16_GMA_DCT_SPEED_DIFF_0_50KPH" 0 /end CHARACTERISTIC
/begin CHARACTERISTIC TP_S16_GMA_DCT_SPEED_DIFF_50_70KPH "Ref. Speed difference of Front Wheels for GMA detection, In ABS, 50-70kph" VALUE 0x800205F8 CalPrmWslcBrk_SWORD 0 Spd12 -4096 4095.875 SYMBOL_LINK "CalPrmWslcBrk01.TP_S16_GMA_DCT_SPEED_DIFF_50_70KPH" 0 /end CHARACTERISTIC
/begin CHARACTERISTIC TP_S16_GMA_DCT_SPEED_DIFF_70_90KPH "Ref. Speed difference of Front Wheels for GMA detection, In ABS, 70-90kph" VALUE 0x800205FA CalPrmWslcBrk_SWORD 0 Spd12 -4096 4095.875 SYMBOL_LINK "CalPrmWslcBrk01.TP_S16_GMA_DCT_SPEED_DIFF_70_90KPH" 0 /end CHARACTERISTIC
/begin CHARACTERISTIC TP_S16_GMA_DCT_SPEED_DIFF_90_M_KPH "Ref. Speed difference of Front Wheels for GMA detection, In ABS, above 90kph" VALUE 0x800205FC CalPrmWslcBrk_SWORD 0 Spd12 -4096 4095.875 SYMBOL_LINK "CalPrmWslcBrk01.TP_S16_GMA_DCT_SPEED_DIFF_90_M_KPH" 0 /end CHARACTERISTIC
/begin CHARACTERISTIC TP_S16_GMA_H_SPEED "GMA High Speed Reference, default 70kph, min 70, max 100" VALUE 0x8002028C CalPrmWslcBrk_SWORD 0 Spd12 -4096 4095.875 SYMBOL_LINK "CalPrmWslcBrk01.TP_S16_GMA_H_SPEED" 0 /end CHARACTERISTIC
/begin CHARACTERISTIC TP_S16_GMA_L_SPEED "GMA Low Speed Reference, default 35kph, min 20, max 50" VALUE 0x8002028E CalPrmWslcBrk_SWORD 0 Spd12 -4096 4095.875 SYMBOL_LINK "CalPrmWslcBrk01.TP_S16_GMA_L_SPEED" 0 /end CHARACTERISTIC
/begin CHARACTERISTIC TP_S16_GMA_M_SPEED "GMA Medium Speed Reference, default 50kph, min 40, max 70" VALUE 0x80020290 CalPrmWslcBrk_SWORD 0 Spd12 -4096 4095.875 SYMBOL_LINK "CalPrmWslcBrk01.TP_S16_GMA_M_SPEED" 0 /end CHARACTERISTIC
/begin CHARACTERISTIC TP_S16_H2SP_DETECT_FRONT_VRAD_DIFF1 "Ref. Speed difference of Front Wheels, Sufficient Dump_rise_factor, High-to-Split detection" VALUE 0x8002059E CalPrmWslcBrk_SWORD 0 Spd12 -4096 4095.875 SYMBOL_LINK "CalPrmWslcBrk01.TP_S16_H2SP_DETECT_FRONT_VRAD_DIFF1" 0 /end CHARACTERISTIC
/begin CHARACTERISTIC TP_S16_H2SP_DETECT_FRONT_VRAD_DIFF2 "Ref. Speed difference of Front Wheels, Insufficient Dump_rise_factor, High-to-Split detection" VALUE 0x800205A0 CalPrmWslcBrk_SWORD 0 Spd12 -4096 4095.875 SYMBOL_LINK "CalPrmWslcBrk01.TP_S16_H2SP_DETECT_FRONT_VRAD_DIFF2" 0 /end CHARACTERISTIC
/begin CHARACTERISTIC TP_S16_HDF_REF_LMu_40_60kph_R "HDF reference, condition for special 1st cycle dump" VALUE 0x800205BC CalPrmWslcBrk_SWORD 0 Gain -32768 32767 SYMBOL_LINK "CalPrmWslcBrk01.TP_S16_HDF_REF_LMu_40_60kph_R" 0 /end CHARACTERISTIC
/begin CHARACTERISTIC TP_S16_HDF_REF_LMu_Ab_60kph_R "HDF reference, condition for special 1st cycle dump" VALUE 0x800205BE CalPrmWslcBrk_SWORD 0 Gain -32768 32767 SYMBOL_LINK "CalPrmWslcBrk01.TP_S16_HDF_REF_LMu_Ab_60kph_R" 0 /end CHARACTERISTIC
/begin CHARACTERISTIC TP_S16_HDF_REF_LMu_B_40kph_R "HDF reference, condition for special 1st cycle dump" VALUE 0x800205C0 CalPrmWslcBrk_SWORD 0 Gain -32768 32767 SYMBOL_LINK "CalPrmWslcBrk01.TP_S16_HDF_REF_LMu_B_40kph_R" 0 /end CHARACTERISTIC
/begin CHARACTERISTIC TP_S16_High_dump_factor_Lower_Limit "Lower Limit of High Dump Factor" VALUE 0x800205CE CalPrmWslcBrk_SWORD 0 Gain -32768 32767 SYMBOL_LINK "CalPrmWslcBrk01.TP_S16_High_dump_factor_Lower_Limit" 0 /end CHARACTERISTIC
/begin CHARACTERISTIC TP_S16_High_dump_factor_Numerator "Numerator of High Dump Factor" VALUE 0x800205D0 CalPrmWslcBrk_SWORD 0 Gain -32768 32767 SYMBOL_LINK "CalPrmWslcBrk01.TP_S16_High_dump_factor_Numerator" 0 /end CHARACTERISTIC
/begin CHARACTERISTIC TP_S16_High_dump_factor_Upper_Limit "Upper Limit of High Dump Factor" VALUE 0x800205D2 CalPrmWslcBrk_SWORD 0 Gain -32768 32767 SYMBOL_LINK "CalPrmWslcBrk01.TP_S16_High_dump_factor_Upper_Limit" 0 /end CHARACTERISTIC
/begin CHARACTERISTIC TP_S16_L2H_DCT_ALLOWED_AFZ "Ref. Road surface for Low-to-High Detection (default : 0.1g)" VALUE 0x80020630 CalPrmWslcBrk_SWORD 0 A42 -327.68 327.67 SYMBOL_LINK "CalPrmWslcBrk01.TP_S16_L2H_DCT_ALLOWED_AFZ" 0 /end CHARACTERISTIC
/begin CHARACTERISTIC TP_S16_L2H_DCT_DIFF_DECEL "Deceleration difference for Low-to-High Detection (default : 0.05g)" VALUE 0x80020632 CalPrmWslcBrk_SWORD 0 A42 -327.68 327.67 SYMBOL_LINK "CalPrmWslcBrk01.TP_S16_L2H_DCT_DIFF_DECEL" 0 /end CHARACTERISTIC
/begin CHARACTERISTIC TP_S16_L2H_DCT_DIFF_DECEL_H "Deceleration difference for Low-to-High Detection (default : 0.1g)" VALUE 0x80020634 CalPrmWslcBrk_SWORD 0 A42 -327.68 327.67 SYMBOL_LINK "CalPrmWslcBrk01.TP_S16_L2H_DCT_DIFF_DECEL_H" 0 /end CHARACTERISTIC
/begin CHARACTERISTIC TP_S16_L2H_RESET_DIFF_DECEL "Low-to-High reset condition by decel diff(default : 0.03g)" VALUE 0x80020636 CalPrmWslcBrk_SWORD 0 A42 -327.68 327.67 SYMBOL_LINK "CalPrmWslcBrk01.TP_S16_L2H_RESET_DIFF_DECEL" 0 /end CHARACTERISTIC
/begin CHARACTERISTIC TP_S16_LMu_TARGET_dYAW_SPEED_H "Target Delta-Yaw at High Speed in Low Mu, default 3 deg/sec" VALUE 0x800204DA CalPrmWslcBrk_SWORD 0 AgSpd31 -327.68 327.67 SYMBOL_LINK "CalPrmWslcBrk01.TP_S16_LMu_TARGET_dYAW_SPEED_H" 0 /end CHARACTERISTIC
/begin CHARACTERISTIC TP_S16_LMu_TARGET_dYAW_SPEED_L "Target Delta-Yaw at Low Speed in Low Mu, default 5 deg/sec" VALUE 0x800204DC CalPrmWslcBrk_SWORD 0 AgSpd31 -327.68 327.67 SYMBOL_LINK "CalPrmWslcBrk01.TP_S16_LMu_TARGET_dYAW_SPEED_L" 0 /end CHARACTERISTIC
/begin CHARACTERISTIC TP_S16_LMu_TARGET_dYAW_SPEED_M "Target Delta-Yaw at Med Speed in Low Mu, default 3 deg/sec" VALUE 0x800204DE CalPrmWslcBrk_SWORD 0 AgSpd31 -327.68 327.67 SYMBOL_LINK "CalPrmWslcBrk01.TP_S16_LMu_TARGET_dYAW_SPEED_M" 0 /end CHARACTERISTIC
/begin CHARACTERISTIC TP_S16_NEED_INC_PRESS_YDF_L1 "Yaw-dump factor for Pressure Increase level 1 (default : -400)" VALUE 0x80020510 CalPrmWslcBrk_SWORD 0 Gain -32768 32767 SYMBOL_LINK "CalPrmWslcBrk01.TP_S16_NEED_INC_PRESS_YDF_L1" 0 /end CHARACTERISTIC
/begin CHARACTERISTIC TP_S16_NEED_INC_PRESS_YDF_L2 "Yaw-dump factor for Pressure Increase level 2 (default : -1000)" VALUE 0x80020512 CalPrmWslcBrk_SWORD 0 Gain -32768 32767 SYMBOL_LINK "CalPrmWslcBrk01.TP_S16_NEED_INC_PRESS_YDF_L2" 0 /end CHARACTERISTIC
/begin CHARACTERISTIC TP_S16_SPLIT_TARGET_dYAW_SPEED_H "Target Delta-Yaw at High Speed in Split Mu, default 5 deg/sec" VALUE 0x800204E0 CalPrmWslcBrk_SWORD 0 AgSpd31 -327.68 327.67 SYMBOL_LINK "CalPrmWslcBrk01.TP_S16_SPLIT_TARGET_dYAW_SPEED_H" 0 /end CHARACTERISTIC
/begin CHARACTERISTIC TP_S16_SPLIT_TARGET_dYAW_SPEED_L "Target Delta-Yaw at Low Speed in Split Mu, default 9 deg/sec" VALUE 0x800204E2 CalPrmWslcBrk_SWORD 0 AgSpd31 -327.68 327.67 SYMBOL_LINK "CalPrmWslcBrk01.TP_S16_SPLIT_TARGET_dYAW_SPEED_L" 0 /end CHARACTERISTIC
/begin CHARACTERISTIC TP_S16_SPLIT_TARGET_dYAW_SPEED_M "Target Delta-Yaw at Med Speed in Split Mu, default 7 deg/sec" VALUE 0x800204E4 CalPrmWslcBrk_SWORD 0 AgSpd31 -327.68 327.67 SYMBOL_LINK "CalPrmWslcBrk01.TP_S16_SPLIT_TARGET_dYAW_SPEED_M" 0 /end CHARACTERISTIC
/begin CHARACTERISTIC TP_S16_Slip_Gain_BFAFZOK_100_150_R "Slip Gain, Before AFZ OK, 100-150kph, Decel State, Rear Wheels" VALUE 0x8002030E CalPrmWslcBrk_SWORD 0 Gain -32768 32767 SYMBOL_LINK "CalPrmWslcBrk01.TP_S16_Slip_Gain_BFAFZOK_100_150_R" 0 /end CHARACTERISTIC
/begin CHARACTERISTIC TP_S16_Slip_Gain_BFAFZOK_10_20_R "Slip Gain, Before AFZ OK, 10-20kph, Decel State, Rear Wheels" VALUE 0x80020310 CalPrmWslcBrk_SWORD 0 Gain -32768 32767 SYMBOL_LINK "CalPrmWslcBrk01.TP_S16_Slip_Gain_BFAFZOK_10_20_R" 0 /end CHARACTERISTIC
/begin CHARACTERISTIC TP_S16_Slip_Gain_BFAFZOK_20_40_R "Slip Gain, Before AFZ OK, 20-40kph, Decel State, Rear Wheels" VALUE 0x80020312 CalPrmWslcBrk_SWORD 0 Gain -32768 32767 SYMBOL_LINK "CalPrmWslcBrk01.TP_S16_Slip_Gain_BFAFZOK_20_40_R" 0 /end CHARACTERISTIC
/begin CHARACTERISTIC TP_S16_Slip_Gain_BFAFZOK_40_60_R "Slip Gain, Before AFZ OK, 40-60kph, Decel State, Rear Wheels" VALUE 0x80020314 CalPrmWslcBrk_SWORD 0 Gain -32768 32767 SYMBOL_LINK "CalPrmWslcBrk01.TP_S16_Slip_Gain_BFAFZOK_40_60_R" 0 /end CHARACTERISTIC
/begin CHARACTERISTIC TP_S16_Slip_Gain_BFAFZOK_60_100_R "Slip Gain, Before AFZ OK, 60-100kph, Decel State, Rear Wheels" VALUE 0x80020316 CalPrmWslcBrk_SWORD 0 Gain -32768 32767 SYMBOL_LINK "CalPrmWslcBrk01.TP_S16_Slip_Gain_BFAFZOK_60_100_R" 0 /end CHARACTERISTIC
/begin CHARACTERISTIC TP_S16_Slip_Gain_BFAFZOK_Ab_150_R "Slip Gain, Before AFZ OK, Above 150kph, Decel State, Rear Wheels" VALUE 0x80020318 CalPrmWslcBrk_SWORD 0 Gain -32768 32767 SYMBOL_LINK "CalPrmWslcBrk01.TP_S16_Slip_Gain_BFAFZOK_Ab_150_R" 0 /end CHARACTERISTIC
/begin CHARACTERISTIC TP_S16_Slip_Gain_BFAFZOK_B_10_R "Slip Gain, Before AFZ OK, Below 10kph, Decel State, Rear Wheels" VALUE 0x8002031A CalPrmWslcBrk_SWORD 0 Gain -32768 32767 SYMBOL_LINK "CalPrmWslcBrk01.TP_S16_Slip_Gain_BFAFZOK_B_10_R" 0 /end CHARACTERISTIC
/begin CHARACTERISTIC TP_S16_YDF_RISEHOLD_T_MAX_YDF "Yaw-dump factor for maximum rise-hold scans (default : 1000)" VALUE 0x80020514 CalPrmWslcBrk_SWORD 0 Gain -32768 32767 SYMBOL_LINK "CalPrmWslcBrk01.TP_S16_YDF_RISEHOLD_T_MAX_YDF" 0 /end CHARACTERISTIC
/begin CHARACTERISTIC TP_S8_Arad_1stPoint_20_40KPH "1st reference point to set the reference EBD cut slip depending on wheel acceleration, 20-40KPH" VALUE 0x80020690 CalPrmWslcBrk_SBYTE 0 A20 -32 31.75 SYMBOL_LINK "CalPrmWslcBrk01.TP_S8_Arad_1stPoint_20_40KPH" 0 /end CHARACTERISTIC
/begin CHARACTERISTIC TP_S8_Arad_2ndPoint_20_40KPH "2nd reference point to set the reference EBD cut slip depending on wheel acceleration, 20-40KPH" VALUE 0x80020691 CalPrmWslcBrk_SBYTE 0 A20 -32 31.75 SYMBOL_LINK "CalPrmWslcBrk01.TP_S8_Arad_2ndPoint_20_40KPH" 0 /end CHARACTERISTIC
/begin CHARACTERISTIC TP_S8_Arad_3rdPoint_20_40KPH "3rd reference point to set the reference EBD cut slip depending on wheel acceleration, 20-40KPH" VALUE 0x80020692 CalPrmWslcBrk_SBYTE 0 A20 -32 31.75 SYMBOL_LINK "CalPrmWslcBrk01.TP_S8_Arad_3rdPoint_20_40KPH" 0 /end CHARACTERISTIC
/begin CHARACTERISTIC TP_S8_Arad_Fact_1_2P_20_40KPH "subtracting value from initial cut slip at wheel acceleration between Arad_1stPoint ~ Arad_2ndPoint, 20-40KPH" VALUE 0x80020693 CalPrmWslcBrk_SBYTE 0 Perc6 -128 127 SYMBOL_LINK "CalPrmWslcBrk01.TP_S8_Arad_Fact_1_2P_20_40KPH" 0 /end CHARACTERISTIC
/begin CHARACTERISTIC TP_S8_Arad_Fact_2_3P_20_40KPH "subtracting value from initial cut slip at wheel acceleration between Arad_2ndPoint ~ Arad_3rdPoint, 20-40KPH" VALUE 0x80020694 CalPrmWslcBrk_SBYTE 0 Perc6 -128 127 SYMBOL_LINK "CalPrmWslcBrk01.TP_S8_Arad_Fact_2_3P_20_40KPH" 0 /end CHARACTERISTIC
/begin CHARACTERISTIC TP_S8_Arad_Fact_Ab_3P_20_40KPH "subtracting value from initial cut slip at wheel acceleration above Arad_3rdPoint, 20-40KPH" VALUE 0x80020695 CalPrmWslcBrk_SBYTE 0 Perc6 -128 127 SYMBOL_LINK "CalPrmWslcBrk01.TP_S8_Arad_Fact_Ab_3P_20_40KPH" 0 /end CHARACTERISTIC
/begin CHARACTERISTIC TP_S8_Arad_Fact_B_1P_20_40KPH "subtracting value from initial cut slip at wheel acceleration below Arad_1stPoint, 20-40KPH" VALUE 0x80020696 CalPrmWslcBrk_SBYTE 0 Perc6 -128 127 SYMBOL_LINK "CalPrmWslcBrk01.TP_S8_Arad_Fact_B_1P_20_40KPH" 0 /end CHARACTERISTIC
/begin CHARACTERISTIC TP_S8_BMP_SUS_ARAD_GAUGE_THRES_F1 "Bump detection threshold for Duty compensation, front wheel arad gauge Lv1" VALUE 0x8002062C CalPrmWslcBrk_SBYTE 0 Gain -128 127 SYMBOL_LINK "CalPrmWslcBrk01.TP_S8_BMP_SUS_ARAD_GAUGE_THRES_F1" 0 /end CHARACTERISTIC
/begin CHARACTERISTIC TP_S8_BMP_SUS_ARAD_GAUGE_THRES_F2 "Bump detection threshold for Duty compensation, rear wheel arad gauge Lv1" VALUE 0x8002062E CalPrmWslcBrk_SBYTE 0 Gain -128 127 SYMBOL_LINK "CalPrmWslcBrk01.TP_S8_BMP_SUS_ARAD_GAUGE_THRES_F2" 0 /end CHARACTERISTIC
/begin CHARACTERISTIC TP_S8_BMP_SUS_ARAD_GAUGE_THRES_R1 "Bump detection threshold for Duty compensation, front wheel arad gauge Lv2" VALUE 0x8002062D CalPrmWslcBrk_SBYTE 0 Gain -128 127 SYMBOL_LINK "CalPrmWslcBrk01.TP_S8_BMP_SUS_ARAD_GAUGE_THRES_R1" 0 /end CHARACTERISTIC
/begin CHARACTERISTIC TP_S8_BMP_SUS_ARAD_GAUGE_THRES_R2 "Bump detection threshold for Duty compensation, rear wheel arad gauge Lv2" VALUE 0x8002062F CalPrmWslcBrk_SBYTE 0 Gain -128 127 SYMBOL_LINK "CalPrmWslcBrk01.TP_S8_BMP_SUS_ARAD_GAUGE_THRES_R2" 0 /end CHARACTERISTIC
/begin CHARACTERISTIC TP_S8_BMP_SUS_ARAD_THRES_F1 "Bump detection threshold for Duty compensation, front wheel arad avg Lv1" VALUE 0x80020628 CalPrmWslcBrk_SBYTE 0 A20 -32 31.75 SYMBOL_LINK "CalPrmWslcBrk01.TP_S8_BMP_SUS_ARAD_THRES_F1" 0 /end CHARACTERISTIC
/begin CHARACTERISTIC TP_S8_BMP_SUS_ARAD_THRES_F2 "Bump detection threshold for Duty compensation, rear wheel arad avg Lv1" VALUE 0x8002062A CalPrmWslcBrk_SBYTE 0 A20 -32 31.75 SYMBOL_LINK "CalPrmWslcBrk01.TP_S8_BMP_SUS_ARAD_THRES_F2" 0 /end CHARACTERISTIC
/begin CHARACTERISTIC TP_S8_BMP_SUS_ARAD_THRES_R1 "Bump detection threshold for Duty compensation, front wheel arad avg Lv2" VALUE 0x80020629 CalPrmWslcBrk_SBYTE 0 A20 -32 31.75 SYMBOL_LINK "CalPrmWslcBrk01.TP_S8_BMP_SUS_ARAD_THRES_R1" 0 /end CHARACTERISTIC
/begin CHARACTERISTIC TP_S8_BMP_SUS_ARAD_THRES_R2 "Bump detection threshold for Duty compensation, rear wheel arad avg Lv2" VALUE 0x8002062B CalPrmWslcBrk_SBYTE 0 A20 -32 31.75 SYMBOL_LINK "CalPrmWslcBrk01.TP_S8_BMP_SUS_ARAD_THRES_R2" 0 /end CHARACTERISTIC
/begin CHARACTERISTIC TP_S8_CBC_ARAD_THRES_COMP_H "CBC start wheel deceleration condition compensation at high vehicle speed" VALUE 0x8002074C CalPrmWslcBrk_SBYTE 0 A20 -32 31.75 SYMBOL_LINK "CalPrmWslcBrk01.TP_S8_CBC_ARAD_THRES_COMP_H" 0 /end CHARACTERISTIC
/begin CHARACTERISTIC TP_S8_CBC_ARAD_THRES_COMP_M "CBC start wheel deceleration condition compensation at med vehicle speed" VALUE 0x8002074D CalPrmWslcBrk_SBYTE 0 A20 -32 31.75 SYMBOL_LINK "CalPrmWslcBrk01.TP_S8_CBC_ARAD_THRES_COMP_M" 0 /end CHARACTERISTIC
/begin CHARACTERISTIC TP_S8_CBC_ARAD_THRES_H "CBC start wheel deceleration threshold at low Ay level" VALUE 0x8002074E CalPrmWslcBrk_SBYTE 0 A20 -32 31.75 SYMBOL_LINK "CalPrmWslcBrk01.TP_S8_CBC_ARAD_THRES_H" 0 /end CHARACTERISTIC
/begin CHARACTERISTIC TP_S8_CBC_ARAD_THRES_L "CBC start wheel deceleration threshold at high Ay level" VALUE 0x8002074F CalPrmWslcBrk_SBYTE 0 A20 -32 31.75 SYMBOL_LINK "CalPrmWslcBrk01.TP_S8_CBC_ARAD_THRES_L" 0 /end CHARACTERISTIC
/begin CHARACTERISTIC TP_S8_CBC_ARAD_THRES_M "CBC start wheel deceleration threshold at med Ay level" VALUE 0x80020750 CalPrmWslcBrk_SBYTE 0 A20 -32 31.75 SYMBOL_LINK "CalPrmWslcBrk01.TP_S8_CBC_ARAD_THRES_M" 0 /end CHARACTERISTIC
/begin CHARACTERISTIC TP_S8_CBC_WHEEL_SPIN_OK_LEVEL "Max. wheel spin level for detection of steady state driving condition, default 3km/h" VALUE 0x80020722 CalPrmWslcBrk_SBYTE 0 Spd12 -16 15.875 SYMBOL_LINK "CalPrmWslcBrk01.TP_S8_CBC_WHEEL_SPIN_OK_LEVEL" 0 /end CHARACTERISTIC
/begin CHARACTERISTIC TP_S8_Comp_Duty_For_SPHside_F "Compensation Duty For Split High-side Front Wheel" VALUE 0x800202B0 CalPrmWslcBrk_SBYTE 0 Gain -128 127 SYMBOL_LINK "CalPrmWslcBrk01.TP_S8_Comp_Duty_For_SPHside_F" 0 /end CHARACTERISTIC
/begin CHARACTERISTIC TP_S8_Counter_threshold_Lower_Lim_F "Rough Road Detection counting threshold, if wheel speed difference is negative(-) ( Default = 0.5kph ), Front Wheels" VALUE 0x800204C0 CalPrmWslcBrk_SBYTE 0 Spd12 -16 15.875 SYMBOL_LINK "CalPrmWslcBrk01.TP_S8_Counter_threshold_Lower_Lim_F" 0 /end CHARACTERISTIC
/begin CHARACTERISTIC TP_S8_Counter_threshold_Lower_Lim_R "Rough Road Detection counting threshold, if wheel speed difference is negative(-) ( Default = 0.5kph ), Rear Wheels" VALUE 0x800204C1 CalPrmWslcBrk_SBYTE 0 Spd12 -16 15.875 SYMBOL_LINK "CalPrmWslcBrk01.TP_S8_Counter_threshold_Lower_Lim_R" 0 /end CHARACTERISTIC
/begin CHARACTERISTIC TP_S8_Counter_threshold_Upper_Lim_F "Rough Road Detection counting threshold, if wheel speed difference is positive(+) ( Default = 0.5kph ), Front Wheels" VALUE 0x800204C2 CalPrmWslcBrk_SBYTE 0 Spd12 -16 15.875 SYMBOL_LINK "CalPrmWslcBrk01.TP_S8_Counter_threshold_Upper_Lim_F" 0 /end CHARACTERISTIC
/begin CHARACTERISTIC TP_S8_Counter_threshold_Upper_Lim_R "Rough Road Detection counting threshold, if wheel speed difference is positive(+) ( Default = 0.5kph ), Rear Wheels" VALUE 0x800204C3 CalPrmWslcBrk_SBYTE 0 Spd12 -16 15.875 SYMBOL_LINK "CalPrmWslcBrk01.TP_S8_Counter_threshold_Upper_Lim_R" 0 /end CHARACTERISTIC
/begin CHARACTERISTIC TP_S8_DetectAccel_Reset_EngTorq "Engine Torque Level to Detect Driver's Release Throttle" VALUE 0x8002061A CalPrmWslcBrk_SBYTE 0 Perc6 -128 127 SYMBOL_LINK "CalPrmWslcBrk01.TP_S8_DetectAccel_Reset_EngTorq" 0 /end CHARACTERISTIC
/begin CHARACTERISTIC TP_S8_DetectAccel_Reset_Throttle "MPT ratio to Detect Driver's Release Throttle" VALUE 0x8002061B CalPrmWslcBrk_SBYTE 0 Perc6 -128 127 SYMBOL_LINK "CalPrmWslcBrk01.TP_S8_DetectAccel_Reset_Throttle" 0 /end CHARACTERISTIC
/begin CHARACTERISTIC TP_S8_EBD_Cut_Vdiff_100_150KPH "Vref-Vrad threshold to start EBD control, 100~150KPH" VALUE 0x8002067D CalPrmWslcBrk_SBYTE 0 Spd12 -16 15.875 SYMBOL_LINK "CalPrmWslcBrk01.TP_S8_EBD_Cut_Vdiff_100_150KPH" 0 /end CHARACTERISTIC
/begin CHARACTERISTIC TP_S8_EBD_Cut_Vdiff_20_40KPH "Vref-Vrad threshold to start EBD control, 20~40KPH" VALUE 0x8002067E CalPrmWslcBrk_SBYTE 0 Spd12 -16 15.875 SYMBOL_LINK "CalPrmWslcBrk01.TP_S8_EBD_Cut_Vdiff_20_40KPH" 0 /end CHARACTERISTIC
/begin CHARACTERISTIC TP_S8_EBD_Cut_Vdiff_40_60KPH "Vref-Vrad threshold to start EBD control, 40~60KPH" VALUE 0x8002067F CalPrmWslcBrk_SBYTE 0 Spd12 -16 15.875 SYMBOL_LINK "CalPrmWslcBrk01.TP_S8_EBD_Cut_Vdiff_40_60KPH" 0 /end CHARACTERISTIC
/begin CHARACTERISTIC TP_S8_EBD_Cut_Vdiff_60_100KPH "Vref-Vrad threshold to start EBD control, 60~100KPH" VALUE 0x80020680 CalPrmWslcBrk_SBYTE 0 Spd12 -16 15.875 SYMBOL_LINK "CalPrmWslcBrk01.TP_S8_EBD_Cut_Vdiff_60_100KPH" 0 /end CHARACTERISTIC
/begin CHARACTERISTIC TP_S8_EBD_Cut_Vdiff_Ab_150KPH "Vref-Vrad threshold to start EBD control, Above 150KPH" VALUE 0x80020681 CalPrmWslcBrk_SBYTE 0 Spd12 -16 15.875 SYMBOL_LINK "CalPrmWslcBrk01.TP_S8_EBD_Cut_Vdiff_Ab_150KPH" 0 /end CHARACTERISTIC
/begin CHARACTERISTIC TP_S8_EBD_Cut_Vdiff_B_20KPH "Vref-Vrad threshold to start EBD control, Below 20KPH" VALUE 0x80020682 CalPrmWslcBrk_SBYTE 0 Spd12 -16 15.875 SYMBOL_LINK "CalPrmWslcBrk01.TP_S8_EBD_Cut_Vdiff_B_20KPH" 0 /end CHARACTERISTIC
/begin CHARACTERISTIC TP_S8_F_WL_Fact_ASum1G_Slip0_2P "Cut slip compensation value if : 0%>avg.Front wheel slip >-2%, AND Front arad sum > -1g" VALUE 0x800206B6 CalPrmWslcBrk_SBYTE 0 Perc6 -128 127 SYMBOL_LINK "CalPrmWslcBrk01.TP_S8_F_WL_Fact_ASum1G_Slip0_2P" 0 /end CHARACTERISTIC
/begin CHARACTERISTIC TP_S8_F_WL_Fact_ASum3G_Slip0_2P "Cut slip compensation value if : 0%>avg.Front wheel slip >-2%, AND -1g > Front arad sum > -3g" VALUE 0x800206B7 CalPrmWslcBrk_SBYTE 0 Perc6 -128 127 SYMBOL_LINK "CalPrmWslcBrk01.TP_S8_F_WL_Fact_ASum3G_Slip0_2P" 0 /end CHARACTERISTIC
/begin CHARACTERISTIC TP_S8_F_WL_Fact_ASumAb3G_Slip0_2P "Cut slip compensation value if : 0%>avg.Front wheel slip >-2%, AND Front arad sum < -3g" VALUE 0x800206B8 CalPrmWslcBrk_SBYTE 0 Perc6 -128 127 SYMBOL_LINK "CalPrmWslcBrk01.TP_S8_F_WL_Fact_ASumAb3G_Slip0_2P" 0 /end CHARACTERISTIC
/begin CHARACTERISTIC TP_S8_GMA_DCT_SLIP_DIFF_0_50KPH "Ref. Slip difference of Front Wheels for GMA detection, In ABS, Below 50kph" VALUE 0x800205FE CalPrmWslcBrk_SBYTE 0 Perc6 -128 127 SYMBOL_LINK "CalPrmWslcBrk01.TP_S8_GMA_DCT_SLIP_DIFF_0_50KPH" 0 /end CHARACTERISTIC
/begin CHARACTERISTIC TP_S8_GMA_DCT_SLIP_DIFF_50_70KPH "Ref. Slip difference of Front Wheels for GMA detection, In ABS, 50-70kph" VALUE 0x800205FF CalPrmWslcBrk_SBYTE 0 Perc6 -128 127 SYMBOL_LINK "CalPrmWslcBrk01.TP_S8_GMA_DCT_SLIP_DIFF_50_70KPH" 0 /end CHARACTERISTIC
/begin CHARACTERISTIC TP_S8_GMA_DCT_SLIP_DIFF_70_90KPH "Ref. Slip difference of Front Wheels for GMA detection, In ABS, 70-90kph" VALUE 0x80020600 CalPrmWslcBrk_SBYTE 0 Perc6 -128 127 SYMBOL_LINK "CalPrmWslcBrk01.TP_S8_GMA_DCT_SLIP_DIFF_70_90KPH" 0 /end CHARACTERISTIC
/begin CHARACTERISTIC TP_S8_GMA_DCT_SLIP_DIFF_90_M_KPH "Ref. Slip difference of Front Wheels for GMA detection, In ABS, above 90kph" VALUE 0x80020601 CalPrmWslcBrk_SBYTE 0 Perc6 -128 127 SYMBOL_LINK "CalPrmWslcBrk01.TP_S8_GMA_DCT_SLIP_DIFF_90_M_KPH" 0 /end CHARACTERISTIC
/begin CHARACTERISTIC TP_S8_GMA_RiseTime_H_SPEED_PHASE1 "GMA pulse-up reapply time @H_SPEED, 1st pulse, default 7, min 5, max 20" VALUE 0x800202A2 CalPrmWslcBrk_SBYTE 0 Gain -128 127 SYMBOL_LINK "CalPrmWslcBrk01.TP_S8_GMA_RiseTime_H_SPEED_PHASE1" 0 /end CHARACTERISTIC
/begin CHARACTERISTIC TP_S8_GMA_RiseTime_H_SPEED_PHASE2 "GMA pulse-up reapply time @H_SPEED, 2nd~4th pulse, default 7, min 5, max 20" VALUE 0x800202A3 CalPrmWslcBrk_SBYTE 0 Gain -128 127 SYMBOL_LINK "CalPrmWslcBrk01.TP_S8_GMA_RiseTime_H_SPEED_PHASE2" 0 /end CHARACTERISTIC
/begin CHARACTERISTIC TP_S8_GMA_RiseTime_H_SPEED_PHASE3 "GMA pulse-up reapply time @H_SPEED, 5th~higher pulse, default 7, min 5, max 20" VALUE 0x800202A4 CalPrmWslcBrk_SBYTE 0 Gain -128 127 SYMBOL_LINK "CalPrmWslcBrk01.TP_S8_GMA_RiseTime_H_SPEED_PHASE3" 0 /end CHARACTERISTIC
/begin CHARACTERISTIC TP_S8_GMA_RiseTime_ML_SPEED_PHASE1 "GMA pulse-up reapply time @ML_SPEED, 1st pulse, default 7, min 5, max 20" VALUE 0x800202A5 CalPrmWslcBrk_SBYTE 0 Gain -128 127 SYMBOL_LINK "CalPrmWslcBrk01.TP_S8_GMA_RiseTime_ML_SPEED_PHASE1" 0 /end CHARACTERISTIC
/begin CHARACTERISTIC TP_S8_GMA_RiseTime_ML_SPEED_PHASE2 "GMA pulse-up reapply time @ML_SPEED, 2nd~4th pulse, default 7, min 5, max 20" VALUE 0x800202A6 CalPrmWslcBrk_SBYTE 0 Gain -128 127 SYMBOL_LINK "CalPrmWslcBrk01.TP_S8_GMA_RiseTime_ML_SPEED_PHASE2" 0 /end CHARACTERISTIC
/begin CHARACTERISTIC TP_S8_GMA_RiseTime_ML_SPEED_PHASE3 "GMA pulse-up reapply time @ML_SPEED, 5th~higher pulse, default 7, min 5, max 20" VALUE 0x800202A7 CalPrmWslcBrk_SBYTE 0 Gain -128 127 SYMBOL_LINK "CalPrmWslcBrk01.TP_S8_GMA_RiseTime_ML_SPEED_PHASE3" 0 /end CHARACTERISTIC
/begin CHARACTERISTIC TP_S8_H2SP_DETECT_FRONT_DECEL1 "Ref. Peak wheel deceleration of Low side Front wheel, Sufficient Dump_rise_factor, High-to-Split detection" VALUE 0x800205A2 CalPrmWslcBrk_SBYTE 0 A20 -32 31.75 SYMBOL_LINK "CalPrmWslcBrk01.TP_S8_H2SP_DETECT_FRONT_DECEL1" 0 /end CHARACTERISTIC
/begin CHARACTERISTIC TP_S8_H2SP_DETECT_FRONT_DECEL2 "Ref. Peak wheel deceleration of Low side Front wheel, Insufficient Dump_rise_factor, High-to-Split detection" VALUE 0x800205A3 CalPrmWslcBrk_SBYTE 0 A20 -32 31.75 SYMBOL_LINK "CalPrmWslcBrk01.TP_S8_H2SP_DETECT_FRONT_DECEL2" 0 /end CHARACTERISTIC
/begin CHARACTERISTIC TP_S8_HOMO_dYAW_ABS_GAIN "Delta-Yaw Gain @ Normal Mu Condition During ABS, default 15, min 10, max 20" VALUE 0x800204F8 CalPrmWslcBrk_SBYTE 0 Gain -128 127 SYMBOL_LINK "CalPrmWslcBrk01.TP_S8_HOMO_dYAW_ABS_GAIN" 0 /end CHARACTERISTIC
/begin CHARACTERISTIC TP_S8_HOMO_dYAW_DOT_ABS_GAIN "Delta-Yaw Dot Gain @ Normal Mu Condition During ABS, default 2, min 0, max 4" VALUE 0x800204F9 CalPrmWslcBrk_SBYTE 0 Gain -128 127 SYMBOL_LINK "CalPrmWslcBrk01.TP_S8_HOMO_dYAW_DOT_ABS_GAIN" 0 /end CHARACTERISTIC
/begin CHARACTERISTIC TP_S8_H_to_Split_Detection_AFZ "Ref. AFZ to check High-to-Split detection ( Default = 0.35g)" VALUE 0x800205A4 CalPrmWslcBrk_SBYTE 0 A42 -1.28 1.27 SYMBOL_LINK "CalPrmWslcBrk01.TP_S8_H_to_Split_Detection_AFZ" 0 /end CHARACTERISTIC
/begin CHARACTERISTIC TP_S8_H_to_Split_Dump_Diff "Ref. Dump_rise_factor difference of Front wheels ( Default = 1 )" VALUE 0x800205A5 CalPrmWslcBrk_SBYTE 0 Gain -128 127 SYMBOL_LINK "CalPrmWslcBrk01.TP_S8_H_to_Split_Dump_Diff" 0 /end CHARACTERISTIC
/begin CHARACTERISTIC TP_S8_L2H_STABLE_THR_SLIP_F "Slip reference for stable state, front wheel(default : 2)" VALUE 0x80020638 CalPrmWslcBrk_SBYTE 0 Perc6 -128 127 SYMBOL_LINK "CalPrmWslcBrk01.TP_S8_L2H_STABLE_THR_SLIP_F" 0 /end CHARACTERISTIC
/begin CHARACTERISTIC TP_S8_L2H_STABLE_THR_SLIP_F_OPP "Slip reference for stable state, front opposite wheel(default : 3)" VALUE 0x80020639 CalPrmWslcBrk_SBYTE 0 Perc6 -128 127 SYMBOL_LINK "CalPrmWslcBrk01.TP_S8_L2H_STABLE_THR_SLIP_F_OPP" 0 /end CHARACTERISTIC
/begin CHARACTERISTIC TP_S8_L2H_STABLE_THR_SLIP_R "Slip reference for stable state, rear wheel(default : 3)" VALUE 0x8002063A CalPrmWslcBrk_SBYTE 0 Perc6 -128 127 SYMBOL_LINK "CalPrmWslcBrk01.TP_S8_L2H_STABLE_THR_SLIP_R" 0 /end CHARACTERISTIC
/begin CHARACTERISTIC TP_S8_L2H_STABLE_THR_SLIP_R_OPP "Slip reference for stable state, rear opposite wheel(default : 3)" VALUE 0x8002063B CalPrmWslcBrk_SBYTE 0 Perc6 -128 127 SYMBOL_LINK "CalPrmWslcBrk01.TP_S8_L2H_STABLE_THR_SLIP_R_OPP" 0 /end CHARACTERISTIC
/begin CHARACTERISTIC TP_S8_L2H_UNSTABLE_THR_SLIP_F "Slip reference for unstable state, front wheel(default : 3)" VALUE 0x8002063C CalPrmWslcBrk_SBYTE 0 Perc6 -128 127 SYMBOL_LINK "CalPrmWslcBrk01.TP_S8_L2H_UNSTABLE_THR_SLIP_F" 0 /end CHARACTERISTIC
/begin CHARACTERISTIC TP_S8_L2H_UNSTABLE_THR_SLIP_F_1 "Slip reference for Unstable state Lv1, front wheel(default : 5)" VALUE 0x8002063D CalPrmWslcBrk_SBYTE 0 Perc6 -128 127 SYMBOL_LINK "CalPrmWslcBrk01.TP_S8_L2H_UNSTABLE_THR_SLIP_F_1" 0 /end CHARACTERISTIC
/begin CHARACTERISTIC TP_S8_L2H_UNSTABLE_THR_SLIP_F_2 "Slip reference for Unstable state Lv2, front wheel(default : 10)" VALUE 0x8002063E CalPrmWslcBrk_SBYTE 0 Perc6 -128 127 SYMBOL_LINK "CalPrmWslcBrk01.TP_S8_L2H_UNSTABLE_THR_SLIP_F_2" 0 /end CHARACTERISTIC
/begin CHARACTERISTIC TP_S8_L2H_UNSTABLE_THR_SLIP_F_3 "Slip reference for Unstable state Lv3, front wheel(default : 15)" VALUE 0x8002063F CalPrmWslcBrk_SBYTE 0 Perc6 -128 127 SYMBOL_LINK "CalPrmWslcBrk01.TP_S8_L2H_UNSTABLE_THR_SLIP_F_3" 0 /end CHARACTERISTIC
/begin CHARACTERISTIC TP_S8_L2H_UNSTABLE_THR_SLIP_F_OPP "Slip reference for unstable state, front opposite wheel(default : 3)" VALUE 0x80020640 CalPrmWslcBrk_SBYTE 0 Perc6 -128 127 SYMBOL_LINK "CalPrmWslcBrk01.TP_S8_L2H_UNSTABLE_THR_SLIP_F_OPP" 0 /end CHARACTERISTIC
/begin CHARACTERISTIC TP_S8_L2H_UNSTABLE_THR_SLIP_R "Slip reference for unstable state, rear wheel(default : 4)" VALUE 0x80020641 CalPrmWslcBrk_SBYTE 0 Perc6 -128 127 SYMBOL_LINK "CalPrmWslcBrk01.TP_S8_L2H_UNSTABLE_THR_SLIP_R" 0 /end CHARACTERISTIC
/begin CHARACTERISTIC TP_S8_L2H_UNSTABLE_THR_SLIP_R_OPP "Slip reference for unstable state, rear opposite wheel(default : 4)" VALUE 0x80020642 CalPrmWslcBrk_SBYTE 0 Perc6 -128 127 SYMBOL_LINK "CalPrmWslcBrk01.TP_S8_L2H_UNSTABLE_THR_SLIP_R_OPP" 0 /end CHARACTERISTIC
/begin CHARACTERISTIC TP_S8_LFC_HIGH_PEAK_ACCEL "Ref. Peak Wheel acceleration, High-mu" VALUE 0x80020589 CalPrmWslcBrk_SBYTE 0 A20 -32 31.75 SYMBOL_LINK "CalPrmWslcBrk01.TP_S8_LFC_HIGH_PEAK_ACCEL" 0 /end CHARACTERISTIC
/begin CHARACTERISTIC TP_S8_LFC_MED_PEAK_ACCEL "Ref. Peak Wheel acceleration, Medium-mu" VALUE 0x8002058A CalPrmWslcBrk_SBYTE 0 A20 -32 31.75 SYMBOL_LINK "CalPrmWslcBrk01.TP_S8_LFC_MED_PEAK_ACCEL" 0 /end CHARACTERISTIC
/begin CHARACTERISTIC TP_S8_Pulse_Down_Gain_Front_Decel "Pulse Down Gain of Front, Accel State" VALUE 0x800202E2 CalPrmWslcBrk_SBYTE 0 Gain -128 127 SYMBOL_LINK "CalPrmWslcBrk01.TP_S8_Pulse_Down_Gain_Front_Decel" 0 /end CHARACTERISTIC
/begin CHARACTERISTIC TP_S8_Pulse_Down_Gain_Rear_Decel "Pulse Down Gain of Rear, Accel State" VALUE 0x800202E3 CalPrmWslcBrk_SBYTE 0 Gain -128 127 SYMBOL_LINK "CalPrmWslcBrk01.TP_S8_Pulse_Down_Gain_Rear_Decel" 0 /end CHARACTERISTIC
/begin CHARACTERISTIC TP_S8_Rough_road_detector_F_level0 "Starting value of transient Rough Road ( Default = 5 )" VALUE 0x800204C4 CalPrmWslcBrk_SBYTE 0 Gain -128 127 SYMBOL_LINK "CalPrmWslcBrk01.TP_S8_Rough_road_detector_F_level0" 0 /end CHARACTERISTIC
/begin CHARACTERISTIC TP_S8_Rough_road_detector_F_level1 "Starting value of transient Rough Road ( Default = 7 )" VALUE 0x800204C5 CalPrmWslcBrk_SBYTE 0 Gain -128 127 SYMBOL_LINK "CalPrmWslcBrk01.TP_S8_Rough_road_detector_F_level1" 0 /end CHARACTERISTIC
/begin CHARACTERISTIC TP_S8_Rough_road_detector_F_level2 "Starting value of fully Rough Road ( Default = 10 )" VALUE 0x800204C6 CalPrmWslcBrk_SBYTE 0 Gain -128 127 SYMBOL_LINK "CalPrmWslcBrk01.TP_S8_Rough_road_detector_F_level2" 0 /end CHARACTERISTIC
/begin CHARACTERISTIC TP_S8_Rough_road_detector_R_level0 "Starting value of transient Rough Road ( Default = 5 )" VALUE 0x800204C7 CalPrmWslcBrk_SBYTE 0 Gain -128 127 SYMBOL_LINK "CalPrmWslcBrk01.TP_S8_Rough_road_detector_R_level0" 0 /end CHARACTERISTIC
/begin CHARACTERISTIC TP_S8_Rough_road_detector_R_level1 "Starting value of transient Rough Road ( Default = 7 )" VALUE 0x800204C8 CalPrmWslcBrk_SBYTE 0 Gain -128 127 SYMBOL_LINK "CalPrmWslcBrk01.TP_S8_Rough_road_detector_R_level1" 0 /end CHARACTERISTIC
/begin CHARACTERISTIC TP_S8_Rough_road_detector_R_level2 "Starting value of fully Rough Road ( Default = 10 )" VALUE 0x800204C9 CalPrmWslcBrk_SBYTE 0 Gain -128 127 SYMBOL_LINK "CalPrmWslcBrk01.TP_S8_Rough_road_detector_R_level2" 0 /end CHARACTERISTIC
/begin CHARACTERISTIC TP_S8_SPLIT_dYAW_ABS_GAIN_1 "Delta-Yaw Gain @ Split Mu @ the early stage of ABS cycle, default 10, min 10, max 20" VALUE 0x800204FA CalPrmWslcBrk_SBYTE 0 Gain -128 127 SYMBOL_LINK "CalPrmWslcBrk01.TP_S8_SPLIT_dYAW_ABS_GAIN_1" 0 /end CHARACTERISTIC
/begin CHARACTERISTIC TP_S8_SPLIT_dYAW_ABS_GAIN_2 "Delta-Yaw Gain @ Split Mu @ the remaining ABS cycle, default 15, min 10, max 20" VALUE 0x800204FB CalPrmWslcBrk_SBYTE 0 Gain -128 127 SYMBOL_LINK "CalPrmWslcBrk01.TP_S8_SPLIT_dYAW_ABS_GAIN_2" 0 /end CHARACTERISTIC
/begin CHARACTERISTIC TP_S8_SPLIT_dYAW_DOT_ABS_GAIN_1 "Delta-Yaw Dot Gain @ Split Mu @ the early stage of ABS cycle(till dYaw <= target dYaw), default 0, min 0, max 4" VALUE 0x800204FC CalPrmWslcBrk_SBYTE 0 Gain -128 127 SYMBOL_LINK "CalPrmWslcBrk01.TP_S8_SPLIT_dYAW_DOT_ABS_GAIN_1" 0 /end CHARACTERISTIC
/begin CHARACTERISTIC TP_S8_SPLIT_dYAW_DOT_ABS_GAIN_2 "Delta-Yaw Dot Gain @ Split Mu @ the remaining ABS cycle, default 2, min 0, max 4" VALUE 0x800204FD CalPrmWslcBrk_SBYTE 0 Gain -128 127 SYMBOL_LINK "CalPrmWslcBrk01.TP_S8_SPLIT_dYAW_DOT_ABS_GAIN_2" 0 /end CHARACTERISTIC
/begin CHARACTERISTIC TP_S8_dV_F_slip_after_ABS_fz "rel_lam for outside front wheel after ABS_fz(flags=234)" VALUE 0x8002021C CalPrmWslcBrk_SBYTE 0 Perc6 -128 127 SYMBOL_LINK "CalPrmWslcBrk01.TP_S8_dV_F_slip_after_ABS_fz" 0 /end CHARACTERISTIC
/begin CHARACTERISTIC TP_U16_LFC_H2L_UNSTABIL_TIME_H_V "Ref. Time of Wheel Unstable state, High-to-Low Mu Jump detection" VALUE 0x8002058C CalPrmWslcBrk_UWORD 0 Gain 0 65535 SYMBOL_LINK "CalPrmWslcBrk01.TP_U16_LFC_H2L_UNSTABIL_TIME_H_V" 0 /end CHARACTERISTIC
/begin CHARACTERISTIC TP_U8TCSCpBaseTarWhlSpinDiff[0] "" VALUE 0x8003A270 CalPrmWspcEng_UBYTE 0 Spd12 0 31.875 SYMBOL_LINK "CalPrmWspcEng01.TP_U8TCSCpBaseTarWhlSpinDiff[0]" 0 /end CHARACTERISTIC
/begin CHARACTERISTIC TP_U8TCSCpBaseTarWhlSpinDiff[1] "" VALUE 0x8003A271 CalPrmWspcEng_UBYTE 0 Spd12 0 31.875 SYMBOL_LINK "CalPrmWspcEng01.TP_U8TCSCpBaseTarWhlSpinDiff[1]" 0 /end CHARACTERISTIC
/begin CHARACTERISTIC TP_U8TCSCpBaseTarWhlSpinDiff[2] "" VALUE 0x8003A272 CalPrmWspcEng_UBYTE 0 Spd12 0 31.875 SYMBOL_LINK "CalPrmWspcEng01.TP_U8TCSCpBaseTarWhlSpinDiff[2]" 0 /end CHARACTERISTIC
/begin CHARACTERISTIC TP_U8TCSCpBaseTarWhlSpinDiff[3] "" VALUE 0x8003A273 CalPrmWspcEng_UBYTE 0 Spd12 0 31.875 SYMBOL_LINK "CalPrmWspcEng01.TP_U8TCSCpBaseTarWhlSpinDiff[3]" 0 /end CHARACTERISTIC
/begin CHARACTERISTIC TP_U8TCSCpBaseTarWhlSpinDiff[4] "" VALUE 0x8003A274 CalPrmWspcEng_UBYTE 0 Spd12 0 31.875 SYMBOL_LINK "CalPrmWspcEng01.TP_U8TCSCpBaseTarWhlSpinDiff[4]" 0 /end CHARACTERISTIC
/begin CHARACTERISTIC TP_U8TCSCpBsAsmdMuDiffHill_F[0] "" VALUE 0x8003A27F CalPrmWspcEng_UBYTE 0 A42 0 2.55 SYMBOL_LINK "CalPrmWspcEng01.TP_U8TCSCpBsAsmdMuDiffHill_F[0]" 0 /end CHARACTERISTIC
/begin CHARACTERISTIC TP_U8TCSCpBsAsmdMuDiffHill_F[1] "" VALUE 0x8003A280 CalPrmWspcEng_UBYTE 0 A42 0 2.55 SYMBOL_LINK "CalPrmWspcEng01.TP_U8TCSCpBsAsmdMuDiffHill_F[1]" 0 /end CHARACTERISTIC
/begin CHARACTERISTIC TP_U8TCSCpBsAsmdMuDiffHill_F[2] "" VALUE 0x8003A281 CalPrmWspcEng_UBYTE 0 A42 0 2.55 SYMBOL_LINK "CalPrmWspcEng01.TP_U8TCSCpBsAsmdMuDiffHill_F[2]" 0 /end CHARACTERISTIC
/begin CHARACTERISTIC TP_U8TCSCpBsAsmdMuDiffHill_F[3] "" VALUE 0x8003A282 CalPrmWspcEng_UBYTE 0 A42 0 2.55 SYMBOL_LINK "CalPrmWspcEng01.TP_U8TCSCpBsAsmdMuDiffHill_F[3]" 0 /end CHARACTERISTIC
/begin CHARACTERISTIC TP_U8TCSCpBsAsmdMuDiffHill_F[4] "" VALUE 0x8003A283 CalPrmWspcEng_UBYTE 0 A42 0 2.55 SYMBOL_LINK "CalPrmWspcEng01.TP_U8TCSCpBsAsmdMuDiffHill_F[4]" 0 /end CHARACTERISTIC
/begin CHARACTERISTIC TP_U8TCSCpBsAsmdMuDiffHill_R[0] "" VALUE 0x8003A284 CalPrmWspcEng_UBYTE 0 A42 0 2.55 SYMBOL_LINK "CalPrmWspcEng01.TP_U8TCSCpBsAsmdMuDiffHill_R[0]" 0 /end CHARACTERISTIC
/begin CHARACTERISTIC TP_U8TCSCpBsAsmdMuDiffHill_R[1] "" VALUE 0x8003A285 CalPrmWspcEng_UBYTE 0 A42 0 2.55 SYMBOL_LINK "CalPrmWspcEng01.TP_U8TCSCpBsAsmdMuDiffHill_R[1]" 0 /end CHARACTERISTIC
/begin CHARACTERISTIC TP_U8TCSCpBsAsmdMuDiffHill_R[2] "" VALUE 0x8003A286 CalPrmWspcEng_UBYTE 0 A42 0 2.55 SYMBOL_LINK "CalPrmWspcEng01.TP_U8TCSCpBsAsmdMuDiffHill_R[2]" 0 /end CHARACTERISTIC
/begin CHARACTERISTIC TP_U8TCSCpBsAsmdMuDiffHill_R[3] "" VALUE 0x8003A287 CalPrmWspcEng_UBYTE 0 A42 0 2.55 SYMBOL_LINK "CalPrmWspcEng01.TP_U8TCSCpBsAsmdMuDiffHill_R[3]" 0 /end CHARACTERISTIC
/begin CHARACTERISTIC TP_U8TCSCpBsAsmdMuDiffHill_R[4] "" VALUE 0x8003A288 CalPrmWspcEng_UBYTE 0 A42 0 2.55 SYMBOL_LINK "CalPrmWspcEng01.TP_U8TCSCpBsAsmdMuDiffHill_R[4]" 0 /end CHARACTERISTIC
/begin CHARACTERISTIC TP_U8TCSCpBsHillIG4ASFBCtl_F[0] "" VALUE 0x8003A29D CalPrmWspcEng_UBYTE 0 Gain 0 255 SYMBOL_LINK "CalPrmWspcEng01.TP_U8TCSCpBsHillIG4ASFBCtl_F[0]" 0 /end CHARACTERISTIC
/begin CHARACTERISTIC TP_U8TCSCpBsHillIG4ASFBCtl_F[1] "" VALUE 0x8003A29E CalPrmWspcEng_UBYTE 0 Gain 0 255 SYMBOL_LINK "CalPrmWspcEng01.TP_U8TCSCpBsHillIG4ASFBCtl_F[1]" 0 /end CHARACTERISTIC
/begin CHARACTERISTIC TP_U8TCSCpBsHillIG4ASFBCtl_F[2] "" VALUE 0x8003A29F CalPrmWspcEng_UBYTE 0 Gain 0 255 SYMBOL_LINK "CalPrmWspcEng01.TP_U8TCSCpBsHillIG4ASFBCtl_F[2]" 0 /end CHARACTERISTIC
/begin CHARACTERISTIC TP_U8TCSCpBsHillIG4ASFBCtl_F[3] "" VALUE 0x8003A2A0 CalPrmWspcEng_UBYTE 0 Gain 0 255 SYMBOL_LINK "CalPrmWspcEng01.TP_U8TCSCpBsHillIG4ASFBCtl_F[3]" 0 /end CHARACTERISTIC
/begin CHARACTERISTIC TP_U8TCSCpBsHillIG4ASFBCtl_F[4] "" VALUE 0x8003A2A1 CalPrmWspcEng_UBYTE 0 Gain 0 255 SYMBOL_LINK "CalPrmWspcEng01.TP_U8TCSCpBsHillIG4ASFBCtl_F[4]" 0 /end CHARACTERISTIC
/begin CHARACTERISTIC TP_U8TCSCpBsHillIG4ASFBCtl_R[0] "" VALUE 0x8003A2A2 CalPrmWspcEng_UBYTE 0 Gain 0 255 SYMBOL_LINK "CalPrmWspcEng01.TP_U8TCSCpBsHillIG4ASFBCtl_R[0]" 0 /end CHARACTERISTIC
/begin CHARACTERISTIC TP_U8TCSCpBsHillIG4ASFBCtl_R[1] "" VALUE 0x8003A2A3 CalPrmWspcEng_UBYTE 0 Gain 0 255 SYMBOL_LINK "CalPrmWspcEng01.TP_U8TCSCpBsHillIG4ASFBCtl_R[1]" 0 /end CHARACTERISTIC
/begin CHARACTERISTIC TP_U8TCSCpBsHillIG4ASFBCtl_R[2] "" VALUE 0x8003A2A4 CalPrmWspcEng_UBYTE 0 Gain 0 255 SYMBOL_LINK "CalPrmWspcEng01.TP_U8TCSCpBsHillIG4ASFBCtl_R[2]" 0 /end CHARACTERISTIC
/begin CHARACTERISTIC TP_U8TCSCpBsHillIG4ASFBCtl_R[3] "" VALUE 0x8003A2A5 CalPrmWspcEng_UBYTE 0 Gain 0 255 SYMBOL_LINK "CalPrmWspcEng01.TP_U8TCSCpBsHillIG4ASFBCtl_R[3]" 0 /end CHARACTERISTIC
/begin CHARACTERISTIC TP_U8TCSCpBsHillIG4ASFBCtl_R[4] "" VALUE 0x8003A2A6 CalPrmWspcEng_UBYTE 0 Gain 0 255 SYMBOL_LINK "CalPrmWspcEng01.TP_U8TCSCpBsHillIG4ASFBCtl_R[4]" 0 /end CHARACTERISTIC
/begin CHARACTERISTIC TP_U8TCSCpBsStIG4ASFBCtl_F[0] "" VALUE 0x8003A2BB CalPrmWspcEng_UBYTE 0 Gain 0 255 SYMBOL_LINK "CalPrmWspcEng01.TP_U8TCSCpBsStIG4ASFBCtl_F[0]" 0 /end CHARACTERISTIC
/begin CHARACTERISTIC TP_U8TCSCpBsStIG4ASFBCtl_F[1] "" VALUE 0x8003A2BC CalPrmWspcEng_UBYTE 0 Gain 0 255 SYMBOL_LINK "CalPrmWspcEng01.TP_U8TCSCpBsStIG4ASFBCtl_F[1]" 0 /end CHARACTERISTIC
/begin CHARACTERISTIC TP_U8TCSCpBsStIG4ASFBCtl_F[2] "" VALUE 0x8003A2BD CalPrmWspcEng_UBYTE 0 Gain 0 255 SYMBOL_LINK "CalPrmWspcEng01.TP_U8TCSCpBsStIG4ASFBCtl_F[2]" 0 /end CHARACTERISTIC
/begin CHARACTERISTIC TP_U8TCSCpBsStIG4ASFBCtl_F[3] "" VALUE 0x8003A2BE CalPrmWspcEng_UBYTE 0 Gain 0 255 SYMBOL_LINK "CalPrmWspcEng01.TP_U8TCSCpBsStIG4ASFBCtl_F[3]" 0 /end CHARACTERISTIC
/begin CHARACTERISTIC TP_U8TCSCpBsStIG4ASFBCtl_F[4] "" VALUE 0x8003A2BF CalPrmWspcEng_UBYTE 0 Gain 0 255 SYMBOL_LINK "CalPrmWspcEng01.TP_U8TCSCpBsStIG4ASFBCtl_F[4]" 0 /end CHARACTERISTIC
/begin CHARACTERISTIC TP_U8TCSCpBsStIG4ASFBCtl_R[0] "" VALUE 0x8003A2C0 CalPrmWspcEng_UBYTE 0 Gain 0 255 SYMBOL_LINK "CalPrmWspcEng01.TP_U8TCSCpBsStIG4ASFBCtl_R[0]" 0 /end CHARACTERISTIC
/begin CHARACTERISTIC TP_U8TCSCpBsStIG4ASFBCtl_R[1] "" VALUE 0x8003A2C1 CalPrmWspcEng_UBYTE 0 Gain 0 255 SYMBOL_LINK "CalPrmWspcEng01.TP_U8TCSCpBsStIG4ASFBCtl_R[1]" 0 /end CHARACTERISTIC
/begin CHARACTERISTIC TP_U8TCSCpBsStIG4ASFBCtl_R[2] "" VALUE 0x8003A2C2 CalPrmWspcEng_UBYTE 0 Gain 0 255 SYMBOL_LINK "CalPrmWspcEng01.TP_U8TCSCpBsStIG4ASFBCtl_R[2]" 0 /end CHARACTERISTIC
/begin CHARACTERISTIC TP_U8TCSCpBsStIG4ASFBCtl_R[3] "" VALUE 0x8003A2C3 CalPrmWspcEng_UBYTE 0 Gain 0 255 SYMBOL_LINK "CalPrmWspcEng01.TP_U8TCSCpBsStIG4ASFBCtl_R[3]" 0 /end CHARACTERISTIC
/begin CHARACTERISTIC TP_U8TCSCpBsStIG4ASFBCtl_R[4] "" VALUE 0x8003A2C4 CalPrmWspcEng_UBYTE 0 Gain 0 255 SYMBOL_LINK "CalPrmWspcEng01.TP_U8TCSCpBsStIG4ASFBCtl_R[4]" 0 /end CHARACTERISTIC
/begin CHARACTERISTIC TP_U8TCSCpBsStPG4ASFBCtlN_F[0] "" VALUE 0x8003A2C5 CalPrmWspcEng_UBYTE 0 Gain 0 255 SYMBOL_LINK "CalPrmWspcEng01.TP_U8TCSCpBsStPG4ASFBCtlN_F[0]" 0 /end CHARACTERISTIC
/begin CHARACTERISTIC TP_U8TCSCpBsStPG4ASFBCtlN_F[1] "" VALUE 0x8003A2C6 CalPrmWspcEng_UBYTE 0 Gain 0 255 SYMBOL_LINK "CalPrmWspcEng01.TP_U8TCSCpBsStPG4ASFBCtlN_F[1]" 0 /end CHARACTERISTIC
/begin CHARACTERISTIC TP_U8TCSCpBsStPG4ASFBCtlN_F[2] "" VALUE 0x8003A2C7 CalPrmWspcEng_UBYTE 0 Gain 0 255 SYMBOL_LINK "CalPrmWspcEng01.TP_U8TCSCpBsStPG4ASFBCtlN_F[2]" 0 /end CHARACTERISTIC
/begin CHARACTERISTIC TP_U8TCSCpBsStPG4ASFBCtlN_F[3] "" VALUE 0x8003A2C8 CalPrmWspcEng_UBYTE 0 Gain 0 255 SYMBOL_LINK "CalPrmWspcEng01.TP_U8TCSCpBsStPG4ASFBCtlN_F[3]" 0 /end CHARACTERISTIC
/begin CHARACTERISTIC TP_U8TCSCpBsStPG4ASFBCtlN_F[4] "" VALUE 0x8003A2C9 CalPrmWspcEng_UBYTE 0 Gain 0 255 SYMBOL_LINK "CalPrmWspcEng01.TP_U8TCSCpBsStPG4ASFBCtlN_F[4]" 0 /end CHARACTERISTIC
/begin CHARACTERISTIC TP_U8TCSCpBsStPG4ASFBCtlN_R[0] "" VALUE 0x8003A2CA CalPrmWspcEng_UBYTE 0 Gain 0 255 SYMBOL_LINK "CalPrmWspcEng01.TP_U8TCSCpBsStPG4ASFBCtlN_R[0]" 0 /end CHARACTERISTIC
/begin CHARACTERISTIC TP_U8TCSCpBsStPG4ASFBCtlN_R[1] "" VALUE 0x8003A2CB CalPrmWspcEng_UBYTE 0 Gain 0 255 SYMBOL_LINK "CalPrmWspcEng01.TP_U8TCSCpBsStPG4ASFBCtlN_R[1]" 0 /end CHARACTERISTIC
/begin CHARACTERISTIC TP_U8TCSCpBsStPG4ASFBCtlN_R[2] "" VALUE 0x8003A2CC CalPrmWspcEng_UBYTE 0 Gain 0 255 SYMBOL_LINK "CalPrmWspcEng01.TP_U8TCSCpBsStPG4ASFBCtlN_R[2]" 0 /end CHARACTERISTIC
/begin CHARACTERISTIC TP_U8TCSCpBsStPG4ASFBCtlN_R[3] "" VALUE 0x8003A2CD CalPrmWspcEng_UBYTE 0 Gain 0 255 SYMBOL_LINK "CalPrmWspcEng01.TP_U8TCSCpBsStPG4ASFBCtlN_R[3]" 0 /end CHARACTERISTIC
/begin CHARACTERISTIC TP_U8TCSCpBsStPG4ASFBCtlN_R[4] "" VALUE 0x8003A2CE CalPrmWspcEng_UBYTE 0 Gain 0 255 SYMBOL_LINK "CalPrmWspcEng01.TP_U8TCSCpBsStPG4ASFBCtlN_R[4]" 0 /end CHARACTERISTIC
/begin CHARACTERISTIC TP_U8TCSCpBsStPG4ASFBCtlP_F[0] "" VALUE 0x8003A2CF CalPrmWspcEng_UBYTE 0 Gain 0 255 SYMBOL_LINK "CalPrmWspcEng01.TP_U8TCSCpBsStPG4ASFBCtlP_F[0]" 0 /end CHARACTERISTIC
/begin CHARACTERISTIC TP_U8TCSCpBsStPG4ASFBCtlP_F[1] "" VALUE 0x8003A2D0 CalPrmWspcEng_UBYTE 0 Gain 0 255 SYMBOL_LINK "CalPrmWspcEng01.TP_U8TCSCpBsStPG4ASFBCtlP_F[1]" 0 /end CHARACTERISTIC
/begin CHARACTERISTIC TP_U8TCSCpBsStPG4ASFBCtlP_F[2] "" VALUE 0x8003A2D1 CalPrmWspcEng_UBYTE 0 Gain 0 255 SYMBOL_LINK "CalPrmWspcEng01.TP_U8TCSCpBsStPG4ASFBCtlP_F[2]" 0 /end CHARACTERISTIC
/begin CHARACTERISTIC TP_U8TCSCpBsStPG4ASFBCtlP_F[3] "" VALUE 0x8003A2D2 CalPrmWspcEng_UBYTE 0 Gain 0 255 SYMBOL_LINK "CalPrmWspcEng01.TP_U8TCSCpBsStPG4ASFBCtlP_F[3]" 0 /end CHARACTERISTIC
/begin CHARACTERISTIC TP_U8TCSCpBsStPG4ASFBCtlP_F[4] "" VALUE 0x8003A2D3 CalPrmWspcEng_UBYTE 0 Gain 0 255 SYMBOL_LINK "CalPrmWspcEng01.TP_U8TCSCpBsStPG4ASFBCtlP_F[4]" 0 /end CHARACTERISTIC
/begin CHARACTERISTIC TP_U8TCSCpBsStPG4ASFBCtlP_R[0] "" VALUE 0x8003A2D4 CalPrmWspcEng_UBYTE 0 Gain 0 255 SYMBOL_LINK "CalPrmWspcEng01.TP_U8TCSCpBsStPG4ASFBCtlP_R[0]" 0 /end CHARACTERISTIC
/begin CHARACTERISTIC TP_U8TCSCpBsStPG4ASFBCtlP_R[1] "" VALUE 0x8003A2D5 CalPrmWspcEng_UBYTE 0 Gain 0 255 SYMBOL_LINK "CalPrmWspcEng01.TP_U8TCSCpBsStPG4ASFBCtlP_R[1]" 0 /end CHARACTERISTIC
/begin CHARACTERISTIC TP_U8TCSCpBsStPG4ASFBCtlP_R[2] "" VALUE 0x8003A2D6 CalPrmWspcEng_UBYTE 0 Gain 0 255 SYMBOL_LINK "CalPrmWspcEng01.TP_U8TCSCpBsStPG4ASFBCtlP_R[2]" 0 /end CHARACTERISTIC
/begin CHARACTERISTIC TP_U8TCSCpBsStPG4ASFBCtlP_R[3] "" VALUE 0x8003A2D7 CalPrmWspcEng_UBYTE 0 Gain 0 255 SYMBOL_LINK "CalPrmWspcEng01.TP_U8TCSCpBsStPG4ASFBCtlP_R[3]" 0 /end CHARACTERISTIC
/begin CHARACTERISTIC TP_U8TCSCpBsStPG4ASFBCtlP_R[4] "" VALUE 0x8003A2D8 CalPrmWspcEng_UBYTE 0 Gain 0 255 SYMBOL_LINK "CalPrmWspcEng01.TP_U8TCSCpBsStPG4ASFBCtlP_R[4]" 0 /end CHARACTERISTIC
/begin CHARACTERISTIC TP_U8TCSCpICtlActCntTh "" VALUE 0x8003A307 CalPrmWspcEng_UBYTE 0 Gain 0 255 SYMBOL_LINK "CalPrmWspcEng01.TP_U8TCSCpICtlActCntTh" 0 /end CHARACTERISTIC
/begin CHARACTERISTIC TP_U8TCSCpICtlActWhlChgRateTh "" VALUE 0x8003A308 CalPrmWspcEng_UBYTE 0 A42 0 2.55 SYMBOL_LINK "CalPrmWspcEng01.TP_U8TCSCpICtlActWhlChgRateTh" 0 /end CHARACTERISTIC
/begin CHARACTERISTIC TP_U8TCSCpIgainEffPctStN_F "" VALUE 0x8003A309 CalPrmWspcEng_UBYTE 0 Fac31 0 255 SYMBOL_LINK "CalPrmWspcEng01.TP_U8TCSCpIgainEffPctStN_F" 0 /end CHARACTERISTIC
/begin CHARACTERISTIC TP_U8TCSCpIgainEffPctStN_R "" VALUE 0x8003A30A CalPrmWspcEng_UBYTE 0 Fac31 0 255 SYMBOL_LINK "CalPrmWspcEng01.TP_U8TCSCpIgainEffPctStN_R" 0 /end CHARACTERISTIC
/begin CHARACTERISTIC TP_U8TCSCpIgainEffPctStP_F "" VALUE 0x8003A30B CalPrmWspcEng_UBYTE 0 Fac31 0 255 SYMBOL_LINK "CalPrmWspcEng01.TP_U8TCSCpIgainEffPctStP_F" 0 /end CHARACTERISTIC
/begin CHARACTERISTIC TP_U8TCSCpIgainEffPctStP_R "" VALUE 0x8003A30C CalPrmWspcEng_UBYTE 0 Fac31 0 255 SYMBOL_LINK "CalPrmWspcEng01.TP_U8TCSCpIgainEffPctStP_R" 0 /end CHARACTERISTIC
/begin CHARACTERISTIC TP_U8TCSCpIgainEffPctTurnN_F "" VALUE 0x8003A30D CalPrmWspcEng_UBYTE 0 Fac31 0 255 SYMBOL_LINK "CalPrmWspcEng01.TP_U8TCSCpIgainEffPctTurnN_F" 0 /end CHARACTERISTIC
/begin CHARACTERISTIC TP_U8TCSCpIgainEffPctTurnN_R "" VALUE 0x8003A30E CalPrmWspcEng_UBYTE 0 Fac31 0 255 SYMBOL_LINK "CalPrmWspcEng01.TP_U8TCSCpIgainEffPctTurnN_R" 0 /end CHARACTERISTIC
/begin CHARACTERISTIC TP_U8TCSCpIgainEffPctTurnP_F "" VALUE 0x8003A30F CalPrmWspcEng_UBYTE 0 Fac31 0 255 SYMBOL_LINK "CalPrmWspcEng01.TP_U8TCSCpIgainEffPctTurnP_F" 0 /end CHARACTERISTIC
/begin CHARACTERISTIC TP_U8TCSCpIgainEffPctTurnP_R "" VALUE 0x8003A310 CalPrmWspcEng_UBYTE 0 Fac31 0 255 SYMBOL_LINK "CalPrmWspcEng01.TP_U8TCSCpIgainEffPctTurnP_R" 0 /end CHARACTERISTIC
/begin CHARACTERISTIC TP_U8TCSCpPgFac4ASFBCtlSt_F[0] "" VALUE 0x8003A321 CalPrmWspcEng_UBYTE 0 Fac31 0 255 SYMBOL_LINK "CalPrmWspcEng01.TP_U8TCSCpPgFac4ASFBCtlSt_F[0]" 0 /end CHARACTERISTIC
/begin CHARACTERISTIC TP_U8TCSCpPgFac4ASFBCtlSt_F[1] "" VALUE 0x8003A322 CalPrmWspcEng_UBYTE 0 Fac31 0 255 SYMBOL_LINK "CalPrmWspcEng01.TP_U8TCSCpPgFac4ASFBCtlSt_F[1]" 0 /end CHARACTERISTIC
/begin CHARACTERISTIC TP_U8TCSCpPgFac4ASFBCtlSt_F[2] "" VALUE 0x8003A323 CalPrmWspcEng_UBYTE 0 Fac31 0 255 SYMBOL_LINK "CalPrmWspcEng01.TP_U8TCSCpPgFac4ASFBCtlSt_F[2]" 0 /end CHARACTERISTIC
/begin CHARACTERISTIC TP_U8TCSCpPgFac4ASFBCtlSt_F[3] "" VALUE 0x8003A324 CalPrmWspcEng_UBYTE 0 Fac31 0 255 SYMBOL_LINK "CalPrmWspcEng01.TP_U8TCSCpPgFac4ASFBCtlSt_F[3]" 0 /end CHARACTERISTIC
/begin CHARACTERISTIC TP_U8TCSCpPgFac4ASFBCtlSt_F[4] "" VALUE 0x8003A325 CalPrmWspcEng_UBYTE 0 Fac31 0 255 SYMBOL_LINK "CalPrmWspcEng01.TP_U8TCSCpPgFac4ASFBCtlSt_F[4]" 0 /end CHARACTERISTIC
/begin CHARACTERISTIC TP_U8TCSCpPgFac4ASFBCtlSt_R[0] "" VALUE 0x8003A326 CalPrmWspcEng_UBYTE 0 Fac31 0 255 SYMBOL_LINK "CalPrmWspcEng01.TP_U8TCSCpPgFac4ASFBCtlSt_R[0]" 0 /end CHARACTERISTIC
/begin CHARACTERISTIC TP_U8TCSCpPgFac4ASFBCtlSt_R[1] "" VALUE 0x8003A327 CalPrmWspcEng_UBYTE 0 Fac31 0 255 SYMBOL_LINK "CalPrmWspcEng01.TP_U8TCSCpPgFac4ASFBCtlSt_R[1]" 0 /end CHARACTERISTIC
/begin CHARACTERISTIC TP_U8TCSCpPgFac4ASFBCtlSt_R[2] "" VALUE 0x8003A328 CalPrmWspcEng_UBYTE 0 Fac31 0 255 SYMBOL_LINK "CalPrmWspcEng01.TP_U8TCSCpPgFac4ASFBCtlSt_R[2]" 0 /end CHARACTERISTIC
/begin CHARACTERISTIC TP_U8TCSCpPgFac4ASFBCtlSt_R[3] "" VALUE 0x8003A329 CalPrmWspcEng_UBYTE 0 Fac31 0 255 SYMBOL_LINK "CalPrmWspcEng01.TP_U8TCSCpPgFac4ASFBCtlSt_R[3]" 0 /end CHARACTERISTIC
/begin CHARACTERISTIC TP_U8TCSCpPgFac4ASFBCtlSt_R[4] "" VALUE 0x8003A32A CalPrmWspcEng_UBYTE 0 Fac31 0 255 SYMBOL_LINK "CalPrmWspcEng01.TP_U8TCSCpPgFac4ASFBCtlSt_R[4]" 0 /end CHARACTERISTIC
/begin CHARACTERISTIC TP_U8TCSCpSclFctTrq2PresFrt "" VALUE 0x8003A338 CalPrmWspcEng_UBYTE 0 Gain 0 255 SYMBOL_LINK "CalPrmWspcEng01.TP_U8TCSCpSclFctTrq2PresFrt" 0 /end CHARACTERISTIC
/begin CHARACTERISTIC TP_U8TCSCpSclFctTrq2PresRer "" VALUE 0x8003A339 CalPrmWspcEng_UBYTE 0 Gain 0 255 SYMBOL_LINK "CalPrmWspcEng01.TP_U8TCSCpSclFctTrq2PresRer" 0 /end CHARACTERISTIC
/begin CHARACTERISTIC TP_U8_1stDPRisePerDumpRatio_HMu_F "Ratio to Dump scans for 1st cycle Unstable Rise time, High-mu, Front Wheels, default 50%, min 10, max 100" VALUE 0x800205D7 CalPrmWslcBrk_UBYTE 0 Perc6 0 255 SYMBOL_LINK "CalPrmWslcBrk01.TP_U8_1stDPRisePerDumpRatio_HMu_F" 0 /end CHARACTERISTIC
/begin CHARACTERISTIC TP_U8_1stDPRisePerDumpRatio_HMu_R "Ratio to Dump scans for 1st cycle Unstable Rise time, High-mu, Rear Wheels, default 50%, min 10, max 100" VALUE 0x800205D8 CalPrmWslcBrk_UBYTE 0 Perc6 0 255 SYMBOL_LINK "CalPrmWslcBrk01.TP_U8_1stDPRisePerDumpRatio_HMu_R" 0 /end CHARACTERISTIC
/begin CHARACTERISTIC TP_U8_1stDPRisePerDumpRatio_LMu_F "Ratio to Dump scans for 1st cycle Unstable Rise time, Low-mu, Front Wheels, default 50%, min 10, max 100" VALUE 0x800205D9 CalPrmWslcBrk_UBYTE 0 Perc6 0 255 SYMBOL_LINK "CalPrmWslcBrk01.TP_U8_1stDPRisePerDumpRatio_LMu_F" 0 /end CHARACTERISTIC
/begin CHARACTERISTIC TP_U8_1stDPRisePerDumpRatio_LMu_R "Ratio to Dump scans for 1st cycle Unstable Rise time, Low-mu, Rear Wheels, default 50%, min 10, max 100" VALUE 0x800205DA CalPrmWslcBrk_UBYTE 0 Perc6 0 255 SYMBOL_LINK "CalPrmWslcBrk01.TP_U8_1stDPRisePerDumpRatio_LMu_R" 0 /end CHARACTERISTIC
/begin CHARACTERISTIC TP_U8_1stDPRisePerDumpRatio_MMu_F "Ratio to Dump scans for 1st cycle Unstable Rise time, Medium-mu, Front Wheels, default 50%, min 10, max 100" VALUE 0x800205DB CalPrmWslcBrk_UBYTE 0 Perc6 0 255 SYMBOL_LINK "CalPrmWslcBrk01.TP_U8_1stDPRisePerDumpRatio_MMu_F" 0 /end CHARACTERISTIC
/begin CHARACTERISTIC TP_U8_1stDPRisePerDumpRatio_MMu_R "Ratio to Dump scans for 1st cycle Unstable Rise time, Medium-mu, Rear Wheels, default 50%, min 10, max 100" VALUE 0x800205DC CalPrmWslcBrk_UBYTE 0 Perc6 0 255 SYMBOL_LINK "CalPrmWslcBrk01.TP_U8_1stDPRisePerDumpRatio_MMu_R" 0 /end CHARACTERISTIC
/begin CHARACTERISTIC TP_U8_1st_Dumpscantime_HMu_HHDF_F "Time of 1st dump-scan for High High_dump_factor in High mu, Front Wheels" VALUE 0x80020499 CalPrmWslcBrk_UBYTE 0 Gain 0 255 SYMBOL_LINK "CalPrmWslcBrk01.TP_U8_1st_Dumpscantime_HMu_HHDF_F" 0 /end CHARACTERISTIC
/begin CHARACTERISTIC TP_U8_1st_Dumpscantime_HMu_HHDF_R "Time of 1st dump-scan for High High_dump_factor in High mu, Rear Wheels" VALUE 0x8002049F CalPrmWslcBrk_UBYTE 0 Gain 0 255 SYMBOL_LINK "CalPrmWslcBrk01.TP_U8_1st_Dumpscantime_HMu_HHDF_R" 0 /end CHARACTERISTIC
/begin CHARACTERISTIC TP_U8_1st_Dumpscantime_HMu_LHDF_F "Time of 1st dump-scan for Low High_dump_factor in High mu, Front Wheels" VALUE 0x8002049A CalPrmWslcBrk_UBYTE 0 Gain 0 255 SYMBOL_LINK "CalPrmWslcBrk01.TP_U8_1st_Dumpscantime_HMu_LHDF_F" 0 /end CHARACTERISTIC
/begin CHARACTERISTIC TP_U8_1st_Dumpscantime_HMu_LHDF_R "Time of 1st dump-scan for Low High_dump_factor in High mu, Rear Wheels" VALUE 0x800204A0 CalPrmWslcBrk_UBYTE 0 Gain 0 255 SYMBOL_LINK "CalPrmWslcBrk01.TP_U8_1st_Dumpscantime_HMu_LHDF_R" 0 /end CHARACTERISTIC
/begin CHARACTERISTIC TP_U8_1st_Dumpscantime_HMu_LMHDF_F "Time of 1st dump-scan for LowMed High_dump_factor in High mu, Front Wheels" VALUE 0x8002049B CalPrmWslcBrk_UBYTE 0 Gain 0 255 SYMBOL_LINK "CalPrmWslcBrk01.TP_U8_1st_Dumpscantime_HMu_LMHDF_F" 0 /end CHARACTERISTIC
/begin CHARACTERISTIC TP_U8_1st_Dumpscantime_HMu_MHDF_F "Time of 1st dump-scan for Medium High_dump_factor in High mu, Front Wheels" VALUE 0x8002049C CalPrmWslcBrk_UBYTE 0 Gain 0 255 SYMBOL_LINK "CalPrmWslcBrk01.TP_U8_1st_Dumpscantime_HMu_MHDF_F" 0 /end CHARACTERISTIC
/begin CHARACTERISTIC TP_U8_1st_Dumpscantime_HMu_MHDF_R "Time of 1st dump-scan for Medium High_dump_factor in High mu, Rear Wheels" VALUE 0x800204A1 CalPrmWslcBrk_UBYTE 0 Gain 0 255 SYMBOL_LINK "CalPrmWslcBrk01.TP_U8_1st_Dumpscantime_HMu_MHDF_R" 0 /end CHARACTERISTIC
/begin CHARACTERISTIC TP_U8_1st_Dumptime_HMu_B_20_F "Dump time in ms of 1st dump-scan in High mu, below 20kph, Front Wheels" VALUE 0x8002049D CalPrmWslcBrk_UBYTE 0 Gain 0 255 SYMBOL_LINK "CalPrmWslcBrk01.TP_U8_1st_Dumptime_HMu_B_20_F" 0 /end CHARACTERISTIC
/begin CHARACTERISTIC TP_U8_1st_Dumptime_HMu_B_20_R "Dump time in ms of 1st dump-scan in High mu, below 20kph, Rear Wheels" VALUE 0x800204A2 CalPrmWslcBrk_UBYTE 0 Gain 0 255 SYMBOL_LINK "CalPrmWslcBrk01.TP_U8_1st_Dumptime_HMu_B_20_R" 0 /end CHARACTERISTIC
/begin CHARACTERISTIC TP_U8_1st_Dumptime_HMu_LHDF_B_20_F "Dump time in ms of 1st dump-scan for Low High_dump_factor in High mu, below 20kph, Front Wheels" VALUE 0x8002049E CalPrmWslcBrk_UBYTE 0 Gain 0 255 SYMBOL_LINK "CalPrmWslcBrk01.TP_U8_1st_Dumptime_HMu_LHDF_B_20_F" 0 /end CHARACTERISTIC
/begin CHARACTERISTIC TP_U8_1st_Dumptime_HMu_LHDF_B_20_R "Dump time in ms of 1st dump-scan for Low High_dump_factor in High mu, below 20kph, Rear Wheels" VALUE 0x800204A3 CalPrmWslcBrk_UBYTE 0 Gain 0 255 SYMBOL_LINK "CalPrmWslcBrk01.TP_U8_1st_Dumptime_HMu_LHDF_B_20_R" 0 /end CHARACTERISTIC
/begin CHARACTERISTIC TP_U8_B_10KPH_Dumpscantime_LMMu_R "Time of dump-scan in Low-med mu below 10kph, Rear Wheels" VALUE 0x800204B2 CalPrmWslcBrk_UBYTE 0 Gain 0 255 SYMBOL_LINK "CalPrmWslcBrk01.TP_U8_B_10KPH_Dumpscantime_LMMu_R" 0 /end CHARACTERISTIC
/begin CHARACTERISTIC TP_U8_B_10KPH_Dumpscantime_LMu_F "Time of dump-scan in Low mu below 10kph, Front Wheels" VALUE 0x800204B8 CalPrmWslcBrk_UBYTE 0 Gain 0 255 SYMBOL_LINK "CalPrmWslcBrk01.TP_U8_B_10KPH_Dumpscantime_LMu_F" 0 /end CHARACTERISTIC
/begin CHARACTERISTIC TP_U8_B_10KPH_Dumpscantime_LMu_R "Time of dump-scan in Low mu below 10kph, Rear Wheels" VALUE 0x800204BD CalPrmWslcBrk_UBYTE 0 Gain 0 255 SYMBOL_LINK "CalPrmWslcBrk01.TP_U8_B_10KPH_Dumpscantime_LMu_R" 0 /end CHARACTERISTIC
/begin CHARACTERISTIC TP_U8_B_20KPH_Dumpscantime_LMMu_F "Time of dump-scan in Low-med mu below 20kph, Front Wheels" VALUE 0x800204AD CalPrmWslcBrk_UBYTE 0 Gain 0 255 SYMBOL_LINK "CalPrmWslcBrk01.TP_U8_B_20KPH_Dumpscantime_LMMu_F" 0 /end CHARACTERISTIC
/begin CHARACTERISTIC TP_U8_B_20KPH_Dumpscantime_MMu_F "Time of dump-scan in Medium mu below 20kph, Front Wheels" VALUE 0x800204A6 CalPrmWslcBrk_UBYTE 0 Gain 0 255 SYMBOL_LINK "CalPrmWslcBrk01.TP_U8_B_20KPH_Dumpscantime_MMu_F" 0 /end CHARACTERISTIC
/begin CHARACTERISTIC TP_U8_DV_BASE_PRO_FOR_GMA_WL "dV percentage after U8_GMA_WL_DV_SET_COUNTER_REF times pulse-up" VALUE 0x80020283 CalPrmWslcBrk_UBYTE 0 Perc10 0 99.603 SYMBOL_LINK "CalPrmWslcBrk01.TP_U8_DV_BASE_PRO_FOR_GMA_WL" 0 /end CHARACTERISTIC
/begin CHARACTERISTIC TP_U8_EBD_HOLD_TIMER "Max. EBD hold time at high vehicle decel (default : 250)" VALUE 0x80020675 CalPrmWslcBrk_UBYTE 0 Gain 0 255 SYMBOL_LINK "CalPrmWslcBrk01.TP_U8_EBD_HOLD_TIMER" 0 /end CHARACTERISTIC
/begin CHARACTERISTIC TP_U8_EBD_STANDSTILL_HOLD_TIME "max ebd hold time @ lower limit speed, default 10,min 2 sec" VALUE 0x80020676 CalPrmWslcBrk_UBYTE 0 Ti71 0 25.5 SYMBOL_LINK "CalPrmWslcBrk01.TP_U8_EBD_STANDSTILL_HOLD_TIME" 0 /end CHARACTERISTIC
/begin CHARACTERISTIC TP_U8_GMA_D_F_H_SPEED "GMA DUMP TIME above S16_GMA_H_SPEED, Front Wheels" VALUE 0x80020292 CalPrmWslcBrk_UBYTE 0 Gain 0 255 SYMBOL_LINK "CalPrmWslcBrk01.TP_U8_GMA_D_F_H_SPEED" 0 /end CHARACTERISTIC
/begin CHARACTERISTIC TP_U8_GMA_D_F_L_SPEED "GMA DUMP TIME below S16_GMA_L_SPEED, Front Wheels" VALUE 0x80020293 CalPrmWslcBrk_UBYTE 0 Gain 0 255 SYMBOL_LINK "CalPrmWslcBrk01.TP_U8_GMA_D_F_L_SPEED" 0 /end CHARACTERISTIC
/begin CHARACTERISTIC TP_U8_GMA_D_F_M_SPEED "GMA DUMP TIME S16_GMA_H_SPEED to S16_GMA_L_SPEED, Front Wheels" VALUE 0x80020294 CalPrmWslcBrk_UBYTE 0 Gain 0 255 SYMBOL_LINK "CalPrmWslcBrk01.TP_U8_GMA_D_F_M_SPEED" 0 /end CHARACTERISTIC
/begin CHARACTERISTIC TP_U8_GMA_D_R_H_SPEED "GMA DUMP TIME above S16_GMA_H_SPEED, Rear Wheels" VALUE 0x80020295 CalPrmWslcBrk_UBYTE 0 Gain 0 255 SYMBOL_LINK "CalPrmWslcBrk01.TP_U8_GMA_D_R_H_SPEED" 0 /end CHARACTERISTIC
/begin CHARACTERISTIC TP_U8_GMA_D_R_L_SPEED "GMA DUMP TIME below S16_GMA_L_SPEED, Rear Wheels" VALUE 0x80020296 CalPrmWslcBrk_UBYTE 0 Gain 0 255 SYMBOL_LINK "CalPrmWslcBrk01.TP_U8_GMA_D_R_L_SPEED" 0 /end CHARACTERISTIC
/begin CHARACTERISTIC TP_U8_GMA_D_R_M_SPEED "GMA DUMP TIME S16_GMA_H_SPEED to S16_GMA_L_SPEED, Rear Wheels" VALUE 0x80020297 CalPrmWslcBrk_UBYTE 0 Gain 0 255 SYMBOL_LINK "CalPrmWslcBrk01.TP_U8_GMA_D_R_M_SPEED" 0 /end CHARACTERISTIC
/begin CHARACTERISTIC TP_U8_GMA_WL_DV_SET_COUNTER_REF "No. of GMA Pulse-ups needed to reach High-Mu skid pressure" VALUE 0x80020284 CalPrmWslcBrk_UBYTE 0 Gain 0 255 SYMBOL_LINK "CalPrmWslcBrk01.TP_U8_GMA_WL_DV_SET_COUNTER_REF" 0 /end CHARACTERISTIC
/begin CHARACTERISTIC TP_U8_H2SPLIT_SLIP_DIFF "Min. Front Wheel Slip Difference for Detecting High to Split Mu by Using Speed Difference (default 15%)" VALUE 0x800205A7 CalPrmWslcBrk_UBYTE 0 Perc6 0 255 SYMBOL_LINK "CalPrmWslcBrk01.TP_U8_H2SPLIT_SLIP_DIFF" 0 /end CHARACTERISTIC
/begin CHARACTERISTIC TP_U8_H2SPLIT_VDIFF_F1 "Front Speed Difference Level1 Value for Detecting H2Split by Using Front Vrad Diff. VDIFF_F1 & Rear Vrad Diff. VDIFF_R1" VALUE 0x800205A8 CalPrmWslcBrk_UBYTE 0 Gain 0 255 SYMBOL_LINK "CalPrmWslcBrk01.TP_U8_H2SPLIT_VDIFF_F1" 0 /end CHARACTERISTIC
/begin CHARACTERISTIC TP_U8_H2SPLIT_VDIFF_F2 "Front Speed Difference Level2 Value for Detecting H2Split by Using Front Vrad Diff. VDIFF_F2 & Rear Vrad Diff. VDIFF_R2" VALUE 0x800205A9 CalPrmWslcBrk_UBYTE 0 Gain 0 255 SYMBOL_LINK "CalPrmWslcBrk01.TP_U8_H2SPLIT_VDIFF_F2" 0 /end CHARACTERISTIC
/begin CHARACTERISTIC TP_U8_H2SPLIT_VDIFF_R1 "Rear Speed Difference Level1 Value for Detecting H2Split by Using Front Vrad Diff. VDIFF_F1 & Rear Vrad Diff. VDIFF_R1" VALUE 0x800205AA CalPrmWslcBrk_UBYTE 0 Gain 0 255 SYMBOL_LINK "CalPrmWslcBrk01.TP_U8_H2SPLIT_VDIFF_R1" 0 /end CHARACTERISTIC
/begin CHARACTERISTIC TP_U8_H2SPLIT_VDIFF_R2 "Rear Speed Difference Level2 Value for Detecting H2Split by Using Front Vrad Diff. VDIFF_F2 & Rear Vrad Diff. VDIFF_R2" VALUE 0x800205AB CalPrmWslcBrk_UBYTE 0 Gain 0 255 SYMBOL_LINK "CalPrmWslcBrk01.TP_U8_H2SPLIT_VDIFF_R2" 0 /end CHARACTERISTIC
/begin CHARACTERISTIC TP_U8_H2SP_DET_LOW_MU "Ref. AFZ to check Low-mu Detection for Resetting High-to-Split Control (default 0.25g )" VALUE 0x800205A6 CalPrmWslcBrk_UBYTE 0 A42 0 2.55 SYMBOL_LINK "CalPrmWslcBrk01.TP_U8_H2SP_DET_LOW_MU" 0 /end CHARACTERISTIC
/begin CHARACTERISTIC TP_U8_HIGH_MU "Differentiation Point of High Mu Region" VALUE 0x80020568 CalPrmWslcBrk_UBYTE 0 A42 0 2.55 SYMBOL_LINK "CalPrmWslcBrk01.TP_U8_HIGH_MU" 0 /end CHARACTERISTIC
/begin CHARACTERISTIC TP_U8_HOLD13 "HOLD_TIME 1st to 3rd hold phase at S16_GMA_M_SPEED" VALUE 0x8002029D CalPrmWslcBrk_UBYTE 0 Gain 0 255 SYMBOL_LINK "CalPrmWslcBrk01.TP_U8_HOLD13" 0 /end CHARACTERISTIC
/begin CHARACTERISTIC TP_U8_HOLD13_H_SPEED "HOLD_TIME 1st to 3rd hold phase at S16_GMA_H_SPEED" VALUE 0x80020298 CalPrmWslcBrk_UBYTE 0 Gain 0 255 SYMBOL_LINK "CalPrmWslcBrk01.TP_U8_HOLD13_H_SPEED" 0 /end CHARACTERISTIC
/begin CHARACTERISTIC TP_U8_HOLD45 "HOLD_TIME 4th to 5th hold phase at S16_GMA_M_SPEED" VALUE 0x8002029E CalPrmWslcBrk_UBYTE 0 Gain 0 255 SYMBOL_LINK "CalPrmWslcBrk01.TP_U8_HOLD45" 0 /end CHARACTERISTIC
/begin CHARACTERISTIC TP_U8_HOLD45_H_SPEED "HOLD_TIME 4th to 5th hold phase at S16_GMA_H_SPEED" VALUE 0x80020299 CalPrmWslcBrk_UBYTE 0 Gain 0 255 SYMBOL_LINK "CalPrmWslcBrk01.TP_U8_HOLD45_H_SPEED" 0 /end CHARACTERISTIC
/begin CHARACTERISTIC TP_U8_HOLD67 "HOLD_TIME 6th to 7th hold phase at S16_GMA_M_SPEED" VALUE 0x8002029F CalPrmWslcBrk_UBYTE 0 Gain 0 255 SYMBOL_LINK "CalPrmWslcBrk01.TP_U8_HOLD67" 0 /end CHARACTERISTIC
/begin CHARACTERISTIC TP_U8_HOLD67_H_SPEED "HOLD_TIME 6th to 7th hold phase at S16_GMA_H_SPEED" VALUE 0x8002029A CalPrmWslcBrk_UBYTE 0 Gain 0 255 SYMBOL_LINK "CalPrmWslcBrk01.TP_U8_HOLD67_H_SPEED" 0 /end CHARACTERISTIC
/begin CHARACTERISTIC TP_U8_HOLD8 "HOLD_TIME after 8th hold phase at S16_GMA_M_SPEED" VALUE 0x800202A0 CalPrmWslcBrk_UBYTE 0 Gain 0 255 SYMBOL_LINK "CalPrmWslcBrk01.TP_U8_HOLD8" 0 /end CHARACTERISTIC
/begin CHARACTERISTIC TP_U8_HOLD8_H_SPEED "HOLD_TIME after 8th hold phase at S16_GMA_H_SPEED" VALUE 0x8002029B CalPrmWslcBrk_UBYTE 0 Gain 0 255 SYMBOL_LINK "CalPrmWslcBrk01.TP_U8_HOLD8_H_SPEED" 0 /end CHARACTERISTIC
/begin CHARACTERISTIC TP_U8_HOLD_0 "HOLD_TIME at initial hold phase at S16_GMA_M_SPEED" VALUE 0x800202A1 CalPrmWslcBrk_UBYTE 0 Gain 0 255 SYMBOL_LINK "CalPrmWslcBrk01.TP_U8_HOLD_0" 0 /end CHARACTERISTIC
/begin CHARACTERISTIC TP_U8_HOLD_0_H_SPEED "HOLD_TIME at initial hold phase at S16_GMA_H_SPEED" VALUE 0x8002029C CalPrmWslcBrk_UBYTE 0 Gain 0 255 SYMBOL_LINK "CalPrmWslcBrk01.TP_U8_HOLD_0_H_SPEED" 0 /end CHARACTERISTIC
/begin CHARACTERISTIC TP_U8_High_Vel_dV_Pro_BF_AFZOK_R "dV ratio of 160kph or above, before AFZ_OK, Rear Wheels(min limit: TP_U8_dV_BF_AFZOK_160kph_R)" VALUE 0x80020232 CalPrmWslcBrk_UBYTE 0 Perc10 0 99.603 SYMBOL_LINK "CalPrmWslcBrk01.TP_U8_High_Vel_dV_Pro_BF_AFZOK_R" 0 /end CHARACTERISTIC
/begin CHARACTERISTIC TP_U8_INIT_DUTY_ACTIVE_BRK_MAX "Initial Duty during Active Brake, at press 100bar" VALUE 0x8002055E CalPrmWslcBrk_UBYTE 0 Gain 0 255 SYMBOL_LINK "CalPrmWslcBrk01.TP_U8_INIT_DUTY_ACTIVE_BRK_MAX" 0 /end CHARACTERISTIC
/begin CHARACTERISTIC TP_U8_INIT_DUTY_ACTIVE_BRK_MIN "Initial Duty during Active Brake, at press 20bar" VALUE 0x8002055F CalPrmWslcBrk_UBYTE 0 Gain 0 255 SYMBOL_LINK "CalPrmWslcBrk01.TP_U8_INIT_DUTY_ACTIVE_BRK_MIN" 0 /end CHARACTERISTIC
/begin CHARACTERISTIC TP_U8_Initial_Duty_Ratio_F "Initial Duty for Front Wheels" VALUE 0x800202B1 CalPrmWslcBrk_UBYTE 0 Gain 0 255 SYMBOL_LINK "CalPrmWslcBrk01.TP_U8_Initial_Duty_Ratio_F" 0 /end CHARACTERISTIC
/begin CHARACTERISTIC TP_U8_Initial_Duty_Ratio_R "Initial Duty for Rear Wheels" VALUE 0x800202B2 CalPrmWslcBrk_UBYTE 0 Gain 0 255 SYMBOL_LINK "CalPrmWslcBrk01.TP_U8_Initial_Duty_Ratio_R" 0 /end CHARACTERISTIC
/begin CHARACTERISTIC TP_U8_LFC_H2L_DUMP_H_V "Ref. Dump counter, High-to-Low Mu Jump detection" VALUE 0x8002058E CalPrmWslcBrk_UBYTE 0 Gain 0 255 SYMBOL_LINK "CalPrmWslcBrk01.TP_U8_LFC_H2L_DUMP_H_V" 0 /end CHARACTERISTIC
/begin CHARACTERISTIC TP_U8_LFC_HIGH_DUMP "Ref. Dump counter, High-mu" VALUE 0x8002058F CalPrmWslcBrk_UBYTE 0 Gain 0 255 SYMBOL_LINK "CalPrmWslcBrk01.TP_U8_LFC_HIGH_DUMP" 0 /end CHARACTERISTIC
/begin CHARACTERISTIC TP_U8_LFC_HIGH_UNSTABIL_TIME "Ref. Time of Wheel Unstable state, High-mu" VALUE 0x80020590 CalPrmWslcBrk_UBYTE 0 Gain 0 255 SYMBOL_LINK "CalPrmWslcBrk01.TP_U8_LFC_HIGH_UNSTABIL_TIME" 0 /end CHARACTERISTIC
/begin CHARACTERISTIC TP_U8_LFC_Initial_Duty_Comp_Low_F "Initial Duty for Low_Mu, Front Wheels" VALUE 0x800202B3 CalPrmWslcBrk_UBYTE 0 Gain 0 255 SYMBOL_LINK "CalPrmWslcBrk01.TP_U8_LFC_Initial_Duty_Comp_Low_F" 0 /end CHARACTERISTIC
/begin CHARACTERISTIC TP_U8_LFC_Initial_Duty_Comp_Low_R "Initial Duty for Low_Mu, Rear Wheels" VALUE 0x800202B4 CalPrmWslcBrk_UBYTE 0 Gain 0 255 SYMBOL_LINK "CalPrmWslcBrk01.TP_U8_LFC_Initial_Duty_Comp_Low_R" 0 /end CHARACTERISTIC
/begin CHARACTERISTIC TP_U8_LFC_MED_DUMP "Ref. Dump counter, Medium-mu" VALUE 0x80020591 CalPrmWslcBrk_UBYTE 0 Gain 0 255 SYMBOL_LINK "CalPrmWslcBrk01.TP_U8_LFC_MED_DUMP" 0 /end CHARACTERISTIC
/begin CHARACTERISTIC TP_U8_LFC_MED_UNSTABIL_TIME "Ref. Time of Wheel Unstable state, Medium-mu" VALUE 0x80020592 CalPrmWslcBrk_UBYTE 0 Gain 0 255 SYMBOL_LINK "CalPrmWslcBrk01.TP_U8_LFC_MED_UNSTABIL_TIME" 0 /end CHARACTERISTIC
/begin CHARACTERISTIC TP_U8_LOW_MU "Differentiation Point of Low MU Region" VALUE 0x80020569 CalPrmWslcBrk_UBYTE 0 A42 0 2.55 SYMBOL_LINK "CalPrmWslcBrk01.TP_U8_LOW_MU" 0 /end CHARACTERISTIC
/begin CHARACTERISTIC TP_U8_MIN_DP_RISE_FOR_BUMP_OR_WA "Min. Unstable Rise time, Bump or Wet asphalt" VALUE 0x800205DD CalPrmWslcBrk_UBYTE 0 Gain 0 255 SYMBOL_LINK "CalPrmWslcBrk01.TP_U8_MIN_DP_RISE_FOR_BUMP_OR_WA" 0 /end CHARACTERISTIC
/begin CHARACTERISTIC TP_U8_MIN_INIT_dP_RISE_AT_LOW_MP_F "Min. Unstable Rise time, Slight braking, Front wheels" VALUE 0x800205DE CalPrmWslcBrk_UBYTE 0 Gain 0 255 SYMBOL_LINK "CalPrmWslcBrk01.TP_U8_MIN_INIT_dP_RISE_AT_LOW_MP_F" 0 /end CHARACTERISTIC
/begin CHARACTERISTIC TP_U8_MIN_INIT_dP_RISE_AT_LOW_MP_R "Min. Unstable Rise time, Slight braking, Rear wheels" VALUE 0x800205DF CalPrmWslcBrk_UBYTE 0 Gain 0 255 SYMBOL_LINK "CalPrmWslcBrk01.TP_U8_MIN_INIT_dP_RISE_AT_LOW_MP_R" 0 /end CHARACTERISTIC
/begin CHARACTERISTIC TP_U8_Max_hold_scan_ref "Maximum Allowable Hold Scans" VALUE 0x800205D4 CalPrmWslcBrk_UBYTE 0 Gain 0 255 SYMBOL_LINK "CalPrmWslcBrk01.TP_U8_Max_hold_scan_ref" 0 /end CHARACTERISTIC
/begin CHARACTERISTIC TP_U8_PULSE_HIGH_MU "Differentiation Point of High Mu Region" VALUE 0x80020216 CalPrmWslcBrk_UBYTE 0 A42 0 2.55 SYMBOL_LINK "CalPrmWslcBrk01.TP_U8_PULSE_HIGH_MU" 0 /end CHARACTERISTIC
/begin CHARACTERISTIC TP_U8_PULSE_LOW_MED_MU "Differentiation Point of Low-med MU Region" VALUE 0x80020217 CalPrmWslcBrk_UBYTE 0 A42 0 2.55 SYMBOL_LINK "CalPrmWslcBrk01.TP_U8_PULSE_LOW_MED_MU" 0 /end CHARACTERISTIC
/begin CHARACTERISTIC TP_U8_PULSE_LOW_MU "Differentiation Point of Low MU Region" VALUE 0x80020218 CalPrmWslcBrk_UBYTE 0 A42 0 2.55 SYMBOL_LINK "CalPrmWslcBrk01.TP_U8_PULSE_LOW_MU" 0 /end CHARACTERISTIC
/begin CHARACTERISTIC TP_U8_PULSE_MEDIUM_MU "Differentiation Point of Med MU Region" VALUE 0x80020219 CalPrmWslcBrk_UBYTE 0 A42 0 2.55 SYMBOL_LINK "CalPrmWslcBrk01.TP_U8_PULSE_MEDIUM_MU" 0 /end CHARACTERISTIC
/begin CHARACTERISTIC TP_U8_PULSE_MED_HIGH_MU "Differentiation Point of Med-high MU Region" VALUE 0x8002021A CalPrmWslcBrk_UBYTE 0 A42 0 2.55 SYMBOL_LINK "CalPrmWslcBrk01.TP_U8_PULSE_MED_HIGH_MU" 0 /end CHARACTERISTIC
/begin CHARACTERISTIC TP_U8_PULSE_UNDER_LOW_MED_MU "Differentiation Point of Low-med MU Region" VALUE 0x8002021B CalPrmWslcBrk_UBYTE 0 A42 0 2.55 SYMBOL_LINK "CalPrmWslcBrk01.TP_U8_PULSE_UNDER_LOW_MED_MU" 0 /end CHARACTERISTIC
/begin CHARACTERISTIC TP_U8_ROUGH_SPEED_LEVEL1 "Max. Speed for Using Tunned dV Threshold Value ( default 50km/h )" VALUE 0x800204CA CalPrmWslcBrk_UBYTE 0 Gain 0 255 SYMBOL_LINK "CalPrmWslcBrk01.TP_U8_ROUGH_SPEED_LEVEL1" 0 /end CHARACTERISTIC
/begin CHARACTERISTIC TP_U8_ROUGH_SPEED_LEVEL2 "Min. Speed for Using GAIN LEVEL2 X Tunned dV Threshold Value ( default 80km/h )" VALUE 0x800204CB CalPrmWslcBrk_UBYTE 0 Gain 0 255 SYMBOL_LINK "CalPrmWslcBrk01.TP_U8_ROUGH_SPEED_LEVEL2" 0 /end CHARACTERISTIC
/begin CHARACTERISTIC TP_U8_ROUGH_THRES_GAIN_LEVEL2 "Front Interpolation Gain Used at Upper Range of Speed Level2 (default gain 4 )" VALUE 0x800204CC CalPrmWslcBrk_UBYTE 0 Gain 0 255 SYMBOL_LINK "CalPrmWslcBrk01.TP_U8_ROUGH_THRES_GAIN_LEVEL2" 0 /end CHARACTERISTIC
/begin CHARACTERISTIC TP_U8_ROUGH_THRES_GAIN_LEVEL2_R "Rear Interpolation Gain Used at Upper Range of Speed Level2 (default gain 4 )" VALUE 0x800204CD CalPrmWslcBrk_UBYTE 0 Gain 0 255 SYMBOL_LINK "CalPrmWslcBrk01.TP_U8_ROUGH_THRES_GAIN_LEVEL2_R" 0 /end CHARACTERISTIC
/begin CHARACTERISTIC TP_U8_SP_LOW_FRT_DUMPTIM_AFZ "Ref. Road surface for determination Split Low-side front wheel dump scantime, default 0.3g, min 0.15g" VALUE 0x800205EA CalPrmWslcBrk_UBYTE 0 A42 0 2.55 SYMBOL_LINK "CalPrmWslcBrk01.TP_U8_SP_LOW_FRT_DUMPTIM_AFZ" 0 /end CHARACTERISTIC
/begin CHARACTERISTIC TP_U8_SP_LOW_RER_DUMPTIM_AFZ "Ref. Road surface for determination Split Low-side rear wheel dump scantime, default 0.3g, min 0.15g" VALUE 0x800205EB CalPrmWslcBrk_UBYTE 0 A42 0 2.55 SYMBOL_LINK "CalPrmWslcBrk01.TP_U8_SP_LOW_RER_DUMPTIM_AFZ" 0 /end CHARACTERISTIC
/begin CHARACTERISTIC TP_U8_STB_DMP_MAX_HIGH_BothOverInR "Stable Dump limitation level for Front Wheel if Both Front and Rear Wheels are in Over Ctrl, high-mu (default : 4)" VALUE 0x8002052A CalPrmWslcBrk_UBYTE 0 Gain 0 255 SYMBOL_LINK "CalPrmWslcBrk01.TP_U8_STB_DMP_MAX_HIGH_BothOverInR" 0 /end CHARACTERISTIC
/begin CHARACTERISTIC TP_U8_STB_DMP_MAX_HIGH_OverInF "Stable Dump limitation level for Over Inside Front Wheel, High-mu (default : 2)" VALUE 0x8002051E CalPrmWslcBrk_UBYTE 0 Gain 0 255 SYMBOL_LINK "CalPrmWslcBrk01.TP_U8_STB_DMP_MAX_HIGH_OverInF" 0 /end CHARACTERISTIC
/begin CHARACTERISTIC TP_U8_STB_DMP_MAX_LOW_BothOverInR "Stable Dump limitation level for Front Wheel if Both Front and Rear Wheels are in Over Ctrl, low-mu (default : 6)" VALUE 0x8002052B CalPrmWslcBrk_UBYTE 0 Gain 0 255 SYMBOL_LINK "CalPrmWslcBrk01.TP_U8_STB_DMP_MAX_LOW_BothOverInR" 0 /end CHARACTERISTIC
/begin CHARACTERISTIC TP_U8_STB_DMP_MAX_LOW_OverInF "Stable Dump limitation level for Over Inside Front Wheel, low-mu (default : 6)" VALUE 0x8002051F CalPrmWslcBrk_UBYTE 0 Gain 0 255 SYMBOL_LINK "CalPrmWslcBrk01.TP_U8_STB_DMP_MAX_LOW_OverInF" 0 /end CHARACTERISTIC
/begin CHARACTERISTIC TP_U8_STB_DMP_MAX_MED_BothOverInR "Stable Dump limitation level for Front Wheel if Both Front and Rear Wheels are in Over Ctrl, med-mu (default : 4)" VALUE 0x8002052C CalPrmWslcBrk_UBYTE 0 Gain 0 255 SYMBOL_LINK "CalPrmWslcBrk01.TP_U8_STB_DMP_MAX_MED_BothOverInR" 0 /end CHARACTERISTIC
/begin CHARACTERISTIC TP_U8_STB_DMP_MAX_MED_OverInF "Stable Dump limitation level for Over Inside Front Wheel, med-mu (default : 4)" VALUE 0x80020520 CalPrmWslcBrk_UBYTE 0 Gain 0 255 SYMBOL_LINK "CalPrmWslcBrk01.TP_U8_STB_DMP_MAX_MED_OverInF" 0 /end CHARACTERISTIC
/begin CHARACTERISTIC TP_U8_STB_DMP_MAX_SP_BothOverInR "Stable Dump limitation level for Front Wheel if Both Front and Rear Wheels are in Over Ctrl, split-mu (default : 4)" VALUE 0x8002052D CalPrmWslcBrk_UBYTE 0 Gain 0 255 SYMBOL_LINK "CalPrmWslcBrk01.TP_U8_STB_DMP_MAX_SP_BothOverInR" 0 /end CHARACTERISTIC
/begin CHARACTERISTIC TP_U8_STB_DMP_MAX_SP_OverInF "Stable Dump limitation level for Over Inside Front Wheel, Split-mu (default : 4)" VALUE 0x80020521 CalPrmWslcBrk_UBYTE 0 Gain 0 255 SYMBOL_LINK "CalPrmWslcBrk01.TP_U8_STB_DMP_MAX_SP_OverInF" 0 /end CHARACTERISTIC
/begin CHARACTERISTIC TP_U8_TCS_VIB_AMPLITUDE_ENTER "" VALUE 0x8003A25C CalPrmWspcEng_UBYTE 0 Spd12 0 31.875 SYMBOL_LINK "CalPrmWspcEng01.TP_U8_TCS_VIB_AMPLITUDE_ENTER" 0 /end CHARACTERISTIC
/begin CHARACTERISTIC TP_U8_TCS_VIB_AMPLITUDE_OUT "" VALUE 0x8003A25D CalPrmWspcEng_UBYTE 0 Spd12 0 31.875 SYMBOL_LINK "CalPrmWspcEng01.TP_U8_TCS_VIB_AMPLITUDE_OUT" 0 /end CHARACTERISTIC
/begin CHARACTERISTIC TP_U8_TCS_VIB_BRK_CTL_PERIOD "" VALUE 0x8003A25E CalPrmWspcEng_UBYTE 0 Ti21 0 2.55 SYMBOL_LINK "CalPrmWspcEng01.TP_U8_TCS_VIB_BRK_CTL_PERIOD" 0 /end CHARACTERISTIC
/begin CHARACTERISTIC TP_U8_TCS_VIB_CNT_SCAN "" VALUE 0x8003A25F CalPrmWspcEng_UBYTE 0 Ti21 0 2.55 SYMBOL_LINK "CalPrmWspcEng01.TP_U8_TCS_VIB_CNT_SCAN" 0 /end CHARACTERISTIC
/begin CHARACTERISTIC TP_U8_TCS_VIB_FLAG_ENTER_CYCLE "" VALUE 0x8003A260 CalPrmWspcEng_UBYTE 0 Ti21 0 2.55 SYMBOL_LINK "CalPrmWspcEng01.TP_U8_TCS_VIB_FLAG_ENTER_CYCLE" 0 /end CHARACTERISTIC
/begin CHARACTERISTIC TP_U8_TCS_VIB_FLAG_OUT_CYCLE "" VALUE 0x8003A261 CalPrmWspcEng_UBYTE 0 Ti21 0 2.55 SYMBOL_LINK "CalPrmWspcEng01.TP_U8_TCS_VIB_FLAG_OUT_CYCLE" 0 /end CHARACTERISTIC
/begin CHARACTERISTIC TP_U8_TCS_VIB_FREQUENCY_ENTER "" VALUE 0x8003A262 CalPrmWspcEng_UBYTE 0 Gain 0 255 SYMBOL_LINK "CalPrmWspcEng01.TP_U8_TCS_VIB_FREQUENCY_ENTER" 0 /end CHARACTERISTIC
/begin CHARACTERISTIC TP_U8_TCS_VIB_FREQUENCY_OUT "" VALUE 0x8003A263 CalPrmWspcEng_UBYTE 0 Gain 0 255 SYMBOL_LINK "CalPrmWspcEng01.TP_U8_TCS_VIB_FREQUENCY_OUT" 0 /end CHARACTERISTIC
/begin CHARACTERISTIC TP_U8_TCS_VIB_FREQUENCY_THR "" VALUE 0x8003A264 CalPrmWspcEng_UBYTE 0 Gain 0 255 SYMBOL_LINK "CalPrmWspcEng01.TP_U8_TCS_VIB_FREQUENCY_THR" 0 /end CHARACTERISTIC
/begin CHARACTERISTIC TP_U8_TCS_VIB_OVERFLOW_SCAN "" VALUE 0x8003A265 CalPrmWspcEng_UBYTE 0 Ti21 0 2.55 SYMBOL_LINK "CalPrmWspcEng01.TP_U8_TCS_VIB_OVERFLOW_SCAN" 0 /end CHARACTERISTIC
/begin CHARACTERISTIC TP_U8_TCS_VIB_REFERENCE_VREF_ENTER "" VALUE 0x8003A266 CalPrmWspcEng_UBYTE 0 Spd12 0 31.875 SYMBOL_LINK "CalPrmWspcEng01.TP_U8_TCS_VIB_REFERENCE_VREF_ENTER" 0 /end CHARACTERISTIC
/begin CHARACTERISTIC TP_U8_TCS_VIB_REFERENCE_VREF_OUT "" VALUE 0x8003A267 CalPrmWspcEng_UBYTE 0 Spd12 0 31.875 SYMBOL_LINK "CalPrmWspcEng01.TP_U8_TCS_VIB_REFERENCE_VREF_OUT" 0 /end CHARACTERISTIC
/begin CHARACTERISTIC TP_U8_TCS_VIB_TIMESHIFT_SCAN_TCMF "" VALUE 0x8003A268 CalPrmWspcEng_UBYTE 0 Ti21 0 2.55 SYMBOL_LINK "CalPrmWspcEng01.TP_U8_TCS_VIB_TIMESHIFT_SCAN_TCMF" 0 /end CHARACTERISTIC
/begin CHARACTERISTIC TP_U8_YDF_DUMPHOLD_T_AT_DEC_L1 "Dump hold scans at Pressure Decrease level 1 (default : 70)" VALUE 0x8002050C CalPrmWslcBrk_UBYTE 0 Gain 0 255 SYMBOL_LINK "CalPrmWslcBrk01.TP_U8_YDF_DUMPHOLD_T_AT_DEC_L1" 0 /end CHARACTERISTIC
/begin CHARACTERISTIC TP_U8_YDF_DUMPHOLD_T_AT_DEC_L2 "Dump hold scans at Pressure Decrease level 2 (default : 14)" VALUE 0x8002050D CalPrmWslcBrk_UBYTE 0 Gain 0 255 SYMBOL_LINK "CalPrmWslcBrk01.TP_U8_YDF_DUMPHOLD_T_AT_DEC_L2" 0 /end CHARACTERISTIC
/begin CHARACTERISTIC TP_U8_YDF_DUMPHOLD_T_AT_DEC_L3 "Dump hold scans at Pressure Decrease level 3 (default : 4)" VALUE 0x8002050E CalPrmWslcBrk_UBYTE 0 Gain 0 255 SYMBOL_LINK "CalPrmWslcBrk01.TP_U8_YDF_DUMPHOLD_T_AT_DEC_L3" 0 /end CHARACTERISTIC
/begin CHARACTERISTIC TP_U8_YDF_DUMPHOLD_T_MAX "Maximum Dump hold scans at Pressure Decrease level 0 (default : 70)" VALUE 0x8002050F CalPrmWslcBrk_UBYTE 0 Gain 0 255 SYMBOL_LINK "CalPrmWslcBrk01.TP_U8_YDF_DUMPHOLD_T_MAX" 0 /end CHARACTERISTIC
/begin CHARACTERISTIC TP_U8_dV_BF_AFZOK_100kph_R "dV, below 100kph to 80kph, before AFZ_OK, Rear Wheels" VALUE 0x8002022E CalPrmWslcBrk_UBYTE 0 Spd12 0 31.875 SYMBOL_LINK "CalPrmWslcBrk01.TP_U8_dV_BF_AFZOK_100kph_R" 0 /end CHARACTERISTIC
/begin CHARACTERISTIC TP_U8_dV_BF_AFZOK_10kph_R "dV, below 10kph, before AFZ_OK, Rear Wheels" VALUE 0x80020229 CalPrmWslcBrk_UBYTE 0 Spd12 0 31.875 SYMBOL_LINK "CalPrmWslcBrk01.TP_U8_dV_BF_AFZOK_10kph_R" 0 /end CHARACTERISTIC
/begin CHARACTERISTIC TP_U8_dV_BF_AFZOK_120kph_R "dV, below 120kph to 100kph, before AFZ_OK, Rear Wheels" VALUE 0x8002022F CalPrmWslcBrk_UBYTE 0 Spd12 0 31.875 SYMBOL_LINK "CalPrmWslcBrk01.TP_U8_dV_BF_AFZOK_120kph_R" 0 /end CHARACTERISTIC
/begin CHARACTERISTIC TP_U8_dV_BF_AFZOK_140kph_R "dV, below 140kph to 120kph, before AFZ_OK, Rear Wheels" VALUE 0x80020230 CalPrmWslcBrk_UBYTE 0 Spd12 0 31.875 SYMBOL_LINK "CalPrmWslcBrk01.TP_U8_dV_BF_AFZOK_140kph_R" 0 /end CHARACTERISTIC
/begin CHARACTERISTIC TP_U8_dV_BF_AFZOK_160kph_R "dV, below 160kph to 140kph, before AFZ_OK, Rear Wheels" VALUE 0x80020231 CalPrmWslcBrk_UBYTE 0 Spd12 0 31.875 SYMBOL_LINK "CalPrmWslcBrk01.TP_U8_dV_BF_AFZOK_160kph_R" 0 /end CHARACTERISTIC
/begin CHARACTERISTIC TP_U8_dV_BF_AFZOK_20kph_R "dV, below 20kph to 10kph, before AFZ_OK, Rear Wheels" VALUE 0x8002022A CalPrmWslcBrk_UBYTE 0 Spd12 0 31.875 SYMBOL_LINK "CalPrmWslcBrk01.TP_U8_dV_BF_AFZOK_20kph_R" 0 /end CHARACTERISTIC
/begin CHARACTERISTIC TP_U8_dV_BF_AFZOK_40kph_R "dV, below 40kph to 20kph, before AFZ_OK, Rear Wheels" VALUE 0x8002022B CalPrmWslcBrk_UBYTE 0 Spd12 0 31.875 SYMBOL_LINK "CalPrmWslcBrk01.TP_U8_dV_BF_AFZOK_40kph_R" 0 /end CHARACTERISTIC
/begin CHARACTERISTIC TP_U8_dV_BF_AFZOK_60kph_R "dV, below 60kph to 40kph, before AFZ_OK, Rear Wheels" VALUE 0x8002022C CalPrmWslcBrk_UBYTE 0 Spd12 0 31.875 SYMBOL_LINK "CalPrmWslcBrk01.TP_U8_dV_BF_AFZOK_60kph_R" 0 /end CHARACTERISTIC
/begin CHARACTERISTIC TP_U8_dV_BF_AFZOK_80kph_R "dV, below 80kph to 60kph, before AFZ_OK, Rear Wheels" VALUE 0x8002022D CalPrmWslcBrk_UBYTE 0 Spd12 0 31.875 SYMBOL_LINK "CalPrmWslcBrk01.TP_U8_dV_BF_AFZOK_80kph_R" 0 /end CHARACTERISTIC
/begin CHARACTERISTIC TP_U8_dV_HMu_100kph_F "dV, below 100kph to 80kph, High mu, Front Wheels" VALUE 0x80020238 CalPrmWslcBrk_UBYTE 0 Spd12 0 31.875 SYMBOL_LINK "CalPrmWslcBrk01.TP_U8_dV_HMu_100kph_F" 0 /end CHARACTERISTIC
/begin CHARACTERISTIC TP_U8_dV_HMu_100kph_R "dV, below 100kph to 80kph, High mu, Rear Wheels" VALUE 0x80020242 CalPrmWslcBrk_UBYTE 0 Spd12 0 31.875 SYMBOL_LINK "CalPrmWslcBrk01.TP_U8_dV_HMu_100kph_R" 0 /end CHARACTERISTIC
/begin CHARACTERISTIC TP_U8_dV_HMu_10kph_F "dV, below 10kph, High mu, Front Wheels" VALUE 0x80020233 CalPrmWslcBrk_UBYTE 0 Spd12 0 31.875 SYMBOL_LINK "CalPrmWslcBrk01.TP_U8_dV_HMu_10kph_F" 0 /end CHARACTERISTIC
/begin CHARACTERISTIC TP_U8_dV_HMu_10kph_R "dV, below 10kph, High mu, Rear Wheels" VALUE 0x8002023D CalPrmWslcBrk_UBYTE 0 Spd12 0 31.875 SYMBOL_LINK "CalPrmWslcBrk01.TP_U8_dV_HMu_10kph_R" 0 /end CHARACTERISTIC
/begin CHARACTERISTIC TP_U8_dV_HMu_120kph_F "dV, below 120kph to 100kph, High mu, Front Wheels" VALUE 0x80020239 CalPrmWslcBrk_UBYTE 0 Spd12 0 31.875 SYMBOL_LINK "CalPrmWslcBrk01.TP_U8_dV_HMu_120kph_F" 0 /end CHARACTERISTIC
/begin CHARACTERISTIC TP_U8_dV_HMu_120kph_R "dV, below 120kph to 100kph, High mu, Rear Wheels" VALUE 0x80020243 CalPrmWslcBrk_UBYTE 0 Spd12 0 31.875 SYMBOL_LINK "CalPrmWslcBrk01.TP_U8_dV_HMu_120kph_R" 0 /end CHARACTERISTIC
/begin CHARACTERISTIC TP_U8_dV_HMu_140kph_F "dV, below 140kph to 120kph, High mu, Front Wheels" VALUE 0x8002023A CalPrmWslcBrk_UBYTE 0 Spd12 0 31.875 SYMBOL_LINK "CalPrmWslcBrk01.TP_U8_dV_HMu_140kph_F" 0 /end CHARACTERISTIC
/begin CHARACTERISTIC TP_U8_dV_HMu_140kph_R "dV, below 140kph to 120kph, High mu, Rear Wheels" VALUE 0x80020244 CalPrmWslcBrk_UBYTE 0 Spd12 0 31.875 SYMBOL_LINK "CalPrmWslcBrk01.TP_U8_dV_HMu_140kph_R" 0 /end CHARACTERISTIC
/begin CHARACTERISTIC TP_U8_dV_HMu_160kph_F "dV, below 160kph to 140kph, High mu, Front Wheels" VALUE 0x8002023B CalPrmWslcBrk_UBYTE 0 Spd12 0 31.875 SYMBOL_LINK "CalPrmWslcBrk01.TP_U8_dV_HMu_160kph_F" 0 /end CHARACTERISTIC
/begin CHARACTERISTIC TP_U8_dV_HMu_160kph_R "dV, below 160kph to 140kph, High mu, Rear Wheels" VALUE 0x80020245 CalPrmWslcBrk_UBYTE 0 Spd12 0 31.875 SYMBOL_LINK "CalPrmWslcBrk01.TP_U8_dV_HMu_160kph_R" 0 /end CHARACTERISTIC
/begin CHARACTERISTIC TP_U8_dV_HMu_20kph_F "dV, below 20kph to 10kph, High mu, Front Wheels" VALUE 0x80020234 CalPrmWslcBrk_UBYTE 0 Spd12 0 31.875 SYMBOL_LINK "CalPrmWslcBrk01.TP_U8_dV_HMu_20kph_F" 0 /end CHARACTERISTIC
/begin CHARACTERISTIC TP_U8_dV_HMu_20kph_R "dV, below 20kph to 10kph, High mu, Rear Wheels" VALUE 0x8002023E CalPrmWslcBrk_UBYTE 0 Spd12 0 31.875 SYMBOL_LINK "CalPrmWslcBrk01.TP_U8_dV_HMu_20kph_R" 0 /end CHARACTERISTIC
/begin CHARACTERISTIC TP_U8_dV_HMu_40kph_F "dV, below 40kph to 20kph, High mu, Front Wheels" VALUE 0x80020235 CalPrmWslcBrk_UBYTE 0 Spd12 0 31.875 SYMBOL_LINK "CalPrmWslcBrk01.TP_U8_dV_HMu_40kph_F" 0 /end CHARACTERISTIC
/begin CHARACTERISTIC TP_U8_dV_HMu_40kph_R "dV, below 40kph to 20kph, High mu, Rear Wheels" VALUE 0x8002023F CalPrmWslcBrk_UBYTE 0 Spd12 0 31.875 SYMBOL_LINK "CalPrmWslcBrk01.TP_U8_dV_HMu_40kph_R" 0 /end CHARACTERISTIC
/begin CHARACTERISTIC TP_U8_dV_HMu_60kph_F "dV, below 60kph to 40kph, High mu, Front Wheels" VALUE 0x80020236 CalPrmWslcBrk_UBYTE 0 Spd12 0 31.875 SYMBOL_LINK "CalPrmWslcBrk01.TP_U8_dV_HMu_60kph_F" 0 /end CHARACTERISTIC
/begin CHARACTERISTIC TP_U8_dV_HMu_60kph_R "dV, below 60kph to 40kph, High mu, Rear Wheels" VALUE 0x80020240 CalPrmWslcBrk_UBYTE 0 Spd12 0 31.875 SYMBOL_LINK "CalPrmWslcBrk01.TP_U8_dV_HMu_60kph_R" 0 /end CHARACTERISTIC
/begin CHARACTERISTIC TP_U8_dV_HMu_80kph_F "dV, below 80kph to 60kph, High mu, Front Wheels" VALUE 0x80020237 CalPrmWslcBrk_UBYTE 0 Spd12 0 31.875 SYMBOL_LINK "CalPrmWslcBrk01.TP_U8_dV_HMu_80kph_F" 0 /end CHARACTERISTIC
/begin CHARACTERISTIC TP_U8_dV_HMu_80kph_R "dV, below 80kph to 60kph, High mu, Rear Wheels" VALUE 0x80020241 CalPrmWslcBrk_UBYTE 0 Spd12 0 31.875 SYMBOL_LINK "CalPrmWslcBrk01.TP_U8_dV_HMu_80kph_R" 0 /end CHARACTERISTIC
/begin CHARACTERISTIC TP_U8_dV_Higher_Limit_F "Higher Limit of d_V in Front Wheels" VALUE 0x8002021D CalPrmWslcBrk_UBYTE 0 Spd12 0 31.875 SYMBOL_LINK "CalPrmWslcBrk01.TP_U8_dV_Higher_Limit_F" 0 /end CHARACTERISTIC
/begin CHARACTERISTIC TP_U8_dV_Higher_Limit_R "Higher Limit of d_V in Rear Wheels" VALUE 0x8002021E CalPrmWslcBrk_UBYTE 0 Spd12 0 31.875 SYMBOL_LINK "CalPrmWslcBrk01.TP_U8_dV_Higher_Limit_R" 0 /end CHARACTERISTIC
/begin CHARACTERISTIC TP_U8_dV_LMMu_100kph_F "dV, below 100kph to 80kph, Lowmed mu, Front Wheels" VALUE 0x80020260 CalPrmWslcBrk_UBYTE 0 Spd12 0 31.875 SYMBOL_LINK "CalPrmWslcBrk01.TP_U8_dV_LMMu_100kph_F" 0 /end CHARACTERISTIC
/begin CHARACTERISTIC TP_U8_dV_LMMu_100kph_R "dV, below 100kph to 80kph, Lowmed mu, Rear Wheels" VALUE 0x8002026A CalPrmWslcBrk_UBYTE 0 Spd12 0 31.875 SYMBOL_LINK "CalPrmWslcBrk01.TP_U8_dV_LMMu_100kph_R" 0 /end CHARACTERISTIC
/begin CHARACTERISTIC TP_U8_dV_LMMu_10kph_F "dV, below 10kph, Lowmed mu, Front Wheels" VALUE 0x8002025B CalPrmWslcBrk_UBYTE 0 Spd12 0 31.875 SYMBOL_LINK "CalPrmWslcBrk01.TP_U8_dV_LMMu_10kph_F" 0 /end CHARACTERISTIC
/begin CHARACTERISTIC TP_U8_dV_LMMu_10kph_R "dV, below 10kph, Lowmed mu, Rear Wheels" VALUE 0x80020265 CalPrmWslcBrk_UBYTE 0 Spd12 0 31.875 SYMBOL_LINK "CalPrmWslcBrk01.TP_U8_dV_LMMu_10kph_R" 0 /end CHARACTERISTIC
/begin CHARACTERISTIC TP_U8_dV_LMMu_120kph_F "dV, below 120kph to 100kph, Lowmed mu, Front Wheels" VALUE 0x80020261 CalPrmWslcBrk_UBYTE 0 Spd12 0 31.875 SYMBOL_LINK "CalPrmWslcBrk01.TP_U8_dV_LMMu_120kph_F" 0 /end CHARACTERISTIC
/begin CHARACTERISTIC TP_U8_dV_LMMu_120kph_R "dV, below 120kph to 100kph, Lowmed mu, Rear Wheels" VALUE 0x8002026B CalPrmWslcBrk_UBYTE 0 Spd12 0 31.875 SYMBOL_LINK "CalPrmWslcBrk01.TP_U8_dV_LMMu_120kph_R" 0 /end CHARACTERISTIC
/begin CHARACTERISTIC TP_U8_dV_LMMu_140kph_F "dV, below 140kph to 120kph, Lowmed mu, Front Wheels" VALUE 0x80020262 CalPrmWslcBrk_UBYTE 0 Spd12 0 31.875 SYMBOL_LINK "CalPrmWslcBrk01.TP_U8_dV_LMMu_140kph_F" 0 /end CHARACTERISTIC
/begin CHARACTERISTIC TP_U8_dV_LMMu_140kph_R "dV, below 140kph to 120kph, Lowmed mu, Rear Wheels" VALUE 0x8002026C CalPrmWslcBrk_UBYTE 0 Spd12 0 31.875 SYMBOL_LINK "CalPrmWslcBrk01.TP_U8_dV_LMMu_140kph_R" 0 /end CHARACTERISTIC
/begin CHARACTERISTIC TP_U8_dV_LMMu_160kph_F "dV, below 160kph to 140kph, Lowmed mu, Front Wheels" VALUE 0x80020263 CalPrmWslcBrk_UBYTE 0 Spd12 0 31.875 SYMBOL_LINK "CalPrmWslcBrk01.TP_U8_dV_LMMu_160kph_F" 0 /end CHARACTERISTIC
/begin CHARACTERISTIC TP_U8_dV_LMMu_160kph_R "dV, below 160kph to 140kph, Lowmed mu, Rear Wheels" VALUE 0x8002026D CalPrmWslcBrk_UBYTE 0 Spd12 0 31.875 SYMBOL_LINK "CalPrmWslcBrk01.TP_U8_dV_LMMu_160kph_R" 0 /end CHARACTERISTIC
/begin CHARACTERISTIC TP_U8_dV_LMMu_20kph_F "dV, below 20kph to 10kph, Lowmed mu, Front Wheels" VALUE 0x8002025C CalPrmWslcBrk_UBYTE 0 Spd12 0 31.875 SYMBOL_LINK "CalPrmWslcBrk01.TP_U8_dV_LMMu_20kph_F" 0 /end CHARACTERISTIC
/begin CHARACTERISTIC TP_U8_dV_LMMu_20kph_R "dV, below 20kph to 10kph, Lowmed mu, Rear Wheels" VALUE 0x80020266 CalPrmWslcBrk_UBYTE 0 Spd12 0 31.875 SYMBOL_LINK "CalPrmWslcBrk01.TP_U8_dV_LMMu_20kph_R" 0 /end CHARACTERISTIC
/begin CHARACTERISTIC TP_U8_dV_LMMu_40kph_F "dV, below 40kph to 20kph, Lowmed mu, Front Wheels" VALUE 0x8002025D CalPrmWslcBrk_UBYTE 0 Spd12 0 31.875 SYMBOL_LINK "CalPrmWslcBrk01.TP_U8_dV_LMMu_40kph_F" 0 /end CHARACTERISTIC
/begin CHARACTERISTIC TP_U8_dV_LMMu_40kph_R "dV, below 40kph to 20kph, Lowmed mu, Rear Wheels" VALUE 0x80020267 CalPrmWslcBrk_UBYTE 0 Spd12 0 31.875 SYMBOL_LINK "CalPrmWslcBrk01.TP_U8_dV_LMMu_40kph_R" 0 /end CHARACTERISTIC
/begin CHARACTERISTIC TP_U8_dV_LMMu_60kph_F "dV, below 60kph to 40kph, Lowmed mu, Front Wheels" VALUE 0x8002025E CalPrmWslcBrk_UBYTE 0 Spd12 0 31.875 SYMBOL_LINK "CalPrmWslcBrk01.TP_U8_dV_LMMu_60kph_F" 0 /end CHARACTERISTIC
/begin CHARACTERISTIC TP_U8_dV_LMMu_60kph_R "dV, below 60kph to 40kph, Lowmed mu, Rear Wheels" VALUE 0x80020268 CalPrmWslcBrk_UBYTE 0 Spd12 0 31.875 SYMBOL_LINK "CalPrmWslcBrk01.TP_U8_dV_LMMu_60kph_R" 0 /end CHARACTERISTIC
/begin CHARACTERISTIC TP_U8_dV_LMMu_80kph_F "dV, below 80kph to 60kph, Lowmed mu, Front Wheels" VALUE 0x8002025F CalPrmWslcBrk_UBYTE 0 Spd12 0 31.875 SYMBOL_LINK "CalPrmWslcBrk01.TP_U8_dV_LMMu_80kph_F" 0 /end CHARACTERISTIC
/begin CHARACTERISTIC TP_U8_dV_LMMu_80kph_R "dV, below 80kph to 60kph, Lowmed mu, Rear Wheels" VALUE 0x80020269 CalPrmWslcBrk_UBYTE 0 Spd12 0 31.875 SYMBOL_LINK "CalPrmWslcBrk01.TP_U8_dV_LMMu_80kph_R" 0 /end CHARACTERISTIC
/begin CHARACTERISTIC TP_U8_dV_LMu_100kph_F "dV, below 100kph to 80kph, Low mu, Front Wheels" VALUE 0x80020274 CalPrmWslcBrk_UBYTE 0 Spd12 0 31.875 SYMBOL_LINK "CalPrmWslcBrk01.TP_U8_dV_LMu_100kph_F" 0 /end CHARACTERISTIC
/begin CHARACTERISTIC TP_U8_dV_LMu_100kph_R "dV, below 100kph to 80kph, Low mu, Rear Wheels" VALUE 0x8002027E CalPrmWslcBrk_UBYTE 0 Spd12 0 31.875 SYMBOL_LINK "CalPrmWslcBrk01.TP_U8_dV_LMu_100kph_R" 0 /end CHARACTERISTIC
/begin CHARACTERISTIC TP_U8_dV_LMu_10kph_F "dV, below 10kph, Low mu, Front Wheels" VALUE 0x8002026F CalPrmWslcBrk_UBYTE 0 Spd12 0 31.875 SYMBOL_LINK "CalPrmWslcBrk01.TP_U8_dV_LMu_10kph_F" 0 /end CHARACTERISTIC
/begin CHARACTERISTIC TP_U8_dV_LMu_10kph_R "dV, below 10kph, Low mu, Rear Wheels" VALUE 0x80020279 CalPrmWslcBrk_UBYTE 0 Spd12 0 31.875 SYMBOL_LINK "CalPrmWslcBrk01.TP_U8_dV_LMu_10kph_R" 0 /end CHARACTERISTIC
/begin CHARACTERISTIC TP_U8_dV_LMu_120kph_F "dV, below 120kph to 100kph, Low mu, Front Wheels" VALUE 0x80020275 CalPrmWslcBrk_UBYTE 0 Spd12 0 31.875 SYMBOL_LINK "CalPrmWslcBrk01.TP_U8_dV_LMu_120kph_F" 0 /end CHARACTERISTIC
/begin CHARACTERISTIC TP_U8_dV_LMu_120kph_R "dV, below 120kph to 100kph, Low mu, Rear Wheels" VALUE 0x8002027F CalPrmWslcBrk_UBYTE 0 Spd12 0 31.875 SYMBOL_LINK "CalPrmWslcBrk01.TP_U8_dV_LMu_120kph_R" 0 /end CHARACTERISTIC
/begin CHARACTERISTIC TP_U8_dV_LMu_140kph_F "dV, below 140kph to 120kph, Low mu, Front Wheels" VALUE 0x80020276 CalPrmWslcBrk_UBYTE 0 Spd12 0 31.875 SYMBOL_LINK "CalPrmWslcBrk01.TP_U8_dV_LMu_140kph_F" 0 /end CHARACTERISTIC
/begin CHARACTERISTIC TP_U8_dV_LMu_140kph_R "dV, below 140kph to 120kph, Low mu, Rear Wheels" VALUE 0x80020280 CalPrmWslcBrk_UBYTE 0 Spd12 0 31.875 SYMBOL_LINK "CalPrmWslcBrk01.TP_U8_dV_LMu_140kph_R" 0 /end CHARACTERISTIC
/begin CHARACTERISTIC TP_U8_dV_LMu_160kph_F "dV, below 160kph to 140kph, Low mu, Front Wheels" VALUE 0x80020277 CalPrmWslcBrk_UBYTE 0 Spd12 0 31.875 SYMBOL_LINK "CalPrmWslcBrk01.TP_U8_dV_LMu_160kph_F" 0 /end CHARACTERISTIC
/begin CHARACTERISTIC TP_U8_dV_LMu_160kph_R "dV, below 160kph to 140kph, Low mu, Rear Wheels" VALUE 0x80020281 CalPrmWslcBrk_UBYTE 0 Spd12 0 31.875 SYMBOL_LINK "CalPrmWslcBrk01.TP_U8_dV_LMu_160kph_R" 0 /end CHARACTERISTIC
/begin CHARACTERISTIC TP_U8_dV_LMu_20kph_F "dV, below 20kph to 10kph, Low mu, Front Wheels" VALUE 0x80020270 CalPrmWslcBrk_UBYTE 0 Spd12 0 31.875 SYMBOL_LINK "CalPrmWslcBrk01.TP_U8_dV_LMu_20kph_F" 0 /end CHARACTERISTIC
/begin CHARACTERISTIC TP_U8_dV_LMu_20kph_R "dV, below 20kph to 10kph, Low mu, Rear Wheels" VALUE 0x8002027A CalPrmWslcBrk_UBYTE 0 Spd12 0 31.875 SYMBOL_LINK "CalPrmWslcBrk01.TP_U8_dV_LMu_20kph_R" 0 /end CHARACTERISTIC
/begin CHARACTERISTIC TP_U8_dV_LMu_40kph_F "dV, below 40kph to 20kph, Low mu, Front Wheels" VALUE 0x80020271 CalPrmWslcBrk_UBYTE 0 Spd12 0 31.875 SYMBOL_LINK "CalPrmWslcBrk01.TP_U8_dV_LMu_40kph_F" 0 /end CHARACTERISTIC
/begin CHARACTERISTIC TP_U8_dV_LMu_40kph_R "dV, below 40kph to 20kph, Low mu, Rear Wheels" VALUE 0x8002027B CalPrmWslcBrk_UBYTE 0 Spd12 0 31.875 SYMBOL_LINK "CalPrmWslcBrk01.TP_U8_dV_LMu_40kph_R" 0 /end CHARACTERISTIC
/begin CHARACTERISTIC TP_U8_dV_LMu_60kph_F "dV, below 60kph to 40kph, Low mu, Front Wheels" VALUE 0x80020272 CalPrmWslcBrk_UBYTE 0 Spd12 0 31.875 SYMBOL_LINK "CalPrmWslcBrk01.TP_U8_dV_LMu_60kph_F" 0 /end CHARACTERISTIC
/begin CHARACTERISTIC TP_U8_dV_LMu_60kph_R "dV, below 60kph to 40kph, Low mu, Rear Wheels" VALUE 0x8002027C CalPrmWslcBrk_UBYTE 0 Spd12 0 31.875 SYMBOL_LINK "CalPrmWslcBrk01.TP_U8_dV_LMu_60kph_R" 0 /end CHARACTERISTIC
/begin CHARACTERISTIC TP_U8_dV_LMu_80kph_F "dV, below 80kph to 60kph, Low mu, Front Wheels" VALUE 0x80020273 CalPrmWslcBrk_UBYTE 0 Spd12 0 31.875 SYMBOL_LINK "CalPrmWslcBrk01.TP_U8_dV_LMu_80kph_F" 0 /end CHARACTERISTIC
/begin CHARACTERISTIC TP_U8_dV_LMu_80kph_R "dV, below 80kph to 60kph, Low mu, Rear Wheels" VALUE 0x8002027D CalPrmWslcBrk_UBYTE 0 Spd12 0 31.875 SYMBOL_LINK "CalPrmWslcBrk01.TP_U8_dV_LMu_80kph_R" 0 /end CHARACTERISTIC
/begin CHARACTERISTIC TP_U8_dV_MMu_100kph_F "dV, below 100kph to 80kph, Medium mu, Front Wheels" VALUE 0x8002024C CalPrmWslcBrk_UBYTE 0 Spd12 0 31.875 SYMBOL_LINK "CalPrmWslcBrk01.TP_U8_dV_MMu_100kph_F" 0 /end CHARACTERISTIC
/begin CHARACTERISTIC TP_U8_dV_MMu_100kph_R "dV, below 100kph to 80kph, Medium mu, Rear Wheels" VALUE 0x80020256 CalPrmWslcBrk_UBYTE 0 Spd12 0 31.875 SYMBOL_LINK "CalPrmWslcBrk01.TP_U8_dV_MMu_100kph_R" 0 /end CHARACTERISTIC
/begin CHARACTERISTIC TP_U8_dV_MMu_10kph_F "dV, below 10kph, Medium mu, Front Wheels" VALUE 0x80020247 CalPrmWslcBrk_UBYTE 0 Spd12 0 31.875 SYMBOL_LINK "CalPrmWslcBrk01.TP_U8_dV_MMu_10kph_F" 0 /end CHARACTERISTIC
/begin CHARACTERISTIC TP_U8_dV_MMu_10kph_R "dV, below 10kph, Medium mu, Rear Wheels" VALUE 0x80020251 CalPrmWslcBrk_UBYTE 0 Spd12 0 31.875 SYMBOL_LINK "CalPrmWslcBrk01.TP_U8_dV_MMu_10kph_R" 0 /end CHARACTERISTIC
/begin CHARACTERISTIC TP_U8_dV_MMu_120kph_F "dV, below 120kph to 100kph, Medium mu, Front Wheels" VALUE 0x8002024D CalPrmWslcBrk_UBYTE 0 Spd12 0 31.875 SYMBOL_LINK "CalPrmWslcBrk01.TP_U8_dV_MMu_120kph_F" 0 /end CHARACTERISTIC
/begin CHARACTERISTIC TP_U8_dV_MMu_120kph_R "dV, below 120kph to 100kph, Medium mu, Rear Wheels" VALUE 0x80020257 CalPrmWslcBrk_UBYTE 0 Spd12 0 31.875 SYMBOL_LINK "CalPrmWslcBrk01.TP_U8_dV_MMu_120kph_R" 0 /end CHARACTERISTIC
/begin CHARACTERISTIC TP_U8_dV_MMu_140kph_F "dV, below 140kph to 120kph, Medium mu, Front Wheels" VALUE 0x8002024E CalPrmWslcBrk_UBYTE 0 Spd12 0 31.875 SYMBOL_LINK "CalPrmWslcBrk01.TP_U8_dV_MMu_140kph_F" 0 /end CHARACTERISTIC
/begin CHARACTERISTIC TP_U8_dV_MMu_140kph_R "dV, below 140kph to 120kph, Medium mu, Rear Wheels" VALUE 0x80020258 CalPrmWslcBrk_UBYTE 0 Spd12 0 31.875 SYMBOL_LINK "CalPrmWslcBrk01.TP_U8_dV_MMu_140kph_R" 0 /end CHARACTERISTIC
/begin CHARACTERISTIC TP_U8_dV_MMu_160kph_F "dV, below 160kph to 140kph, Medium mu, Front Wheels" VALUE 0x8002024F CalPrmWslcBrk_UBYTE 0 Spd12 0 31.875 SYMBOL_LINK "CalPrmWslcBrk01.TP_U8_dV_MMu_160kph_F" 0 /end CHARACTERISTIC
/begin CHARACTERISTIC TP_U8_dV_MMu_160kph_R "dV, below 160kph to 140kph, Medium mu, Rear Wheels" VALUE 0x80020259 CalPrmWslcBrk_UBYTE 0 Spd12 0 31.875 SYMBOL_LINK "CalPrmWslcBrk01.TP_U8_dV_MMu_160kph_R" 0 /end CHARACTERISTIC
/begin CHARACTERISTIC TP_U8_dV_MMu_20kph_F "dV, below 20kph to 10kph, Medium mu, Front Wheels" VALUE 0x80020248 CalPrmWslcBrk_UBYTE 0 Spd12 0 31.875 SYMBOL_LINK "CalPrmWslcBrk01.TP_U8_dV_MMu_20kph_F" 0 /end CHARACTERISTIC
/begin CHARACTERISTIC TP_U8_dV_MMu_20kph_R "dV, below 20kph to 10kph, Medium mu, Rear Wheels" VALUE 0x80020252 CalPrmWslcBrk_UBYTE 0 Spd12 0 31.875 SYMBOL_LINK "CalPrmWslcBrk01.TP_U8_dV_MMu_20kph_R" 0 /end CHARACTERISTIC
/begin CHARACTERISTIC TP_U8_dV_MMu_40kph_F "dV, below 40kph to 20kph, Medium mu, Front Wheels" VALUE 0x80020249 CalPrmWslcBrk_UBYTE 0 Spd12 0 31.875 SYMBOL_LINK "CalPrmWslcBrk01.TP_U8_dV_MMu_40kph_F" 0 /end CHARACTERISTIC
/begin CHARACTERISTIC TP_U8_dV_MMu_40kph_R "dV, below 40kph to 20kph, Medium mu, Rear Wheels" VALUE 0x80020253 CalPrmWslcBrk_UBYTE 0 Spd12 0 31.875 SYMBOL_LINK "CalPrmWslcBrk01.TP_U8_dV_MMu_40kph_R" 0 /end CHARACTERISTIC
/begin CHARACTERISTIC TP_U8_dV_MMu_60kph_F "dV, below 60kph to 40kph, Medium mu, Front Wheels" VALUE 0x8002024A CalPrmWslcBrk_UBYTE 0 Spd12 0 31.875 SYMBOL_LINK "CalPrmWslcBrk01.TP_U8_dV_MMu_60kph_F" 0 /end CHARACTERISTIC
/begin CHARACTERISTIC TP_U8_dV_MMu_60kph_R "dV, below 60kph to 40kph, Medium mu, Rear Wheels" VALUE 0x80020254 CalPrmWslcBrk_UBYTE 0 Spd12 0 31.875 SYMBOL_LINK "CalPrmWslcBrk01.TP_U8_dV_MMu_60kph_R" 0 /end CHARACTERISTIC
/begin CHARACTERISTIC TP_U8_dV_MMu_80kph_F "dV, below 80kph to 60kph, Medium mu, Front Wheels" VALUE 0x8002024B CalPrmWslcBrk_UBYTE 0 Spd12 0 31.875 SYMBOL_LINK "CalPrmWslcBrk01.TP_U8_dV_MMu_80kph_F" 0 /end CHARACTERISTIC
/begin CHARACTERISTIC TP_U8_dV_MMu_80kph_R "dV, below 80kph to 60kph, Medium mu, Rear Wheels" VALUE 0x80020255 CalPrmWslcBrk_UBYTE 0 Spd12 0 31.875 SYMBOL_LINK "CalPrmWslcBrk01.TP_U8_dV_MMu_80kph_R" 0 /end CHARACTERISTIC
/begin CHARACTERISTIC TP_U8_dV_Pro_High_Vel_HMu_F "dV ratio of 160kph or above, High mu,, Front Wheels(min limit: TP_U8_dV_HMu_160kph_F)" VALUE 0x8002023C CalPrmWslcBrk_UBYTE 0 Perc10 0 99.603 SYMBOL_LINK "CalPrmWslcBrk01.TP_U8_dV_Pro_High_Vel_HMu_F" 0 /end CHARACTERISTIC
/begin CHARACTERISTIC TP_U8_dV_Pro_High_Vel_HMu_R "dV ratio of 160kph or above, High mu,, Rear Wheels(min limit: TP_U8_dV_HMu_160kph_R)" VALUE 0x80020246 CalPrmWslcBrk_UBYTE 0 Perc10 0 99.603 SYMBOL_LINK "CalPrmWslcBrk01.TP_U8_dV_Pro_High_Vel_HMu_R" 0 /end CHARACTERISTIC
/begin CHARACTERISTIC TP_U8_dV_Pro_High_Vel_LMMu_F "dV ratio of 160kph or above, Lowmed mu,, Front Wheels(min limit: TP_U8_dV_LMMu_160kph_F)" VALUE 0x80020264 CalPrmWslcBrk_UBYTE 0 Perc10 0 99.603 SYMBOL_LINK "CalPrmWslcBrk01.TP_U8_dV_Pro_High_Vel_LMMu_F" 0 /end CHARACTERISTIC
/begin CHARACTERISTIC TP_U8_dV_Pro_High_Vel_LMMu_R "dV ratio of 160kph or above, Lowmed mu,, Rear Wheels(min limit: TP_U8_dV_LMMu_160kph_R)" VALUE 0x8002026E CalPrmWslcBrk_UBYTE 0 Perc10 0 99.603 SYMBOL_LINK "CalPrmWslcBrk01.TP_U8_dV_Pro_High_Vel_LMMu_R" 0 /end CHARACTERISTIC
/begin CHARACTERISTIC TP_U8_dV_Pro_High_Vel_LMu_F "dV ratio of 160kph or above, Low mu,, Front Wheels(min limit: TP_U8_dV_LMu_160kph_F)" VALUE 0x80020278 CalPrmWslcBrk_UBYTE 0 Perc10 0 99.603 SYMBOL_LINK "CalPrmWslcBrk01.TP_U8_dV_Pro_High_Vel_LMu_F" 0 /end CHARACTERISTIC
/begin CHARACTERISTIC TP_U8_dV_Pro_High_Vel_LMu_R "dV ratio of 160kph or above, Low mu,, Rear Wheels(min limit: TP_U8_dV_LMu_160kph_R)" VALUE 0x80020282 CalPrmWslcBrk_UBYTE 0 Perc10 0 99.603 SYMBOL_LINK "CalPrmWslcBrk01.TP_U8_dV_Pro_High_Vel_LMu_R" 0 /end CHARACTERISTIC
/begin CHARACTERISTIC TP_U8_dV_Pro_High_Vel_MMu_F "dV ratio of 160kph or above, Medium mu,, Front Wheels(min limit: TP_U8_dV_MMu_160kph_F)" VALUE 0x80020250 CalPrmWslcBrk_UBYTE 0 Perc10 0 99.603 SYMBOL_LINK "CalPrmWslcBrk01.TP_U8_dV_Pro_High_Vel_MMu_F" 0 /end CHARACTERISTIC
/begin CHARACTERISTIC TP_U8_dV_Pro_High_Vel_MMu_R "dV ratio of 160kph or above, Medium mu,, Rear Wheels(min limit: TP_U8_dV_MMu_160kph_R)" VALUE 0x8002025A CalPrmWslcBrk_UBYTE 0 Perc10 0 99.603 SYMBOL_LINK "CalPrmWslcBrk01.TP_U8_dV_Pro_High_Vel_MMu_R" 0 /end CHARACTERISTIC
/begin CHARACTERISTIC TP_U8_dV_Pro_High_Vel_SpMu_F "dV ratio of 100kph or above, Split mu,, Front Wheels(min limit: TP_U8_dV_SpMu_100kph_F)" VALUE 0x80020285 CalPrmWslcBrk_UBYTE 0 Spd12 0 31.875 SYMBOL_LINK "CalPrmWslcBrk01.TP_U8_dV_Pro_High_Vel_SpMu_F" 0 /end CHARACTERISTIC
/begin CHARACTERISTIC TP_U8_dV_SpMu_100kph_F "dV, below 100kph to 80kph, Split mu, Front Wheels" VALUE 0x80020286 CalPrmWslcBrk_UBYTE 0 Spd12 0 31.875 SYMBOL_LINK "CalPrmWslcBrk01.TP_U8_dV_SpMu_100kph_F" 0 /end CHARACTERISTIC
/begin CHARACTERISTIC TP_U8_dV_SpMu_10kph_F "dV, below 10kph, Split mu, Front Wheels" VALUE 0x80020287 CalPrmWslcBrk_UBYTE 0 Spd12 0 31.875 SYMBOL_LINK "CalPrmWslcBrk01.TP_U8_dV_SpMu_10kph_F" 0 /end CHARACTERISTIC
/begin CHARACTERISTIC TP_U8_dV_SpMu_20kph_F "dV, below 20kph to 10kph, Split mu, Front Wheels" VALUE 0x80020288 CalPrmWslcBrk_UBYTE 0 Spd12 0 31.875 SYMBOL_LINK "CalPrmWslcBrk01.TP_U8_dV_SpMu_20kph_F" 0 /end CHARACTERISTIC
/begin CHARACTERISTIC TP_U8_dV_SpMu_40kph_F "dV, below 40kph to 20kph, Split mu, Front Wheels" VALUE 0x80020289 CalPrmWslcBrk_UBYTE 0 Spd12 0 31.875 SYMBOL_LINK "CalPrmWslcBrk01.TP_U8_dV_SpMu_40kph_F" 0 /end CHARACTERISTIC
/begin CHARACTERISTIC TP_U8_dV_SpMu_60kph_F "dV, below 60kph to 40kph, Split mu, Front Wheels" VALUE 0x8002028A CalPrmWslcBrk_UBYTE 0 Spd12 0 31.875 SYMBOL_LINK "CalPrmWslcBrk01.TP_U8_dV_SpMu_60kph_F" 0 /end CHARACTERISTIC
/begin CHARACTERISTIC TP_U8_dV_SpMu_80kph_F "dV, below 80kph to 60kph, Split mu, Front Wheels" VALUE 0x8002028B CalPrmWslcBrk_UBYTE 0 Spd12 0 31.875 SYMBOL_LINK "CalPrmWslcBrk01.TP_U8_dV_SpMu_80kph_F" 0 /end CHARACTERISTIC
/begin CHARACTERISTIC TQGEAR_POS_TM_R "" VALUE 0x80020D5E CalPrmLatDynsCoorrBrk_UBYTE 0 Gain 0 255 SYMBOL_LINK "CalPrmLatDynsCoorrBrk01.TQGEAR_POS_TM_R" 0 /end CHARACTERISTIC
/begin CHARACTERISTIC TQS16_DYN_WSTR_DOT_MIN "" VALUE 0x80020B5C CalPrmLatDynsCoorrBrk_SWORD 0 Gain -32768 32767 SYMBOL_LINK "CalPrmLatDynsCoorrBrk01.TQS16_DYN_WSTR_DOT_MIN" 0 /end CHARACTERISTIC
/begin CHARACTERISTIC TQS16_EHC_Alatm_Enter "" VALUE 0x80020CE8 CalPrmLatDynsCoorrBrk_SWORD 0 Gain -32768 32767 SYMBOL_LINK "CalPrmLatDynsCoorrBrk01.TQS16_EHC_Alatm_Enter" 0 /end CHARACTERISTIC
/begin CHARACTERISTIC TQS16_EHC_Alatm_Exit "" VALUE 0x80020CEA CalPrmLatDynsCoorrBrk_SWORD 0 Gain -32768 32767 SYMBOL_LINK "CalPrmLatDynsCoorrBrk01.TQS16_EHC_Alatm_Exit" 0 /end CHARACTERISTIC
/begin CHARACTERISTIC TQS16_EHC_DYaw1st_Enter_SPD "" VALUE 0x80020CE4 CalPrmLatDynsCoorrBrk_SWORD 0 Gain -32768 32767 SYMBOL_LINK "CalPrmLatDynsCoorrBrk01.TQS16_EHC_DYaw1st_Enter_SPD" 0 /end CHARACTERISTIC
/begin CHARACTERISTIC TQS16_EHC_DYaw1st_Exit_SPD "" VALUE 0x80020CE6 CalPrmLatDynsCoorrBrk_SWORD 0 Gain -32768 32767 SYMBOL_LINK "CalPrmLatDynsCoorrBrk01.TQS16_EHC_DYaw1st_Exit_SPD" 0 /end CHARACTERISTIC
/begin CHARACTERISTIC TQS16_EHC_ENTER_STEER "" VALUE 0x80020CEC CalPrmLatDynsCoorrBrk_SWORD 0 Gain -32768 32767 SYMBOL_LINK "CalPrmLatDynsCoorrBrk01.TQS16_EHC_ENTER_STEER" 0 /end CHARACTERISTIC
/begin CHARACTERISTIC TQS16_EHC_Enter_SPD "" VALUE 0x80020CE0 CalPrmLatDynsCoorrBrk_SWORD 0 Gain -32768 32767 SYMBOL_LINK "CalPrmLatDynsCoorrBrk01.TQS16_EHC_Enter_SPD" 0 /end CHARACTERISTIC
/begin CHARACTERISTIC TQS16_EHC_Exit_SPD "" VALUE 0x80020CE2 CalPrmLatDynsCoorrBrk_SWORD 0 Gain -32768 32767 SYMBOL_LINK "CalPrmLatDynsCoorrBrk01.TQS16_EHC_Exit_SPD" 0 /end CHARACTERISTIC
/begin CHARACTERISTIC TQS16_EHC_WSTR_MAX_ALAT_G "" VALUE 0x80020F16 CalPrmLatDynsCoorrBrk_SWORD 0 Gain -32768 32767 SYMBOL_LINK "CalPrmLatDynsCoorrBrk01.TQS16_EHC_WSTR_MAX_ALAT_G" 0 /end CHARACTERISTIC
/begin CHARACTERISTIC TQS16_RI_THRES "" VALUE 0x80020B1A CalPrmLatDynsCoorrBrk_SWORD 0 Gain -32768 32767 SYMBOL_LINK "CalPrmLatDynsCoorrBrk01.TQS16_RI_THRES" 0 /end CHARACTERISTIC
/begin CHARACTERISTIC TQS16_ROP_BANK_DET_RI_WEG "" VALUE 0x80020B1C CalPrmLatDynsCoorrBrk_SWORD 0 Gain -32768 32767 SYMBOL_LINK "CalPrmLatDynsCoorrBrk01.TQS16_ROP_BANK_DET_RI_WEG" 0 /end CHARACTERISTIC
/begin CHARACTERISTIC TQS16_ROP_BANK_SUS_RI_WEG "" VALUE 0x80020B1E CalPrmLatDynsCoorrBrk_SWORD 0 Gain -32768 32767 SYMBOL_LINK "CalPrmLatDynsCoorrBrk01.TQS16_ROP_BANK_SUS_RI_WEG" 0 /end CHARACTERISTIC
/begin CHARACTERISTIC TQS16_ROP_PRE_FRT_ENT_WSTR_TH "" VALUE 0x80020B20 CalPrmLatDynsCoorrBrk_SWORD 0 Gain -32768 32767 SYMBOL_LINK "CalPrmLatDynsCoorrBrk01.TQS16_ROP_PRE_FRT_ENT_WSTR_TH" 0 /end CHARACTERISTIC
/begin CHARACTERISTIC TQS16_SS_WSTR_DOT_MAX "" VALUE 0x80020B5E CalPrmLatDynsCoorrBrk_SWORD 0 Gain -32768 32767 SYMBOL_LINK "CalPrmLatDynsCoorrBrk01.TQS16_SS_WSTR_DOT_MAX" 0 /end CHARACTERISTIC
/begin CHARACTERISTIC TQS16_TTL_max "" VALUE 0x80020B22 CalPrmLatDynsCoorrBrk_SWORD 0 Gain -32768 32767 SYMBOL_LINK "CalPrmLatDynsCoorrBrk01.TQS16_TTL_max" 0 /end CHARACTERISTIC
/begin CHARACTERISTIC TQS16_TTL_min "" VALUE 0x80020B24 CalPrmLatDynsCoorrBrk_SWORD 0 Gain -32768 32767 SYMBOL_LINK "CalPrmLatDynsCoorrBrk01.TQS16_TTL_min" 0 /end CHARACTERISTIC
/begin CHARACTERISTIC TQS16_TTL_thres "" VALUE 0x80020B26 CalPrmLatDynsCoorrBrk_SWORD 0 Gain -32768 32767 SYMBOL_LINK "CalPrmLatDynsCoorrBrk01.TQS16_TTL_thres" 0 /end CHARACTERISTIC
/begin CHARACTERISTIC TQS16_TVBB_AYC_TH "" VALUE 0x80020D60 CalPrmLatDynsCoorrBrk_SWORD 0 Gain -32768 32767 SYMBOL_LINK "CalPrmLatDynsCoorrBrk01.TQS16_TVBB_AYC_TH" 0 /end CHARACTERISTIC
/begin CHARACTERISTIC TQS16_TVBB_DELTA_YAW_TH_EXTI "" VALUE 0x80020DF4 CalPrmLatDynsCoorrBrk_SWORD 0 Gain -32768 32767 SYMBOL_LINK "CalPrmLatDynsCoorrBrk01.TQS16_TVBB_DELTA_YAW_TH_EXTI" 0 /end CHARACTERISTIC
/begin CHARACTERISTIC TQS16_TVBB_DEL_YAW_INHIBIT_TH_ENTER "" VALUE 0x80020D64 CalPrmLatDynsCoorrBrk_SWORD 0 Gain -32768 32767 SYMBOL_LINK "CalPrmLatDynsCoorrBrk01.TQS16_TVBB_DEL_YAW_INHIBIT_TH_ENTER" 0 /end CHARACTERISTIC
/begin CHARACTERISTIC TQS16_TVBB_DEL_YAW_INHIBIT_TH_EXIT "" VALUE 0x80020D66 CalPrmLatDynsCoorrBrk_SWORD 0 Gain -32768 32767 SYMBOL_LINK "CalPrmLatDynsCoorrBrk01.TQS16_TVBB_DEL_YAW_INHIBIT_TH_EXIT" 0 /end CHARACTERISTIC
/begin CHARACTERISTIC TQS16_TVBB_ENTER_ALATM_TH_HSP "" VALUE 0x80020D70 CalPrmLatDynsCoorrBrk_SWORD 0 Gain -32768 32767 SYMBOL_LINK "CalPrmLatDynsCoorrBrk01.TQS16_TVBB_ENTER_ALATM_TH_HSP" 0 /end CHARACTERISTIC
/begin CHARACTERISTIC TQS16_TVBB_ENTER_ALATM_TH_LSP "" VALUE 0x80020D72 CalPrmLatDynsCoorrBrk_SWORD 0 Gain -32768 32767 SYMBOL_LINK "CalPrmLatDynsCoorrBrk01.TQS16_TVBB_ENTER_ALATM_TH_LSP" 0 /end CHARACTERISTIC
/begin CHARACTERISTIC TQS16_TVBB_ENTER_ALATM_TH_MSP "" VALUE 0x80020D74 CalPrmLatDynsCoorrBrk_SWORD 0 Gain -32768 32767 SYMBOL_LINK "CalPrmLatDynsCoorrBrk01.TQS16_TVBB_ENTER_ALATM_TH_MSP" 0 /end CHARACTERISTIC
/begin CHARACTERISTIC TQS16_TVBB_ENTER_MOMENT "" VALUE 0x80020DFE CalPrmLatDynsCoorrBrk_SWORD 0 Gain -32768 32767 SYMBOL_LINK "CalPrmLatDynsCoorrBrk01.TQS16_TVBB_ENTER_MOMENT" 0 /end CHARACTERISTIC
/begin CHARACTERISTIC TQS16_TVBB_ENTER_TH_REF_HSP "" VALUE 0x80020D6E CalPrmLatDynsCoorrBrk_SWORD 0 Gain -32768 32767 SYMBOL_LINK "CalPrmLatDynsCoorrBrk01.TQS16_TVBB_ENTER_TH_REF_HSP" 0 /end CHARACTERISTIC
/begin CHARACTERISTIC TQS16_TVBB_ENTER_TH_REF_LSP "" VALUE 0x80020D6A CalPrmLatDynsCoorrBrk_SWORD 0 Gain -32768 32767 SYMBOL_LINK "CalPrmLatDynsCoorrBrk01.TQS16_TVBB_ENTER_TH_REF_LSP" 0 /end CHARACTERISTIC
/begin CHARACTERISTIC TQS16_TVBB_ENTER_TH_REF_MSP "" VALUE 0x80020D6C CalPrmLatDynsCoorrBrk_SWORD 0 Gain -32768 32767 SYMBOL_LINK "CalPrmLatDynsCoorrBrk01.TQS16_TVBB_ENTER_TH_REF_MSP" 0 /end CHARACTERISTIC
/begin CHARACTERISTIC TQS16_TVBB_EXIT_MOMENT "" VALUE 0x80020E00 CalPrmLatDynsCoorrBrk_SWORD 0 Gain -32768 32767 SYMBOL_LINK "CalPrmLatDynsCoorrBrk01.TQS16_TVBB_EXIT_MOMENT" 0 /end CHARACTERISTIC
/begin CHARACTERISTIC TQS16_TVBB_SPD_MIN "" VALUE 0x80020D68 CalPrmLatDynsCoorrBrk_SWORD 0 Gain -32768 32767 SYMBOL_LINK "CalPrmLatDynsCoorrBrk01.TQS16_TVBB_SPD_MIN" 0 /end CHARACTERISTIC
/begin CHARACTERISTIC TQS8_TVBB_INHIBIT_WH_SLIP_HSP "" VALUE 0x80020D78 CalPrmLatDynsCoorrBrk_SBYTE 0 Gain -128 127 SYMBOL_LINK "CalPrmLatDynsCoorrBrk01.TQS8_TVBB_INHIBIT_WH_SLIP_HSP" 0 /end CHARACTERISTIC
/begin CHARACTERISTIC TQS8_TVBB_INHIBIT_WH_SLIP_LSP "" VALUE 0x80020D76 CalPrmLatDynsCoorrBrk_SBYTE 0 Gain -128 127 SYMBOL_LINK "CalPrmLatDynsCoorrBrk01.TQS8_TVBB_INHIBIT_WH_SLIP_LSP" 0 /end CHARACTERISTIC
/begin CHARACTERISTIC TQS8_TVBB_INHIBIT_WH_SLIP_MSP "" VALUE 0x80020D77 CalPrmLatDynsCoorrBrk_SBYTE 0 Gain -128 127 SYMBOL_LINK "CalPrmLatDynsCoorrBrk01.TQS8_TVBB_INHIBIT_WH_SLIP_MSP" 0 /end CHARACTERISTIC
/begin CHARACTERISTIC TQU8_TVBB_ACT_IN_ETCS "" VALUE 0x80020E2E CalPrmLatDynsCoorrBrk_UBYTE 0 Gain 0 255 SYMBOL_LINK "CalPrmLatDynsCoorrBrk01.TQU8_TVBB_ACT_IN_ETCS" 0 /end CHARACTERISTIC
/begin CHARACTERISTIC TQU8_TVBB_APS_TH "" VALUE 0x80020D5F CalPrmLatDynsCoorrBrk_UBYTE 0 Gain 0 255 SYMBOL_LINK "CalPrmLatDynsCoorrBrk01.TQU8_TVBB_APS_TH" 0 /end CHARACTERISTIC
/begin CHARACTERISTIC TQU8_TVBB_TURN_INTENT_DCT_TIME "" VALUE 0x80020D62 CalPrmLatDynsCoorrBrk_UBYTE 0 Gain 0 255 SYMBOL_LINK "CalPrmLatDynsCoorrBrk01.TQU8_TVBB_TURN_INTENT_DCT_TIME" 0 /end CHARACTERISTIC
/begin CHARACTERISTIC U8_WPE_LFC_ESC_MP_Rise_Duty_f_1st "Temp" VALUE 0x8002174A CalPrmBrkTqCtrlrBrk_UBYTE 0 Gain 0 255 SYMBOL_LINK "CalPrmBrkTqCtrlrBrk01.U8_WPE_LFC_ESC_MP_Rise_Duty_f_1st" 0 /end CHARACTERISTIC
/begin CHARACTERISTIC U8_WPE_LFC_ESC_MP_Rise_Duty_f_2nd "Temp" VALUE 0x8002174B CalPrmBrkTqCtrlrBrk_UBYTE 0 Gain 0 255 SYMBOL_LINK "CalPrmBrkTqCtrlrBrk01.U8_WPE_LFC_ESC_MP_Rise_Duty_f_2nd" 0 /end CHARACTERISTIC
/begin CHARACTERISTIC U8_WPE_LFC_ESC_MP_Rise_Duty_f_3rd "Temp" VALUE 0x8002174C CalPrmBrkTqCtrlrBrk_UBYTE 0 Gain 0 255 SYMBOL_LINK "CalPrmBrkTqCtrlrBrk01.U8_WPE_LFC_ESC_MP_Rise_Duty_f_3rd" 0 /end CHARACTERISTIC
/begin CHARACTERISTIC U8_WPE_LFC_ESC_MP_Rise_Duty_f_4th "Temp" VALUE 0x8002174D CalPrmBrkTqCtrlrBrk_UBYTE 0 Gain 0 255 SYMBOL_LINK "CalPrmBrkTqCtrlrBrk01.U8_WPE_LFC_ESC_MP_Rise_Duty_f_4th" 0 /end CHARACTERISTIC
/begin CHARACTERISTIC U8_WPE_LFC_ESC_MP_Rise_Duty_f_5th "Temp" VALUE 0x8002174E CalPrmBrkTqCtrlrBrk_UBYTE 0 Gain 0 255 SYMBOL_LINK "CalPrmBrkTqCtrlrBrk01.U8_WPE_LFC_ESC_MP_Rise_Duty_f_5th" 0 /end CHARACTERISTIC
/begin CHARACTERISTIC U8_WPE_LFC_ESC_MP_Rise_Duty_f_6th "Temp" VALUE 0x8002174F CalPrmBrkTqCtrlrBrk_UBYTE 0 Gain 0 255 SYMBOL_LINK "CalPrmBrkTqCtrlrBrk01.U8_WPE_LFC_ESC_MP_Rise_Duty_f_6th" 0 /end CHARACTERISTIC
/begin CHARACTERISTIC U8_WPE_LFC_ESC_MP_Rise_Duty_r_1st "Temp" VALUE 0x8002175C CalPrmBrkTqCtrlrBrk_UBYTE 0 Gain 0 255 SYMBOL_LINK "CalPrmBrkTqCtrlrBrk01.U8_WPE_LFC_ESC_MP_Rise_Duty_r_1st" 0 /end CHARACTERISTIC
/begin CHARACTERISTIC U8_WPE_LFC_ESC_MP_Rise_Duty_r_2nd "Temp" VALUE 0x8002175D CalPrmBrkTqCtrlrBrk_UBYTE 0 Gain 0 255 SYMBOL_LINK "CalPrmBrkTqCtrlrBrk01.U8_WPE_LFC_ESC_MP_Rise_Duty_r_2nd" 0 /end CHARACTERISTIC
/begin CHARACTERISTIC U8_WPE_LFC_ESC_MP_Rise_Duty_r_3rd "Temp" VALUE 0x8002175E CalPrmBrkTqCtrlrBrk_UBYTE 0 Gain 0 255 SYMBOL_LINK "CalPrmBrkTqCtrlrBrk01.U8_WPE_LFC_ESC_MP_Rise_Duty_r_3rd" 0 /end CHARACTERISTIC
/begin CHARACTERISTIC U8_WPE_LFC_ESC_MP_Rise_Duty_r_4th "Temp" VALUE 0x8002175F CalPrmBrkTqCtrlrBrk_UBYTE 0 Gain 0 255 SYMBOL_LINK "CalPrmBrkTqCtrlrBrk01.U8_WPE_LFC_ESC_MP_Rise_Duty_r_4th" 0 /end CHARACTERISTIC
/begin CHARACTERISTIC U8_WPE_LFC_ESC_MP_Rise_Duty_r_5th "Temp" VALUE 0x80021760 CalPrmBrkTqCtrlrBrk_UBYTE 0 Gain 0 255 SYMBOL_LINK "CalPrmBrkTqCtrlrBrk01.U8_WPE_LFC_ESC_MP_Rise_Duty_r_5th" 0 /end CHARACTERISTIC
/begin CHARACTERISTIC U8_WPE_LFC_ESC_MP_Rise_Duty_r_6th "Temp" VALUE 0x80021761 CalPrmBrkTqCtrlrBrk_UBYTE 0 Gain 0 255 SYMBOL_LINK "CalPrmBrkTqCtrlrBrk01.U8_WPE_LFC_ESC_MP_Rise_Duty_r_6th" 0 /end CHARACTERISTIC
/begin COMPU_METHOD A20 "" LINEAR "%.15" "g" COEFFS_LINEAR 0.25 0 /end COMPU_METHOD
/begin COMPU_METHOD A21 "" LINEAR "%.15" "g" COEFFS_LINEAR 0.25 0 /end COMPU_METHOD
/begin COMPU_METHOD A41 "" LINEAR "%.15" "g" COEFFS_LINEAR 0.001 0 /end COMPU_METHOD
/begin COMPU_METHOD A42 "" LINEAR "%.15" "g" COEFFS_LINEAR 0.01 0 /end COMPU_METHOD
/begin COMPU_METHOD A48 "" LINEAR "%.15" "g" COEFFS_LINEAR 0.0001 0 /end COMPU_METHOD
/begin COMPU_METHOD AgSpd31 "" LINEAR "%.15" "DegPerSec" COEFFS_LINEAR 0.01 0 /end COMPU_METHOD
/begin COMPU_METHOD Fac31 "" LINEAR "%.15" "NA" COEFFS_LINEAR 1 0 /end COMPU_METHOD
/begin COMPU_METHOD Gain "" LINEAR "%.15" "NA" COEFFS_LINEAR 1 0 /end COMPU_METHOD
/begin COMPU_METHOD Gain21 "" LINEAR "%.15" "NA" COEFFS_LINEAR 10 0 /end COMPU_METHOD
/begin COMPU_METHOD Len21 "" LINEAR "%.15" "m" COEFFS_LINEAR 0.1 0 /end COMPU_METHOD
/begin COMPU_METHOD Len81 "" LINEAR "%.15" "cm" COEFFS_LINEAR 0.1 0 /end COMPU_METHOD
/begin COMPU_METHOD Nr2 "" LINEAR "%.15" "NA" COEFFS_LINEAR 1 0 /end COMPU_METHOD
/begin COMPU_METHOD OnOff1 "" LINEAR "%.15" "NA" COEFFS_LINEAR 1 0 STATUS_STRING_REF OnOffTable /end COMPU_METHOD
/begin COMPU_METHOD P34 "" LINEAR "%.15" "bar" COEFFS_LINEAR 0.1 0 /end COMPU_METHOD
/begin COMPU_METHOD PGrdt13 "" LINEAR "%.15" "bar/30ms" COEFFS_LINEAR 0.1 0 /end COMPU_METHOD
/begin COMPU_METHOD Perc10 "" LINEAR "%.15" "Percentage" COEFFS_LINEAR 0.3906 0 /end COMPU_METHOD
/begin COMPU_METHOD Perc6 "" LINEAR "%.15" "Percentage" COEFFS_LINEAR 1 0 /end COMPU_METHOD
/begin COMPU_METHOD Spd12 "" LINEAR "%.15" "kph" COEFFS_LINEAR 0.125 0 /end COMPU_METHOD
/begin COMPU_METHOD Ti11 "" LINEAR "%.15" "sec" COEFFS_LINEAR 1 0 /end COMPU_METHOD
/begin COMPU_METHOD Ti21 "" LINEAR "%.15" "sec" COEFFS_LINEAR 0.01 0 /end COMPU_METHOD
/begin COMPU_METHOD Ti41 "" LINEAR "%.15" "sec" COEFFS_LINEAR 0.005 0 /end COMPU_METHOD
/begin COMPU_METHOD Ti61 "" LINEAR "%.15" "sec" COEFFS_LINEAR 0.5 0 /end COMPU_METHOD
/begin COMPU_METHOD Ti71 "" LINEAR "%.15" "sec" COEFFS_LINEAR 0.1 0 /end COMPU_METHOD
/begin COMPU_METHOD Tq2 "" LINEAR "%.15" "Nm" COEFFS_LINEAR 1 0 /end COMPU_METHOD
/begin COMPU_METHOD Tq51 "" LINEAR "%.15" "Nm" COEFFS_LINEAR 0.1 0 /end COMPU_METHOD
/begin COMPU_METHOD TqGrdt10 "" LINEAR "%.15" "Nm/10ms" COEFFS_LINEAR 1 0 /end COMPU_METHOD
/begin COMPU_METHOD TrsmStGearLvr1 "" LINEAR "%.15" "NA" COEFFS_LINEAR 1 0 STATUS_STRING_REF TrsmStGearLvrTable /end COMPU_METHOD
/begin COMPU_METHOD TrsmTyp1 "" LINEAR "%.15" "NA" COEFFS_LINEAR 1 0 STATUS_STRING_REF TrsmTypTable /end COMPU_METHOD
/begin COMPU_METHOD UnderSteerSts1 "" LINEAR "%.15" "NA" COEFFS_LINEAR 1 0 STATUS_STRING_REF UnderStrTable /end COMPU_METHOD
/begin COMPU_METHOD Vol11 "" LINEAR "%.15" "cc" COEFFS_LINEAR 0.001 0 /end COMPU_METHOD
/begin COMPU_METHOD WhlRotlDirStd1 "" LINEAR "%.15" "NA" COEFFS_LINEAR 1 0 STATUS_STRING_REF WhlRotlDirStdTable /end COMPU_METHOD
/begin COMPU_VTAB ActvSts1 "ACtive Status" TAB_VERB 2 0 "Not Active" 1 "Active" DEFAULT_VALUE "" /end COMPU_VTAB
/begin COMPU_VTAB DrvnAxleTqCtrlFct1 "" TAB_VERB 22 0 "no control" 10 "ROP" 11 "ESC" 12 "TVBB" 13 "TSP" 20 "PBA" 30 "EBD" 31 "ABS" 32 "CBC" 33 "SLS" 34 "PAC" 35 "RBB" 36 "EDC" 40 "TCS" 50 "AVH" 51 "HAS" 52 "ISG" 60 "AEB" 61 "SCC" 70 "EBP" 80 "TSP" 81 "HDC" DEFAULT_VALUE "" /end COMPU_VTAB
/begin COMPU_VTAB InCtrlTable "" TAB_VERB 2 0 "NotInControl" 1 "InControl" DEFAULT_VALUE "" /end COMPU_VTAB
/begin COMPU_VTAB InvldVld2 "Validity status" TAB_VERB 2 0 "Invalid" 1 "Valid" DEFAULT_VALUE "" /end COMPU_VTAB
/begin COMPU_VTAB OnOff1 "" TAB_VERB 2 0 "off" 1 "on" DEFAULT_VALUE "" /end COMPU_VTAB
/begin COMPU_VTAB OnOffTable "" TAB_VERB 2 0 "Off" 1 "On" DEFAULT_VALUE "" /end COMPU_VTAB
/begin COMPU_VTAB ReqSts1 "Request status" TAB_VERB 2 0 "not requested" 1 "requested" DEFAULT_VALUE "" /end COMPU_VTAB
/begin COMPU_VTAB TrsmGearTar1 "Transmission Gear" TAB_VERB 10 0 "P" 1 "1st" 2 "2nd" 3 "3rd" 4 "4th" 5 "5th" 6 "6th" 7 "7th" 8 "8th" 14 "R" DEFAULT_VALUE "" /end COMPU_VTAB
/begin COMPU_VTAB TrsmStGearLvr1 "" TAB_VERB 9 0 "P" 1 "L" 2 "2" 3 "3" 4 "DS Mode" 5 "D" 6 "N" 7 "R" 8 "Sports Mode" DEFAULT_VALUE "" /end COMPU_VTAB
/begin COMPU_VTAB TrsmStGearLvrTable "" TAB_VERB 9 0 "P" 1 "L" 2 "2" 3 "3" 4 "DSMode" 5 "D" 6 "N" 7 "R" 8 "SportsMode" DEFAULT_VALUE "" /end COMPU_VTAB
/begin COMPU_VTAB TrsmTypTable "" TAB_VERB 5 0 "MT" 1 "AT" 2 "CVT" 3 "DCT" 4 "HEV" DEFAULT_VALUE "" /end COMPU_VTAB
/begin COMPU_VTAB UnderStrTable "" TAB_VERB 2 0 "NotInUndersteer" 1 "InUndersteer" DEFAULT_VALUE "" /end COMPU_VTAB
/begin COMPU_VTAB WhlRotlDirStdTable "" TAB_VERB 4 0 "Undefined" 1 "Standstill" 2 "Forward" 3 "Backward" DEFAULT_VALUE "" /end COMPU_VTAB
/begin RECORD_LAYOUT CalPrmAwdCtrlrEng_SBYTE FNC_VALUES 1 SBYTE COLUMN_DIR DIRECT ALIGNMENT_BYTE 1 ALIGNMENT_WORD 1 ALIGNMENT_LONG 1 ALIGNMENT_FLOAT32_IEEE 1 ALIGNMENT_FLOAT64_IEEE 1 ALIGNMENT_INT64 1 /end RECORD_LAYOUT
/begin RECORD_LAYOUT CalPrmAwdCtrlrEng_UWORD FNC_VALUES 1 UWORD COLUMN_DIR DIRECT ALIGNMENT_BYTE 1 ALIGNMENT_WORD 1 ALIGNMENT_LONG 1 ALIGNMENT_FLOAT32_IEEE 1 ALIGNMENT_FLOAT64_IEEE 1 ALIGNMENT_INT64 1 /end RECORD_LAYOUT
/begin RECORD_LAYOUT CalPrmBrkAssisCoorrEng_SBYTE FNC_VALUES 1 SBYTE COLUMN_DIR DIRECT ALIGNMENT_BYTE 1 ALIGNMENT_WORD 1 ALIGNMENT_LONG 1 ALIGNMENT_FLOAT32_IEEE 1 ALIGNMENT_FLOAT64_IEEE 1 ALIGNMENT_INT64 1 /end RECORD_LAYOUT
/begin RECORD_LAYOUT CalPrmBrkAssisCoorrEng_SWORD FNC_VALUES 1 SWORD COLUMN_DIR DIRECT ALIGNMENT_BYTE 1 ALIGNMENT_WORD 1 ALIGNMENT_LONG 1 ALIGNMENT_FLOAT32_IEEE 1 ALIGNMENT_FLOAT64_IEEE 1 ALIGNMENT_INT64 1 /end RECORD_LAYOUT
/begin RECORD_LAYOUT CalPrmBrkAssisCoorrEng_UBYTE FNC_VALUES 1 UBYTE COLUMN_DIR DIRECT ALIGNMENT_BYTE 1 ALIGNMENT_WORD 1 ALIGNMENT_LONG 1 ALIGNMENT_FLOAT32_IEEE 1 ALIGNMENT_FLOAT64_IEEE 1 ALIGNMENT_INT64 1 /end RECORD_LAYOUT
/begin RECORD_LAYOUT CalPrmBrkAssisCoorrEng_UWORD FNC_VALUES 1 UWORD COLUMN_DIR DIRECT ALIGNMENT_BYTE 1 ALIGNMENT_WORD 1 ALIGNMENT_LONG 1 ALIGNMENT_FLOAT32_IEEE 1 ALIGNMENT_FLOAT64_IEEE 1 ALIGNMENT_INT64 1 /end RECORD_LAYOUT
/begin RECORD_LAYOUT CalPrmBrkTqCtrlrBrk_SBYTE FNC_VALUES 1 SBYTE COLUMN_DIR DIRECT ALIGNMENT_BYTE 1 ALIGNMENT_WORD 1 ALIGNMENT_LONG 1 ALIGNMENT_FLOAT32_IEEE 1 ALIGNMENT_FLOAT64_IEEE 1 ALIGNMENT_INT64 1 /end RECORD_LAYOUT
/begin RECORD_LAYOUT CalPrmBrkTqCtrlrBrk_SWORD FNC_VALUES 1 SWORD COLUMN_DIR DIRECT ALIGNMENT_BYTE 1 ALIGNMENT_WORD 1 ALIGNMENT_LONG 1 ALIGNMENT_FLOAT32_IEEE 1 ALIGNMENT_FLOAT64_IEEE 1 ALIGNMENT_INT64 1 /end RECORD_LAYOUT
/begin RECORD_LAYOUT CalPrmBrkTqCtrlrBrk_UBYTE FNC_VALUES 1 UBYTE COLUMN_DIR DIRECT ALIGNMENT_BYTE 1 ALIGNMENT_WORD 1 ALIGNMENT_LONG 1 ALIGNMENT_FLOAT32_IEEE 1 ALIGNMENT_FLOAT64_IEEE 1 ALIGNMENT_INT64 1 /end RECORD_LAYOUT
/begin RECORD_LAYOUT CalPrmCmnBrk_SBYTE FNC_VALUES 1 SBYTE COLUMN_DIR DIRECT ALIGNMENT_BYTE 1 ALIGNMENT_WORD 1 ALIGNMENT_LONG 1 ALIGNMENT_FLOAT32_IEEE 1 ALIGNMENT_FLOAT64_IEEE 1 ALIGNMENT_INT64 1 /end RECORD_LAYOUT
/begin RECORD_LAYOUT CalPrmCmnEng_SBYTE FNC_VALUES 1 SBYTE COLUMN_DIR DIRECT ALIGNMENT_BYTE 1 ALIGNMENT_WORD 1 ALIGNMENT_LONG 1 ALIGNMENT_FLOAT32_IEEE 1 ALIGNMENT_FLOAT64_IEEE 1 ALIGNMENT_INT64 1 /end RECORD_LAYOUT
/begin RECORD_LAYOUT CalPrmLatDynsCoorrBrk_SBYTE FNC_VALUES 1 SBYTE COLUMN_DIR DIRECT ALIGNMENT_BYTE 1 ALIGNMENT_WORD 1 ALIGNMENT_LONG 1 ALIGNMENT_FLOAT32_IEEE 1 ALIGNMENT_FLOAT64_IEEE 1 ALIGNMENT_INT64 1 /end RECORD_LAYOUT
/begin RECORD_LAYOUT CalPrmLatDynsCoorrBrk_SWORD FNC_VALUES 1 SWORD COLUMN_DIR DIRECT ALIGNMENT_BYTE 1 ALIGNMENT_WORD 1 ALIGNMENT_LONG 1 ALIGNMENT_FLOAT32_IEEE 1 ALIGNMENT_FLOAT64_IEEE 1 ALIGNMENT_INT64 1 /end RECORD_LAYOUT
/begin RECORD_LAYOUT CalPrmLatDynsCoorrBrk_UBYTE FNC_VALUES 1 UBYTE COLUMN_DIR DIRECT ALIGNMENT_BYTE 1 ALIGNMENT_WORD 1 ALIGNMENT_LONG 1 ALIGNMENT_FLOAT32_IEEE 1 ALIGNMENT_FLOAT64_IEEE 1 ALIGNMENT_INT64 1 /end RECORD_LAYOUT
/begin RECORD_LAYOUT CalPrmLoPCoorrBrk_SWORD FNC_VALUES 1 SWORD COLUMN_DIR DIRECT ALIGNMENT_BYTE 1 ALIGNMENT_WORD 1 ALIGNMENT_LONG 1 ALIGNMENT_FLOAT32_IEEE 1 ALIGNMENT_FLOAT64_IEEE 1 ALIGNMENT_INT64 1 /end RECORD_LAYOUT
/begin RECORD_LAYOUT CalPrmLoPCoorrBrk_UBYTE FNC_VALUES 1 UBYTE COLUMN_DIR DIRECT ALIGNMENT_BYTE 1 ALIGNMENT_WORD 1 ALIGNMENT_LONG 1 ALIGNMENT_FLOAT32_IEEE 1 ALIGNMENT_FLOAT64_IEEE 1 ALIGNMENT_INT64 1 /end RECORD_LAYOUT
/begin RECORD_LAYOUT CalPrmSsmBrk_SBYTE FNC_VALUES 1 SBYTE COLUMN_DIR DIRECT ALIGNMENT_BYTE 1 ALIGNMENT_WORD 1 ALIGNMENT_LONG 1 ALIGNMENT_FLOAT32_IEEE 1 ALIGNMENT_FLOAT64_IEEE 1 ALIGNMENT_INT64 1 /end RECORD_LAYOUT
/begin RECORD_LAYOUT CalPrmSsmBrk_SWORD FNC_VALUES 1 SWORD COLUMN_DIR DIRECT ALIGNMENT_BYTE 1 ALIGNMENT_WORD 1 ALIGNMENT_LONG 1 ALIGNMENT_FLOAT32_IEEE 1 ALIGNMENT_FLOAT64_IEEE 1 ALIGNMENT_INT64 1 /end RECORD_LAYOUT
/begin RECORD_LAYOUT CalPrmSsmBrk_UBYTE FNC_VALUES 1 UBYTE COLUMN_DIR DIRECT ALIGNMENT_BYTE 1 ALIGNMENT_WORD 1 ALIGNMENT_LONG 1 ALIGNMENT_FLOAT32_IEEE 1 ALIGNMENT_FLOAT64_IEEE 1 ALIGNMENT_INT64 1 /end RECORD_LAYOUT
/begin RECORD_LAYOUT CalPrmSsmEng_SWORD FNC_VALUES 1 SWORD COLUMN_DIR DIRECT ALIGNMENT_BYTE 1 ALIGNMENT_WORD 1 ALIGNMENT_LONG 1 ALIGNMENT_FLOAT32_IEEE 1 ALIGNMENT_FLOAT64_IEEE 1 ALIGNMENT_INT64 1 /end RECORD_LAYOUT
/begin RECORD_LAYOUT CalPrmSsmEng_UBYTE FNC_VALUES 1 UBYTE COLUMN_DIR DIRECT ALIGNMENT_BYTE 1 ALIGNMENT_WORD 1 ALIGNMENT_LONG 1 ALIGNMENT_FLOAT32_IEEE 1 ALIGNMENT_FLOAT64_IEEE 1 ALIGNMENT_INT64 1 /end RECORD_LAYOUT
/begin RECORD_LAYOUT CalPrmWslcBrk_SBYTE FNC_VALUES 1 SBYTE COLUMN_DIR DIRECT ALIGNMENT_BYTE 1 ALIGNMENT_WORD 1 ALIGNMENT_LONG 1 ALIGNMENT_FLOAT32_IEEE 1 ALIGNMENT_FLOAT64_IEEE 1 ALIGNMENT_INT64 1 /end RECORD_LAYOUT
/begin RECORD_LAYOUT CalPrmWslcBrk_SWORD FNC_VALUES 1 SWORD COLUMN_DIR DIRECT ALIGNMENT_BYTE 1 ALIGNMENT_WORD 1 ALIGNMENT_LONG 1 ALIGNMENT_FLOAT32_IEEE 1 ALIGNMENT_FLOAT64_IEEE 1 ALIGNMENT_INT64 1 /end RECORD_LAYOUT
/begin RECORD_LAYOUT CalPrmWslcBrk_UBYTE FNC_VALUES 1 UBYTE COLUMN_DIR DIRECT ALIGNMENT_BYTE 1 ALIGNMENT_WORD 1 ALIGNMENT_LONG 1 ALIGNMENT_FLOAT32_IEEE 1 ALIGNMENT_FLOAT64_IEEE 1 ALIGNMENT_INT64 1 /end RECORD_LAYOUT
/begin RECORD_LAYOUT CalPrmWslcBrk_UWORD FNC_VALUES 1 UWORD COLUMN_DIR DIRECT ALIGNMENT_BYTE 1 ALIGNMENT_WORD 1 ALIGNMENT_LONG 1 ALIGNMENT_FLOAT32_IEEE 1 ALIGNMENT_FLOAT64_IEEE 1 ALIGNMENT_INT64 1 /end RECORD_LAYOUT
/begin RECORD_LAYOUT CalPrmWspcEng_SWORD FNC_VALUES 1 SWORD COLUMN_DIR DIRECT ALIGNMENT_BYTE 1 ALIGNMENT_WORD 1 ALIGNMENT_LONG 1 ALIGNMENT_FLOAT32_IEEE 1 ALIGNMENT_FLOAT64_IEEE 1 ALIGNMENT_INT64 1 /end RECORD_LAYOUT
/begin RECORD_LAYOUT CalPrmWspcEng_UBYTE FNC_VALUES 1 UBYTE COLUMN_DIR DIRECT ALIGNMENT_BYTE 1 ALIGNMENT_WORD 1 ALIGNMENT_LONG 1 ALIGNMENT_FLOAT32_IEEE 1 ALIGNMENT_FLOAT64_IEEE 1 ALIGNMENT_INT64 1 /end RECORD_LAYOUT
/begin GROUP a_GMA_Speed_Reference "" /begin REF_CHARACTERISTIC TP_S16_GMA_H_SPEED TP_S16_GMA_L_SPEED TP_S16_GMA_M_SPEED /end REF_CHARACTERISTIC /end GROUP
/begin GROUP a_GMA_detection "" /begin SUB_GROUP a_GMA_Detection_BfABS b_GMA_Detection_InABS /end SUB_GROUP /end GROUP
/begin GROUP a_H2SP_Detect_1 ""
 /begin REF_CHARACTERISTIC TP_S16_H2SP_DETECT_FRONT_VRAD_DIFF1 TP_S16_H2SP_DETECT_FRONT_VRAD_DIFF2 TP_S8_H2SP_DETECT_FRONT_DECEL1 TP_S8_H2SP_DETECT_FRONT_DECEL2 TP_S8_H_to_Split_Detection_AFZ TP_S8_H_to_Split_Dump_Diff TP_U8_H2SP_DET_LOW_MU /end REF_CHARACTERISTIC
/end GROUP
/begin GROUP a_HighMu_F_Dumptime ""
 /begin REF_CHARACTERISTIC TP_U8_1st_Dumpscantime_HMu_HHDF_F TP_U8_1st_Dumpscantime_HMu_LHDF_F TP_U8_1st_Dumpscantime_HMu_LMHDF_F TP_U8_1st_Dumpscantime_HMu_MHDF_F /end REF_CHARACTERISTIC
 /begin SUB_GROUP a_Low_Speed_HMu_F /end SUB_GROUP
/end GROUP
/begin GROUP a_High_Mu_Front ""
 /begin REF_CHARACTERISTIC TP_U8_dV_HMu_100kph_F TP_U8_dV_HMu_10kph_F TP_U8_dV_HMu_120kph_F TP_U8_dV_HMu_140kph_F TP_U8_dV_HMu_160kph_F TP_U8_dV_HMu_20kph_F TP_U8_dV_HMu_40kph_F TP_U8_dV_HMu_60kph_F TP_U8_dV_HMu_80kph_F TP_U8_dV_Pro_High_Vel_HMu_F /end REF_CHARACTERISTIC
/end GROUP
/begin GROUP a_High_Mu_UR_Time "" /begin SUB_GROUP a_Front_H_T b_Rear_H_T /end SUB_GROUP /end GROUP
/begin GROUP a_High_Speed ""
 /begin REF_CHARACTERISTIC TP_U8_HOLD13_H_SPEED TP_U8_HOLD45_H_SPEED TP_U8_HOLD67_H_SPEED TP_U8_HOLD8_H_SPEED TP_U8_HOLD_0_H_SPEED /end REF_CHARACTERISTIC
/end GROUP
/begin GROUP a_High_Speed_Reapply_time ""
 /begin REF_CHARACTERISTIC TP_S8_GMA_RiseTime_H_SPEED_PHASE1 TP_S8_GMA_RiseTime_H_SPEED_PHASE2 TP_S8_GMA_RiseTime_H_SPEED_PHASE3 /end REF_CHARACTERISTIC
/end GROUP
/begin GROUP a_I_gain "" /begin REF_CHARACTERISTIC TP_U8TCSCpICtlActCntTh TP_U8TCSCpICtlActWhlChgRateTh /end REF_CHARACTERISTIC /begin SUB_GROUP a_Igain_Straight b_Igain_Hill c_Igain_Turn /end SUB_GROUP /end GROUP
/begin GROUP a_IgainFactor_Straight ""
 /begin REF_CHARACTERISTIC TP_U8TCSCpIgainEffPctStN_F TP_U8TCSCpIgainEffPctStN_R TP_U8TCSCpIgainEffPctStP_F TP_U8TCSCpIgainEffPctStP_R /end REF_CHARACTERISTIC
/end GROUP
/begin GROUP a_Igain_Straight ""
 /begin REF_CHARACTERISTIC TP_U8TCSCpBsStIG4ASFBCtl_F[0] TP_U8TCSCpBsStIG4ASFBCtl_F[1] TP_U8TCSCpBsStIG4ASFBCtl_F[2] TP_U8TCSCpBsStIG4ASFBCtl_F[3] TP_U8TCSCpBsStIG4ASFBCtl_F[4] TP_U8TCSCpBsStIG4ASFBCtl_R[0] TP_U8TCSCpBsStIG4ASFBCtl_R[1] TP_U8TCSCpBsStIG4ASFBCtl_R[2] TP_U8TCSCpBsStIG4ASFBCtl_R[3] TP_U8TCSCpBsStIG4ASFBCtl_R[4] /end REF_CHARACTERISTIC
/end GROUP
/begin GROUP a_Initial_cycle_Mu "" /begin SUB_GROUP a_Front_Initial b_Rear_Initial /end SUB_GROUP /end GROUP
/begin GROUP a_L2H_Decel_Threshold ""
 /begin REF_CHARACTERISTIC TP_S16_L2H_DCT_ALLOWED_AFZ TP_S16_L2H_DCT_DIFF_DECEL TP_S16_L2H_DCT_DIFF_DECEL_H TP_S16_L2H_RESET_DIFF_DECEL /end REF_CHARACTERISTIC
/end GROUP
/begin GROUP a_LFC_AB ""
 /begin REF_CHARACTERISTIC TP_U8_INIT_DUTY_ACTIVE_BRK_MAX TP_U8_INIT_DUTY_ACTIVE_BRK_MIN /end REF_CHARACTERISTIC
/end GROUP
/begin GROUP a_LowMed_Mu_Front ""
 /begin REF_CHARACTERISTIC TP_U8_dV_LMMu_100kph_F TP_U8_dV_LMMu_10kph_F TP_U8_dV_LMMu_120kph_F TP_U8_dV_LMMu_140kph_F TP_U8_dV_LMMu_160kph_F TP_U8_dV_LMMu_20kph_F TP_U8_dV_LMMu_40kph_F TP_U8_dV_LMMu_60kph_F TP_U8_dV_LMMu_80kph_F TP_U8_dV_Pro_High_Vel_LMMu_F /end REF_CHARACTERISTIC
/end GROUP
/begin GROUP a_Low_Mu_Front ""
 /begin REF_CHARACTERISTIC TP_U8_dV_LMu_100kph_F TP_U8_dV_LMu_10kph_F TP_U8_dV_LMu_120kph_F TP_U8_dV_LMu_140kph_F TP_U8_dV_LMu_160kph_F TP_U8_dV_LMu_20kph_F TP_U8_dV_LMu_40kph_F TP_U8_dV_LMu_60kph_F TP_U8_dV_LMu_80kph_F TP_U8_dV_Pro_High_Vel_LMu_F /end REF_CHARACTERISTIC
/end GROUP
/begin GROUP a_Low_Speed_HMu_F ""
 /begin REF_CHARACTERISTIC TP_U8_1st_Dumptime_HMu_B_20_F TP_U8_1st_Dumptime_HMu_LHDF_B_20_F /end REF_CHARACTERISTIC
/end GROUP
/begin GROUP a_Low_Speed_LMMu_F "" /begin REF_CHARACTERISTIC TP_U8_B_20KPH_Dumpscantime_LMMu_F /end REF_CHARACTERISTIC /end GROUP
/begin GROUP a_Low_Speed_LMMu_R "" /begin REF_CHARACTERISTIC TP_U8_B_10KPH_Dumpscantime_LMMu_R /end REF_CHARACTERISTIC /end GROUP
/begin GROUP a_Low_Speed_LMu_F "" /begin REF_CHARACTERISTIC TP_U8_B_10KPH_Dumpscantime_LMu_F /end REF_CHARACTERISTIC /end GROUP
/begin GROUP a_Low_Speed_LMu_R "" /begin REF_CHARACTERISTIC TP_U8_B_10KPH_Dumpscantime_LMu_R /end REF_CHARACTERISTIC /end GROUP
/begin GROUP a_Low_Speed_MMu_F "" /begin REF_CHARACTERISTIC TP_U8_B_20KPH_Dumpscantime_MMu_F /end REF_CHARACTERISTIC /end GROUP
/begin GROUP a_Medium_Mu_Front ""
 /begin REF_CHARACTERISTIC TP_U8_dV_MMu_100kph_F TP_U8_dV_MMu_10kph_F TP_U8_dV_MMu_120kph_F TP_U8_dV_MMu_140kph_F TP_U8_dV_MMu_160kph_F TP_U8_dV_MMu_20kph_F TP_U8_dV_MMu_40kph_F TP_U8_dV_MMu_60kph_F TP_U8_dV_MMu_80kph_F TP_U8_dV_Pro_High_Vel_MMu_F /end REF_CHARACTERISTIC
/end GROUP
/begin GROUP a_Mu_Detection ""
 /begin REF_CHARACTERISTIC TP_U8_PULSE_HIGH_MU TP_U8_PULSE_LOW_MED_MU TP_U8_PULSE_LOW_MU TP_U8_PULSE_MEDIUM_MU TP_U8_PULSE_MED_HIGH_MU TP_U8_PULSE_UNDER_LOW_MED_MU /end REF_CHARACTERISTIC
/end GROUP
/begin GROUP a_Mu_Detection_Logic "" /begin REF_CHARACTERISTIC TP_U8_HIGH_MU TP_U8_LOW_MU /end REF_CHARACTERISTIC /end GROUP
/begin GROUP a_Over_Inside_Front_Ctrl ""
 /begin REF_CHARACTERISTIC TP_U8_STB_DMP_MAX_HIGH_OverInF TP_U8_STB_DMP_MAX_LOW_OverInF TP_U8_STB_DMP_MAX_MED_OverInF TP_U8_STB_DMP_MAX_SP_OverInF /end REF_CHARACTERISTIC
/end GROUP
/begin GROUP a_P_gain "" /begin SUB_GROUP a_Pgain_Straight b_Pgain_Hill c_Pgain_Turn /end SUB_GROUP /end GROUP
/begin GROUP a_PgainFactor_Straight ""
 /begin REF_CHARACTERISTIC TP_U8TCSCpPgFac4ASFBCtlSt_F[0] TP_U8TCSCpPgFac4ASFBCtlSt_F[1] TP_U8TCSCpPgFac4ASFBCtlSt_F[2] TP_U8TCSCpPgFac4ASFBCtlSt_F[3] TP_U8TCSCpPgFac4ASFBCtlSt_F[4] TP_U8TCSCpPgFac4ASFBCtlSt_R[0] TP_U8TCSCpPgFac4ASFBCtlSt_R[1] TP_U8TCSCpPgFac4ASFBCtlSt_R[2] TP_U8TCSCpPgFac4ASFBCtlSt_R[3] TP_U8TCSCpPgFac4ASFBCtlSt_R[4] /end REF_CHARACTERISTIC
/end GROUP
/begin GROUP a_Pgain_Straight ""
 /begin REF_CHARACTERISTIC TP_U8TCSCpBsStPG4ASFBCtlN_F[0] TP_U8TCSCpBsStPG4ASFBCtlN_F[1] TP_U8TCSCpBsStPG4ASFBCtlN_F[2] TP_U8TCSCpBsStPG4ASFBCtlN_F[3] TP_U8TCSCpBsStPG4ASFBCtlN_F[4] TP_U8TCSCpBsStPG4ASFBCtlN_R[0] TP_U8TCSCpBsStPG4ASFBCtlN_R[1] TP_U8TCSCpBsStPG4ASFBCtlN_R[2] TP_U8TCSCpBsStPG4ASFBCtlN_R[3] TP_U8TCSCpBsStPG4ASFBCtlN_R[4] TP_U8TCSCpBsStPG4ASFBCtlP_F[0] TP_U8TCSCpBsStPG4ASFBCtlP_F[1] TP_U8TCSCpBsStPG4ASFBCtlP_F[2] TP_U8TCSCpBsStPG4ASFBCtlP_F[3] TP_U8TCSCpBsStPG4ASFBCtlP_F[4] TP_U8TCSCpBsStPG4ASFBCtlP_R[0] TP_U8TCSCpBsStPG4ASFBCtlP_R[1] TP_U8TCSCpBsStPG4ASFBCtlP_R[2] TP_U8TCSCpBsStPG4ASFBCtlP_R[3] TP_U8TCSCpBsStPG4ASFBCtlP_R[4] /end REF_CHARACTERISTIC
/end GROUP
/begin GROUP a_Pulse_down ""
 /begin REF_CHARACTERISTIC TP_S8_Pulse_Down_Gain_Front_Decel TP_S8_Pulse_Down_Gain_Rear_Decel /end REF_CHARACTERISTIC
 /begin SUB_GROUP a_Pulse_down_Gain_per_RoadMu /end SUB_GROUP
/end GROUP
/begin GROUP a_Pulse_down_AB "" /begin SUB_GROUP a_Front_Pulse_down_LMu_AB b_Rear_Pulse_down_LMu_AB /end SUB_GROUP /end GROUP
/begin GROUP a_Pulse_down_Gain_per_RoadMu ""
 /begin SUB_GROUP a_Before_AFZ_OK_Gain_Front b_Before_AFZ_OK_Gain_Rear c_High_Mu_Gain_Front d_High_Mu_Gain_Rear e_Medium_Mu_Gain_Front f_Medium_Mu_Gain_Rear g_LowMed_Mu_Gain_Front h_LowMed_Mu_Gain_Rear i_Low_Mu_Gain_Front j_Low_Mu_Gain_Rear k_Split_HighSide_Gain_Front /end SUB_GROUP
/end GROUP
/begin GROUP a_Pulse_down_Logic "" /begin SUB_GROUP a_First_Cycle_Adaptation b_Dump_Factor /end SUB_GROUP /end GROUP
/begin GROUP a_Release_detect ""
 /begin REF_CHARACTERISTIC TP_S8_DetectAccel_Reset_EngTorq TP_S8_DetectAccel_Reset_Throttle /end REF_CHARACTERISTIC
/end GROUP
/begin GROUP a_RiseHold_YDF_Ref ""
 /begin REF_CHARACTERISTIC TP_S16_NEED_INC_PRESS_YDF_L1 TP_S16_NEED_INC_PRESS_YDF_L2 TP_S16_YDF_RISEHOLD_T_MAX_YDF /end REF_CHARACTERISTIC
/end GROUP
/begin GROUP a_Rough_Road_Detection ""
 /begin REF_CHARACTERISTIC TP_S8_Counter_threshold_Lower_Lim_F TP_S8_Counter_threshold_Lower_Lim_R TP_S8_Counter_threshold_Upper_Lim_F TP_S8_Counter_threshold_Upper_Lim_R TP_S8_Rough_road_detector_F_level0 TP_S8_Rough_road_detector_F_level1 TP_S8_Rough_road_detector_F_level2 TP_S8_Rough_road_detector_R_level0 TP_S8_Rough_road_detector_R_level1 TP_S8_Rough_road_detector_R_level2 /end REF_CHARACTERISTIC
 /begin SUB_GROUP a_Speed_Gain_Set /end SUB_GROUP
/end GROUP
/begin GROUP a_SclFctTrq2PresFrt "" /begin REF_CHARACTERISTIC TP_U8TCSCpSclFctTrq2PresFrt TP_U8TCSCpSclFctTrq2PresRer /end REF_CHARACTERISTIC /end GROUP
/begin GROUP a_Set_Del_Yaw_Offset "" /begin SUB_GROUP a_Set_Target_Del_Yaw b_Set_Target_Del_Yaw_2 /end SUB_GROUP /end GROUP
/begin GROUP a_Set_Target_Del_Yaw ""
 /begin REF_CHARACTERISTIC TP_S16_DEFAULT_TARGET_dYAW_SPEED_H TP_S16_DEFAULT_TARGET_dYAW_SPEED_L TP_S16_DEFAULT_TARGET_dYAW_SPEED_M TP_S16_LMu_TARGET_dYAW_SPEED_H TP_S16_LMu_TARGET_dYAW_SPEED_L TP_S16_LMu_TARGET_dYAW_SPEED_M TP_S16_SPLIT_TARGET_dYAW_SPEED_H TP_S16_SPLIT_TARGET_dYAW_SPEED_L TP_S16_SPLIT_TARGET_dYAW_SPEED_M /end REF_CHARACTERISTIC
/end GROUP
/begin GROUP a_Speed_Gain_Set ""
 /begin REF_CHARACTERISTIC TP_U8_ROUGH_SPEED_LEVEL1 TP_U8_ROUGH_SPEED_LEVEL2 TP_U8_ROUGH_THRES_GAIN_LEVEL2 TP_U8_ROUGH_THRES_GAIN_LEVEL2_R /end REF_CHARACTERISTIC
/end GROUP
/begin GROUP a_Split_Lowside_DumpScantime "" /begin REF_CHARACTERISTIC TP_U8_SP_LOW_FRT_DUMPTIM_AFZ TP_U8_SP_LOW_RER_DUMPTIM_AFZ /end REF_CHARACTERISTIC /end GROUP
/begin GROUP a_Split_Mu_HighSide_Front ""
 /begin REF_CHARACTERISTIC TP_U8_DV_BASE_PRO_FOR_GMA_WL TP_U8_GMA_WL_DV_SET_COUNTER_REF TP_U8_dV_Pro_High_Vel_SpMu_F TP_U8_dV_SpMu_100kph_F TP_U8_dV_SpMu_10kph_F TP_U8_dV_SpMu_20kph_F TP_U8_dV_SpMu_40kph_F TP_U8_dV_SpMu_60kph_F TP_U8_dV_SpMu_80kph_F /end REF_CHARACTERISTIC
/end GROUP
/begin GROUP a_SsmDetn ""
 /begin SUB_GROUP aa_SSM_BrkgStsDetn ab_SSM_DrvAIntend ac_SSM_HoldPCalc ad_SSM_ReBrkgChk ae_SSM_RoadGrdtDetn af_SSM_Control af_SSM_TrsmInfoDetn ag_SSM_VehSpdDetn /end SUB_GROUP
/end GROUP
/begin GROUP a_Steady_State_Condition ""
 /begin REF_CHARACTERISTIC TP_S16_CBC_STEADY_MAX_ACCEL TP_S16_CBC_STEADY_MAX_DECEL TP_S8_CBC_WHEEL_SPIN_OK_LEVEL /end REF_CHARACTERISTIC
/end GROUP
/begin GROUP a_TargetSpin_Straight ""
 /begin REF_CHARACTERISTIC TP_U8TCSCpBaseTarWhlSpinDiff[0] TP_U8TCSCpBaseTarWhlSpinDiff[1] TP_U8TCSCpBaseTarWhlSpinDiff[2] TP_U8TCSCpBaseTarWhlSpinDiff[3] TP_U8TCSCpBaseTarWhlSpinDiff[4] /end REF_CHARACTERISTIC
/end GROUP
/begin GROUP a_Unstable_Rise_Thresholds ""
 /begin SUB_GROUP a_BF_AFZOK_UR_Thres b_High_Mu_UR_Thres c_Med_High_Mu_UR_Thres d_Medium_Mu_UR_Thres e_Low_Med_Mu_UR_Thres f_Under_Low_Med_Mu_UR_Thres g_Low_Mu_UR_Thres h_Split_Mu_UR_Thres /end SUB_GROUP
/end GROUP
/begin GROUP a_Vibration ""
 /begin REF_CHARACTERISTIC TP_S16FFBrkTorqReduce4Vibration TP_S16TCSCpBrkCtlTrqAddInVIB TP_U8_TCS_VIB_AMPLITUDE_ENTER TP_U8_TCS_VIB_AMPLITUDE_OUT TP_U8_TCS_VIB_BRK_CTL_PERIOD TP_U8_TCS_VIB_CNT_SCAN TP_U8_TCS_VIB_FLAG_ENTER_CYCLE TP_U8_TCS_VIB_FLAG_OUT_CYCLE TP_U8_TCS_VIB_FREQUENCY_ENTER TP_U8_TCS_VIB_FREQUENCY_OUT TP_U8_TCS_VIB_FREQUENCY_THR TP_U8_TCS_VIB_OVERFLOW_SCAN TP_U8_TCS_VIB_REFERENCE_VREF_ENTER TP_U8_TCS_VIB_REFERENCE_VREF_OUT TP_U8_TCS_VIB_TIMESHIFT_SCAN_TCMF /end REF_CHARACTERISTIC
/end GROUP
/begin GROUP a_WpeBrkVolumeFront ""
 /begin REF_CHARACTERISTIC S16_WPE_Caliper_Model_Volume_No_f S16_WPE_Caliper_Model_Volume_f_1 S16_WPE_Caliper_Model_Volume_f_10 S16_WPE_Caliper_Model_Volume_f_11 S16_WPE_Caliper_Model_Volume_f_12 S16_WPE_Caliper_Model_Volume_f_13 S16_WPE_Caliper_Model_Volume_f_14 S16_WPE_Caliper_Model_Volume_f_15 S16_WPE_Caliper_Model_Volume_f_16 S16_WPE_Caliper_Model_Volume_f_2 S16_WPE_Caliper_Model_Volume_f_3 S16_WPE_Caliper_Model_Volume_f_4 S16_WPE_Caliper_Model_Volume_f_5 S16_WPE_Caliper_Model_Volume_f_6 S16_WPE_Caliper_Model_Volume_f_7 S16_WPE_Caliper_Model_Volume_f_8 S16_WPE_Caliper_Model_Volume_f_9 /end REF_CHARACTERISTIC
/end GROUP
/begin GROUP a_WpeLfcEscMpRise ""
 /begin REF_CHARACTERISTIC S16_WPE_LFC_ESC_MP_Rise_Gain_f_1st S16_WPE_LFC_ESC_MP_Rise_Gain_f_2nd S16_WPE_LFC_ESC_MP_Rise_Gain_f_3rd S16_WPE_LFC_ESC_MP_Rise_Gain_f_4th S16_WPE_LFC_ESC_MP_Rise_Gain_f_5th S16_WPE_LFC_ESC_MP_Rise_Gain_f_6th S16_WPE_LFC_ESC_MP_Rise_Gain_r_1st S16_WPE_LFC_ESC_MP_Rise_Gain_r_2nd S16_WPE_LFC_ESC_MP_Rise_Gain_r_3rd S16_WPE_LFC_ESC_MP_Rise_Gain_r_4th S16_WPE_LFC_ESC_MP_Rise_Gain_r_5th S16_WPE_LFC_ESC_MP_Rise_Gain_r_6th U8_WPE_LFC_ESC_MP_Rise_Duty_f_1st U8_WPE_LFC_ESC_MP_Rise_Duty_f_2nd U8_WPE_LFC_ESC_MP_Rise_Duty_f_3rd U8_WPE_LFC_ESC_MP_Rise_Duty_f_4th U8_WPE_LFC_ESC_MP_Rise_Duty_f_5th U8_WPE_LFC_ESC_MP_Rise_Duty_f_6th U8_WPE_LFC_ESC_MP_Rise_Duty_r_1st U8_WPE_LFC_ESC_MP_Rise_Duty_r_2nd U8_WPE_LFC_ESC_MP_Rise_Duty_r_3rd U8_WPE_LFC_ESC_MP_Rise_Duty_r_4th U8_WPE_LFC_ESC_MP_Rise_Duty_r_5th U8_WPE_LFC_ESC_MP_Rise_Duty_r_6th /end REF_CHARACTERISTIC
/end GROUP
/begin GROUP a_WpeNcDumpFront ""
 /begin REF_CHARACTERISTIC S16_WPE_NC_Dump_Gain_Press_f_1st S16_WPE_NC_Dump_Gain_Press_f_2nd S16_WPE_NC_Dump_Gain_Press_f_3rd S16_WPE_NC_Dump_Gain_Press_f_4th S16_WPE_NC_Dump_Gain_Press_f_5th S16_WPE_NC_Dump_Gain_Press_f_6th S16_WPE_NC_Dump_Gain_f_1st S16_WPE_NC_Dump_Gain_f_2nd S16_WPE_NC_Dump_Gain_f_3rd S16_WPE_NC_Dump_Gain_f_4th S16_WPE_NC_Dump_Gain_f_5th S16_WPE_NC_Dump_Gain_f_6th /end REF_CHARACTERISTIC
/end GROUP
/begin GROUP a_WpeTcDumpFront ""
 /begin REF_CHARACTERISTIC S16_WPE_TC_Dump_Gain_Press_f_1st S16_WPE_TC_Dump_Gain_Press_f_2nd S16_WPE_TC_Dump_Gain_Press_f_3rd S16_WPE_TC_Dump_Gain_Press_f_4th S16_WPE_TC_Dump_Gain_Press_f_5th S16_WPE_TC_Dump_Gain_Press_f_6th S16_WPE_TC_Dump_Gain_f_1st S16_WPE_TC_Dump_Gain_f_2nd S16_WPE_TC_Dump_Gain_f_3rd S16_WPE_TC_Dump_Gain_f_4th S16_WPE_TC_Dump_Gain_f_5th S16_WPE_TC_Dump_Gain_f_6th /end REF_CHARACTERISTIC
/end GROUP
/begin GROUP a_dV_Common ""
 /begin REF_CHARACTERISTIC TP_S8_dV_F_slip_after_ABS_fz TP_U8_dV_Higher_Limit_F TP_U8_dV_Higher_Limit_R /end REF_CHARACTERISTIC
/end GROUP
/begin GROUP aa_EBP_Activation ""
 /begin REF_CHARACTERISTIC LPC_S16_EBP_TARGET_PRESS LPC_U8_EBP_APPLY_TIME LPC_U8_EBP_ENABLE_TIME_THR /end REF_CHARACTERISTIC
/end GROUP
/begin GROUP aa_Roll_Detection ""
 /begin REF_CHARACTERISTIC SSM_S16_ROLL_RISE_PRESSURE SSM_U8_MAX_ROLL_RISE_ATTEMPT SSM_U8_ROLL_RISE_TIME /end REF_CHARACTERISTIC
/end GROUP
/begin GROUP aa_SSM_BrkgStsDetn "" /begin REF_CHARACTERISTIC SSM_S16_SSM_MAX_MP_OFFSET_BLS_FAIL /end REF_CHARACTERISTIC /end GROUP
/begin GROUP ab_EBP_Enter ""
 /begin REF_CHARACTERISTIC LPC_U8_EBP_ENTER_MPRESS LPC_U8_EBP_ENTER_SPEED LPC_U8_EBP_MTP_DIFF_LV1 LPC_U8_EBP_MTP_DIFF_LV2 LPC_U8_EBP_MTP_DIFF_LV3 /end REF_CHARACTERISTIC
/end GROUP
/begin GROUP ab_Max_Activation_Time ""
 /begin REF_CHARACTERISTIC SSM_S16_ADD_ACT_TIME_NO_ACT_EPB SSM_S16_AUTO_PAUSE_TIME SSM_S16_AVH_IGN_DECOUNT_CYCLE SSM_S16_AVH_RECOVERY_IGN_CNT_REF SSM_S16_MAX_ON_TIME_ONE_CYCLE SSM_S16_MAX_ON_TIME_ONE_CYCLE_AUTO SSM_S16_MAX_ON_TIME_ONE_IGN SSM_S16_MAX_ON_TIME_ONE_IGN_AUTO /end REF_CHARACTERISTIC
/end GROUP
/begin GROUP ab_SSM_DrvAIntend "" /begin REF_CHARACTERISTIC SSM_S16_SSM_ACC_PEDAL_ON_MIN_TH /end REF_CHARACTERISTIC /end GROUP
/begin GROUP ac_EBP_Exit "" /begin REF_CHARACTERISTIC LPC_U8_EBP_EXIT_MPRESS LPC_U8_EBP_EXIT_MTP /end REF_CHARACTERISTIC /end GROUP
/begin GROUP ac_Max_Slope ""
 /begin REF_CHARACTERISTIC SSM_S16_EPB_ACT_DELAY_MAXHILL SSM_S8_AVH_ACT_MAX_GRADE_DW SSM_U8_AVH_ACT_MAX_GRADE /end REF_CHARACTERISTIC
/end GROUP
/begin GROUP ac_SSM_HoldPCalc ""
 /begin REF_CHARACTERISTIC SSM_S16_SSM_HOLD_PRESS_SAFETY_MARGIN SSM_S16_SSM_MAX_PRESS_SLOP SSM_S16_SSM_MIN_CTRL_PRESS SSM_S16_SSM_MIN_CTRL_PRESS_F_N_HM SSM_S16_SSM_MIN_CTRL_PRESS_F_N_LM SSM_S16_SSM_MIN_CTRL_PRESS_F_N_MAX SSM_S16_SSM_MIN_CTRL_PRESS_F_P_HM SSM_S16_SSM_MIN_CTRL_PRESS_F_P_LM SSM_S16_SSM_MIN_CTRL_PRESS_F_P_MAX SSM_S16_SSM_MIN_CTRL_PRESS_HM SSM_S16_SSM_MIN_CTRL_PRESS_LM SSM_S16_SSM_MIN_CTRL_PRESS_MAX SSM_S16_SSM_MIN_CTRL_PRESS_R_N_HM SSM_S16_SSM_MIN_CTRL_PRESS_R_N_LM SSM_S16_SSM_MIN_CTRL_PRESS_R_N_MAX SSM_S16_SSM_MIN_CTRL_PRESS_R_P_HM SSM_S16_SSM_MIN_CTRL_PRESS_R_P_LM SSM_S16_SSM_MIN_CTRL_PRESS_R_P_MAX SSM_S16_SSM_MIN_PRESS_SLOP SSM_S16_SSM_VV_ACT_COMP_MAX_P_SLP SSM_S16_SSM_VV_ACT_COMP_MIN_P_SLP SSM_U16_SSM_WHEEL_RADIUS SSM_U8_SSM_CALC_MIN_PRESS_METHOD /end REF_CHARACTERISTIC
/end GROUP
/begin GROUP ad_AVH_Logic_Tuning ""
 /begin REF_CHARACTERISTIC SSM_S16_AVH_ALARM_TIME_EPB_OK SSM_S16_AVH_ALARM_TIME_INBIT_SW_OFF SSM_S16_AVH_ALARM_TIME_INBIT_SW_ON SSM_S16_AVH_APPLY_TIME_1ST_REF_P SSM_S16_AVH_APPLY_TIME_2ND_REF_P SSM_S16_AVH_APPLY_TIME_3RD_REF_P SSM_S16_AVH_APPLY_TIME_4TH_REF_P SSM_S16_AVH_APPLY_TIME_5TH_REF_P SSM_U8_AVH_APPLY_TIME_1ST SSM_U8_AVH_APPLY_TIME_1ST_MIN SSM_U8_AVH_APPLY_TIME_2ND SSM_U8_AVH_APPLY_TIME_2ND_MIN SSM_U8_AVH_APPLY_TIME_3RD SSM_U8_AVH_APPLY_TIME_3RD_MIN SSM_U8_AVH_APPLY_TIME_4TH SSM_U8_AVH_APPLY_TIME_4TH_MIN SSM_U8_AVH_APPLY_TIME_5TH SSM_U8_AVH_APPLY_TIME_5TH_MIN /end REF_CHARACTERISTIC
/end GROUP
/begin GROUP ad_SSM_ReBrkgChk "" /begin REF_CHARACTERISTIC SSM_S16_SSM_REBRAKE_DCT_THRESHOLD /end REF_CHARACTERISTIC /end GROUP
/begin GROUP ae_AVH_etc ""
 /begin REF_CHARACTERISTIC SSM_S16_AVH_ABNORMAL_HOLD_TIME SSM_S16_AVH_FAST_EXIT_MTP_TH /end REF_CHARACTERISTIC
/end GROUP
/begin GROUP ae_SSM_RoadGrdtDetn ""
 /begin REF_CHARACTERISTIC SSM_S16_SSM_AX_DIFF_FOR_DIVE_DETECT SSM_S16_SSM_AX_DIFF_LOW_REF SSM_S16_SSM_AX_DIFF_MAX_REF SSM_S16_SSM_AX_DIFF_MED_REF SSM_U8_SSM_AX_AVG_VALID_TH_LOW_DIF SSM_U8_SSM_AX_AVG_VALID_TH_MAX_DIF SSM_U8_SSM_AX_AVG_VALID_TH_MID_DIF /end REF_CHARACTERISTIC
/end GROUP
/begin GROUP af_SSM_Control ""
 /begin REF_CHARACTERISTIC SSM_S16_SSM_MAX_EXIT_TORQUE SSM_U8_SSM_EXIT_DRV_TQ_GAIN SSM_U8_SSM_HIGH_MID_SLOP SSM_U8_SSM_H_M_ACC_POSITION SSM_U8_SSM_H_M_ACC_RELS_TIME_DWN SSM_U8_SSM_H_M_ACC_RELS_TIME_UP SSM_U8_SSM_H_M_SLOP_RELEASE_TIME SSM_U8_SSM_LOW_MID_SLOP SSM_U8_SSM_L_M_ACC_POSITION SSM_U8_SSM_L_M_ACC_RELS_TIME_DWN SSM_U8_SSM_L_M_ACC_RELS_TIME_UP SSM_U8_SSM_L_M_SLOP_RELEASE_TIME SSM_U8_SSM_MAX_ACC_POSITION SSM_U8_SSM_MAX_ACC_RELS_TIME_DWN SSM_U8_SSM_MAX_ACC_RELS_TIME_UP SSM_U8_SSM_MAX_SLOP SSM_U8_SSM_MAX_SLOP_RELEASE_TIME SSM_U8_SSM_MIN_ACC_POSITION SSM_U8_SSM_MIN_ACC_RELS_TIME_DWN SSM_U8_SSM_MIN_ACC_RELS_TIME_UP SSM_U8_SSM_MIN_SLOP SSM_U8_SSM_MIN_SLOP_RELEASE_TIME /end REF_CHARACTERISTIC
/end GROUP
/begin GROUP af_SSM_TrsmInfoDetn ""
 /begin REF_CHARACTERISTIC SSM_U8_SSM_AT_PARK_GEAR_DELAY_TIME SSM_U8_SSM_AX_IGNORE_TIME_TM_SHIFT /end REF_CHARACTERISTIC
/end GROUP
/begin GROUP ag_SSM_VehSpdDetn ""
 /begin REF_CHARACTERISTIC SSM_S16_SSM_MIN_WH_SPEED SSM_S16_SSM_MOVING_DETECT_CYCLE SSM_S16_SSM_SPIN_DETECTION_TH SSM_S16_SSM_STOP_DETECT_MAX_SPD SSM_U8_SSM_DLY_ROLL_DET_TIME SSM_U8_SSM_ROLL_TH_FOR_EPB_ACT SSM_U8_SSM_ROLL_TH_FOR_RISE /end REF_CHARACTERISTIC
/end GROUP
/begin GROUP b.EHC_Enter_Exit ""
 /begin REF_CHARACTERISTIC TQS16_EHC_Alatm_Enter TQS16_EHC_Alatm_Exit TQS16_EHC_DYaw1st_Enter_SPD TQS16_EHC_DYaw1st_Exit_SPD TQS16_EHC_ENTER_STEER TQS16_EHC_Enter_SPD TQS16_EHC_Exit_SPD TQS16_EHC_WSTR_MAX_ALAT_G /end REF_CHARACTERISTIC
 /begin SUB_GROUP ba.EHC_Wstr_Dot bb.EHC_Yaw_Dot bc.EHC_Wstr_Peak bc.EHC_Yaw_Peak bd.EHC_Steer_Enter /end SUB_GROUP
/end GROUP
/begin GROUP b.Override "" /begin SUB_GROUP ba.TC_Override bb.Motor_Override /end SUB_GROUP /end GROUP
/begin GROUP b.Rop_Enter_Exit ""
 /begin REF_CHARACTERISTIC TQS16_DYN_WSTR_DOT_MIN TQS16_RI_THRES TQS16_ROP_BANK_DET_RI_WEG TQS16_ROP_BANK_SUS_RI_WEG TQS16_ROP_PRE_FRT_ENT_WSTR_TH TQS16_SS_WSTR_DOT_MAX TQS16_TTL_max TQS16_TTL_min TQS16_TTL_thres /end REF_CHARACTERISTIC
 /begin SUB_GROUP Rop_Wstr_Dot Rop_Yaw_Dot ba.Rop_SS_Th bb.Rop_DYN_Th bc.Rop_Alat_Th bd.Rop_RI_Thres /end SUB_GROUP
/end GROUP
/begin GROUP b.TVBB_Enter_Exit ""
 /begin REF_CHARACTERISTIC TQGEAR_POS_TM_R TQS16_TVBB_AYC_TH TQS16_TVBB_DELTA_YAW_TH_EXTI TQS16_TVBB_DEL_YAW_INHIBIT_TH_ENTER TQS16_TVBB_DEL_YAW_INHIBIT_TH_EXIT TQS16_TVBB_ENTER_ALATM_TH_HSP TQS16_TVBB_ENTER_ALATM_TH_LSP TQS16_TVBB_ENTER_ALATM_TH_MSP TQS16_TVBB_ENTER_MOMENT TQS16_TVBB_ENTER_TH_REF_HSP TQS16_TVBB_ENTER_TH_REF_LSP TQS16_TVBB_ENTER_TH_REF_MSP TQS16_TVBB_EXIT_MOMENT TQS16_TVBB_SPD_MIN TQS8_TVBB_INHIBIT_WH_SLIP_HSP TQS8_TVBB_INHIBIT_WH_SLIP_LSP TQS8_TVBB_INHIBIT_WH_SLIP_MSP TQU8_TVBB_ACT_IN_ETCS TQU8_TVBB_APS_TH TQU8_TVBB_TURN_INTENT_DCT_TIME /end REF_CHARACTERISTIC
 /begin SUB_GROUP ba.TVBB_Enter_Speed bb.TVBB_Enter_DelYaw bbb.TVBB_Enter_DelYaw bc.TVBB_Enter_Slip /end SUB_GROUP
/end GROUP
/begin GROUP b_1stCycle_UR_Time ""
 /begin REF_CHARACTERISTIC TP_U8_1stDPRisePerDumpRatio_HMu_F TP_U8_1stDPRisePerDumpRatio_HMu_R TP_U8_1stDPRisePerDumpRatio_LMu_F TP_U8_1stDPRisePerDumpRatio_LMu_R TP_U8_1stDPRisePerDumpRatio_MMu_F TP_U8_1stDPRisePerDumpRatio_MMu_R TP_U8_MIN_DP_RISE_FOR_BUMP_OR_WA TP_U8_MIN_INIT_dP_RISE_AT_LOW_MP_F TP_U8_MIN_INIT_dP_RISE_AT_LOW_MP_R /end REF_CHARACTERISTIC
/end GROUP
/begin GROUP b_20_40KPH ""
 /begin REF_CHARACTERISTIC TP_S8_Arad_1stPoint_20_40KPH TP_S8_Arad_2ndPoint_20_40KPH TP_S8_Arad_3rdPoint_20_40KPH TP_S8_Arad_Fact_1_2P_20_40KPH TP_S8_Arad_Fact_2_3P_20_40KPH TP_S8_Arad_Fact_Ab_3P_20_40KPH TP_S8_Arad_Fact_B_1P_20_40KPH /end REF_CHARACTERISTIC
/end GROUP
/begin GROUP b_ABS_Bump_detection_2 ""
 /begin REF_CHARACTERISTIC TP_S8_BMP_SUS_ARAD_GAUGE_THRES_F1 TP_S8_BMP_SUS_ARAD_GAUGE_THRES_F2 TP_S8_BMP_SUS_ARAD_GAUGE_THRES_R1 TP_S8_BMP_SUS_ARAD_GAUGE_THRES_R2 TP_S8_BMP_SUS_ARAD_THRES_F1 TP_S8_BMP_SUS_ARAD_THRES_F2 TP_S8_BMP_SUS_ARAD_THRES_R1 TP_S8_BMP_SUS_ARAD_THRES_R2 /end REF_CHARACTERISTIC
/end GROUP
/begin GROUP b_AVH ""
 /begin SUB_GROUP ba_AVH_Fast_Exit bb_AVH_Sensitive_Enter bc_AVH_Cal_Idle_Torq bd_AVH_Reserved /end SUB_GROUP
/end GROUP
/begin GROUP b_Asymmetric_Driveline_Protect ""
 /begin REF_CHARACTERISTIC TP_S16TCSCpThOfWhlSpnDiffDPInSt[0] TP_S16TCSCpThOfWhlSpnDiffDPInSt[1] TP_S16TCSCpThOfWhlSpnDiffDPInSt[2] TP_S16TCSCpThOfWhlSpnDiffDPInSt[3] TP_S16TCSCpThOfWhlSpnDiffDPInSt[4] /end REF_CHARACTERISTIC
/end GROUP
/begin GROUP b_Ay_Reliability_Check ""
 /begin REF_CHARACTERISTIC TP_S16_CBC_AY_ERROR_CHECK_TIME TP_S16_CBC_AY_ERROR_DET_LEVEL TP_S16_CBC_AY_ERROR_SUS_LEVEL TP_S16_CBC_AY_OK_CHECK_TIME /end REF_CHARACTERISTIC
/end GROUP
/begin GROUP b_BDW "" /begin SUB_GROUP ba_BDW_Enter bb_BDW_Activation bc_BDW_Exit bd_BDW_Reserved /end SUB_GROUP /end GROUP
/begin GROUP b_BF_AFZ_OK_Rear ""
 /begin REF_CHARACTERISTIC TP_U8_High_Vel_dV_Pro_BF_AFZOK_R TP_U8_dV_BF_AFZOK_100kph_R TP_U8_dV_BF_AFZOK_10kph_R TP_U8_dV_BF_AFZOK_120kph_R TP_U8_dV_BF_AFZOK_140kph_R TP_U8_dV_BF_AFZOK_160kph_R TP_U8_dV_BF_AFZOK_20kph_R TP_U8_dV_BF_AFZOK_40kph_R TP_U8_dV_BF_AFZOK_60kph_R TP_U8_dV_BF_AFZOK_80kph_R /end REF_CHARACTERISTIC
/end GROUP
/begin GROUP b_BaseTorque_Hill ""
 /begin REF_CHARACTERISTIC TP_U8TCSCpBsAsmdMuDiffHill_F[0] TP_U8TCSCpBsAsmdMuDiffHill_F[1] TP_U8TCSCpBsAsmdMuDiffHill_F[2] TP_U8TCSCpBsAsmdMuDiffHill_F[3] TP_U8TCSCpBsAsmdMuDiffHill_F[4] TP_U8TCSCpBsAsmdMuDiffHill_R[0] TP_U8TCSCpBsAsmdMuDiffHill_R[1] TP_U8TCSCpBsAsmdMuDiffHill_R[2] TP_U8TCSCpBsAsmdMuDiffHill_R[3] TP_U8TCSCpBsAsmdMuDiffHill_R[4] /end REF_CHARACTERISTIC
/end GROUP
/begin GROUP b_Before_AFZ_OK_Gain_Rear ""
 /begin REF_CHARACTERISTIC TP_S16_Decel_Gain_BFAFZOK_100_150_R TP_S16_Decel_Gain_BFAFZOK_10_20_R TP_S16_Decel_Gain_BFAFZOK_20_40_R TP_S16_Decel_Gain_BFAFZOK_40_60_R TP_S16_Decel_Gain_BFAFZOK_60_100_R TP_S16_Decel_Gain_BFAFZOK_Ab_150_R TP_S16_Decel_Gain_BFAFZOK_B_10_R TP_S16_Slip_Gain_BFAFZOK_100_150_R TP_S16_Slip_Gain_BFAFZOK_10_20_R TP_S16_Slip_Gain_BFAFZOK_20_40_R TP_S16_Slip_Gain_BFAFZOK_40_60_R TP_S16_Slip_Gain_BFAFZOK_60_100_R TP_S16_Slip_Gain_BFAFZOK_Ab_150_R TP_S16_Slip_Gain_BFAFZOK_B_10_R /end REF_CHARACTERISTIC
/end GROUP
/begin GROUP b_Both_Over_R ""
 /begin REF_CHARACTERISTIC TP_U8_STB_DMP_MAX_HIGH_BothOverInR TP_U8_STB_DMP_MAX_LOW_BothOverInR TP_U8_STB_DMP_MAX_MED_BothOverInR TP_U8_STB_DMP_MAX_SP_BothOverInR /end REF_CHARACTERISTIC
/end GROUP
/begin GROUP b_BrkPGrdtLim "" /begin SUB_GROUP Hill Hill_Initial Normal Normal_Initial SteepReduction VCA /end SUB_GROUP /end GROUP
/begin GROUP b_CBC ""
 /begin SUB_GROUP a_CBC_Enter_Thres b_CBC_Exit_Thres c_CBC_Control_Ay_Level d_CBC_Control_Delta_P e_CBC_Control_Valve f_CBC_Fade_Out g_CBC_Front_Thres h_CBC_Front_Delta_P i_CBC_Rear_Slip_Control /end SUB_GROUP
/end GROUP
/begin GROUP b_CBC_Abs ""
 /begin SUB_GROUP a_CBC_abs_Enter_Thres b_CBC_abs_Exit_Thres c_CBC_abs_Control_Delta_P d_CBC_abs_Control_Valve e_CBC_abs_Fade_Out f_CBC_abs_Est_Pressure g_CBC_abs_Est_Ay h_CBC_abs_Ay_Reliability i_CBC_abs_Rear_Slip_Control /end SUB_GROUP
/end GROUP
/begin GROUP b_CBC_Enter_Arad_Thres ""
 /begin REF_CHARACTERISTIC TP_S8_CBC_ARAD_THRES_COMP_H TP_S8_CBC_ARAD_THRES_COMP_M TP_S8_CBC_ARAD_THRES_H TP_S8_CBC_ARAD_THRES_L TP_S8_CBC_ARAD_THRES_M /end REF_CHARACTERISTIC
/end GROUP
/begin GROUP b_CBC_Exit_Thres "" /begin REF_CHARACTERISTIC TP_S16_CBC_ALAT_EXIT TP_S16_CBC_MPRESS_EXIT /end REF_CHARACTERISTIC /end GROUP
/begin GROUP b_CBC_abs_Exit_Thres "" /begin REF_CHARACTERISTIC TP_S16_CBC_ALAT_EXIT_ABS TP_S16_CBC_MPRESS_EXIT_ABS /end REF_CHARACTERISTIC /end GROUP
/begin GROUP b_Del_Yaw_Gain ""
 /begin REF_CHARACTERISTIC TP_S8_HOMO_dYAW_ABS_GAIN TP_S8_HOMO_dYAW_DOT_ABS_GAIN TP_S8_SPLIT_dYAW_ABS_GAIN_1 TP_S8_SPLIT_dYAW_ABS_GAIN_2 TP_S8_SPLIT_dYAW_DOT_ABS_GAIN_1 TP_S8_SPLIT_dYAW_DOT_ABS_GAIN_2 /end REF_CHARACTERISTIC
/end GROUP
/begin GROUP b_DumpHold_Rate ""
 /begin REF_CHARACTERISTIC TP_U8_YDF_DUMPHOLD_T_AT_DEC_L1 TP_U8_YDF_DUMPHOLD_T_AT_DEC_L2 TP_U8_YDF_DUMPHOLD_T_AT_DEC_L3 TP_U8_YDF_DUMPHOLD_T_MAX /end REF_CHARACTERISTIC
/end GROUP
/begin GROUP b_Dump_Factor ""
 /begin REF_CHARACTERISTIC TP_S16_High_dump_factor_Lower_Limit TP_S16_High_dump_factor_Numerator TP_S16_High_dump_factor_Upper_Limit TP_U8_Max_hold_scan_ref /end REF_CHARACTERISTIC
/end GROUP
/begin GROUP b_Dump_Rate_Per_YDF "" /begin SUB_GROUP a_DumpHold_YDF_Ref b_DumpHold_Rate /end SUB_GROUP /end GROUP
/begin GROUP b_EBD_Cut_in ""
 /begin SUB_GROUP a_EBD_Cut_in_arad_Thres b_EBD_Cut_in_dV_Thres c_EBD_Cut_in_slip_Thres /end SUB_GROUP
/end GROUP
/begin GROUP b_EBD_Cut_in_dV_Thres ""
 /begin REF_CHARACTERISTIC TP_S8_EBD_Cut_Vdiff_100_150KPH TP_S8_EBD_Cut_Vdiff_20_40KPH TP_S8_EBD_Cut_Vdiff_40_60KPH TP_S8_EBD_Cut_Vdiff_60_100KPH TP_S8_EBD_Cut_Vdiff_Ab_150KPH TP_S8_EBD_Cut_Vdiff_B_20KPH /end REF_CHARACTERISTIC
/end GROUP
/begin GROUP b_EBD_Dump_Threshold "" /begin REF_CHARACTERISTIC TP_S16_EBD_Dump_HDF_ref TP_S16_EBD_Hold_Dump_ref /end REF_CHARACTERISTIC /end GROUP
/begin GROUP b_EBD_Reapply_Hold_Scans "" /begin REF_CHARACTERISTIC TP_U8_EBD_HOLD_TIMER TP_U8_EBD_STANDSTILL_HOLD_TIME /end REF_CHARACTERISTIC /end GROUP
/begin GROUP b_Factor_for_arad ""
 /begin SUB_GROUP a_Below_20KPH b_20_40KPH c_40_60KPH d_60_100KPH e_100_150KPH f_Above_150KPH /end SUB_GROUP
/end GROUP
/begin GROUP b_Fadeout_straight_RA ""
 /begin REF_CHARACTERISTIC TP_S16TCSCpFadeOutCtrlHghPreSTTh_RA TP_S16TCSCpFadeOutCtrlLowPreSTTh_RA TP_S16TCSCpFadeOutDecTQ4HghPreST_RA TP_S16TCSCpFadeOutDecTQ4LowPreST_RA /end REF_CHARACTERISTIC
/end GROUP
/begin GROUP b_First_Cycle_Low_Ref_Rear ""
 /begin REF_CHARACTERISTIC TP_S16_HDF_REF_LMu_40_60kph_R TP_S16_HDF_REF_LMu_Ab_60kph_R TP_S16_HDF_REF_LMu_B_40kph_R /end REF_CHARACTERISTIC
/end GROUP
/begin GROUP b_Front_slip_0_2_percent ""
 /begin REF_CHARACTERISTIC TP_S8_F_WL_Fact_ASum1G_Slip0_2P TP_S8_F_WL_Fact_ASum3G_Slip0_2P TP_S8_F_WL_Fact_ASumAb3G_Slip0_2P /end REF_CHARACTERISTIC
/end GROUP
/begin GROUP b_GMA_Detection_InABS ""
 /begin REF_CHARACTERISTIC TP_S16_GMA_DCT_SPEED_DIFF_0_50KPH TP_S16_GMA_DCT_SPEED_DIFF_50_70KPH TP_S16_GMA_DCT_SPEED_DIFF_70_90KPH TP_S16_GMA_DCT_SPEED_DIFF_90_M_KPH TP_S8_GMA_DCT_SLIP_DIFF_0_50KPH TP_S8_GMA_DCT_SLIP_DIFF_50_70KPH TP_S8_GMA_DCT_SLIP_DIFF_70_90KPH TP_S8_GMA_DCT_SLIP_DIFF_90_M_KPH /end REF_CHARACTERISTIC
/end GROUP
/begin GROUP b_GMA_Dump_time ""
 /begin REF_CHARACTERISTIC TP_U8_GMA_D_F_H_SPEED TP_U8_GMA_D_F_L_SPEED TP_U8_GMA_D_F_M_SPEED TP_U8_GMA_D_R_H_SPEED TP_U8_GMA_D_R_L_SPEED TP_U8_GMA_D_R_M_SPEED /end REF_CHARACTERISTIC
/end GROUP
/begin GROUP b_GMA_Permit_Speed "" /begin REF_CHARACTERISTIC TP_S16_GMA_ALLOWED_LIMIT_SPEED /end REF_CHARACTERISTIC /end GROUP
/begin GROUP b_H2SP_Detect_2 ""
 /begin REF_CHARACTERISTIC TP_U8_H2SPLIT_SLIP_DIFF TP_U8_H2SPLIT_VDIFF_F1 TP_U8_H2SPLIT_VDIFF_F2 TP_U8_H2SPLIT_VDIFF_R1 TP_U8_H2SPLIT_VDIFF_R2 /end REF_CHARACTERISTIC
/end GROUP
/begin GROUP b_HighMu_R_Dumptime ""
 /begin REF_CHARACTERISTIC TP_U8_1st_Dumpscantime_HMu_HHDF_R TP_U8_1st_Dumpscantime_HMu_LHDF_R TP_U8_1st_Dumpscantime_HMu_MHDF_R /end REF_CHARACTERISTIC
 /begin SUB_GROUP b_Low_Speed_HMu_R /end SUB_GROUP
/end GROUP
/begin GROUP b_High_Mu "" /begin SUB_GROUP a_High_Mu_Front b_High_Mu_Rear /end SUB_GROUP /end GROUP
/begin GROUP b_High_Mu_Rear ""
 /begin REF_CHARACTERISTIC TP_U8_dV_HMu_100kph_R TP_U8_dV_HMu_10kph_R TP_U8_dV_HMu_120kph_R TP_U8_dV_HMu_140kph_R TP_U8_dV_HMu_160kph_R TP_U8_dV_HMu_20kph_R TP_U8_dV_HMu_40kph_R TP_U8_dV_HMu_60kph_R TP_U8_dV_HMu_80kph_R TP_U8_dV_Pro_High_Vel_HMu_R /end REF_CHARACTERISTIC
/end GROUP
/begin GROUP b_High_Mu_UR_Thres "" /begin SUB_GROUP a_Front_H b_Rear_H /end SUB_GROUP /end GROUP
/begin GROUP b_I_gain_Factor "" /begin SUB_GROUP a_IgainFactor_Straight b_IgainFactor_Turn /end SUB_GROUP /end GROUP
/begin GROUP b_IgainFactor_Turn ""
 /begin REF_CHARACTERISTIC TP_U8TCSCpIgainEffPctTurnN_F TP_U8TCSCpIgainEffPctTurnN_R TP_U8TCSCpIgainEffPctTurnP_F TP_U8TCSCpIgainEffPctTurnP_R /end REF_CHARACTERISTIC
/end GROUP
/begin GROUP b_Igain_Hill ""
 /begin REF_CHARACTERISTIC TP_U8TCSCpBsHillIG4ASFBCtl_F[0] TP_U8TCSCpBsHillIG4ASFBCtl_F[1] TP_U8TCSCpBsHillIG4ASFBCtl_F[2] TP_U8TCSCpBsHillIG4ASFBCtl_F[3] TP_U8TCSCpBsHillIG4ASFBCtl_F[4] TP_U8TCSCpBsHillIG4ASFBCtl_R[0] TP_U8TCSCpBsHillIG4ASFBCtl_R[1] TP_U8TCSCpBsHillIG4ASFBCtl_R[2] TP_U8TCSCpBsHillIG4ASFBCtl_R[3] TP_U8TCSCpBsHillIG4ASFBCtl_R[4] /end REF_CHARACTERISTIC
/end GROUP
/begin GROUP b_Inintial_Duty ""
 /begin REF_CHARACTERISTIC TP_S8_Comp_Duty_For_SPHside_F TP_U8_Initial_Duty_Ratio_F TP_U8_Initial_Duty_Ratio_R TP_U8_LFC_Initial_Duty_Comp_Low_F TP_U8_LFC_Initial_Duty_Comp_Low_R /end REF_CHARACTERISTIC
/end GROUP
/begin GROUP b_L2H_Slip_Threshold ""
 /begin REF_CHARACTERISTIC TP_S8_L2H_STABLE_THR_SLIP_F TP_S8_L2H_STABLE_THR_SLIP_F_OPP TP_S8_L2H_STABLE_THR_SLIP_R TP_S8_L2H_STABLE_THR_SLIP_R_OPP TP_S8_L2H_UNSTABLE_THR_SLIP_F TP_S8_L2H_UNSTABLE_THR_SLIP_F_1 TP_S8_L2H_UNSTABLE_THR_SLIP_F_2 TP_S8_L2H_UNSTABLE_THR_SLIP_F_3 TP_S8_L2H_UNSTABLE_THR_SLIP_F_OPP TP_S8_L2H_UNSTABLE_THR_SLIP_R TP_S8_L2H_UNSTABLE_THR_SLIP_R_OPP /end REF_CHARACTERISTIC
/end GROUP
/begin GROUP b_Logic_Tuning ""
 /begin SUB_GROUP a_Mu_Detection_Logic b_dV_Limit_Outside_ABS c_LFC_Logic d_dP_Control_Logic e_GMA_Logic f_Stable_Forced_Hold g_Driver_Accel_Detect h_ABS_Bump_detection i_L2H_Detection j_Wheel_Press_Est_Gain_ABS k_OutABS_YMR l_Pedal_effort_change m_Slight_braking_detection /end SUB_GROUP
/end GROUP
/begin GROUP b_LowMed_Mu_Rear ""
 /begin REF_CHARACTERISTIC TP_U8_dV_LMMu_100kph_R TP_U8_dV_LMMu_10kph_R TP_U8_dV_LMMu_120kph_R TP_U8_dV_LMMu_140kph_R TP_U8_dV_LMMu_160kph_R TP_U8_dV_LMMu_20kph_R TP_U8_dV_LMMu_40kph_R TP_U8_dV_LMMu_60kph_R TP_U8_dV_LMMu_80kph_R TP_U8_dV_Pro_High_Vel_LMMu_R /end REF_CHARACTERISTIC
/end GROUP
/begin GROUP b_Low_Mu_Rear ""
 /begin REF_CHARACTERISTIC TP_U8_dV_LMu_100kph_R TP_U8_dV_LMu_10kph_R TP_U8_dV_LMu_120kph_R TP_U8_dV_LMu_140kph_R TP_U8_dV_LMu_160kph_R TP_U8_dV_LMu_20kph_R TP_U8_dV_LMu_40kph_R TP_U8_dV_LMu_60kph_R TP_U8_dV_LMu_80kph_R TP_U8_dV_Pro_High_Vel_LMu_R /end REF_CHARACTERISTIC
/end GROUP
/begin GROUP b_Low_Speed_HMu_R ""
 /begin REF_CHARACTERISTIC TP_U8_1st_Dumptime_HMu_B_20_R TP_U8_1st_Dumptime_HMu_LHDF_B_20_R /end REF_CHARACTERISTIC
/end GROUP
/begin GROUP b_Med_High_Mu_UR_Time "" /begin SUB_GROUP a_Front_MH_T b_Rear_MH_T /end SUB_GROUP /end GROUP
/begin GROUP b_Med_Speed ""
 /begin REF_CHARACTERISTIC TP_U8_HOLD13 TP_U8_HOLD45 TP_U8_HOLD67 TP_U8_HOLD8 TP_U8_HOLD_0 /end REF_CHARACTERISTIC
/end GROUP
/begin GROUP b_Med_Speed_Reapply_time ""
 /begin REF_CHARACTERISTIC TP_S8_GMA_RiseTime_ML_SPEED_PHASE1 TP_S8_GMA_RiseTime_ML_SPEED_PHASE2 TP_S8_GMA_RiseTime_ML_SPEED_PHASE3 /end REF_CHARACTERISTIC
/end GROUP
/begin GROUP b_Medium_Mu_Rear ""
 /begin REF_CHARACTERISTIC TP_U8_dV_MMu_100kph_R TP_U8_dV_MMu_10kph_R TP_U8_dV_MMu_120kph_R TP_U8_dV_MMu_140kph_R TP_U8_dV_MMu_160kph_R TP_U8_dV_MMu_20kph_R TP_U8_dV_MMu_40kph_R TP_U8_dV_MMu_60kph_R TP_U8_dV_MMu_80kph_R TP_U8_dV_Pro_High_Vel_MMu_R /end REF_CHARACTERISTIC
/end GROUP
/begin GROUP b_Mu_Jump_Detect ""
 /begin REF_CHARACTERISTIC TP_S8_LFC_HIGH_PEAK_ACCEL TP_S8_LFC_MED_PEAK_ACCEL TP_U16_LFC_H2L_UNSTABIL_TIME_H_V TP_U8_LFC_H2L_DUMP_H_V TP_U8_LFC_HIGH_DUMP TP_U8_LFC_HIGH_UNSTABIL_TIME TP_U8_LFC_MED_DUMP TP_U8_LFC_MED_UNSTABIL_TIME /end REF_CHARACTERISTIC
/end GROUP
/end MODULE
/end PROJECT
