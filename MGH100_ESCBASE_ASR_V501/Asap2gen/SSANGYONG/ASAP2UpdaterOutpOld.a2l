ASAP2_VERSION 1 60
/begin PROJECT Master ""
/begin MODULE CPP ""
/begin MOD_COMMON "" BYTE_ORDER MSB_LAST ALIGNMENT_BYTE 1 ALIGNMENT_WORD 1 ALIGNMENT_LONG 1 ALIGNMENT_FLOAT32_IEEE 1 ALIGNMENT_FLOAT64_IEEE 1 ALIGNMENT_INT64 1 /end MOD_COMMON
/begin VARIANT_CODING
 /begin VAR_CHARACTERISTIC TP_U8TCSCpBsHillIG4ASFBCtl_R[4] EngCalVariantCriterion
  /begin VAR_ADDRESS 0x8003A2A6 0x8003B0A6 0x8003BEA6 0x8003CCA6 0x8003DAA6 0x8003E8A6 0x8003F6A6 0x800404A6 0x800412A6 0x800420A6 0x80042EA6 0x80043CA6 0x80044AA6 0x800458A6 0x800466A6 0x800474A6 0x800482A6 0x800490A6 0x80049EA6 0x8004ACA6 0x8004BAA6 0x8004C8A6 0x8004D6A6 0x8004E4A6 /end VAR_ADDRESS
 /end VAR_CHARACTERISTIC
 /begin VAR_CHARACTERISTIC TP_U8TCSCpBsHillPG4ASFBCtlN_F[0] EngCalVariantCriterion
  /begin VAR_ADDRESS 0x8003A2A7 0x8003B0A7 0x8003BEA7 0x8003CCA7 0x8003DAA7 0x8003E8A7 0x8003F6A7 0x800404A7 0x800412A7 0x800420A7 0x80042EA7 0x80043CA7 0x80044AA7 0x800458A7 0x800466A7 0x800474A7 0x800482A7 0x800490A7 0x80049EA7 0x8004ACA7 0x8004BAA7 0x8004C8A7 0x8004D6A7 0x8004E4A7 /end VAR_ADDRESS
 /end VAR_CHARACTERISTIC
 /begin VAR_CHARACTERISTIC TP_U8TCSCpBsHillPG4ASFBCtlN_F[1] EngCalVariantCriterion
  /begin VAR_ADDRESS 0x8003A2A8 0x8003B0A8 0x8003BEA8 0x8003CCA8 0x8003DAA8 0x8003E8A8 0x8003F6A8 0x800404A8 0x800412A8 0x800420A8 0x80042EA8 0x80043CA8 0x80044AA8 0x800458A8 0x800466A8 0x800474A8 0x800482A8 0x800490A8 0x80049EA8 0x8004ACA8 0x8004BAA8 0x8004C8A8 0x8004D6A8 0x8004E4A8 /end VAR_ADDRESS
 /end VAR_CHARACTERISTIC
 /begin VAR_CHARACTERISTIC TP_U8TCSCpBsHillPG4ASFBCtlN_F[2] EngCalVariantCriterion
  /begin VAR_ADDRESS 0x8003A2A9 0x8003B0A9 0x8003BEA9 0x8003CCA9 0x8003DAA9 0x8003E8A9 0x8003F6A9 0x800404A9 0x800412A9 0x800420A9 0x80042EA9 0x80043CA9 0x80044AA9 0x800458A9 0x800466A9 0x800474A9 0x800482A9 0x800490A9 0x80049EA9 0x8004ACA9 0x8004BAA9 0x8004C8A9 0x8004D6A9 0x8004E4A9 /end VAR_ADDRESS
 /end VAR_CHARACTERISTIC
 /begin VAR_CHARACTERISTIC TP_U8TCSCpBsHillPG4ASFBCtlN_F[3] EngCalVariantCriterion
  /begin VAR_ADDRESS 0x8003A2AA 0x8003B0AA 0x8003BEAA 0x8003CCAA 0x8003DAAA 0x8003E8AA 0x8003F6AA 0x800404AA 0x800412AA 0x800420AA 0x80042EAA 0x80043CAA 0x80044AAA 0x800458AA 0x800466AA 0x800474AA 0x800482AA 0x800490AA 0x80049EAA 0x8004ACAA 0x8004BAAA 0x8004C8AA 0x8004D6AA 0x8004E4AA /end VAR_ADDRESS
 /end VAR_CHARACTERISTIC
 /begin VAR_CHARACTERISTIC TP_U8TCSCpBsHillPG4ASFBCtlN_F[4] EngCalVariantCriterion
  /begin VAR_ADDRESS 0x8003A2AB 0x8003B0AB 0x8003BEAB 0x8003CCAB 0x8003DAAB 0x8003E8AB 0x8003F6AB 0x800404AB 0x800412AB 0x800420AB 0x80042EAB 0x80043CAB 0x80044AAB 0x800458AB 0x800466AB 0x800474AB 0x800482AB 0x800490AB 0x80049EAB 0x8004ACAB 0x8004BAAB 0x8004C8AB 0x8004D6AB 0x8004E4AB /end VAR_ADDRESS
 /end VAR_CHARACTERISTIC
 /begin VAR_CHARACTERISTIC TP_U8TCSCpBsHillPG4ASFBCtlN_R[0] EngCalVariantCriterion
  /begin VAR_ADDRESS 0x8003A2AC 0x8003B0AC 0x8003BEAC 0x8003CCAC 0x8003DAAC 0x8003E8AC 0x8003F6AC 0x800404AC 0x800412AC 0x800420AC 0x80042EAC 0x80043CAC 0x80044AAC 0x800458AC 0x800466AC 0x800474AC 0x800482AC 0x800490AC 0x80049EAC 0x8004ACAC 0x8004BAAC 0x8004C8AC 0x8004D6AC 0x8004E4AC /end VAR_ADDRESS
 /end VAR_CHARACTERISTIC
 /begin VAR_CHARACTERISTIC TP_U8TCSCpBsHillPG4ASFBCtlN_R[1] EngCalVariantCriterion
  /begin VAR_ADDRESS 0x8003A2AD 0x8003B0AD 0x8003BEAD 0x8003CCAD 0x8003DAAD 0x8003E8AD 0x8003F6AD 0x800404AD 0x800412AD 0x800420AD 0x80042EAD 0x80043CAD 0x80044AAD 0x800458AD 0x800466AD 0x800474AD 0x800482AD 0x800490AD 0x80049EAD 0x8004ACAD 0x8004BAAD 0x8004C8AD 0x8004D6AD 0x8004E4AD /end VAR_ADDRESS
 /end VAR_CHARACTERISTIC
 /begin VAR_CHARACTERISTIC TP_U8TCSCpBsHillPG4ASFBCtlN_R[2] EngCalVariantCriterion
  /begin VAR_ADDRESS 0x8003A2AE 0x8003B0AE 0x8003BEAE 0x8003CCAE 0x8003DAAE 0x8003E8AE 0x8003F6AE 0x800404AE 0x800412AE 0x800420AE 0x80042EAE 0x80043CAE 0x80044AAE 0x800458AE 0x800466AE 0x800474AE 0x800482AE 0x800490AE 0x80049EAE 0x8004ACAE 0x8004BAAE 0x8004C8AE 0x8004D6AE 0x8004E4AE /end VAR_ADDRESS
 /end VAR_CHARACTERISTIC
 /begin VAR_CHARACTERISTIC TP_U8TCSCpBsHillPG4ASFBCtlN_R[3] EngCalVariantCriterion
  /begin VAR_ADDRESS 0x8003A2AF 0x8003B0AF 0x8003BEAF 0x8003CCAF 0x8003DAAF 0x8003E8AF 0x8003F6AF 0x800404AF 0x800412AF 0x800420AF 0x80042EAF 0x80043CAF 0x80044AAF 0x800458AF 0x800466AF 0x800474AF 0x800482AF 0x800490AF 0x80049EAF 0x8004ACAF 0x8004BAAF 0x8004C8AF 0x8004D6AF 0x8004E4AF /end VAR_ADDRESS
 /end VAR_CHARACTERISTIC
 /begin VAR_CHARACTERISTIC TP_U8TCSCpBsHillPG4ASFBCtlN_R[4] EngCalVariantCriterion
  /begin VAR_ADDRESS 0x8003A2B0 0x8003B0B0 0x8003BEB0 0x8003CCB0 0x8003DAB0 0x8003E8B0 0x8003F6B0 0x800404B0 0x800412B0 0x800420B0 0x80042EB0 0x80043CB0 0x80044AB0 0x800458B0 0x800466B0 0x800474B0 0x800482B0 0x800490B0 0x80049EB0 0x8004ACB0 0x8004BAB0 0x8004C8B0 0x8004D6B0 0x8004E4B0 /end VAR_ADDRESS
 /end VAR_CHARACTERISTIC
 /begin VAR_CHARACTERISTIC TP_U8TCSCpBsHillPG4ASFBCtlP_F[0] EngCalVariantCriterion
  /begin VAR_ADDRESS 0x8003A2B1 0x8003B0B1 0x8003BEB1 0x8003CCB1 0x8003DAB1 0x8003E8B1 0x8003F6B1 0x800404B1 0x800412B1 0x800420B1 0x80042EB1 0x80043CB1 0x80044AB1 0x800458B1 0x800466B1 0x800474B1 0x800482B1 0x800490B1 0x80049EB1 0x8004ACB1 0x8004BAB1 0x8004C8B1 0x8004D6B1 0x8004E4B1 /end VAR_ADDRESS
 /end VAR_CHARACTERISTIC
 /begin VAR_CHARACTERISTIC TP_U8TCSCpBsHillPG4ASFBCtlP_F[1] EngCalVariantCriterion
  /begin VAR_ADDRESS 0x8003A2B2 0x8003B0B2 0x8003BEB2 0x8003CCB2 0x8003DAB2 0x8003E8B2 0x8003F6B2 0x800404B2 0x800412B2 0x800420B2 0x80042EB2 0x80043CB2 0x80044AB2 0x800458B2 0x800466B2 0x800474B2 0x800482B2 0x800490B2 0x80049EB2 0x8004ACB2 0x8004BAB2 0x8004C8B2 0x8004D6B2 0x8004E4B2 /end VAR_ADDRESS
 /end VAR_CHARACTERISTIC
 /begin VAR_CHARACTERISTIC TP_U8TCSCpBsHillPG4ASFBCtlP_F[2] EngCalVariantCriterion
  /begin VAR_ADDRESS 0x8003A2B3 0x8003B0B3 0x8003BEB3 0x8003CCB3 0x8003DAB3 0x8003E8B3 0x8003F6B3 0x800404B3 0x800412B3 0x800420B3 0x80042EB3 0x80043CB3 0x80044AB3 0x800458B3 0x800466B3 0x800474B3 0x800482B3 0x800490B3 0x80049EB3 0x8004ACB3 0x8004BAB3 0x8004C8B3 0x8004D6B3 0x8004E4B3 /end VAR_ADDRESS
 /end VAR_CHARACTERISTIC
 /begin VAR_CHARACTERISTIC TP_U8TCSCpBsHillPG4ASFBCtlP_F[3] EngCalVariantCriterion
  /begin VAR_ADDRESS 0x8003A2B4 0x8003B0B4 0x8003BEB4 0x8003CCB4 0x8003DAB4 0x8003E8B4 0x8003F6B4 0x800404B4 0x800412B4 0x800420B4 0x80042EB4 0x80043CB4 0x80044AB4 0x800458B4 0x800466B4 0x800474B4 0x800482B4 0x800490B4 0x80049EB4 0x8004ACB4 0x8004BAB4 0x8004C8B4 0x8004D6B4 0x8004E4B4 /end VAR_ADDRESS
 /end VAR_CHARACTERISTIC
 /begin VAR_CHARACTERISTIC TP_U8TCSCpBsHillPG4ASFBCtlP_F[4] EngCalVariantCriterion
  /begin VAR_ADDRESS 0x8003A2B5 0x8003B0B5 0x8003BEB5 0x8003CCB5 0x8003DAB5 0x8003E8B5 0x8003F6B5 0x800404B5 0x800412B5 0x800420B5 0x80042EB5 0x80043CB5 0x80044AB5 0x800458B5 0x800466B5 0x800474B5 0x800482B5 0x800490B5 0x80049EB5 0x8004ACB5 0x8004BAB5 0x8004C8B5 0x8004D6B5 0x8004E4B5 /end VAR_ADDRESS
 /end VAR_CHARACTERISTIC
 /begin VAR_CHARACTERISTIC TP_U8TCSCpBsHillPG4ASFBCtlP_R[0] EngCalVariantCriterion
  /begin VAR_ADDRESS 0x8003A2B6 0x8003B0B6 0x8003BEB6 0x8003CCB6 0x8003DAB6 0x8003E8B6 0x8003F6B6 0x800404B6 0x800412B6 0x800420B6 0x80042EB6 0x80043CB6 0x80044AB6 0x800458B6 0x800466B6 0x800474B6 0x800482B6 0x800490B6 0x80049EB6 0x8004ACB6 0x8004BAB6 0x8004C8B6 0x8004D6B6 0x8004E4B6 /end VAR_ADDRESS
 /end VAR_CHARACTERISTIC
 /begin VAR_CHARACTERISTIC TP_U8TCSCpBsHillPG4ASFBCtlP_R[1] EngCalVariantCriterion
  /begin VAR_ADDRESS 0x8003A2B7 0x8003B0B7 0x8003BEB7 0x8003CCB7 0x8003DAB7 0x8003E8B7 0x8003F6B7 0x800404B7 0x800412B7 0x800420B7 0x80042EB7 0x80043CB7 0x80044AB7 0x800458B7 0x800466B7 0x800474B7 0x800482B7 0x800490B7 0x80049EB7 0x8004ACB7 0x8004BAB7 0x8004C8B7 0x8004D6B7 0x8004E4B7 /end VAR_ADDRESS
 /end VAR_CHARACTERISTIC
 /begin VAR_CHARACTERISTIC TP_U8TCSCpBsHillPG4ASFBCtlP_R[2] EngCalVariantCriterion
  /begin VAR_ADDRESS 0x8003A2B8 0x8003B0B8 0x8003BEB8 0x8003CCB8 0x8003DAB8 0x8003E8B8 0x8003F6B8 0x800404B8 0x800412B8 0x800420B8 0x80042EB8 0x80043CB8 0x80044AB8 0x800458B8 0x800466B8 0x800474B8 0x800482B8 0x800490B8 0x80049EB8 0x8004ACB8 0x8004BAB8 0x8004C8B8 0x8004D6B8 0x8004E4B8 /end VAR_ADDRESS
 /end VAR_CHARACTERISTIC
 /begin VAR_CHARACTERISTIC TP_U8TCSCpBsHillPG4ASFBCtlP_R[3] EngCalVariantCriterion
  /begin VAR_ADDRESS 0x8003A2B9 0x8003B0B9 0x8003BEB9 0x8003CCB9 0x8003DAB9 0x8003E8B9 0x8003F6B9 0x800404B9 0x800412B9 0x800420B9 0x80042EB9 0x80043CB9 0x80044AB9 0x800458B9 0x800466B9 0x800474B9 0x800482B9 0x800490B9 0x80049EB9 0x8004ACB9 0x8004BAB9 0x8004C8B9 0x8004D6B9 0x8004E4B9 /end VAR_ADDRESS
 /end VAR_CHARACTERISTIC
 /begin VAR_CHARACTERISTIC TP_U8TCSCpBsHillPG4ASFBCtlP_R[4] EngCalVariantCriterion
  /begin VAR_ADDRESS 0x8003A2BA 0x8003B0BA 0x8003BEBA 0x8003CCBA 0x8003DABA 0x8003E8BA 0x8003F6BA 0x800404BA 0x800412BA 0x800420BA 0x80042EBA 0x80043CBA 0x80044ABA 0x800458BA 0x800466BA 0x800474BA 0x800482BA 0x800490BA 0x80049EBA 0x8004ACBA 0x8004BABA 0x8004C8BA 0x8004D6BA 0x8004E4BA /end VAR_ADDRESS
 /end VAR_CHARACTERISTIC
 /begin VAR_CHARACTERISTIC TP_U8TCSCpBsStIG4ASFBCtl_F[0] EngCalVariantCriterion
  /begin VAR_ADDRESS 0x8003A2BB 0x8003B0BB 0x8003BEBB 0x8003CCBB 0x8003DABB 0x8003E8BB 0x8003F6BB 0x800404BB 0x800412BB 0x800420BB 0x80042EBB 0x80043CBB 0x80044ABB 0x800458BB 0x800466BB 0x800474BB 0x800482BB 0x800490BB 0x80049EBB 0x8004ACBB 0x8004BABB 0x8004C8BB 0x8004D6BB 0x8004E4BB /end VAR_ADDRESS
 /end VAR_CHARACTERISTIC
 /begin VAR_CHARACTERISTIC TP_U8TCSCpBsStIG4ASFBCtl_F[1] EngCalVariantCriterion
  /begin VAR_ADDRESS 0x8003A2BC 0x8003B0BC 0x8003BEBC 0x8003CCBC 0x8003DABC 0x8003E8BC 0x8003F6BC 0x800404BC 0x800412BC 0x800420BC 0x80042EBC 0x80043CBC 0x80044ABC 0x800458BC 0x800466BC 0x800474BC 0x800482BC 0x800490BC 0x80049EBC 0x8004ACBC 0x8004BABC 0x8004C8BC 0x8004D6BC 0x8004E4BC /end VAR_ADDRESS
 /end VAR_CHARACTERISTIC
 /begin VAR_CHARACTERISTIC TP_U8TCSCpBsStIG4ASFBCtl_F[2] EngCalVariantCriterion
  /begin VAR_ADDRESS 0x8003A2BD 0x8003B0BD 0x8003BEBD 0x8003CCBD 0x8003DABD 0x8003E8BD 0x8003F6BD 0x800404BD 0x800412BD 0x800420BD 0x80042EBD 0x80043CBD 0x80044ABD 0x800458BD 0x800466BD 0x800474BD 0x800482BD 0x800490BD 0x80049EBD 0x8004ACBD 0x8004BABD 0x8004C8BD 0x8004D6BD 0x8004E4BD /end VAR_ADDRESS
 /end VAR_CHARACTERISTIC
 /begin VAR_CHARACTERISTIC TP_U8TCSCpBsStIG4ASFBCtl_F[3] EngCalVariantCriterion
  /begin VAR_ADDRESS 0x8003A2BE 0x8003B0BE 0x8003BEBE 0x8003CCBE 0x8003DABE 0x8003E8BE 0x8003F6BE 0x800404BE 0x800412BE 0x800420BE 0x80042EBE 0x80043CBE 0x80044ABE 0x800458BE 0x800466BE 0x800474BE 0x800482BE 0x800490BE 0x80049EBE 0x8004ACBE 0x8004BABE 0x8004C8BE 0x8004D6BE 0x8004E4BE /end VAR_ADDRESS
 /end VAR_CHARACTERISTIC
 /begin VAR_CHARACTERISTIC TP_U8TCSCpBsStIG4ASFBCtl_F[4] EngCalVariantCriterion
  /begin VAR_ADDRESS 0x8003A2BF 0x8003B0BF 0x8003BEBF 0x8003CCBF 0x8003DABF 0x8003E8BF 0x8003F6BF 0x800404BF 0x800412BF 0x800420BF 0x80042EBF 0x80043CBF 0x80044ABF 0x800458BF 0x800466BF 0x800474BF 0x800482BF 0x800490BF 0x80049EBF 0x8004ACBF 0x8004BABF 0x8004C8BF 0x8004D6BF 0x8004E4BF /end VAR_ADDRESS
 /end VAR_CHARACTERISTIC
 /begin VAR_CHARACTERISTIC TP_U8TCSCpBsStIG4ASFBCtl_R[0] EngCalVariantCriterion
  /begin VAR_ADDRESS 0x8003A2C0 0x8003B0C0 0x8003BEC0 0x8003CCC0 0x8003DAC0 0x8003E8C0 0x8003F6C0 0x800404C0 0x800412C0 0x800420C0 0x80042EC0 0x80043CC0 0x80044AC0 0x800458C0 0x800466C0 0x800474C0 0x800482C0 0x800490C0 0x80049EC0 0x8004ACC0 0x8004BAC0 0x8004C8C0 0x8004D6C0 0x8004E4C0 /end VAR_ADDRESS
 /end VAR_CHARACTERISTIC
 /begin VAR_CHARACTERISTIC TP_U8TCSCpBsStIG4ASFBCtl_R[1] EngCalVariantCriterion
  /begin VAR_ADDRESS 0x8003A2C1 0x8003B0C1 0x8003BEC1 0x8003CCC1 0x8003DAC1 0x8003E8C1 0x8003F6C1 0x800404C1 0x800412C1 0x800420C1 0x80042EC1 0x80043CC1 0x80044AC1 0x800458C1 0x800466C1 0x800474C1 0x800482C1 0x800490C1 0x80049EC1 0x8004ACC1 0x8004BAC1 0x8004C8C1 0x8004D6C1 0x8004E4C1 /end VAR_ADDRESS
 /end VAR_CHARACTERISTIC
 /begin VAR_CHARACTERISTIC TP_U8TCSCpBsStIG4ASFBCtl_R[2] EngCalVariantCriterion
  /begin VAR_ADDRESS 0x8003A2C2 0x8003B0C2 0x8003BEC2 0x8003CCC2 0x8003DAC2 0x8003E8C2 0x8003F6C2 0x800404C2 0x800412C2 0x800420C2 0x80042EC2 0x80043CC2 0x80044AC2 0x800458C2 0x800466C2 0x800474C2 0x800482C2 0x800490C2 0x80049EC2 0x8004ACC2 0x8004BAC2 0x8004C8C2 0x8004D6C2 0x8004E4C2 /end VAR_ADDRESS
 /end VAR_CHARACTERISTIC
 /begin VAR_CHARACTERISTIC TP_U8TCSCpBsStIG4ASFBCtl_R[3] EngCalVariantCriterion
  /begin VAR_ADDRESS 0x8003A2C3 0x8003B0C3 0x8003BEC3 0x8003CCC3 0x8003DAC3 0x8003E8C3 0x8003F6C3 0x800404C3 0x800412C3 0x800420C3 0x80042EC3 0x80043CC3 0x80044AC3 0x800458C3 0x800466C3 0x800474C3 0x800482C3 0x800490C3 0x80049EC3 0x8004ACC3 0x8004BAC3 0x8004C8C3 0x8004D6C3 0x8004E4C3 /end VAR_ADDRESS
 /end VAR_CHARACTERISTIC
 /begin VAR_CHARACTERISTIC TP_U8TCSCpBsStIG4ASFBCtl_R[4] EngCalVariantCriterion
  /begin VAR_ADDRESS 0x8003A2C4 0x8003B0C4 0x8003BEC4 0x8003CCC4 0x8003DAC4 0x8003E8C4 0x8003F6C4 0x800404C4 0x800412C4 0x800420C4 0x80042EC4 0x80043CC4 0x80044AC4 0x800458C4 0x800466C4 0x800474C4 0x800482C4 0x800490C4 0x80049EC4 0x8004ACC4 0x8004BAC4 0x8004C8C4 0x8004D6C4 0x8004E4C4 /end VAR_ADDRESS
 /end VAR_CHARACTERISTIC
 /begin VAR_CHARACTERISTIC TP_U8TCSCpBsStPG4ASFBCtlN_F[0] EngCalVariantCriterion
  /begin VAR_ADDRESS 0x8003A2C5 0x8003B0C5 0x8003BEC5 0x8003CCC5 0x8003DAC5 0x8003E8C5 0x8003F6C5 0x800404C5 0x800412C5 0x800420C5 0x80042EC5 0x80043CC5 0x80044AC5 0x800458C5 0x800466C5 0x800474C5 0x800482C5 0x800490C5 0x80049EC5 0x8004ACC5 0x8004BAC5 0x8004C8C5 0x8004D6C5 0x8004E4C5 /end VAR_ADDRESS
 /end VAR_CHARACTERISTIC
 /begin VAR_CHARACTERISTIC TP_U8TCSCpBsStPG4ASFBCtlN_F[1] EngCalVariantCriterion
  /begin VAR_ADDRESS 0x8003A2C6 0x8003B0C6 0x8003BEC6 0x8003CCC6 0x8003DAC6 0x8003E8C6 0x8003F6C6 0x800404C6 0x800412C6 0x800420C6 0x80042EC6 0x80043CC6 0x80044AC6 0x800458C6 0x800466C6 0x800474C6 0x800482C6 0x800490C6 0x80049EC6 0x8004ACC6 0x8004BAC6 0x8004C8C6 0x8004D6C6 0x8004E4C6 /end VAR_ADDRESS
 /end VAR_CHARACTERISTIC
 /begin VAR_CHARACTERISTIC TP_U8TCSCpBsStPG4ASFBCtlN_F[2] EngCalVariantCriterion
  /begin VAR_ADDRESS 0x8003A2C7 0x8003B0C7 0x8003BEC7 0x8003CCC7 0x8003DAC7 0x8003E8C7 0x8003F6C7 0x800404C7 0x800412C7 0x800420C7 0x80042EC7 0x80043CC7 0x80044AC7 0x800458C7 0x800466C7 0x800474C7 0x800482C7 0x800490C7 0x80049EC7 0x8004ACC7 0x8004BAC7 0x8004C8C7 0x8004D6C7 0x8004E4C7 /end VAR_ADDRESS
 /end VAR_CHARACTERISTIC
 /begin VAR_CHARACTERISTIC TP_U8TCSCpBsStPG4ASFBCtlN_F[3] EngCalVariantCriterion
  /begin VAR_ADDRESS 0x8003A2C8 0x8003B0C8 0x8003BEC8 0x8003CCC8 0x8003DAC8 0x8003E8C8 0x8003F6C8 0x800404C8 0x800412C8 0x800420C8 0x80042EC8 0x80043CC8 0x80044AC8 0x800458C8 0x800466C8 0x800474C8 0x800482C8 0x800490C8 0x80049EC8 0x8004ACC8 0x8004BAC8 0x8004C8C8 0x8004D6C8 0x8004E4C8 /end VAR_ADDRESS
 /end VAR_CHARACTERISTIC
 /begin VAR_CHARACTERISTIC TP_U8TCSCpBsStPG4ASFBCtlN_F[4] EngCalVariantCriterion
  /begin VAR_ADDRESS 0x8003A2C9 0x8003B0C9 0x8003BEC9 0x8003CCC9 0x8003DAC9 0x8003E8C9 0x8003F6C9 0x800404C9 0x800412C9 0x800420C9 0x80042EC9 0x80043CC9 0x80044AC9 0x800458C9 0x800466C9 0x800474C9 0x800482C9 0x800490C9 0x80049EC9 0x8004ACC9 0x8004BAC9 0x8004C8C9 0x8004D6C9 0x8004E4C9 /end VAR_ADDRESS
 /end VAR_CHARACTERISTIC
 /begin VAR_CHARACTERISTIC TP_U8TCSCpBsStPG4ASFBCtlN_R[0] EngCalVariantCriterion
  /begin VAR_ADDRESS 0x8003A2CA 0x8003B0CA 0x8003BECA 0x8003CCCA 0x8003DACA 0x8003E8CA 0x8003F6CA 0x800404CA 0x800412CA 0x800420CA 0x80042ECA 0x80043CCA 0x80044ACA 0x800458CA 0x800466CA 0x800474CA 0x800482CA 0x800490CA 0x80049ECA 0x8004ACCA 0x8004BACA 0x8004C8CA 0x8004D6CA 0x8004E4CA /end VAR_ADDRESS
 /end VAR_CHARACTERISTIC
 /begin VAR_CHARACTERISTIC TP_U8TCSCpBsStPG4ASFBCtlN_R[1] EngCalVariantCriterion
  /begin VAR_ADDRESS 0x8003A2CB 0x8003B0CB 0x8003BECB 0x8003CCCB 0x8003DACB 0x8003E8CB 0x8003F6CB 0x800404CB 0x800412CB 0x800420CB 0x80042ECB 0x80043CCB 0x80044ACB 0x800458CB 0x800466CB 0x800474CB 0x800482CB 0x800490CB 0x80049ECB 0x8004ACCB 0x8004BACB 0x8004C8CB 0x8004D6CB 0x8004E4CB /end VAR_ADDRESS
 /end VAR_CHARACTERISTIC
 /begin VAR_CHARACTERISTIC TP_U8TCSCpBsStPG4ASFBCtlN_R[2] EngCalVariantCriterion
  /begin VAR_ADDRESS 0x8003A2CC 0x8003B0CC 0x8003BECC 0x8003CCCC 0x8003DACC 0x8003E8CC 0x8003F6CC 0x800404CC 0x800412CC 0x800420CC 0x80042ECC 0x80043CCC 0x80044ACC 0x800458CC 0x800466CC 0x800474CC 0x800482CC 0x800490CC 0x80049ECC 0x8004ACCC 0x8004BACC 0x8004C8CC 0x8004D6CC 0x8004E4CC /end VAR_ADDRESS
 /end VAR_CHARACTERISTIC
 /begin VAR_CHARACTERISTIC TP_U8TCSCpBsStPG4ASFBCtlN_R[3] EngCalVariantCriterion
  /begin VAR_ADDRESS 0x8003A2CD 0x8003B0CD 0x8003BECD 0x8003CCCD 0x8003DACD 0x8003E8CD 0x8003F6CD 0x800404CD 0x800412CD 0x800420CD 0x80042ECD 0x80043CCD 0x80044ACD 0x800458CD 0x800466CD 0x800474CD 0x800482CD 0x800490CD 0x80049ECD 0x8004ACCD 0x8004BACD 0x8004C8CD 0x8004D6CD 0x8004E4CD /end VAR_ADDRESS
 /end VAR_CHARACTERISTIC
 /begin VAR_CHARACTERISTIC TP_U8TCSCpBsStPG4ASFBCtlN_R[4] EngCalVariantCriterion
  /begin VAR_ADDRESS 0x8003A2CE 0x8003B0CE 0x8003BECE 0x8003CCCE 0x8003DACE 0x8003E8CE 0x8003F6CE 0x800404CE 0x800412CE 0x800420CE 0x80042ECE 0x80043CCE 0x80044ACE 0x800458CE 0x800466CE 0x800474CE 0x800482CE 0x800490CE 0x80049ECE 0x8004ACCE 0x8004BACE 0x8004C8CE 0x8004D6CE 0x8004E4CE /end VAR_ADDRESS
 /end VAR_CHARACTERISTIC
 /begin VAR_CHARACTERISTIC TP_U8TCSCpBsStPG4ASFBCtlP_F[0] EngCalVariantCriterion
  /begin VAR_ADDRESS 0x8003A2CF 0x8003B0CF 0x8003BECF 0x8003CCCF 0x8003DACF 0x8003E8CF 0x8003F6CF 0x800404CF 0x800412CF 0x800420CF 0x80042ECF 0x80043CCF 0x80044ACF 0x800458CF 0x800466CF 0x800474CF 0x800482CF 0x800490CF 0x80049ECF 0x8004ACCF 0x8004BACF 0x8004C8CF 0x8004D6CF 0x8004E4CF /end VAR_ADDRESS
 /end VAR_CHARACTERISTIC
 /begin VAR_CHARACTERISTIC TP_U8TCSCpBsStPG4ASFBCtlP_F[1] EngCalVariantCriterion
  /begin VAR_ADDRESS 0x8003A2D0 0x8003B0D0 0x8003BED0 0x8003CCD0 0x8003DAD0 0x8003E8D0 0x8003F6D0 0x800404D0 0x800412D0 0x800420D0 0x80042ED0 0x80043CD0 0x80044AD0 0x800458D0 0x800466D0 0x800474D0 0x800482D0 0x800490D0 0x80049ED0 0x8004ACD0 0x8004BAD0 0x8004C8D0 0x8004D6D0 0x8004E4D0 /end VAR_ADDRESS
 /end VAR_CHARACTERISTIC
 /begin VAR_CHARACTERISTIC TP_U8TCSCpBsStPG4ASFBCtlP_F[2] EngCalVariantCriterion
  /begin VAR_ADDRESS 0x8003A2D1 0x8003B0D1 0x8003BED1 0x8003CCD1 0x8003DAD1 0x8003E8D1 0x8003F6D1 0x800404D1 0x800412D1 0x800420D1 0x80042ED1 0x80043CD1 0x80044AD1 0x800458D1 0x800466D1 0x800474D1 0x800482D1 0x800490D1 0x80049ED1 0x8004ACD1 0x8004BAD1 0x8004C8D1 0x8004D6D1 0x8004E4D1 /end VAR_ADDRESS
 /end VAR_CHARACTERISTIC
 /begin VAR_CHARACTERISTIC TP_U8TCSCpBsStPG4ASFBCtlP_F[3] EngCalVariantCriterion
  /begin VAR_ADDRESS 0x8003A2D2 0x8003B0D2 0x8003BED2 0x8003CCD2 0x8003DAD2 0x8003E8D2 0x8003F6D2 0x800404D2 0x800412D2 0x800420D2 0x80042ED2 0x80043CD2 0x80044AD2 0x800458D2 0x800466D2 0x800474D2 0x800482D2 0x800490D2 0x80049ED2 0x8004ACD2 0x8004BAD2 0x8004C8D2 0x8004D6D2 0x8004E4D2 /end VAR_ADDRESS
 /end VAR_CHARACTERISTIC
 /begin VAR_CHARACTERISTIC TP_U8TCSCpBsStPG4ASFBCtlP_F[4] EngCalVariantCriterion
  /begin VAR_ADDRESS 0x8003A2D3 0x8003B0D3 0x8003BED3 0x8003CCD3 0x8003DAD3 0x8003E8D3 0x8003F6D3 0x800404D3 0x800412D3 0x800420D3 0x80042ED3 0x80043CD3 0x80044AD3 0x800458D3 0x800466D3 0x800474D3 0x800482D3 0x800490D3 0x80049ED3 0x8004ACD3 0x8004BAD3 0x8004C8D3 0x8004D6D3 0x8004E4D3 /end VAR_ADDRESS
 /end VAR_CHARACTERISTIC
 /begin VAR_CHARACTERISTIC TP_U8TCSCpBsStPG4ASFBCtlP_R[0] EngCalVariantCriterion
  /begin VAR_ADDRESS 0x8003A2D4 0x8003B0D4 0x8003BED4 0x8003CCD4 0x8003DAD4 0x8003E8D4 0x8003F6D4 0x800404D4 0x800412D4 0x800420D4 0x80042ED4 0x80043CD4 0x80044AD4 0x800458D4 0x800466D4 0x800474D4 0x800482D4 0x800490D4 0x80049ED4 0x8004ACD4 0x8004BAD4 0x8004C8D4 0x8004D6D4 0x8004E4D4 /end VAR_ADDRESS
 /end VAR_CHARACTERISTIC
 /begin VAR_CHARACTERISTIC TP_U8TCSCpBsStPG4ASFBCtlP_R[1] EngCalVariantCriterion
  /begin VAR_ADDRESS 0x8003A2D5 0x8003B0D5 0x8003BED5 0x8003CCD5 0x8003DAD5 0x8003E8D5 0x8003F6D5 0x800404D5 0x800412D5 0x800420D5 0x80042ED5 0x80043CD5 0x80044AD5 0x800458D5 0x800466D5 0x800474D5 0x800482D5 0x800490D5 0x80049ED5 0x8004ACD5 0x8004BAD5 0x8004C8D5 0x8004D6D5 0x8004E4D5 /end VAR_ADDRESS
 /end VAR_CHARACTERISTIC
 /begin VAR_CHARACTERISTIC TP_U8TCSCpBsStPG4ASFBCtlP_R[2] EngCalVariantCriterion
  /begin VAR_ADDRESS 0x8003A2D6 0x8003B0D6 0x8003BED6 0x8003CCD6 0x8003DAD6 0x8003E8D6 0x8003F6D6 0x800404D6 0x800412D6 0x800420D6 0x80042ED6 0x80043CD6 0x80044AD6 0x800458D6 0x800466D6 0x800474D6 0x800482D6 0x800490D6 0x80049ED6 0x8004ACD6 0x8004BAD6 0x8004C8D6 0x8004D6D6 0x8004E4D6 /end VAR_ADDRESS
 /end VAR_CHARACTERISTIC
 /begin VAR_CHARACTERISTIC TP_U8TCSCpBsStPG4ASFBCtlP_R[3] EngCalVariantCriterion
  /begin VAR_ADDRESS 0x8003A2D7 0x8003B0D7 0x8003BED7 0x8003CCD7 0x8003DAD7 0x8003E8D7 0x8003F6D7 0x800404D7 0x800412D7 0x800420D7 0x80042ED7 0x80043CD7 0x80044AD7 0x800458D7 0x800466D7 0x800474D7 0x800482D7 0x800490D7 0x80049ED7 0x8004ACD7 0x8004BAD7 0x8004C8D7 0x8004D6D7 0x8004E4D7 /end VAR_ADDRESS
 /end VAR_CHARACTERISTIC
 /begin VAR_CHARACTERISTIC TP_U8TCSCpBsStPG4ASFBCtlP_R[4] EngCalVariantCriterion
  /begin VAR_ADDRESS 0x8003A2D8 0x8003B0D8 0x8003BED8 0x8003CCD8 0x8003DAD8 0x8003E8D8 0x8003F6D8 0x800404D8 0x800412D8 0x800420D8 0x80042ED8 0x80043CD8 0x80044AD8 0x800458D8 0x800466D8 0x800474D8 0x800482D8 0x800490D8 0x80049ED8 0x8004ACD8 0x8004BAD8 0x8004C8D8 0x8004D6D8 0x8004E4D8 /end VAR_ADDRESS
 /end VAR_CHARACTERISTIC
 /begin VAR_CHARACTERISTIC TP_U8TCSCpBsTurnIG4ASFBCtl_F[0] EngCalVariantCriterion
  /begin VAR_ADDRESS 0x8003A2D9 0x8003B0D9 0x8003BED9 0x8003CCD9 0x8003DAD9 0x8003E8D9 0x8003F6D9 0x800404D9 0x800412D9 0x800420D9 0x80042ED9 0x80043CD9 0x80044AD9 0x800458D9 0x800466D9 0x800474D9 0x800482D9 0x800490D9 0x80049ED9 0x8004ACD9 0x8004BAD9 0x8004C8D9 0x8004D6D9 0x8004E4D9 /end VAR_ADDRESS
 /end VAR_CHARACTERISTIC
 /begin VAR_CHARACTERISTIC TP_U8TCSCpBsTurnIG4ASFBCtl_F[1] EngCalVariantCriterion
  /begin VAR_ADDRESS 0x8003A2DA 0x8003B0DA 0x8003BEDA 0x8003CCDA 0x8003DADA 0x8003E8DA 0x8003F6DA 0x800404DA 0x800412DA 0x800420DA 0x80042EDA 0x80043CDA 0x80044ADA 0x800458DA 0x800466DA 0x800474DA 0x800482DA 0x800490DA 0x80049EDA 0x8004ACDA 0x8004BADA 0x8004C8DA 0x8004D6DA 0x8004E4DA /end VAR_ADDRESS
 /end VAR_CHARACTERISTIC
 /begin VAR_CHARACTERISTIC TP_U8TCSCpBsTurnIG4ASFBCtl_F[2] EngCalVariantCriterion
  /begin VAR_ADDRESS 0x8003A2DB 0x8003B0DB 0x8003BEDB 0x8003CCDB 0x8003DADB 0x8003E8DB 0x8003F6DB 0x800404DB 0x800412DB 0x800420DB 0x80042EDB 0x80043CDB 0x80044ADB 0x800458DB 0x800466DB 0x800474DB 0x800482DB 0x800490DB 0x80049EDB 0x8004ACDB 0x8004BADB 0x8004C8DB 0x8004D6DB 0x8004E4DB /end VAR_ADDRESS
 /end VAR_CHARACTERISTIC
 /begin VAR_CHARACTERISTIC TP_U8TCSCpBsTurnIG4ASFBCtl_F[3] EngCalVariantCriterion
  /begin VAR_ADDRESS 0x8003A2DC 0x8003B0DC 0x8003BEDC 0x8003CCDC 0x8003DADC 0x8003E8DC 0x8003F6DC 0x800404DC 0x800412DC 0x800420DC 0x80042EDC 0x80043CDC 0x80044ADC 0x800458DC 0x800466DC 0x800474DC 0x800482DC 0x800490DC 0x80049EDC 0x8004ACDC 0x8004BADC 0x8004C8DC 0x8004D6DC 0x8004E4DC /end VAR_ADDRESS
 /end VAR_CHARACTERISTIC
 /begin VAR_CHARACTERISTIC TP_U8TCSCpBsTurnIG4ASFBCtl_F[4] EngCalVariantCriterion
  /begin VAR_ADDRESS 0x8003A2DD 0x8003B0DD 0x8003BEDD 0x8003CCDD 0x8003DADD 0x8003E8DD 0x8003F6DD 0x800404DD 0x800412DD 0x800420DD 0x80042EDD 0x80043CDD 0x80044ADD 0x800458DD 0x800466DD 0x800474DD 0x800482DD 0x800490DD 0x80049EDD 0x8004ACDD 0x8004BADD 0x8004C8DD 0x8004D6DD 0x8004E4DD /end VAR_ADDRESS
 /end VAR_CHARACTERISTIC
 /begin VAR_CHARACTERISTIC TP_U8TCSCpBsTurnIG4ASFBCtl_R[0] EngCalVariantCriterion
  /begin VAR_ADDRESS 0x8003A2DE 0x8003B0DE 0x8003BEDE 0x8003CCDE 0x8003DADE 0x8003E8DE 0x8003F6DE 0x800404DE 0x800412DE 0x800420DE 0x80042EDE 0x80043CDE 0x80044ADE 0x800458DE 0x800466DE 0x800474DE 0x800482DE 0x800490DE 0x80049EDE 0x8004ACDE 0x8004BADE 0x8004C8DE 0x8004D6DE 0x8004E4DE /end VAR_ADDRESS
 /end VAR_CHARACTERISTIC
 /begin VAR_CHARACTERISTIC TP_U8TCSCpBsTurnIG4ASFBCtl_R[1] EngCalVariantCriterion
  /begin VAR_ADDRESS 0x8003A2DF 0x8003B0DF 0x8003BEDF 0x8003CCDF 0x8003DADF 0x8003E8DF 0x8003F6DF 0x800404DF 0x800412DF 0x800420DF 0x80042EDF 0x80043CDF 0x80044ADF 0x800458DF 0x800466DF 0x800474DF 0x800482DF 0x800490DF 0x80049EDF 0x8004ACDF 0x8004BADF 0x8004C8DF 0x8004D6DF 0x8004E4DF /end VAR_ADDRESS
 /end VAR_CHARACTERISTIC
 /begin VAR_CHARACTERISTIC TP_U8TCSCpBsTurnIG4ASFBCtl_R[2] EngCalVariantCriterion
  /begin VAR_ADDRESS 0x8003A2E0 0x8003B0E0 0x8003BEE0 0x8003CCE0 0x8003DAE0 0x8003E8E0 0x8003F6E0 0x800404E0 0x800412E0 0x800420E0 0x80042EE0 0x80043CE0 0x80044AE0 0x800458E0 0x800466E0 0x800474E0 0x800482E0 0x800490E0 0x80049EE0 0x8004ACE0 0x8004BAE0 0x8004C8E0 0x8004D6E0 0x8004E4E0 /end VAR_ADDRESS
 /end VAR_CHARACTERISTIC
 /begin VAR_CHARACTERISTIC TP_U8TCSCpBsTurnIG4ASFBCtl_R[3] EngCalVariantCriterion
  /begin VAR_ADDRESS 0x8003A2E1 0x8003B0E1 0x8003BEE1 0x8003CCE1 0x8003DAE1 0x8003E8E1 0x8003F6E1 0x800404E1 0x800412E1 0x800420E1 0x80042EE1 0x80043CE1 0x80044AE1 0x800458E1 0x800466E1 0x800474E1 0x800482E1 0x800490E1 0x80049EE1 0x8004ACE1 0x8004BAE1 0x8004C8E1 0x8004D6E1 0x8004E4E1 /end VAR_ADDRESS
 /end VAR_CHARACTERISTIC
 /begin VAR_CHARACTERISTIC TP_U8TCSCpBsTurnIG4ASFBCtl_R[4] EngCalVariantCriterion
  /begin VAR_ADDRESS 0x8003A2E2 0x8003B0E2 0x8003BEE2 0x8003CCE2 0x8003DAE2 0x8003E8E2 0x8003F6E2 0x800404E2 0x800412E2 0x800420E2 0x80042EE2 0x80043CE2 0x80044AE2 0x800458E2 0x800466E2 0x800474E2 0x800482E2 0x800490E2 0x80049EE2 0x8004ACE2 0x8004BAE2 0x8004C8E2 0x8004D6E2 0x8004E4E2 /end VAR_ADDRESS
 /end VAR_CHARACTERISTIC
 /begin VAR_CHARACTERISTIC TP_U8TCSCpBsTurnPG4ASFBCtlN_F[0] EngCalVariantCriterion
  /begin VAR_ADDRESS 0x8003A2E3 0x8003B0E3 0x8003BEE3 0x8003CCE3 0x8003DAE3 0x8003E8E3 0x8003F6E3 0x800404E3 0x800412E3 0x800420E3 0x80042EE3 0x80043CE3 0x80044AE3 0x800458E3 0x800466E3 0x800474E3 0x800482E3 0x800490E3 0x80049EE3 0x8004ACE3 0x8004BAE3 0x8004C8E3 0x8004D6E3 0x8004E4E3 /end VAR_ADDRESS
 /end VAR_CHARACTERISTIC
 /begin VAR_CHARACTERISTIC TP_U8TCSCpBsTurnPG4ASFBCtlN_F[1] EngCalVariantCriterion
  /begin VAR_ADDRESS 0x8003A2E4 0x8003B0E4 0x8003BEE4 0x8003CCE4 0x8003DAE4 0x8003E8E4 0x8003F6E4 0x800404E4 0x800412E4 0x800420E4 0x80042EE4 0x80043CE4 0x80044AE4 0x800458E4 0x800466E4 0x800474E4 0x800482E4 0x800490E4 0x80049EE4 0x8004ACE4 0x8004BAE4 0x8004C8E4 0x8004D6E4 0x8004E4E4 /end VAR_ADDRESS
 /end VAR_CHARACTERISTIC
 /begin VAR_CHARACTERISTIC TP_U8TCSCpBsTurnPG4ASFBCtlN_F[2] EngCalVariantCriterion
  /begin VAR_ADDRESS 0x8003A2E5 0x8003B0E5 0x8003BEE5 0x8003CCE5 0x8003DAE5 0x8003E8E5 0x8003F6E5 0x800404E5 0x800412E5 0x800420E5 0x80042EE5 0x80043CE5 0x80044AE5 0x800458E5 0x800466E5 0x800474E5 0x800482E5 0x800490E5 0x80049EE5 0x8004ACE5 0x8004BAE5 0x8004C8E5 0x8004D6E5 0x8004E4E5 /end VAR_ADDRESS
 /end VAR_CHARACTERISTIC
 /begin VAR_CHARACTERISTIC TP_U8TCSCpBsTurnPG4ASFBCtlN_F[3] EngCalVariantCriterion
  /begin VAR_ADDRESS 0x8003A2E6 0x8003B0E6 0x8003BEE6 0x8003CCE6 0x8003DAE6 0x8003E8E6 0x8003F6E6 0x800404E6 0x800412E6 0x800420E6 0x80042EE6 0x80043CE6 0x80044AE6 0x800458E6 0x800466E6 0x800474E6 0x800482E6 0x800490E6 0x80049EE6 0x8004ACE6 0x8004BAE6 0x8004C8E6 0x8004D6E6 0x8004E4E6 /end VAR_ADDRESS
 /end VAR_CHARACTERISTIC
 /begin VAR_CHARACTERISTIC TP_U8TCSCpBsTurnPG4ASFBCtlN_F[4] EngCalVariantCriterion
  /begin VAR_ADDRESS 0x8003A2E7 0x8003B0E7 0x8003BEE7 0x8003CCE7 0x8003DAE7 0x8003E8E7 0x8003F6E7 0x800404E7 0x800412E7 0x800420E7 0x80042EE7 0x80043CE7 0x80044AE7 0x800458E7 0x800466E7 0x800474E7 0x800482E7 0x800490E7 0x80049EE7 0x8004ACE7 0x8004BAE7 0x8004C8E7 0x8004D6E7 0x8004E4E7 /end VAR_ADDRESS
 /end VAR_CHARACTERISTIC
 /begin VAR_CHARACTERISTIC TP_U8TCSCpBsTurnPG4ASFBCtlN_R[0] EngCalVariantCriterion
  /begin VAR_ADDRESS 0x8003A2E8 0x8003B0E8 0x8003BEE8 0x8003CCE8 0x8003DAE8 0x8003E8E8 0x8003F6E8 0x800404E8 0x800412E8 0x800420E8 0x80042EE8 0x80043CE8 0x80044AE8 0x800458E8 0x800466E8 0x800474E8 0x800482E8 0x800490E8 0x80049EE8 0x8004ACE8 0x8004BAE8 0x8004C8E8 0x8004D6E8 0x8004E4E8 /end VAR_ADDRESS
 /end VAR_CHARACTERISTIC
 /begin VAR_CHARACTERISTIC TP_U8TCSCpBsTurnPG4ASFBCtlN_R[1] EngCalVariantCriterion
  /begin VAR_ADDRESS 0x8003A2E9 0x8003B0E9 0x8003BEE9 0x8003CCE9 0x8003DAE9 0x8003E8E9 0x8003F6E9 0x800404E9 0x800412E9 0x800420E9 0x80042EE9 0x80043CE9 0x80044AE9 0x800458E9 0x800466E9 0x800474E9 0x800482E9 0x800490E9 0x80049EE9 0x8004ACE9 0x8004BAE9 0x8004C8E9 0x8004D6E9 0x8004E4E9 /end VAR_ADDRESS
 /end VAR_CHARACTERISTIC
 /begin VAR_CHARACTERISTIC TP_U8TCSCpBsTurnPG4ASFBCtlN_R[2] EngCalVariantCriterion
  /begin VAR_ADDRESS 0x8003A2EA 0x8003B0EA 0x8003BEEA 0x8003CCEA 0x8003DAEA 0x8003E8EA 0x8003F6EA 0x800404EA 0x800412EA 0x800420EA 0x80042EEA 0x80043CEA 0x80044AEA 0x800458EA 0x800466EA 0x800474EA 0x800482EA 0x800490EA 0x80049EEA 0x8004ACEA 0x8004BAEA 0x8004C8EA 0x8004D6EA 0x8004E4EA /end VAR_ADDRESS
 /end VAR_CHARACTERISTIC
 /begin VAR_CHARACTERISTIC TP_U8TCSCpBsTurnPG4ASFBCtlN_R[3] EngCalVariantCriterion
  /begin VAR_ADDRESS 0x8003A2EB 0x8003B0EB 0x8003BEEB 0x8003CCEB 0x8003DAEB 0x8003E8EB 0x8003F6EB 0x800404EB 0x800412EB 0x800420EB 0x80042EEB 0x80043CEB 0x80044AEB 0x800458EB 0x800466EB 0x800474EB 0x800482EB 0x800490EB 0x80049EEB 0x8004ACEB 0x8004BAEB 0x8004C8EB 0x8004D6EB 0x8004E4EB /end VAR_ADDRESS
 /end VAR_CHARACTERISTIC
 /begin VAR_CHARACTERISTIC TP_U8TCSCpBsTurnPG4ASFBCtlN_R[4] EngCalVariantCriterion
  /begin VAR_ADDRESS 0x8003A2EC 0x8003B0EC 0x8003BEEC 0x8003CCEC 0x8003DAEC 0x8003E8EC 0x8003F6EC 0x800404EC 0x800412EC 0x800420EC 0x80042EEC 0x80043CEC 0x80044AEC 0x800458EC 0x800466EC 0x800474EC 0x800482EC 0x800490EC 0x80049EEC 0x8004ACEC 0x8004BAEC 0x8004C8EC 0x8004D6EC 0x8004E4EC /end VAR_ADDRESS
 /end VAR_CHARACTERISTIC
 /begin VAR_CHARACTERISTIC TP_U8TCSCpBsTurnPG4ASFBCtlP_F[0] EngCalVariantCriterion
  /begin VAR_ADDRESS 0x8003A2ED 0x8003B0ED 0x8003BEED 0x8003CCED 0x8003DAED 0x8003E8ED 0x8003F6ED 0x800404ED 0x800412ED 0x800420ED 0x80042EED 0x80043CED 0x80044AED 0x800458ED 0x800466ED 0x800474ED 0x800482ED 0x800490ED 0x80049EED 0x8004ACED 0x8004BAED 0x8004C8ED 0x8004D6ED 0x8004E4ED /end VAR_ADDRESS
 /end VAR_CHARACTERISTIC
 /begin VAR_CHARACTERISTIC TP_U8TCSCpBsTurnPG4ASFBCtlP_F[1] EngCalVariantCriterion
  /begin VAR_ADDRESS 0x8003A2EE 0x8003B0EE 0x8003BEEE 0x8003CCEE 0x8003DAEE 0x8003E8EE 0x8003F6EE 0x800404EE 0x800412EE 0x800420EE 0x80042EEE 0x80043CEE 0x80044AEE 0x800458EE 0x800466EE 0x800474EE 0x800482EE 0x800490EE 0x80049EEE 0x8004ACEE 0x8004BAEE 0x8004C8EE 0x8004D6EE 0x8004E4EE /end VAR_ADDRESS
 /end VAR_CHARACTERISTIC
 /begin VAR_CHARACTERISTIC TP_U8TCSCpBsTurnPG4ASFBCtlP_F[2] EngCalVariantCriterion
  /begin VAR_ADDRESS 0x8003A2EF 0x8003B0EF 0x8003BEEF 0x8003CCEF 0x8003DAEF 0x8003E8EF 0x8003F6EF 0x800404EF 0x800412EF 0x800420EF 0x80042EEF 0x80043CEF 0x80044AEF 0x800458EF 0x800466EF 0x800474EF 0x800482EF 0x800490EF 0x80049EEF 0x8004ACEF 0x8004BAEF 0x8004C8EF 0x8004D6EF 0x8004E4EF /end VAR_ADDRESS
 /end VAR_CHARACTERISTIC
 /begin VAR_CHARACTERISTIC TP_U8TCSCpBsTurnPG4ASFBCtlP_F[3] EngCalVariantCriterion
  /begin VAR_ADDRESS 0x8003A2F0 0x8003B0F0 0x8003BEF0 0x8003CCF0 0x8003DAF0 0x8003E8F0 0x8003F6F0 0x800404F0 0x800412F0 0x800420F0 0x80042EF0 0x80043CF0 0x80044AF0 0x800458F0 0x800466F0 0x800474F0 0x800482F0 0x800490F0 0x80049EF0 0x8004ACF0 0x8004BAF0 0x8004C8F0 0x8004D6F0 0x8004E4F0 /end VAR_ADDRESS
 /end VAR_CHARACTERISTIC
 /begin VAR_CHARACTERISTIC TP_U8TCSCpBsTurnPG4ASFBCtlP_F[4] EngCalVariantCriterion
  /begin VAR_ADDRESS 0x8003A2F1 0x8003B0F1 0x8003BEF1 0x8003CCF1 0x8003DAF1 0x8003E8F1 0x8003F6F1 0x800404F1 0x800412F1 0x800420F1 0x80042EF1 0x80043CF1 0x80044AF1 0x800458F1 0x800466F1 0x800474F1 0x800482F1 0x800490F1 0x80049EF1 0x8004ACF1 0x8004BAF1 0x8004C8F1 0x8004D6F1 0x8004E4F1 /end VAR_ADDRESS
 /end VAR_CHARACTERISTIC
 /begin VAR_CHARACTERISTIC TP_U8TCSCpBsTurnPG4ASFBCtlP_R[0] EngCalVariantCriterion
  /begin VAR_ADDRESS 0x8003A2F2 0x8003B0F2 0x8003BEF2 0x8003CCF2 0x8003DAF2 0x8003E8F2 0x8003F6F2 0x800404F2 0x800412F2 0x800420F2 0x80042EF2 0x80043CF2 0x80044AF2 0x800458F2 0x800466F2 0x800474F2 0x800482F2 0x800490F2 0x80049EF2 0x8004ACF2 0x8004BAF2 0x8004C8F2 0x8004D6F2 0x8004E4F2 /end VAR_ADDRESS
 /end VAR_CHARACTERISTIC
 /begin VAR_CHARACTERISTIC TP_U8TCSCpBsTurnPG4ASFBCtlP_R[1] EngCalVariantCriterion
  /begin VAR_ADDRESS 0x8003A2F3 0x8003B0F3 0x8003BEF3 0x8003CCF3 0x8003DAF3 0x8003E8F3 0x8003F6F3 0x800404F3 0x800412F3 0x800420F3 0x80042EF3 0x80043CF3 0x80044AF3 0x800458F3 0x800466F3 0x800474F3 0x800482F3 0x800490F3 0x80049EF3 0x8004ACF3 0x8004BAF3 0x8004C8F3 0x8004D6F3 0x8004E4F3 /end VAR_ADDRESS
 /end VAR_CHARACTERISTIC
 /begin VAR_CHARACTERISTIC TP_U8TCSCpBsTurnPG4ASFBCtlP_R[2] EngCalVariantCriterion
  /begin VAR_ADDRESS 0x8003A2F4 0x8003B0F4 0x8003BEF4 0x8003CCF4 0x8003DAF4 0x8003E8F4 0x8003F6F4 0x800404F4 0x800412F4 0x800420F4 0x80042EF4 0x80043CF4 0x80044AF4 0x800458F4 0x800466F4 0x800474F4 0x800482F4 0x800490F4 0x80049EF4 0x8004ACF4 0x8004BAF4 0x8004C8F4 0x8004D6F4 0x8004E4F4 /end VAR_ADDRESS
 /end VAR_CHARACTERISTIC
 /begin VAR_CHARACTERISTIC TP_U8TCSCpBsTurnPG4ASFBCtlP_R[3] EngCalVariantCriterion
  /begin VAR_ADDRESS 0x8003A2F5 0x8003B0F5 0x8003BEF5 0x8003CCF5 0x8003DAF5 0x8003E8F5 0x8003F6F5 0x800404F5 0x800412F5 0x800420F5 0x80042EF5 0x80043CF5 0x80044AF5 0x800458F5 0x800466F5 0x800474F5 0x800482F5 0x800490F5 0x80049EF5 0x8004ACF5 0x8004BAF5 0x8004C8F5 0x8004D6F5 0x8004E4F5 /end VAR_ADDRESS
 /end VAR_CHARACTERISTIC
 /begin VAR_CHARACTERISTIC TP_U8TCSCpBsTurnPG4ASFBCtlP_R[4] EngCalVariantCriterion
  /begin VAR_ADDRESS 0x8003A2F6 0x8003B0F6 0x8003BEF6 0x8003CCF6 0x8003DAF6 0x8003E8F6 0x8003F6F6 0x800404F6 0x800412F6 0x800420F6 0x80042EF6 0x80043CF6 0x80044AF6 0x800458F6 0x800466F6 0x800474F6 0x800482F6 0x800490F6 0x80049EF6 0x8004ACF6 0x8004BAF6 0x8004C8F6 0x8004D6F6 0x8004E4F6 /end VAR_ADDRESS
 /end VAR_CHARACTERISTIC
 /begin VAR_CHARACTERISTIC TP_U8TCSCpBtcsEndByHuntingWhlSpnDiffThr EngCalVariantCriterion
  /begin VAR_ADDRESS 0x8003A2F7 0x8003B0F7 0x8003BEF7 0x8003CCF7 0x8003DAF7 0x8003E8F7 0x8003F6F7 0x800404F7 0x800412F7 0x800420F7 0x80042EF7 0x80043CF7 0x80044AF7 0x800458F7 0x800466F7 0x800474F7 0x800482F7 0x800490F7 0x80049EF7 0x8004ACF7 0x8004BAF7 0x8004C8F7 0x8004D6F7 0x8004E4F7 /end VAR_ADDRESS
 /end VAR_CHARACTERISTIC
 /begin VAR_CHARACTERISTIC TP_U8TCSCpChngRateWhlSpin_1 EngCalVariantCriterion
  /begin VAR_ADDRESS 0x8003A2F8 0x8003B0F8 0x8003BEF8 0x8003CCF8 0x8003DAF8 0x8003E8F8 0x8003F6F8 0x800404F8 0x800412F8 0x800420F8 0x80042EF8 0x80043CF8 0x80044AF8 0x800458F8 0x800466F8 0x800474F8 0x800482F8 0x800490F8 0x80049EF8 0x8004ACF8 0x8004BAF8 0x8004C8F8 0x8004D6F8 0x8004E4F8 /end VAR_ADDRESS
 /end VAR_CHARACTERISTIC
 /begin VAR_CHARACTERISTIC TP_U8TCSCpChngRateWhlSpin_2 EngCalVariantCriterion
  /begin VAR_ADDRESS 0x8003A2F9 0x8003B0F9 0x8003BEF9 0x8003CCF9 0x8003DAF9 0x8003E8F9 0x8003F6F9 0x800404F9 0x800412F9 0x800420F9 0x80042EF9 0x80043CF9 0x80044AF9 0x800458F9 0x800466F9 0x800474F9 0x800482F9 0x800490F9 0x80049EF9 0x8004ACF9 0x8004BAF9 0x8004C8F9 0x8004D6F9 0x8004E4F9 /end VAR_ADDRESS
 /end VAR_CHARACTERISTIC
 /begin VAR_CHARACTERISTIC TP_U8TCSCpCurntFiltGain EngCalVariantCriterion
  /begin VAR_ADDRESS 0x8003A2FA 0x8003B0FA 0x8003BEFA 0x8003CCFA 0x8003DAFA 0x8003E8FA 0x8003F6FA 0x800404FA 0x800412FA 0x800420FA 0x80042EFA 0x80043CFA 0x80044AFA 0x800458FA 0x800466FA 0x800474FA 0x800482FA 0x800490FA 0x80049EFA 0x8004ACFA 0x8004BAFA 0x8004C8FA 0x8004D6FA 0x8004E4FA /end VAR_ADDRESS
 /end VAR_CHARACTERISTIC
 /begin VAR_CHARACTERISTIC TP_U8TCSCpDecBsTarBrkF4ESCBrkCtl EngCalVariantCriterion
  /begin VAR_ADDRESS 0x8003A2FB 0x8003B0FB 0x8003BEFB 0x8003CCFB 0x8003DAFB 0x8003E8FB 0x8003F6FB 0x800404FB 0x800412FB 0x800420FB 0x80042EFB 0x80043CFB 0x80044AFB 0x800458FB 0x800466FB 0x800474FB 0x800482FB 0x800490FB 0x80049EFB 0x8004ACFB 0x8004BAFB 0x8004C8FB 0x8004D6FB 0x8004E4FB /end VAR_ADDRESS
 /end VAR_CHARACTERISTIC
 /begin VAR_CHARACTERISTIC TP_U8TCSCpFFReductFactInHunting EngCalVariantCriterion
  /begin VAR_ADDRESS 0x8003A2FF 0x8003B0FF 0x8003BEFF 0x8003CCFF 0x8003DAFF 0x8003E8FF 0x8003F6FF 0x800404FF 0x800412FF 0x800420FF 0x80042EFF 0x80043CFF 0x80044AFF 0x800458FF 0x800466FF 0x800474FF 0x800482FF 0x800490FF 0x80049EFF 0x8004ACFF 0x8004BAFF 0x8004C8FF 0x8004D6FF 0x8004E4FF /end VAR_ADDRESS
 /end VAR_CHARACTERISTIC
 /begin VAR_CHARACTERISTIC TP_U8TCSCpFadeOutDctScan EngCalVariantCriterion
  /begin VAR_ADDRESS 0x8003A2FC 0x8003B0FC 0x8003BEFC 0x8003CCFC 0x8003DAFC 0x8003E8FC 0x8003F6FC 0x800404FC 0x800412FC 0x800420FC 0x80042EFC 0x80043CFC 0x80044AFC 0x800458FC 0x800466FC 0x800474FC 0x800482FC 0x800490FC 0x80049EFC 0x8004ACFC 0x8004BAFC 0x8004C8FC 0x8004D6FC 0x8004E4FC /end VAR_ADDRESS
 /end VAR_CHARACTERISTIC
 /begin VAR_CHARACTERISTIC TP_U8TCSCpFadeOutExitScan EngCalVariantCriterion
  /begin VAR_ADDRESS 0x8003A2FD 0x8003B0FD 0x8003BEFD 0x8003CCFD 0x8003DAFD 0x8003E8FD 0x8003F6FD 0x800404FD 0x800412FD 0x800420FD 0x80042EFD 0x80043CFD 0x80044AFD 0x800458FD 0x800466FD 0x800474FD 0x800482FD 0x800490FD 0x80049EFD 0x8004ACFD 0x8004BAFD 0x8004C8FD 0x8004D6FD 0x8004E4FD /end VAR_ADDRESS
 /end VAR_CHARACTERISTIC
 /begin VAR_CHARACTERISTIC TP_U8TCSCpFadeOutSpdDiffThr EngCalVariantCriterion
  /begin VAR_ADDRESS 0x8003A2FE 0x8003B0FE 0x8003BEFE 0x8003CCFE 0x8003DAFE 0x8003E8FE 0x8003F6FE 0x800404FE 0x800412FE 0x800420FE 0x80042EFE 0x80043CFE 0x80044AFE 0x800458FE 0x800466FE 0x800474FE 0x800482FE 0x800490FE 0x80049EFE 0x8004ACFE 0x8004BAFE 0x8004C8FE 0x8004D6FE 0x8004E4FE /end VAR_ADDRESS
 /end VAR_CHARACTERISTIC
 /begin VAR_CHARACTERISTIC TP_U8TCSCpFltGain4GearShiftSt EngCalVariantCriterion
  /begin VAR_ADDRESS 0x8003A300 0x8003B100 0x8003BF00 0x8003CD00 0x8003DB00 0x8003E900 0x8003F700 0x80040500 0x80041300 0x80042100 0x80042F00 0x80043D00 0x80044B00 0x80045900 0x80046700 0x80047500 0x80048300 0x80049100 0x80049F00 0x8004AD00 0x8004BB00 0x8004C900 0x8004D700 0x8004E500 /end VAR_ADDRESS
 /end VAR_CHARACTERISTIC
 /begin VAR_CHARACTERISTIC TP_U8TCSCpFltGain4GearShiftTurn EngCalVariantCriterion
  /begin VAR_ADDRESS 0x8003A301 0x8003B101 0x8003BF01 0x8003CD01 0x8003DB01 0x8003E901 0x8003F701 0x80040501 0x80041301 0x80042101 0x80042F01 0x80043D01 0x80044B01 0x80045901 0x80046701 0x80047501 0x80048301 0x80049101 0x80049F01 0x8004AD01 0x8004BB01 0x8004C901 0x8004D701 0x8004E501 /end VAR_ADDRESS
 /end VAR_CHARACTERISTIC
 /begin VAR_CHARACTERISTIC TP_U8TCSCpHghMuWhlDelSpinTh EngCalVariantCriterion
  /begin VAR_ADDRESS 0x8003A302 0x8003B102 0x8003BF02 0x8003CD02 0x8003DB02 0x8003E902 0x8003F702 0x80040502 0x80041302 0x80042102 0x80042F02 0x80043D02 0x80044B02 0x80045902 0x80046702 0x80047502 0x80048302 0x80049102 0x80049F02 0x8004AD02 0x8004BB02 0x8004C902 0x8004D702 0x8004E502 /end VAR_ADDRESS
 /end VAR_CHARACTERISTIC
 /begin VAR_CHARACTERISTIC TP_U8TCSCpHghMuWhlHuntSpinTh EngCalVariantCriterion
  /begin VAR_ADDRESS 0x8003A303 0x8003B103 0x8003BF03 0x8003CD03 0x8003DB03 0x8003E903 0x8003F703 0x80040503 0x80041303 0x80042103 0x80042F03 0x80043D03 0x80044B03 0x80045903 0x80046703 0x80047503 0x80048303 0x80049103 0x80049F03 0x8004AD03 0x8004BB03 0x8004C903 0x8004D703 0x8004E503 /end VAR_ADDRESS
 /end VAR_CHARACTERISTIC
 /begin VAR_CHARACTERISTIC TP_U8TCSCpHghMuWhlSpinTh EngCalVariantCriterion
  /begin VAR_ADDRESS 0x8003A304 0x8003B104 0x8003BF04 0x8003CD04 0x8003DB04 0x8003E904 0x8003F704 0x80040504 0x80041304 0x80042104 0x80042F04 0x80043D04 0x80044B04 0x80045904 0x80046704 0x80047504 0x80048304 0x80049104 0x80049F04 0x8004AD04 0x8004BB04 0x8004C904 0x8004D704 0x8004E504 /end VAR_ADDRESS
 /end VAR_CHARACTERISTIC
 /begin VAR_CHARACTERISTIC TP_U8TCSCpHghMuWhlSpinThHill EngCalVariantCriterion
  /begin VAR_ADDRESS 0x8003A305 0x8003B105 0x8003BF05 0x8003CD05 0x8003DB05 0x8003E905 0x8003F705 0x80040505 0x80041305 0x80042105 0x80042F05 0x80043D05 0x80044B05 0x80045905 0x80046705 0x80047505 0x80048305 0x80049105 0x80049F05 0x8004AD05 0x8004BB05 0x8004C905 0x8004D705 0x8004E505 /end VAR_ADDRESS
 /end VAR_CHARACTERISTIC
 /begin VAR_CHARACTERISTIC TP_U8TCSCpHghMuWhlSpinTm EngCalVariantCriterion
  /begin VAR_ADDRESS 0x8003A306 0x8003B106 0x8003BF06 0x8003CD06 0x8003DB06 0x8003E906 0x8003F706 0x80040506 0x80041306 0x80042106 0x80042F06 0x80043D06 0x80044B06 0x80045906 0x80046706 0x80047506 0x80048306 0x80049106 0x80049F06 0x8004AD06 0x8004BB06 0x8004C906 0x8004D706 0x8004E506 /end VAR_ADDRESS
 /end VAR_CHARACTERISTIC
 /begin VAR_CHARACTERISTIC TP_U8TCSCpICtlActCntTh EngCalVariantCriterion
  /begin VAR_ADDRESS 0x8003A307 0x8003B107 0x8003BF07 0x8003CD07 0x8003DB07 0x8003E907 0x8003F707 0x80040507 0x80041307 0x80042107 0x80042F07 0x80043D07 0x80044B07 0x80045907 0x80046707 0x80047507 0x80048307 0x80049107 0x80049F07 0x8004AD07 0x8004BB07 0x8004C907 0x8004D707 0x8004E507 /end VAR_ADDRESS
 /end VAR_CHARACTERISTIC
 /begin VAR_CHARACTERISTIC TP_U8TCSCpICtlActWhlChgRateTh EngCalVariantCriterion
  /begin VAR_ADDRESS 0x8003A308 0x8003B108 0x8003BF08 0x8003CD08 0x8003DB08 0x8003E908 0x8003F708 0x80040508 0x80041308 0x80042108 0x80042F08 0x80043D08 0x80044B08 0x80045908 0x80046708 0x80047508 0x80048308 0x80049108 0x80049F08 0x8004AD08 0x8004BB08 0x8004C908 0x8004D708 0x8004E508 /end VAR_ADDRESS
 /end VAR_CHARACTERISTIC
 /begin VAR_CHARACTERISTIC TP_U8TCSCpIgainEffPctStN_F EngCalVariantCriterion
  /begin VAR_ADDRESS 0x8003A309 0x8003B109 0x8003BF09 0x8003CD09 0x8003DB09 0x8003E909 0x8003F709 0x80040509 0x80041309 0x80042109 0x80042F09 0x80043D09 0x80044B09 0x80045909 0x80046709 0x80047509 0x80048309 0x80049109 0x80049F09 0x8004AD09 0x8004BB09 0x8004C909 0x8004D709 0x8004E509 /end VAR_ADDRESS
 /end VAR_CHARACTERISTIC
 /begin VAR_CHARACTERISTIC TP_U8TCSCpIgainEffPctStN_R EngCalVariantCriterion
  /begin VAR_ADDRESS 0x8003A30A 0x8003B10A 0x8003BF0A 0x8003CD0A 0x8003DB0A 0x8003E90A 0x8003F70A 0x8004050A 0x8004130A 0x8004210A 0x80042F0A 0x80043D0A 0x80044B0A 0x8004590A 0x8004670A 0x8004750A 0x8004830A 0x8004910A 0x80049F0A 0x8004AD0A 0x8004BB0A 0x8004C90A 0x8004D70A 0x8004E50A /end VAR_ADDRESS
 /end VAR_CHARACTERISTIC
 /begin VAR_CHARACTERISTIC TP_U8TCSCpIgainEffPctStP_F EngCalVariantCriterion
  /begin VAR_ADDRESS 0x8003A30B 0x8003B10B 0x8003BF0B 0x8003CD0B 0x8003DB0B 0x8003E90B 0x8003F70B 0x8004050B 0x8004130B 0x8004210B 0x80042F0B 0x80043D0B 0x80044B0B 0x8004590B 0x8004670B 0x8004750B 0x8004830B 0x8004910B 0x80049F0B 0x8004AD0B 0x8004BB0B 0x8004C90B 0x8004D70B 0x8004E50B /end VAR_ADDRESS
 /end VAR_CHARACTERISTIC
 /begin VAR_CHARACTERISTIC TP_U8TCSCpIgainEffPctStP_R EngCalVariantCriterion
  /begin VAR_ADDRESS 0x8003A30C 0x8003B10C 0x8003BF0C 0x8003CD0C 0x8003DB0C 0x8003E90C 0x8003F70C 0x8004050C 0x8004130C 0x8004210C 0x80042F0C 0x80043D0C 0x80044B0C 0x8004590C 0x8004670C 0x8004750C 0x8004830C 0x8004910C 0x80049F0C 0x8004AD0C 0x8004BB0C 0x8004C90C 0x8004D70C 0x8004E50C /end VAR_ADDRESS
 /end VAR_CHARACTERISTIC
 /begin VAR_CHARACTERISTIC TP_U8TCSCpIgainEffPctTurnN_F EngCalVariantCriterion
  /begin VAR_ADDRESS 0x8003A30D 0x8003B10D 0x8003BF0D 0x8003CD0D 0x8003DB0D 0x8003E90D 0x8003F70D 0x8004050D 0x8004130D 0x8004210D 0x80042F0D 0x80043D0D 0x80044B0D 0x8004590D 0x8004670D 0x8004750D 0x8004830D 0x8004910D 0x80049F0D 0x8004AD0D 0x8004BB0D 0x8004C90D 0x8004D70D 0x8004E50D /end VAR_ADDRESS
 /end VAR_CHARACTERISTIC
 /begin VAR_CHARACTERISTIC TP_U8TCSCpIgainEffPctTurnN_R EngCalVariantCriterion
  /begin VAR_ADDRESS 0x8003A30E 0x8003B10E 0x8003BF0E 0x8003CD0E 0x8003DB0E 0x8003E90E 0x8003F70E 0x8004050E 0x8004130E 0x8004210E 0x80042F0E 0x80043D0E 0x80044B0E 0x8004590E 0x8004670E 0x8004750E 0x8004830E 0x8004910E 0x80049F0E 0x8004AD0E 0x8004BB0E 0x8004C90E 0x8004D70E 0x8004E50E /end VAR_ADDRESS
 /end VAR_CHARACTERISTIC
 /begin VAR_CHARACTERISTIC TP_U8TCSCpIgainEffPctTurnP_F EngCalVariantCriterion
  /begin VAR_ADDRESS 0x8003A30F 0x8003B10F 0x8003BF0F 0x8003CD0F 0x8003DB0F 0x8003E90F 0x8003F70F 0x8004050F 0x8004130F 0x8004210F 0x80042F0F 0x80043D0F 0x80044B0F 0x8004590F 0x8004670F 0x8004750F 0x8004830F 0x8004910F 0x80049F0F 0x8004AD0F 0x8004BB0F 0x8004C90F 0x8004D70F 0x8004E50F /end VAR_ADDRESS
 /end VAR_CHARACTERISTIC
 /begin VAR_CHARACTERISTIC TP_U8TCSCpIgainEffPctTurnP_R EngCalVariantCriterion
  /begin VAR_ADDRESS 0x8003A310 0x8003B110 0x8003BF10 0x8003CD10 0x8003DB10 0x8003E910 0x8003F710 0x80040510 0x80041310 0x80042110 0x80042F10 0x80043D10 0x80044B10 0x80045910 0x80046710 0x80047510 0x80048310 0x80049110 0x80049F10 0x8004AD10 0x8004BB10 0x8004C910 0x8004D710 0x8004E510 /end VAR_ADDRESS
 /end VAR_CHARACTERISTIC
 /begin VAR_CHARACTERISTIC TP_U8TCSCpIniMtrCtlModeTime EngCalVariantCriterion
  /begin VAR_ADDRESS 0x8003A311 0x8003B111 0x8003BF11 0x8003CD11 0x8003DB11 0x8003E911 0x8003F711 0x80040511 0x80041311 0x80042111 0x80042F11 0x80043D11 0x80044B11 0x80045911 0x80046711 0x80047511 0x80048311 0x80049111 0x80049F11 0x8004AD11 0x8004BB11 0x8004C911 0x8004D711 0x8004E511 /end VAR_ADDRESS
 /end VAR_CHARACTERISTIC
 /begin VAR_CHARACTERISTIC TP_U8TCSCpIniMtrCtlModeTimeInTurn EngCalVariantCriterion
  /begin VAR_ADDRESS 0x8003A312 0x8003B112 0x8003BF12 0x8003CD12 0x8003DB12 0x8003E912 0x8003F712 0x80040512 0x80041312 0x80042112 0x80042F12 0x80043D12 0x80044B12 0x80045912 0x80046712 0x80047512 0x80048312 0x80049112 0x80049F12 0x8004AD12 0x8004BB12 0x8004C912 0x8004D712 0x8004E512 /end VAR_ADDRESS
 /end VAR_CHARACTERISTIC
 /begin VAR_CHARACTERISTIC TP_U8TCSCpIniPres EngCalVariantCriterion
  /begin VAR_ADDRESS 0x8003A313 0x8003B113 0x8003BF13 0x8003CD13 0x8003DB13 0x8003E913 0x8003F713 0x80040513 0x80041313 0x80042113 0x80042F13 0x80043D13 0x80044B13 0x80045913 0x80046713 0x80047513 0x80048313 0x80049113 0x80049F13 0x8004AD13 0x8004BB13 0x8004C913 0x8004D713 0x8004E513 /end VAR_ADDRESS
 /end VAR_CHARACTERISTIC
 /begin VAR_CHARACTERISTIC TP_U8TCSCpIniTCVCtlModeTime EngCalVariantCriterion
  /begin VAR_ADDRESS 0x8003A314 0x8003B114 0x8003BF14 0x8003CD14 0x8003DB14 0x8003E914 0x8003F714 0x80040514 0x80041314 0x80042114 0x80042F14 0x80043D14 0x80044B14 0x80045914 0x80046714 0x80047514 0x80048314 0x80049114 0x80049F14 0x8004AD14 0x8004BB14 0x8004C914 0x8004D714 0x8004E514 /end VAR_ADDRESS
 /end VAR_CHARACTERISTIC
 /begin VAR_CHARACTERISTIC TP_U8TCSCpIniTCVCtlModeTimeHill EngCalVariantCriterion
  /begin VAR_ADDRESS 0x8003A315 0x8003B115 0x8003BF15 0x8003CD15 0x8003DB15 0x8003E915 0x8003F715 0x80040515 0x80041315 0x80042115 0x80042F15 0x80043D15 0x80044B15 0x80045915 0x80046715 0x80047515 0x80048315 0x80049115 0x80049F15 0x8004AD15 0x8004BB15 0x8004C915 0x8004D715 0x8004E515 /end VAR_ADDRESS
 /end VAR_CHARACTERISTIC
 /begin VAR_CHARACTERISTIC TP_U8TCSCpIniTCVCtlModeTimeHunt EngCalVariantCriterion
  /begin VAR_ADDRESS 0x8003A316 0x8003B116 0x8003BF16 0x8003CD16 0x8003DB16 0x8003E916 0x8003F716 0x80040516 0x80041316 0x80042116 0x80042F16 0x80043D16 0x80044B16 0x80045916 0x80046716 0x80047516 0x80048316 0x80049116 0x80049F16 0x8004AD16 0x8004BB16 0x8004C916 0x8004D716 0x8004E516 /end VAR_ADDRESS
 /end VAR_CHARACTERISTIC
 /begin VAR_CHARACTERISTIC TP_U8TCSCpIniTCVCtlModeTimeInTurn EngCalVariantCriterion
  /begin VAR_ADDRESS 0x8003A317 0x8003B117 0x8003BF17 0x8003CD17 0x8003DB17 0x8003E917 0x8003F717 0x80040517 0x80041317 0x80042117 0x80042F17 0x80043D17 0x80044B17 0x80045917 0x80046717 0x80047517 0x80048317 0x80049117 0x80049F17 0x8004AD17 0x8004BB17 0x8004C917 0x8004D717 0x8004E517 /end VAR_ADDRESS
 /end VAR_CHARACTERISTIC
 /begin VAR_CHARACTERISTIC TP_U8TCSCpIniVCACtlModeMtorTime EngCalVariantCriterion
  /begin VAR_ADDRESS 0x8003A318 0x8003B118 0x8003BF18 0x8003CD18 0x8003DB18 0x8003E918 0x8003F718 0x80040518 0x80041318 0x80042118 0x80042F18 0x80043D18 0x80044B18 0x80045918 0x80046718 0x80047518 0x80048318 0x80049118 0x80049F18 0x8004AD18 0x8004BB18 0x8004C918 0x8004D718 0x8004E518 /end VAR_ADDRESS
 /end VAR_CHARACTERISTIC
 /begin VAR_CHARACTERISTIC TP_U8TCSCpIniVCACtlModeTime EngCalVariantCriterion
  /begin VAR_ADDRESS 0x8003A319 0x8003B119 0x8003BF19 0x8003CD19 0x8003DB19 0x8003E919 0x8003F719 0x80040519 0x80041319 0x80042119 0x80042F19 0x80043D19 0x80044B19 0x80045919 0x80046719 0x80047519 0x80048319 0x80049119 0x80049F19 0x8004AD19 0x8004BB19 0x8004C919 0x8004D719 0x8004E519 /end VAR_ADDRESS
 /end VAR_CHARACTERISTIC
 /begin VAR_CHARACTERISTIC TP_U8TCSCpL2SplitSuspectTorq EngCalVariantCriterion
  /begin VAR_ADDRESS 0x8003A31A 0x8003B11A 0x8003BF1A 0x8003CD1A 0x8003DB1A 0x8003E91A 0x8003F71A 0x8004051A 0x8004131A 0x8004211A 0x80042F1A 0x80043D1A 0x80044B1A 0x8004591A 0x8004671A 0x8004751A 0x8004831A 0x8004911A 0x80049F1A 0x8004AD1A 0x8004BB1A 0x8004C91A 0x8004D71A 0x8004E51A /end VAR_ADDRESS
 /end VAR_CHARACTERISTIC
 /begin VAR_CHARACTERISTIC TP_U8TCSCpLowPresTh4IniTCVCtl EngCalVariantCriterion
  /begin VAR_ADDRESS 0x8003A31B 0x8003B11B 0x8003BF1B 0x8003CD1B 0x8003DB1B 0x8003E91B 0x8003F71B 0x8004051B 0x8004131B 0x8004211B 0x80042F1B 0x80043D1B 0x80044B1B 0x8004591B 0x8004671B 0x8004751B 0x8004831B 0x8004911B 0x80049F1B 0x8004AD1B 0x8004BB1B 0x8004C91B 0x8004D71B 0x8004E51B /end VAR_ADDRESS
 /end VAR_CHARACTERISTIC
 /begin VAR_CHARACTERISTIC TP_U8TCSCpMonTime4AsymSpnCtlS_1 EngCalVariantCriterion
  /begin VAR_ADDRESS 0x8003A31C 0x8003B11C 0x8003BF1C 0x8003CD1C 0x8003DB1C 0x8003E91C 0x8003F71C 0x8004051C 0x8004131C 0x8004211C 0x80042F1C 0x80043D1C 0x80044B1C 0x8004591C 0x8004671C 0x8004751C 0x8004831C 0x8004911C 0x80049F1C 0x8004AD1C 0x8004BB1C 0x8004C91C 0x8004D71C 0x8004E51C /end VAR_ADDRESS
 /end VAR_CHARACTERISTIC
 /begin VAR_CHARACTERISTIC TP_U8TCSCpMonTime4AsymSpnCtlS_2 EngCalVariantCriterion
  /begin VAR_ADDRESS 0x8003A31D 0x8003B11D 0x8003BF1D 0x8003CD1D 0x8003DB1D 0x8003E91D 0x8003F71D 0x8004051D 0x8004131D 0x8004211D 0x80042F1D 0x80043D1D 0x80044B1D 0x8004591D 0x8004671D 0x8004751D 0x8004831D 0x8004911D 0x80049F1D 0x8004AD1D 0x8004BB1D 0x8004C91D 0x8004D71D 0x8004E51D /end VAR_ADDRESS
 /end VAR_CHARACTERISTIC
 /begin VAR_CHARACTERISTIC TP_U8TCSCpMonTime4SymSpnCtlS_1 EngCalVariantCriterion
  /begin VAR_ADDRESS 0x8003A31E 0x8003B11E 0x8003BF1E 0x8003CD1E 0x8003DB1E 0x8003E91E 0x8003F71E 0x8004051E 0x8004131E 0x8004211E 0x80042F1E 0x80043D1E 0x80044B1E 0x8004591E 0x8004671E 0x8004751E 0x8004831E 0x8004911E 0x80049F1E 0x8004AD1E 0x8004BB1E 0x8004C91E 0x8004D71E 0x8004E51E /end VAR_ADDRESS
 /end VAR_CHARACTERISTIC
 /begin VAR_CHARACTERISTIC TP_U8TCSCpMonTime4SymSpnCtlS_2 EngCalVariantCriterion
  /begin VAR_ADDRESS 0x8003A31F 0x8003B11F 0x8003BF1F 0x8003CD1F 0x8003DB1F 0x8003E91F 0x8003F71F 0x8004051F 0x8004131F 0x8004211F 0x80042F1F 0x80043D1F 0x80044B1F 0x8004591F 0x8004671F 0x8004751F 0x8004831F 0x8004911F 0x80049F1F 0x8004AD1F 0x8004BB1F 0x8004C91F 0x8004D71F 0x8004E51F /end VAR_ADDRESS
 /end VAR_CHARACTERISTIC
 /begin VAR_CHARACTERISTIC TP_U8TCSCpMtrFstRnTmrAftHghMuWhStb EngCalVariantCriterion
  /begin VAR_ADDRESS 0x8003A320 0x8003B120 0x8003BF20 0x8003CD20 0x8003DB20 0x8003E920 0x8003F720 0x80040520 0x80041320 0x80042120 0x80042F20 0x80043D20 0x80044B20 0x80045920 0x80046720 0x80047520 0x80048320 0x80049120 0x80049F20 0x8004AD20 0x8004BB20 0x8004C920 0x8004D720 0x8004E520 /end VAR_ADDRESS
 /end VAR_CHARACTERISTIC
 /begin VAR_CHARACTERISTIC TP_U8TCSCpPgFac4ASFBCtlSt_F[0] EngCalVariantCriterion
  /begin VAR_ADDRESS 0x8003A321 0x8003B121 0x8003BF21 0x8003CD21 0x8003DB21 0x8003E921 0x8003F721 0x80040521 0x80041321 0x80042121 0x80042F21 0x80043D21 0x80044B21 0x80045921 0x80046721 0x80047521 0x80048321 0x80049121 0x80049F21 0x8004AD21 0x8004BB21 0x8004C921 0x8004D721 0x8004E521 /end VAR_ADDRESS
 /end VAR_CHARACTERISTIC
 /begin VAR_CHARACTERISTIC TP_U8TCSCpPgFac4ASFBCtlSt_F[1] EngCalVariantCriterion
  /begin VAR_ADDRESS 0x8003A322 0x8003B122 0x8003BF22 0x8003CD22 0x8003DB22 0x8003E922 0x8003F722 0x80040522 0x80041322 0x80042122 0x80042F22 0x80043D22 0x80044B22 0x80045922 0x80046722 0x80047522 0x80048322 0x80049122 0x80049F22 0x8004AD22 0x8004BB22 0x8004C922 0x8004D722 0x8004E522 /end VAR_ADDRESS
 /end VAR_CHARACTERISTIC
 /begin VAR_CHARACTERISTIC TP_U8TCSCpPgFac4ASFBCtlSt_F[2] EngCalVariantCriterion
  /begin VAR_ADDRESS 0x8003A323 0x8003B123 0x8003BF23 0x8003CD23 0x8003DB23 0x8003E923 0x8003F723 0x80040523 0x80041323 0x80042123 0x80042F23 0x80043D23 0x80044B23 0x80045923 0x80046723 0x80047523 0x80048323 0x80049123 0x80049F23 0x8004AD23 0x8004BB23 0x8004C923 0x8004D723 0x8004E523 /end VAR_ADDRESS
 /end VAR_CHARACTERISTIC
 /begin VAR_CHARACTERISTIC TP_U8TCSCpPgFac4ASFBCtlSt_F[3] EngCalVariantCriterion
  /begin VAR_ADDRESS 0x8003A324 0x8003B124 0x8003BF24 0x8003CD24 0x8003DB24 0x8003E924 0x8003F724 0x80040524 0x80041324 0x80042124 0x80042F24 0x80043D24 0x80044B24 0x80045924 0x80046724 0x80047524 0x80048324 0x80049124 0x80049F24 0x8004AD24 0x8004BB24 0x8004C924 0x8004D724 0x8004E524 /end VAR_ADDRESS
 /end VAR_CHARACTERISTIC
 /begin VAR_CHARACTERISTIC TP_U8TCSCpPgFac4ASFBCtlSt_F[4] EngCalVariantCriterion
  /begin VAR_ADDRESS 0x8003A325 0x8003B125 0x8003BF25 0x8003CD25 0x8003DB25 0x8003E925 0x8003F725 0x80040525 0x80041325 0x80042125 0x80042F25 0x80043D25 0x80044B25 0x80045925 0x80046725 0x80047525 0x80048325 0x80049125 0x80049F25 0x8004AD25 0x8004BB25 0x8004C925 0x8004D725 0x8004E525 /end VAR_ADDRESS
 /end VAR_CHARACTERISTIC
 /begin VAR_CHARACTERISTIC TP_U8TCSCpPgFac4ASFBCtlSt_R[0] EngCalVariantCriterion
  /begin VAR_ADDRESS 0x8003A326 0x8003B126 0x8003BF26 0x8003CD26 0x8003DB26 0x8003E926 0x8003F726 0x80040526 0x80041326 0x80042126 0x80042F26 0x80043D26 0x80044B26 0x80045926 0x80046726 0x80047526 0x80048326 0x80049126 0x80049F26 0x8004AD26 0x8004BB26 0x8004C926 0x8004D726 0x8004E526 /end VAR_ADDRESS
 /end VAR_CHARACTERISTIC
 /begin VAR_CHARACTERISTIC TP_U8TCSCpPgFac4ASFBCtlSt_R[1] EngCalVariantCriterion
  /begin VAR_ADDRESS 0x8003A327 0x8003B127 0x8003BF27 0x8003CD27 0x8003DB27 0x8003E927 0x8003F727 0x80040527 0x80041327 0x80042127 0x80042F27 0x80043D27 0x80044B27 0x80045927 0x80046727 0x80047527 0x80048327 0x80049127 0x80049F27 0x8004AD27 0x8004BB27 0x8004C927 0x8004D727 0x8004E527 /end VAR_ADDRESS
 /end VAR_CHARACTERISTIC
 /begin VAR_CHARACTERISTIC TP_U8TCSCpPgFac4ASFBCtlSt_R[2] EngCalVariantCriterion
  /begin VAR_ADDRESS 0x8003A328 0x8003B128 0x8003BF28 0x8003CD28 0x8003DB28 0x8003E928 0x8003F728 0x80040528 0x80041328 0x80042128 0x80042F28 0x80043D28 0x80044B28 0x80045928 0x80046728 0x80047528 0x80048328 0x80049128 0x80049F28 0x8004AD28 0x8004BB28 0x8004C928 0x8004D728 0x8004E528 /end VAR_ADDRESS
 /end VAR_CHARACTERISTIC
 /begin VAR_CHARACTERISTIC TP_U8TCSCpPgFac4ASFBCtlSt_R[3] EngCalVariantCriterion
  /begin VAR_ADDRESS 0x8003A329 0x8003B129 0x8003BF29 0x8003CD29 0x8003DB29 0x8003E929 0x8003F729 0x80040529 0x80041329 0x80042129 0x80042F29 0x80043D29 0x80044B29 0x80045929 0x80046729 0x80047529 0x80048329 0x80049129 0x80049F29 0x8004AD29 0x8004BB29 0x8004C929 0x8004D729 0x8004E529 /end VAR_ADDRESS
 /end VAR_CHARACTERISTIC
 /begin VAR_CHARACTERISTIC TP_U8TCSCpPgFac4ASFBCtlSt_R[4] EngCalVariantCriterion
  /begin VAR_ADDRESS 0x8003A32A 0x8003B12A 0x8003BF2A 0x8003CD2A 0x8003DB2A 0x8003E92A 0x8003F72A 0x8004052A 0x8004132A 0x8004212A 0x80042F2A 0x80043D2A 0x80044B2A 0x8004592A 0x8004672A 0x8004752A 0x8004832A 0x8004912A 0x80049F2A 0x8004AD2A 0x8004BB2A 0x8004C92A 0x8004D72A 0x8004E52A /end VAR_ADDRESS
 /end VAR_CHARACTERISTIC
 /begin VAR_CHARACTERISTIC TP_U8TCSCpPgFac4ASFBCtlTurn_F[0] EngCalVariantCriterion
  /begin VAR_ADDRESS 0x8003A32B 0x8003B12B 0x8003BF2B 0x8003CD2B 0x8003DB2B 0x8003E92B 0x8003F72B 0x8004052B 0x8004132B 0x8004212B 0x80042F2B 0x80043D2B 0x80044B2B 0x8004592B 0x8004672B 0x8004752B 0x8004832B 0x8004912B 0x80049F2B 0x8004AD2B 0x8004BB2B 0x8004C92B 0x8004D72B 0x8004E52B /end VAR_ADDRESS
 /end VAR_CHARACTERISTIC
 /begin VAR_CHARACTERISTIC TP_U8TCSCpPgFac4ASFBCtlTurn_F[1] EngCalVariantCriterion
  /begin VAR_ADDRESS 0x8003A32C 0x8003B12C 0x8003BF2C 0x8003CD2C 0x8003DB2C 0x8003E92C 0x8003F72C 0x8004052C 0x8004132C 0x8004212C 0x80042F2C 0x80043D2C 0x80044B2C 0x8004592C 0x8004672C 0x8004752C 0x8004832C 0x8004912C 0x80049F2C 0x8004AD2C 0x8004BB2C 0x8004C92C 0x8004D72C 0x8004E52C /end VAR_ADDRESS
 /end VAR_CHARACTERISTIC
 /begin VAR_CHARACTERISTIC TP_U8TCSCpPgFac4ASFBCtlTurn_F[2] EngCalVariantCriterion
  /begin VAR_ADDRESS 0x8003A32D 0x8003B12D 0x8003BF2D 0x8003CD2D 0x8003DB2D 0x8003E92D 0x8003F72D 0x8004052D 0x8004132D 0x8004212D 0x80042F2D 0x80043D2D 0x80044B2D 0x8004592D 0x8004672D 0x8004752D 0x8004832D 0x8004912D 0x80049F2D 0x8004AD2D 0x8004BB2D 0x8004C92D 0x8004D72D 0x8004E52D /end VAR_ADDRESS
 /end VAR_CHARACTERISTIC
 /begin VAR_CHARACTERISTIC TP_U8TCSCpPgFac4ASFBCtlTurn_F[3] EngCalVariantCriterion
  /begin VAR_ADDRESS 0x8003A32E 0x8003B12E 0x8003BF2E 0x8003CD2E 0x8003DB2E 0x8003E92E 0x8003F72E 0x8004052E 0x8004132E 0x8004212E 0x80042F2E 0x80043D2E 0x80044B2E 0x8004592E 0x8004672E 0x8004752E 0x8004832E 0x8004912E 0x80049F2E 0x8004AD2E 0x8004BB2E 0x8004C92E 0x8004D72E 0x8004E52E /end VAR_ADDRESS
 /end VAR_CHARACTERISTIC
 /begin VAR_CHARACTERISTIC TP_U8TCSCpPgFac4ASFBCtlTurn_F[4] EngCalVariantCriterion
  /begin VAR_ADDRESS 0x8003A32F 0x8003B12F 0x8003BF2F 0x8003CD2F 0x8003DB2F 0x8003E92F 0x8003F72F 0x8004052F 0x8004132F 0x8004212F 0x80042F2F 0x80043D2F 0x80044B2F 0x8004592F 0x8004672F 0x8004752F 0x8004832F 0x8004912F 0x80049F2F 0x8004AD2F 0x8004BB2F 0x8004C92F 0x8004D72F 0x8004E52F /end VAR_ADDRESS
 /end VAR_CHARACTERISTIC
 /begin VAR_CHARACTERISTIC TP_U8TCSCpPgFac4ASFBCtlTurn_R[0] EngCalVariantCriterion
  /begin VAR_ADDRESS 0x8003A330 0x8003B130 0x8003BF30 0x8003CD30 0x8003DB30 0x8003E930 0x8003F730 0x80040530 0x80041330 0x80042130 0x80042F30 0x80043D30 0x80044B30 0x80045930 0x80046730 0x80047530 0x80048330 0x80049130 0x80049F30 0x8004AD30 0x8004BB30 0x8004C930 0x8004D730 0x8004E530 /end VAR_ADDRESS
 /end VAR_CHARACTERISTIC
 /begin VAR_CHARACTERISTIC TP_U8TCSCpPgFac4ASFBCtlTurn_R[1] EngCalVariantCriterion
  /begin VAR_ADDRESS 0x8003A331 0x8003B131 0x8003BF31 0x8003CD31 0x8003DB31 0x8003E931 0x8003F731 0x80040531 0x80041331 0x80042131 0x80042F31 0x80043D31 0x80044B31 0x80045931 0x80046731 0x80047531 0x80048331 0x80049131 0x80049F31 0x8004AD31 0x8004BB31 0x8004C931 0x8004D731 0x8004E531 /end VAR_ADDRESS
 /end VAR_CHARACTERISTIC
 /begin VAR_CHARACTERISTIC TP_U8TCSCpPgFac4ASFBCtlTurn_R[2] EngCalVariantCriterion
  /begin VAR_ADDRESS 0x8003A332 0x8003B132 0x8003BF32 0x8003CD32 0x8003DB32 0x8003E932 0x8003F732 0x80040532 0x80041332 0x80042132 0x80042F32 0x80043D32 0x80044B32 0x80045932 0x80046732 0x80047532 0x80048332 0x80049132 0x80049F32 0x8004AD32 0x8004BB32 0x8004C932 0x8004D732 0x8004E532 /end VAR_ADDRESS
 /end VAR_CHARACTERISTIC
 /begin VAR_CHARACTERISTIC TP_U8TCSCpPgFac4ASFBCtlTurn_R[3] EngCalVariantCriterion
  /begin VAR_ADDRESS 0x8003A333 0x8003B133 0x8003BF33 0x8003CD33 0x8003DB33 0x8003E933 0x8003F733 0x80040533 0x80041333 0x80042133 0x80042F33 0x80043D33 0x80044B33 0x80045933 0x80046733 0x80047533 0x80048333 0x80049133 0x80049F33 0x8004AD33 0x8004BB33 0x8004C933 0x8004D733 0x8004E533 /end VAR_ADDRESS
 /end VAR_CHARACTERISTIC
 /begin VAR_CHARACTERISTIC TP_U8TCSCpPgFac4ASFBCtlTurn_R[4] EngCalVariantCriterion
  /begin VAR_ADDRESS 0x8003A334 0x8003B134 0x8003BF34 0x8003CD34 0x8003DB34 0x8003E934 0x8003F734 0x80040534 0x80041334 0x80042134 0x80042F34 0x80043D34 0x80044B34 0x80045934 0x80046734 0x80047534 0x80048334 0x80049134 0x80049F34 0x8004AD34 0x8004BB34 0x8004C934 0x8004D734 0x8004E534 /end VAR_ADDRESS
 /end VAR_CHARACTERISTIC
 /begin VAR_CHARACTERISTIC TP_U8TCSCpPresDifLR4SymSp EngCalVariantCriterion
  /begin VAR_ADDRESS 0x8003A335 0x8003B135 0x8003BF35 0x8003CD35 0x8003DB35 0x8003E935 0x8003F735 0x80040535 0x80041335 0x80042135 0x80042F35 0x80043D35 0x80044B35 0x80045935 0x80046735 0x80047535 0x80048335 0x80049135 0x80049F35 0x8004AD35 0x8004BB35 0x8004C935 0x8004D735 0x8004E535 /end VAR_ADDRESS
 /end VAR_CHARACTERISTIC
 /begin VAR_CHARACTERISTIC TP_U8TCSCpRearCtlOfVCA EngCalVariantCriterion
  /begin VAR_ADDRESS 0x8003A336 0x8003B136 0x8003BF36 0x8003CD36 0x8003DB36 0x8003E936 0x8003F736 0x80040536 0x80041336 0x80042136 0x80042F36 0x80043D36 0x80044B36 0x80045936 0x80046736 0x80047536 0x80048336 0x80049136 0x80049F36 0x8004AD36 0x8004BB36 0x8004C936 0x8004D736 0x8004E536 /end VAR_ADDRESS
 /end VAR_CHARACTERISTIC
 /begin VAR_CHARACTERISTIC TP_U8TCSCpReducePgainF4GearShift EngCalVariantCriterion
  /begin VAR_ADDRESS 0x8003A337 0x8003B137 0x8003BF37 0x8003CD37 0x8003DB37 0x8003E937 0x8003F737 0x80040537 0x80041337 0x80042137 0x80042F37 0x80043D37 0x80044B37 0x80045937 0x80046737 0x80047537 0x80048337 0x80049137 0x80049F37 0x8004AD37 0x8004BB37 0x8004C937 0x8004D737 0x8004E537 /end VAR_ADDRESS
 /end VAR_CHARACTERISTIC
 /begin VAR_CHARACTERISTIC TP_U8TCSCpSclFctTrq2PresFrt EngCalVariantCriterion
  /begin VAR_ADDRESS 0x8003A338 0x8003B138 0x8003BF38 0x8003CD38 0x8003DB38 0x8003E938 0x8003F738 0x80040538 0x80041338 0x80042138 0x80042F38 0x80043D38 0x80044B38 0x80045938 0x80046738 0x80047538 0x80048338 0x80049138 0x80049F38 0x8004AD38 0x8004BB38 0x8004C938 0x8004D738 0x8004E538 /end VAR_ADDRESS
 /end VAR_CHARACTERISTIC
 /begin VAR_CHARACTERISTIC TP_U8TCSCpSclFctTrq2PresRer EngCalVariantCriterion
  /begin VAR_ADDRESS 0x8003A339 0x8003B139 0x8003BF39 0x8003CD39 0x8003DB39 0x8003E939 0x8003F739 0x80040539 0x80041339 0x80042139 0x80042F39 0x80043D39 0x80044B39 0x80045939 0x80046739 0x80047539 0x80048339 0x80049139 0x80049F39 0x8004AD39 0x8004BB39 0x8004C939 0x8004D739 0x8004E539 /end VAR_ADDRESS
 /end VAR_CHARACTERISTIC
 /begin VAR_CHARACTERISTIC TP_U8TCSCpSplitHilDctAccTh EngCalVariantCriterion
  /begin VAR_ADDRESS 0x8003A33A 0x8003B13A 0x8003BF3A 0x8003CD3A 0x8003DB3A 0x8003E93A 0x8003F73A 0x8004053A 0x8004133A 0x8004213A 0x80042F3A 0x80043D3A 0x80044B3A 0x8004593A 0x8004673A 0x8004753A 0x8004833A 0x8004913A 0x80049F3A 0x8004AD3A 0x8004BB3A 0x8004C93A 0x8004D73A 0x8004E53A /end VAR_ADDRESS
 /end VAR_CHARACTERISTIC
 /begin VAR_CHARACTERISTIC TP_U8TCSCpSplitHilDctEnterCnt EngCalVariantCriterion
  /begin VAR_ADDRESS 0x8003A33B 0x8003B13B 0x8003BF3B 0x8003CD3B 0x8003DB3B 0x8003E93B 0x8003F73B 0x8004053B 0x8004133B 0x8004213B 0x80042F3B 0x80043D3B 0x80044B3B 0x8004593B 0x8004673B 0x8004753B 0x8004833B 0x8004913B 0x80049F3B 0x8004AD3B 0x8004BB3B 0x8004C93B 0x8004D73B 0x8004E53B /end VAR_ADDRESS
 /end VAR_CHARACTERISTIC
 /begin VAR_CHARACTERISTIC TP_U8TCSCpSplitHilDctExitCnt EngCalVariantCriterion
  /begin VAR_ADDRESS 0x8003A33C 0x8003B13C 0x8003BF3C 0x8003CD3C 0x8003DB3C 0x8003E93C 0x8003F73C 0x8004053C 0x8004133C 0x8004213C 0x80042F3C 0x80043D3C 0x80044B3C 0x8004593C 0x8004673C 0x8004753C 0x8004833C 0x8004913C 0x80049F3C 0x8004AD3C 0x8004BB3C 0x8004C93C 0x8004D73C 0x8004E53C /end VAR_ADDRESS
 /end VAR_CHARACTERISTIC
 /begin VAR_CHARACTERISTIC TP_U8TCSCpSplitHilDctSpdTh EngCalVariantCriterion
  /begin VAR_ADDRESS 0x8003A33D 0x8003B13D 0x8003BF3D 0x8003CD3D 0x8003DB3D 0x8003E93D 0x8003F73D 0x8004053D 0x8004133D 0x8004213D 0x80042F3D 0x80043D3D 0x80044B3D 0x8004593D 0x8004673D 0x8004753D 0x8004833D 0x8004913D 0x80049F3D 0x8004AD3D 0x8004BB3D 0x8004C93D 0x8004D73D 0x8004E53D /end VAR_ADDRESS
 /end VAR_CHARACTERISTIC
 /begin VAR_CHARACTERISTIC TP_U8TCSCpSplitMuDctEnterCnt EngCalVariantCriterion
  /begin VAR_ADDRESS 0x8003A33E 0x8003B13E 0x8003BF3E 0x8003CD3E 0x8003DB3E 0x8003E93E 0x8003F73E 0x8004053E 0x8004133E 0x8004213E 0x80042F3E 0x80043D3E 0x80044B3E 0x8004593E 0x8004673E 0x8004753E 0x8004833E 0x8004913E 0x80049F3E 0x8004AD3E 0x8004BB3E 0x8004C93E 0x8004D73E 0x8004E53E /end VAR_ADDRESS
 /end VAR_CHARACTERISTIC
 /begin VAR_CHARACTERISTIC TP_U8TCSCpSplitMuDctExitCnt EngCalVariantCriterion
  /begin VAR_ADDRESS 0x8003A33F 0x8003B13F 0x8003BF3F 0x8003CD3F 0x8003DB3F 0x8003E93F 0x8003F73F 0x8004053F 0x8004133F 0x8004213F 0x80042F3F 0x80043D3F 0x80044B3F 0x8004593F 0x8004673F 0x8004753F 0x8004833F 0x8004913F 0x80049F3F 0x8004AD3F 0x8004BB3F 0x8004C93F 0x8004D73F 0x8004E53F /end VAR_ADDRESS
 /end VAR_CHARACTERISTIC
 /begin VAR_CHARACTERISTIC TP_U8TCSCpSplitMuDiffExitHyst EngCalVariantCriterion
  /begin VAR_ADDRESS 0x8003A340 0x8003B140 0x8003BF40 0x8003CD40 0x8003DB40 0x8003E940 0x8003F740 0x80040540 0x80041340 0x80042140 0x80042F40 0x80043D40 0x80044B40 0x80045940 0x80046740 0x80047540 0x80048340 0x80049140 0x80049F40 0x8004AD40 0x8004BB40 0x8004C940 0x8004D740 0x8004E540 /end VAR_ADDRESS
 /end VAR_CHARACTERISTIC
 /begin VAR_CHARACTERISTIC TP_U8TCSCpStuckPressureRiseTime EngCalVariantCriterion
  /begin VAR_ADDRESS 0x8003A341 0x8003B141 0x8003BF41 0x8003CD41 0x8003DB41 0x8003E941 0x8003F741 0x80040541 0x80041341 0x80042141 0x80042F41 0x80043D41 0x80044B41 0x80045941 0x80046741 0x80047541 0x80048341 0x80049141 0x80049F41 0x8004AD41 0x8004BB41 0x8004C941 0x8004D741 0x8004E541 /end VAR_ADDRESS
 /end VAR_CHARACTERISTIC
 /begin VAR_CHARACTERISTIC TP_U8TCSCpSymBoth2WlSpdDifTh EngCalVariantCriterion
  /begin VAR_ADDRESS 0x8003A342 0x8003B142 0x8003BF42 0x8003CD42 0x8003DB42 0x8003E942 0x8003F742 0x80040542 0x80041342 0x80042142 0x80042F42 0x80043D42 0x80044B42 0x80045942 0x80046742 0x80047542 0x80048342 0x80049142 0x80049F42 0x8004AD42 0x8004BB42 0x8004C942 0x8004D742 0x8004E542 /end VAR_ADDRESS
 /end VAR_CHARACTERISTIC
 /begin VAR_CHARACTERISTIC TP_U8TCSCpSymBoth2WlSpinTh EngCalVariantCriterion
  /begin VAR_ADDRESS 0x8003A343 0x8003B143 0x8003BF43 0x8003CD43 0x8003DB43 0x8003E943 0x8003F743 0x80040543 0x80041343 0x80042143 0x80042F43 0x80043D43 0x80044B43 0x80045943 0x80046743 0x80047543 0x80048343 0x80049143 0x80049F43 0x8004AD43 0x8004BB43 0x8004C943 0x8004D743 0x8004E543 /end VAR_ADDRESS
 /end VAR_CHARACTERISTIC
 /begin VAR_CHARACTERISTIC TP_U8TCSCpSymDctScanTime EngCalVariantCriterion
  /begin VAR_ADDRESS 0x8003A344 0x8003B144 0x8003BF44 0x8003CD44 0x8003DB44 0x8003E944 0x8003F744 0x80040544 0x80041344 0x80042144 0x80042F44 0x80043D44 0x80044B44 0x80045944 0x80046744 0x80047544 0x80048344 0x80049144 0x80049F44 0x8004AD44 0x8004BB44 0x8004C944 0x8004D744 0x8004E544 /end VAR_ADDRESS
 /end VAR_CHARACTERISTIC
 /begin VAR_CHARACTERISTIC TP_U8TCSCpSymExtHysOfMovDiffLnR EngCalVariantCriterion
  /begin VAR_ADDRESS 0x8003A345 0x8003B145 0x8003BF45 0x8003CD45 0x8003DB45 0x8003E945 0x8003F745 0x80040545 0x80041345 0x80042145 0x80042F45 0x80043D45 0x80044B45 0x80045945 0x80046745 0x80047545 0x80048345 0x80049145 0x80049F45 0x8004AD45 0x8004BB45 0x8004C945 0x8004D745 0x8004E545 /end VAR_ADDRESS
 /end VAR_CHARACTERISTIC
 /begin VAR_CHARACTERISTIC TP_U8TCSCpSymSpFadeOutHystSpd EngCalVariantCriterion
  /begin VAR_ADDRESS 0x8003A346 0x8003B146 0x8003BF46 0x8003CD46 0x8003DB46 0x8003E946 0x8003F746 0x80040546 0x80041346 0x80042146 0x80042F46 0x80043D46 0x80044B46 0x80045946 0x80046746 0x80047546 0x80048346 0x80049146 0x80049F46 0x8004AD46 0x8004BB46 0x8004C946 0x8004D746 0x8004E546 /end VAR_ADDRESS
 /end VAR_CHARACTERISTIC
 /begin VAR_CHARACTERISTIC TP_U8TCSCpTBrkTorqDec4Sym EngCalVariantCriterion
  /begin VAR_ADDRESS 0x8003A358 0x8003B158 0x8003BF58 0x8003CD58 0x8003DB58 0x8003E958 0x8003F758 0x80040558 0x80041358 0x80042158 0x80042F58 0x80043D58 0x80044B58 0x80045958 0x80046758 0x80047558 0x80048358 0x80049158 0x80049F58 0x8004AD58 0x8004BB58 0x8004C958 0x8004D758 0x8004E558 /end VAR_ADDRESS
 /end VAR_CHARACTERISTIC
 /begin VAR_CHARACTERISTIC TP_U8TCSCpTBrkTorqDec4SymInStall EngCalVariantCriterion
  /begin VAR_ADDRESS 0x8003A359 0x8003B159 0x8003BF59 0x8003CD59 0x8003DB59 0x8003E959 0x8003F759 0x80040559 0x80041359 0x80042159 0x80042F59 0x80043D59 0x80044B59 0x80045959 0x80046759 0x80047559 0x80048359 0x80049159 0x80049F59 0x8004AD59 0x8004BB59 0x8004C959 0x8004D759 0x8004E559 /end VAR_ADDRESS
 /end VAR_CHARACTERISTIC
 /begin VAR_CHARACTERISTIC TP_U8TCSCpTarBrkTqMaxByDrvrTqFac EngCalVariantCriterion
  /begin VAR_ADDRESS 0x8003A347 0x8003B147 0x8003BF47 0x8003CD47 0x8003DB47 0x8003E947 0x8003F747 0x80040547 0x80041347 0x80042147 0x80042F47 0x80043D47 0x80044B47 0x80045947 0x80046747 0x80047547 0x80048347 0x80049147 0x80049F47 0x8004AD47 0x8004BB47 0x8004C947 0x8004D747 0x8004E547 /end VAR_ADDRESS
 /end VAR_CHARACTERISTIC
 /begin VAR_CHARACTERISTIC TP_U8TCSCpTarBrkTqMaxBySplitHillFac EngCalVariantCriterion
  /begin VAR_ADDRESS 0x8003A348 0x8003B148 0x8003BF48 0x8003CD48 0x8003DB48 0x8003E948 0x8003F748 0x80040548 0x80041348 0x80042148 0x80042F48 0x80043D48 0x80044B48 0x80045948 0x80046748 0x80047548 0x80048348 0x80049148 0x80049F48 0x8004AD48 0x8004BB48 0x8004C948 0x8004D748 0x8004E548 /end VAR_ADDRESS
 /end VAR_CHARACTERISTIC
 /begin VAR_CHARACTERISTIC TP_U8TCSCpTarWhlPreTurnMax[0] EngCalVariantCriterion
  /begin VAR_ADDRESS 0x8003A349 0x8003B149 0x8003BF49 0x8003CD49 0x8003DB49 0x8003E949 0x8003F749 0x80040549 0x80041349 0x80042149 0x80042F49 0x80043D49 0x80044B49 0x80045949 0x80046749 0x80047549 0x80048349 0x80049149 0x80049F49 0x8004AD49 0x8004BB49 0x8004C949 0x8004D749 0x8004E549 /end VAR_ADDRESS
 /end VAR_CHARACTERISTIC
 /begin VAR_CHARACTERISTIC TP_U8TCSCpTarWhlPreTurnMax[1] EngCalVariantCriterion
  /begin VAR_ADDRESS 0x8003A34A 0x8003B14A 0x8003BF4A 0x8003CD4A 0x8003DB4A 0x8003E94A 0x8003F74A 0x8004054A 0x8004134A 0x8004214A 0x80042F4A 0x80043D4A 0x80044B4A 0x8004594A 0x8004674A 0x8004754A 0x8004834A 0x8004914A 0x80049F4A 0x8004AD4A 0x8004BB4A 0x8004C94A 0x8004D74A 0x8004E54A /end VAR_ADDRESS
 /end VAR_CHARACTERISTIC
 /begin VAR_CHARACTERISTIC TP_U8TCSCpTarWhlPreTurnMax[2] EngCalVariantCriterion
  /begin VAR_ADDRESS 0x8003A34B 0x8003B14B 0x8003BF4B 0x8003CD4B 0x8003DB4B 0x8003E94B 0x8003F74B 0x8004054B 0x8004134B 0x8004214B 0x80042F4B 0x80043D4B 0x80044B4B 0x8004594B 0x8004674B 0x8004754B 0x8004834B 0x8004914B 0x80049F4B 0x8004AD4B 0x8004BB4B 0x8004C94B 0x8004D74B 0x8004E54B /end VAR_ADDRESS
 /end VAR_CHARACTERISTIC
 /begin VAR_CHARACTERISTIC TP_U8TCSCpTarWhlPreTurnMax[3] EngCalVariantCriterion
  /begin VAR_ADDRESS 0x8003A34C 0x8003B14C 0x8003BF4C 0x8003CD4C 0x8003DB4C 0x8003E94C 0x8003F74C 0x8004054C 0x8004134C 0x8004214C 0x80042F4C 0x80043D4C 0x80044B4C 0x8004594C 0x8004674C 0x8004754C 0x8004834C 0x8004914C 0x80049F4C 0x8004AD4C 0x8004BB4C 0x8004C94C 0x8004D74C 0x8004E54C /end VAR_ADDRESS
 /end VAR_CHARACTERISTIC
 /begin VAR_CHARACTERISTIC TP_U8TCSCpTarWhlPreTurnMax[4] EngCalVariantCriterion
  /begin VAR_ADDRESS 0x8003A34D 0x8003B14D 0x8003BF4D 0x8003CD4D 0x8003DB4D 0x8003E94D 0x8003F74D 0x8004054D 0x8004134D 0x8004214D 0x80042F4D 0x80043D4D 0x80044B4D 0x8004594D 0x8004674D 0x8004754D 0x8004834D 0x8004914D 0x80049F4D 0x8004AD4D 0x8004BB4D 0x8004C94D 0x8004D74D 0x8004E54D /end VAR_ADDRESS
 /end VAR_CHARACTERISTIC
 /begin VAR_CHARACTERISTIC TP_U8TCSCpTarWhlSpinDiffHill[0] EngCalVariantCriterion
  /begin VAR_ADDRESS 0x8003A34E 0x8003B14E 0x8003BF4E 0x8003CD4E 0x8003DB4E 0x8003E94E 0x8003F74E 0x8004054E 0x8004134E 0x8004214E 0x80042F4E 0x80043D4E 0x80044B4E 0x8004594E 0x8004674E 0x8004754E 0x8004834E 0x8004914E 0x80049F4E 0x8004AD4E 0x8004BB4E 0x8004C94E 0x8004D74E 0x8004E54E /end VAR_ADDRESS
 /end VAR_CHARACTERISTIC
 /begin VAR_CHARACTERISTIC TP_U8TCSCpTarWhlSpinDiffHill[1] EngCalVariantCriterion
  /begin VAR_ADDRESS 0x8003A34F 0x8003B14F 0x8003BF4F 0x8003CD4F 0x8003DB4F 0x8003E94F 0x8003F74F 0x8004054F 0x8004134F 0x8004214F 0x80042F4F 0x80043D4F 0x80044B4F 0x8004594F 0x8004674F 0x8004754F 0x8004834F 0x8004914F 0x80049F4F 0x8004AD4F 0x8004BB4F 0x8004C94F 0x8004D74F 0x8004E54F /end VAR_ADDRESS
 /end VAR_CHARACTERISTIC
 /begin VAR_CHARACTERISTIC TP_U8TCSCpTarWhlSpinDiffHill[2] EngCalVariantCriterion
  /begin VAR_ADDRESS 0x8003A350 0x8003B150 0x8003BF50 0x8003CD50 0x8003DB50 0x8003E950 0x8003F750 0x80040550 0x80041350 0x80042150 0x80042F50 0x80043D50 0x80044B50 0x80045950 0x80046750 0x80047550 0x80048350 0x80049150 0x80049F50 0x8004AD50 0x8004BB50 0x8004C950 0x8004D750 0x8004E550 /end VAR_ADDRESS
 /end VAR_CHARACTERISTIC
 /begin VAR_CHARACTERISTIC TP_U8TCSCpTarWhlSpinDiffHill[3] EngCalVariantCriterion
  /begin VAR_ADDRESS 0x8003A351 0x8003B151 0x8003BF51 0x8003CD51 0x8003DB51 0x8003E951 0x8003F751 0x80040551 0x80041351 0x80042151 0x80042F51 0x80043D51 0x80044B51 0x80045951 0x80046751 0x80047551 0x80048351 0x80049151 0x80049F51 0x8004AD51 0x8004BB51 0x8004C951 0x8004D751 0x8004E551 /end VAR_ADDRESS
 /end VAR_CHARACTERISTIC
 /begin VAR_CHARACTERISTIC TP_U8TCSCpTarWhlSpinDiffHill[4] EngCalVariantCriterion
  /begin VAR_ADDRESS 0x8003A352 0x8003B152 0x8003BF52 0x8003CD52 0x8003DB52 0x8003E952 0x8003F752 0x80040552 0x80041352 0x80042152 0x80042F52 0x80043D52 0x80044B52 0x80045952 0x80046752 0x80047552 0x80048352 0x80049152 0x80049F52 0x8004AD52 0x8004BB52 0x8004C952 0x8004D752 0x8004E552 /end VAR_ADDRESS
 /end VAR_CHARACTERISTIC
 /begin VAR_CHARACTERISTIC TP_U8TCSCpTarWhlSpinDiffTurn[0] EngCalVariantCriterion
  /begin VAR_ADDRESS 0x8003A353 0x8003B153 0x8003BF53 0x8003CD53 0x8003DB53 0x8003E953 0x8003F753 0x80040553 0x80041353 0x80042153 0x80042F53 0x80043D53 0x80044B53 0x80045953 0x80046753 0x80047553 0x80048353 0x80049153 0x80049F53 0x8004AD53 0x8004BB53 0x8004C953 0x8004D753 0x8004E553 /end VAR_ADDRESS
 /end VAR_CHARACTERISTIC
 /begin VAR_CHARACTERISTIC TP_U8TCSCpTarWhlSpinDiffTurn[1] EngCalVariantCriterion
  /begin VAR_ADDRESS 0x8003A354 0x8003B154 0x8003BF54 0x8003CD54 0x8003DB54 0x8003E954 0x8003F754 0x80040554 0x80041354 0x80042154 0x80042F54 0x80043D54 0x80044B54 0x80045954 0x80046754 0x80047554 0x80048354 0x80049154 0x80049F54 0x8004AD54 0x8004BB54 0x8004C954 0x8004D754 0x8004E554 /end VAR_ADDRESS
 /end VAR_CHARACTERISTIC
 /begin VAR_CHARACTERISTIC TP_U8TCSCpTarWhlSpinDiffTurn[2] EngCalVariantCriterion
  /begin VAR_ADDRESS 0x8003A355 0x8003B155 0x8003BF55 0x8003CD55 0x8003DB55 0x8003E955 0x8003F755 0x80040555 0x80041355 0x80042155 0x80042F55 0x80043D55 0x80044B55 0x80045955 0x80046755 0x80047555 0x80048355 0x80049155 0x80049F55 0x8004AD55 0x8004BB55 0x8004C955 0x8004D755 0x8004E555 /end VAR_ADDRESS
 /end VAR_CHARACTERISTIC
 /begin VAR_CHARACTERISTIC TP_U8TCSCpTarWhlSpinDiffTurn[3] EngCalVariantCriterion
  /begin VAR_ADDRESS 0x8003A356 0x8003B156 0x8003BF56 0x8003CD56 0x8003DB56 0x8003E956 0x8003F756 0x80040556 0x80041356 0x80042156 0x80042F56 0x80043D56 0x80044B56 0x80045956 0x80046756 0x80047556 0x80048356 0x80049156 0x80049F56 0x8004AD56 0x8004BB56 0x8004C956 0x8004D756 0x8004E556 /end VAR_ADDRESS
 /end VAR_CHARACTERISTIC
 /begin VAR_CHARACTERISTIC TP_U8TCSCpTarWhlSpinDiffTurn[4] EngCalVariantCriterion
  /begin VAR_ADDRESS 0x8003A357 0x8003B157 0x8003BF57 0x8003CD57 0x8003DB57 0x8003E957 0x8003F757 0x80040557 0x80041357 0x80042157 0x80042F57 0x80043D57 0x80044B57 0x80045957 0x80046757 0x80047557 0x80048357 0x80049157 0x80049F57 0x8004AD57 0x8004BB57 0x8004C957 0x8004D757 0x8004E557 /end VAR_ADDRESS
 /end VAR_CHARACTERISTIC
 /begin VAR_CHARACTERISTIC TP_U8TCSCpThOfCnt4SpnDiffSlopeDct EngCalVariantCriterion
  /begin VAR_ADDRESS 0x8003A35A 0x8003B15A 0x8003BF5A 0x8003CD5A 0x8003DB5A 0x8003E95A 0x8003F75A 0x8004055A 0x8004135A 0x8004215A 0x80042F5A 0x80043D5A 0x80044B5A 0x8004595A 0x8004675A 0x8004755A 0x8004835A 0x8004915A 0x80049F5A 0x8004AD5A 0x8004BB5A 0x8004C95A 0x8004D75A 0x8004E55A /end VAR_ADDRESS
 /end VAR_CHARACTERISTIC
 /begin VAR_CHARACTERISTIC TP_U8TCSCpVcaActvOnlyAtBigSpinDtcd EngCalVariantCriterion
  /begin VAR_ADDRESS 0x8003A35B 0x8003B15B 0x8003BF5B 0x8003CD5B 0x8003DB5B 0x8003E95B 0x8003F75B 0x8004055B 0x8004135B 0x8004215B 0x80042F5B 0x80043D5B 0x80044B5B 0x8004595B 0x8004675B 0x8004755B 0x8004835B 0x8004915B 0x80049F5B 0x8004AD5B 0x8004BB5B 0x8004C95B 0x8004D75B 0x8004E55B /end VAR_ADDRESS
 /end VAR_CHARACTERISTIC
 /begin VAR_CHARACTERISTIC TP_U8TCSFadeOutBrkCtrlMinTorq[0] EngCalVariantCriterion
  /begin VAR_ADDRESS 0x8003A35C 0x8003B15C 0x8003BF5C 0x8003CD5C 0x8003DB5C 0x8003E95C 0x8003F75C 0x8004055C 0x8004135C 0x8004215C 0x80042F5C 0x80043D5C 0x80044B5C 0x8004595C 0x8004675C 0x8004755C 0x8004835C 0x8004915C 0x80049F5C 0x8004AD5C 0x8004BB5C 0x8004C95C 0x8004D75C 0x8004E55C /end VAR_ADDRESS
 /end VAR_CHARACTERISTIC
 /begin VAR_CHARACTERISTIC TP_U8TCSFadeOutBrkCtrlMinTorq[1] EngCalVariantCriterion
  /begin VAR_ADDRESS 0x8003A35D 0x8003B15D 0x8003BF5D 0x8003CD5D 0x8003DB5D 0x8003E95D 0x8003F75D 0x8004055D 0x8004135D 0x8004215D 0x80042F5D 0x80043D5D 0x80044B5D 0x8004595D 0x8004675D 0x8004755D 0x8004835D 0x8004915D 0x80049F5D 0x8004AD5D 0x8004BB5D 0x8004C95D 0x8004D75D 0x8004E55D /end VAR_ADDRESS
 /end VAR_CHARACTERISTIC
 /begin VAR_CHARACTERISTIC TP_U8TCSHghMuUnstbRecoveryTh EngCalVariantCriterion
  /begin VAR_ADDRESS 0x8003A35E 0x8003B15E 0x8003BF5E 0x8003CD5E 0x8003DB5E 0x8003E95E 0x8003F75E 0x8004055E 0x8004135E 0x8004215E 0x80042F5E 0x80043D5E 0x80044B5E 0x8004595E 0x8004675E 0x8004755E 0x8004835E 0x8004915E 0x80049F5E 0x8004AD5E 0x8004BB5E 0x8004C95E 0x8004D75E 0x8004E55E /end VAR_ADDRESS
 /end VAR_CHARACTERISTIC
 /begin VAR_CHARACTERISTIC TP_U8TCSHillDctAlongTh EngCalVariantCriterion
  /begin VAR_ADDRESS 0x8003A35F 0x8003B15F 0x8003BF5F 0x8003CD5F 0x8003DB5F 0x8003E95F 0x8003F75F 0x8004055F 0x8004135F 0x8004215F 0x80042F5F 0x80043D5F 0x80044B5F 0x8004595F 0x8004675F 0x8004755F 0x8004835F 0x8004915F 0x80049F5F 0x8004AD5F 0x8004BB5F 0x8004C95F 0x8004D75F 0x8004E55F /end VAR_ADDRESS
 /end VAR_CHARACTERISTIC
 /begin VAR_CHARACTERISTIC TP_U8TMCCpTurnIndex[0] EngCalVariantCriterion
  /begin VAR_ADDRESS 0x8003A64E 0x8003B44E 0x8003C24E 0x8003D04E 0x8003DE4E 0x8003EC4E 0x8003FA4E 0x8004084E 0x8004164E 0x8004244E 0x8004324E 0x8004404E 0x80044E4E 0x80045C4E 0x80046A4E 0x8004784E 0x8004864E 0x8004944E 0x8004A24E 0x8004B04E 0x8004BE4E 0x8004CC4E 0x8004DA4E 0x8004E84E /end VAR_ADDRESS
 /end VAR_CHARACTERISTIC
 /begin VAR_CHARACTERISTIC TP_U8TMCCpTurnIndex[1] EngCalVariantCriterion
  /begin VAR_ADDRESS 0x8003A64F 0x8003B44F 0x8003C24F 0x8003D04F 0x8003DE4F 0x8003EC4F 0x8003FA4F 0x8004084F 0x8004164F 0x8004244F 0x8004324F 0x8004404F 0x80044E4F 0x80045C4F 0x80046A4F 0x8004784F 0x8004864F 0x8004944F 0x8004A24F 0x8004B04F 0x8004BE4F 0x8004CC4F 0x8004DA4F 0x8004E84F /end VAR_ADDRESS
 /end VAR_CHARACTERISTIC
 /begin VAR_CHARACTERISTIC TP_U8TMCCpTurnIndex[2] EngCalVariantCriterion
  /begin VAR_ADDRESS 0x8003A650 0x8003B450 0x8003C250 0x8003D050 0x8003DE50 0x8003EC50 0x8003FA50 0x80040850 0x80041650 0x80042450 0x80043250 0x80044050 0x80044E50 0x80045C50 0x80046A50 0x80047850 0x80048650 0x80049450 0x8004A250 0x8004B050 0x8004BE50 0x8004CC50 0x8004DA50 0x8004E850 /end VAR_ADDRESS
 /end VAR_CHARACTERISTIC
 /begin VAR_CHARACTERISTIC TP_U8TMCpAllowDnShftMinVehSpd[0] EngCalVariantCriterion
  /begin VAR_ADDRESS 0x8003A651 0x8003B451 0x8003C251 0x8003D051 0x8003DE51 0x8003EC51 0x8003FA51 0x80040851 0x80041651 0x80042451 0x80043251 0x80044051 0x80044E51 0x80045C51 0x80046A51 0x80047851 0x80048651 0x80049451 0x8004A251 0x8004B051 0x8004BE51 0x8004CC51 0x8004DA51 0x8004E851 /end VAR_ADDRESS
 /end VAR_CHARACTERISTIC
 /begin VAR_CHARACTERISTIC TP_U8TMCpAllowDnShftMinVehSpd[1] EngCalVariantCriterion
  /begin VAR_ADDRESS 0x8003A652 0x8003B452 0x8003C252 0x8003D052 0x8003DE52 0x8003EC52 0x8003FA52 0x80040852 0x80041652 0x80042452 0x80043252 0x80044052 0x80044E52 0x80045C52 0x80046A52 0x80047852 0x80048652 0x80049452 0x8004A252 0x8004B052 0x8004BE52 0x8004CC52 0x8004DA52 0x8004E852 /end VAR_ADDRESS
 /end VAR_CHARACTERISTIC
 /begin VAR_CHARACTERISTIC TP_U8TMCpAllowDnShftMinVehSpd[2] EngCalVariantCriterion
  /begin VAR_ADDRESS 0x8003A653 0x8003B453 0x8003C253 0x8003D053 0x8003DE53 0x8003EC53 0x8003FA53 0x80040853 0x80041653 0x80042453 0x80043253 0x80044053 0x80044E53 0x80045C53 0x80046A53 0x80047853 0x80048653 0x80049453 0x8004A253 0x8004B053 0x8004BE53 0x8004CC53 0x8004DA53 0x8004E853 /end VAR_ADDRESS
 /end VAR_CHARACTERISTIC
 /begin VAR_CHARACTERISTIC TP_U8TMCpAllowDnShftMinVehSpd[3] EngCalVariantCriterion
  /begin VAR_ADDRESS 0x8003A654 0x8003B454 0x8003C254 0x8003D054 0x8003DE54 0x8003EC54 0x8003FA54 0x80040854 0x80041654 0x80042454 0x80043254 0x80044054 0x80044E54 0x80045C54 0x80046A54 0x80047854 0x80048654 0x80049454 0x8004A254 0x8004B054 0x8004BE54 0x8004CC54 0x8004DA54 0x8004E854 /end VAR_ADDRESS
 /end VAR_CHARACTERISTIC
 /begin VAR_CHARACTERISTIC TP_U8TMCpAllowDnShftMinVehSpd[4] EngCalVariantCriterion
  /begin VAR_ADDRESS 0x8003A655 0x8003B455 0x8003C255 0x8003D055 0x8003DE55 0x8003EC55 0x8003FA55 0x80040855 0x80041655 0x80042455 0x80043255 0x80044055 0x80044E55 0x80045C55 0x80046A55 0x80047855 0x80048655 0x80049455 0x8004A255 0x8004B055 0x8004BE55 0x8004CC55 0x8004DA55 0x8004E855 /end VAR_ADDRESS
 /end VAR_CHARACTERISTIC
 /begin VAR_CHARACTERISTIC TP_U8TMCpAllowDnShftRPM[0] EngCalVariantCriterion
  /begin VAR_ADDRESS 0x8003A656 0x8003B456 0x8003C256 0x8003D056 0x8003DE56 0x8003EC56 0x8003FA56 0x80040856 0x80041656 0x80042456 0x80043256 0x80044056 0x80044E56 0x80045C56 0x80046A56 0x80047856 0x80048656 0x80049456 0x8004A256 0x8004B056 0x8004BE56 0x8004CC56 0x8004DA56 0x8004E856 /end VAR_ADDRESS
 /end VAR_CHARACTERISTIC
 /begin VAR_CHARACTERISTIC TP_U8TMCpAllowDnShftRPM[1] EngCalVariantCriterion
  /begin VAR_ADDRESS 0x8003A657 0x8003B457 0x8003C257 0x8003D057 0x8003DE57 0x8003EC57 0x8003FA57 0x80040857 0x80041657 0x80042457 0x80043257 0x80044057 0x80044E57 0x80045C57 0x80046A57 0x80047857 0x80048657 0x80049457 0x8004A257 0x8004B057 0x8004BE57 0x8004CC57 0x8004DA57 0x8004E857 /end VAR_ADDRESS
 /end VAR_CHARACTERISTIC
 /begin VAR_CHARACTERISTIC TP_U8TMCpAllowDnShftRPM[2] EngCalVariantCriterion
  /begin VAR_ADDRESS 0x8003A658 0x8003B458 0x8003C258 0x8003D058 0x8003DE58 0x8003EC58 0x8003FA58 0x80040858 0x80041658 0x80042458 0x80043258 0x80044058 0x80044E58 0x80045C58 0x80046A58 0x80047858 0x80048658 0x80049458 0x8004A258 0x8004B058 0x8004BE58 0x8004CC58 0x8004DA58 0x8004E858 /end VAR_ADDRESS
 /end VAR_CHARACTERISTIC
 /begin VAR_CHARACTERISTIC TP_U8TMCpAllowDnShftRPM[3] EngCalVariantCriterion
  /begin VAR_ADDRESS 0x8003A659 0x8003B459 0x8003C259 0x8003D059 0x8003DE59 0x8003EC59 0x8003FA59 0x80040859 0x80041659 0x80042459 0x80043259 0x80044059 0x80044E59 0x80045C59 0x80046A59 0x80047859 0x80048659 0x80049459 0x8004A259 0x8004B059 0x8004BE59 0x8004CC59 0x8004DA59 0x8004E859 /end VAR_ADDRESS
 /end VAR_CHARACTERISTIC
 /begin VAR_CHARACTERISTIC TP_U8TMCpAllowDnShftRPM[4] EngCalVariantCriterion
  /begin VAR_ADDRESS 0x8003A65A 0x8003B45A 0x8003C25A 0x8003D05A 0x8003DE5A 0x8003EC5A 0x8003FA5A 0x8004085A 0x8004165A 0x8004245A 0x8004325A 0x8004405A 0x80044E5A 0x80045C5A 0x80046A5A 0x8004785A 0x8004865A 0x8004945A 0x8004A25A 0x8004B05A 0x8004BE5A 0x8004CC5A 0x8004DA5A 0x8004E85A /end VAR_ADDRESS
 /end VAR_CHARACTERISTIC
 /begin VAR_CHARACTERISTIC TP_U8TMCpAllowDnShftVehSpd[0] EngCalVariantCriterion
  /begin VAR_ADDRESS 0x8003A65B 0x8003B45B 0x8003C25B 0x8003D05B 0x8003DE5B 0x8003EC5B 0x8003FA5B 0x8004085B 0x8004165B 0x8004245B 0x8004325B 0x8004405B 0x80044E5B 0x80045C5B 0x80046A5B 0x8004785B 0x8004865B 0x8004945B 0x8004A25B 0x8004B05B 0x8004BE5B 0x8004CC5B 0x8004DA5B 0x8004E85B /end VAR_ADDRESS
 /end VAR_CHARACTERISTIC
 /begin VAR_CHARACTERISTIC TP_U8TMCpAllowDnShftVehSpd[1] EngCalVariantCriterion
  /begin VAR_ADDRESS 0x8003A65C 0x8003B45C 0x8003C25C 0x8003D05C 0x8003DE5C 0x8003EC5C 0x8003FA5C 0x8004085C 0x8004165C 0x8004245C 0x8004325C 0x8004405C 0x80044E5C 0x80045C5C 0x80046A5C 0x8004785C 0x8004865C 0x8004945C 0x8004A25C 0x8004B05C 0x8004BE5C 0x8004CC5C 0x8004DA5C 0x8004E85C /end VAR_ADDRESS
 /end VAR_CHARACTERISTIC
 /begin VAR_CHARACTERISTIC TP_U8TMCpAllowDnShftVehSpd[2] EngCalVariantCriterion
  /begin VAR_ADDRESS 0x8003A65D 0x8003B45D 0x8003C25D 0x8003D05D 0x8003DE5D 0x8003EC5D 0x8003FA5D 0x8004085D 0x8004165D 0x8004245D 0x8004325D 0x8004405D 0x80044E5D 0x80045C5D 0x80046A5D 0x8004785D 0x8004865D 0x8004945D 0x8004A25D 0x8004B05D 0x8004BE5D 0x8004CC5D 0x8004DA5D 0x8004E85D /end VAR_ADDRESS
 /end VAR_CHARACTERISTIC
 /begin VAR_CHARACTERISTIC TP_U8TMCpAllowDnShftVehSpd[3] EngCalVariantCriterion
  /begin VAR_ADDRESS 0x8003A65E 0x8003B45E 0x8003C25E 0x8003D05E 0x8003DE5E 0x8003EC5E 0x8003FA5E 0x8004085E 0x8004165E 0x8004245E 0x8004325E 0x8004405E 0x80044E5E 0x80045C5E 0x80046A5E 0x8004785E 0x8004865E 0x8004945E 0x8004A25E 0x8004B05E 0x8004BE5E 0x8004CC5E 0x8004DA5E 0x8004E85E /end VAR_ADDRESS
 /end VAR_CHARACTERISTIC
 /begin VAR_CHARACTERISTIC TP_U8TMCpAllowDnShftVehSpd[4] EngCalVariantCriterion
  /begin VAR_ADDRESS 0x8003A65F 0x8003B45F 0x8003C25F 0x8003D05F 0x8003DE5F 0x8003EC5F 0x8003FA5F 0x8004085F 0x8004165F 0x8004245F 0x8004325F 0x8004405F 0x80044E5F 0x80045C5F 0x80046A5F 0x8004785F 0x8004865F 0x8004945F 0x8004A25F 0x8004B05F 0x8004BE5F 0x8004CC5F 0x8004DA5F 0x8004E85F /end VAR_ADDRESS
 /end VAR_CHARACTERISTIC
 /begin VAR_CHARACTERISTIC TP_U8TMCpAllowUpShftMaxVehSpd[0] EngCalVariantCriterion
  /begin VAR_ADDRESS 0x8003A660 0x8003B460 0x8003C260 0x8003D060 0x8003DE60 0x8003EC60 0x8003FA60 0x80040860 0x80041660 0x80042460 0x80043260 0x80044060 0x80044E60 0x80045C60 0x80046A60 0x80047860 0x80048660 0x80049460 0x8004A260 0x8004B060 0x8004BE60 0x8004CC60 0x8004DA60 0x8004E860 /end VAR_ADDRESS
 /end VAR_CHARACTERISTIC
 /begin VAR_CHARACTERISTIC TP_U8TMCpAllowUpShftMaxVehSpd[1] EngCalVariantCriterion
  /begin VAR_ADDRESS 0x8003A661 0x8003B461 0x8003C261 0x8003D061 0x8003DE61 0x8003EC61 0x8003FA61 0x80040861 0x80041661 0x80042461 0x80043261 0x80044061 0x80044E61 0x80045C61 0x80046A61 0x80047861 0x80048661 0x80049461 0x8004A261 0x8004B061 0x8004BE61 0x8004CC61 0x8004DA61 0x8004E861 /end VAR_ADDRESS
 /end VAR_CHARACTERISTIC
 /begin VAR_CHARACTERISTIC TP_U8TMCpAllowUpShftMaxVehSpd[2] EngCalVariantCriterion
  /begin VAR_ADDRESS 0x8003A662 0x8003B462 0x8003C262 0x8003D062 0x8003DE62 0x8003EC62 0x8003FA62 0x80040862 0x80041662 0x80042462 0x80043262 0x80044062 0x80044E62 0x80045C62 0x80046A62 0x80047862 0x80048662 0x80049462 0x8004A262 0x8004B062 0x8004BE62 0x8004CC62 0x8004DA62 0x8004E862 /end VAR_ADDRESS
 /end VAR_CHARACTERISTIC
 /begin VAR_CHARACTERISTIC TP_U8TMCpAllowUpShftMaxVehSpd[3] EngCalVariantCriterion
  /begin VAR_ADDRESS 0x8003A663 0x8003B463 0x8003C263 0x8003D063 0x8003DE63 0x8003EC63 0x8003FA63 0x80040863 0x80041663 0x80042463 0x80043263 0x80044063 0x80044E63 0x80045C63 0x80046A63 0x80047863 0x80048663 0x80049463 0x8004A263 0x8004B063 0x8004BE63 0x8004CC63 0x8004DA63 0x8004E863 /end VAR_ADDRESS
 /end VAR_CHARACTERISTIC
 /begin VAR_CHARACTERISTIC TP_U8TMCpAllowUpShftMaxVehSpd[4] EngCalVariantCriterion
  /begin VAR_ADDRESS 0x8003A664 0x8003B464 0x8003C264 0x8003D064 0x8003DE64 0x8003EC64 0x8003FA64 0x80040864 0x80041664 0x80042464 0x80043264 0x80044064 0x80044E64 0x80045C64 0x80046A64 0x80047864 0x80048664 0x80049464 0x8004A264 0x8004B064 0x8004BE64 0x8004CC64 0x8004DA64 0x8004E864 /end VAR_ADDRESS
 /end VAR_CHARACTERISTIC
 /begin VAR_CHARACTERISTIC TP_U8TMCpAllowUpShftRPM[0] EngCalVariantCriterion
  /begin VAR_ADDRESS 0x8003A665 0x8003B465 0x8003C265 0x8003D065 0x8003DE65 0x8003EC65 0x8003FA65 0x80040865 0x80041665 0x80042465 0x80043265 0x80044065 0x80044E65 0x80045C65 0x80046A65 0x80047865 0x80048665 0x80049465 0x8004A265 0x8004B065 0x8004BE65 0x8004CC65 0x8004DA65 0x8004E865 /end VAR_ADDRESS
 /end VAR_CHARACTERISTIC
 /begin VAR_CHARACTERISTIC TP_U8TMCpAllowUpShftRPM[1] EngCalVariantCriterion
  /begin VAR_ADDRESS 0x8003A666 0x8003B466 0x8003C266 0x8003D066 0x8003DE66 0x8003EC66 0x8003FA66 0x80040866 0x80041666 0x80042466 0x80043266 0x80044066 0x80044E66 0x80045C66 0x80046A66 0x80047866 0x80048666 0x80049466 0x8004A266 0x8004B066 0x8004BE66 0x8004CC66 0x8004DA66 0x8004E866 /end VAR_ADDRESS
 /end VAR_CHARACTERISTIC
 /begin VAR_CHARACTERISTIC TP_U8TMCpAllowUpShftRPM[2] EngCalVariantCriterion
  /begin VAR_ADDRESS 0x8003A667 0x8003B467 0x8003C267 0x8003D067 0x8003DE67 0x8003EC67 0x8003FA67 0x80040867 0x80041667 0x80042467 0x80043267 0x80044067 0x80044E67 0x80045C67 0x80046A67 0x80047867 0x80048667 0x80049467 0x8004A267 0x8004B067 0x8004BE67 0x8004CC67 0x8004DA67 0x8004E867 /end VAR_ADDRESS
 /end VAR_CHARACTERISTIC
 /begin VAR_CHARACTERISTIC TP_U8TMCpAllowUpShftRPM[3] EngCalVariantCriterion
  /begin VAR_ADDRESS 0x8003A668 0x8003B468 0x8003C268 0x8003D068 0x8003DE68 0x8003EC68 0x8003FA68 0x80040868 0x80041668 0x80042468 0x80043268 0x80044068 0x80044E68 0x80045C68 0x80046A68 0x80047868 0x80048668 0x80049468 0x8004A268 0x8004B068 0x8004BE68 0x8004CC68 0x8004DA68 0x8004E868 /end VAR_ADDRESS
 /end VAR_CHARACTERISTIC
 /begin VAR_CHARACTERISTIC TP_U8TMCpAllowUpShftRPM[4] EngCalVariantCriterion
  /begin VAR_ADDRESS 0x8003A669 0x8003B469 0x8003C269 0x8003D069 0x8003DE69 0x8003EC69 0x8003FA69 0x80040869 0x80041669 0x80042469 0x80043269 0x80044069 0x80044E69 0x80045C69 0x80046A69 0x80047869 0x80048669 0x80049469 0x8004A269 0x8004B069 0x8004BE69 0x8004CC69 0x8004DA69 0x8004E869 /end VAR_ADDRESS
 /end VAR_CHARACTERISTIC
 /begin VAR_CHARACTERISTIC TP_U8TMCpAllowUpShftVehSpd[0] EngCalVariantCriterion
  /begin VAR_ADDRESS 0x8003A66A 0x8003B46A 0x8003C26A 0x8003D06A 0x8003DE6A 0x8003EC6A 0x8003FA6A 0x8004086A 0x8004166A 0x8004246A 0x8004326A 0x8004406A 0x80044E6A 0x80045C6A 0x80046A6A 0x8004786A 0x8004866A 0x8004946A 0x8004A26A 0x8004B06A 0x8004BE6A 0x8004CC6A 0x8004DA6A 0x8004E86A /end VAR_ADDRESS
 /end VAR_CHARACTERISTIC
 /begin VAR_CHARACTERISTIC TP_U8TMCpAllowUpShftVehSpd[1] EngCalVariantCriterion
  /begin VAR_ADDRESS 0x8003A66B 0x8003B46B 0x8003C26B 0x8003D06B 0x8003DE6B 0x8003EC6B 0x8003FA6B 0x8004086B 0x8004166B 0x8004246B 0x8004326B 0x8004406B 0x80044E6B 0x80045C6B 0x80046A6B 0x8004786B 0x8004866B 0x8004946B 0x8004A26B 0x8004B06B 0x8004BE6B 0x8004CC6B 0x8004DA6B 0x8004E86B /end VAR_ADDRESS
 /end VAR_CHARACTERISTIC
 /begin VAR_CHARACTERISTIC TP_U8TMCpAllowUpShftVehSpd[2] EngCalVariantCriterion
  /begin VAR_ADDRESS 0x8003A66C 0x8003B46C 0x8003C26C 0x8003D06C 0x8003DE6C 0x8003EC6C 0x8003FA6C 0x8004086C 0x8004166C 0x8004246C 0x8004326C 0x8004406C 0x80044E6C 0x80045C6C 0x80046A6C 0x8004786C 0x8004866C 0x8004946C 0x8004A26C 0x8004B06C 0x8004BE6C 0x8004CC6C 0x8004DA6C 0x8004E86C /end VAR_ADDRESS
 /end VAR_CHARACTERISTIC
 /begin VAR_CHARACTERISTIC TP_U8TMCpAllowUpShftVehSpd[3] EngCalVariantCriterion
  /begin VAR_ADDRESS 0x8003A66D 0x8003B46D 0x8003C26D 0x8003D06D 0x8003DE6D 0x8003EC6D 0x8003FA6D 0x8004086D 0x8004166D 0x8004246D 0x8004326D 0x8004406D 0x80044E6D 0x80045C6D 0x80046A6D 0x8004786D 0x8004866D 0x8004946D 0x8004A26D 0x8004B06D 0x8004BE6D 0x8004CC6D 0x8004DA6D 0x8004E86D /end VAR_ADDRESS
 /end VAR_CHARACTERISTIC
 /begin VAR_CHARACTERISTIC TP_U8TMCpAllowUpShftVehSpd[4] EngCalVariantCriterion
  /begin VAR_ADDRESS 0x8003A66E 0x8003B46E 0x8003C26E 0x8003D06E 0x8003DE6E 0x8003EC6E 0x8003FA6E 0x8004086E 0x8004166E 0x8004246E 0x8004326E 0x8004406E 0x80044E6E 0x80045C6E 0x80046A6E 0x8004786E 0x8004866E 0x8004946E 0x8004A26E 0x8004B06E 0x8004BE6E 0x8004CC6E 0x8004DA6E 0x8004E86E /end VAR_ADDRESS
 /end VAR_CHARACTERISTIC
 /begin VAR_CHARACTERISTIC TP_U8TMCpGearShiftTime EngCalVariantCriterion
  /begin VAR_ADDRESS 0x8003A66F 0x8003B46F 0x8003C26F 0x8003D06F 0x8003DE6F 0x8003EC6F 0x8003FA6F 0x8004086F 0x8004166F 0x8004246F 0x8004326F 0x8004406F 0x80044E6F 0x80045C6F 0x80046A6F 0x8004786F 0x8004866F 0x8004946F 0x8004A26F 0x8004B06F 0x8004BE6F 0x8004CC6F 0x8004DA6F 0x8004E86F /end VAR_ADDRESS
 /end VAR_CHARACTERISTIC
 /begin VAR_CHARACTERISTIC TP_U8TMCpMaxGear EngCalVariantCriterion
  /begin VAR_ADDRESS 0x8003A670 0x8003B470 0x8003C270 0x8003D070 0x8003DE70 0x8003EC70 0x8003FA70 0x80040870 0x80041670 0x80042470 0x80043270 0x80044070 0x80044E70 0x80045C70 0x80046A70 0x80047870 0x80048670 0x80049470 0x8004A270 0x8004B070 0x8004BE70 0x8004CC70 0x8004DA70 0x8004E870 /end VAR_ADDRESS
 /end VAR_CHARACTERISTIC
 /begin VAR_CHARACTERISTIC TP_U8TMCpMinGear EngCalVariantCriterion
  /begin VAR_ADDRESS 0x8003A671 0x8003B471 0x8003C271 0x8003D071 0x8003DE71 0x8003EC71 0x8003FA71 0x80040871 0x80041671 0x80042471 0x80043271 0x80044071 0x80044E71 0x80045C71 0x80046A71 0x80047871 0x80048671 0x80049471 0x8004A271 0x8004B071 0x8004BE71 0x8004CC71 0x8004DA71 0x8004E871 /end VAR_ADDRESS
 /end VAR_CHARACTERISTIC
 /begin VAR_CHARACTERISTIC TP_U8TMCpShftChgRPMHys EngCalVariantCriterion
  /begin VAR_ADDRESS 0x8003A672 0x8003B472 0x8003C272 0x8003D072 0x8003DE72 0x8003EC72 0x8003FA72 0x80040872 0x80041672 0x80042472 0x80043272 0x80044072 0x80044E72 0x80045C72 0x80046A72 0x80047872 0x80048672 0x80049472 0x8004A272 0x8004B072 0x8004BE72 0x8004CC72 0x8004DA72 0x8004E872 /end VAR_ADDRESS
 /end VAR_CHARACTERISTIC
 /begin VAR_CHARACTERISTIC TP_U8TMCpShftChgRPMInTrn[0] EngCalVariantCriterion
  /begin VAR_ADDRESS 0x8003A673 0x8003B473 0x8003C273 0x8003D073 0x8003DE73 0x8003EC73 0x8003FA73 0x80040873 0x80041673 0x80042473 0x80043273 0x80044073 0x80044E73 0x80045C73 0x80046A73 0x80047873 0x80048673 0x80049473 0x8004A273 0x8004B073 0x8004BE73 0x8004CC73 0x8004DA73 0x8004E873 /end VAR_ADDRESS
 /end VAR_CHARACTERISTIC
 /begin VAR_CHARACTERISTIC TP_U8TMCpShftChgRPMInTrn[1] EngCalVariantCriterion
  /begin VAR_ADDRESS 0x8003A674 0x8003B474 0x8003C274 0x8003D074 0x8003DE74 0x8003EC74 0x8003FA74 0x80040874 0x80041674 0x80042474 0x80043274 0x80044074 0x80044E74 0x80045C74 0x80046A74 0x80047874 0x80048674 0x80049474 0x8004A274 0x8004B074 0x8004BE74 0x8004CC74 0x8004DA74 0x8004E874 /end VAR_ADDRESS
 /end VAR_CHARACTERISTIC
 /begin VAR_CHARACTERISTIC TP_U8TMCpShftChgRPMInTrn[2] EngCalVariantCriterion
  /begin VAR_ADDRESS 0x8003A675 0x8003B475 0x8003C275 0x8003D075 0x8003DE75 0x8003EC75 0x8003FA75 0x80040875 0x80041675 0x80042475 0x80043275 0x80044075 0x80044E75 0x80045C75 0x80046A75 0x80047875 0x80048675 0x80049475 0x8004A275 0x8004B075 0x8004BE75 0x8004CC75 0x8004DA75 0x8004E875 /end VAR_ADDRESS
 /end VAR_CHARACTERISTIC
 /begin VAR_CHARACTERISTIC TP_U8TMCpShftChgVehSpdHys EngCalVariantCriterion
  /begin VAR_ADDRESS 0x8003A676 0x8003B476 0x8003C276 0x8003D076 0x8003DE76 0x8003EC76 0x8003FA76 0x80040876 0x80041676 0x80042476 0x80043276 0x80044076 0x80044E76 0x80045C76 0x80046A76 0x80047876 0x80048676 0x80049476 0x8004A276 0x8004B076 0x8004BE76 0x8004CC76 0x8004DA76 0x8004E876 /end VAR_ADDRESS
 /end VAR_CHARACTERISTIC
 /begin VAR_CHARACTERISTIC TP_U8TMCpShftChgVehSpdInHill EngCalVariantCriterion
  /begin VAR_ADDRESS 0x8003A677 0x8003B477 0x8003C277 0x8003D077 0x8003DE77 0x8003EC77 0x8003FA77 0x80040877 0x80041677 0x80042477 0x80043277 0x80044077 0x80044E77 0x80045C77 0x80046A77 0x80047877 0x80048677 0x80049477 0x8004A277 0x8004B077 0x8004BE77 0x8004CC77 0x8004DA77 0x8004E877 /end VAR_ADDRESS
 /end VAR_CHARACTERISTIC
 /begin VAR_CHARACTERISTIC TP_U8TMCpShftChgVehSpdInTrn[0] EngCalVariantCriterion
  /begin VAR_ADDRESS 0x8003A678 0x8003B478 0x8003C278 0x8003D078 0x8003DE78 0x8003EC78 0x8003FA78 0x80040878 0x80041678 0x80042478 0x80043278 0x80044078 0x80044E78 0x80045C78 0x80046A78 0x80047878 0x80048678 0x80049478 0x8004A278 0x8004B078 0x8004BE78 0x8004CC78 0x8004DA78 0x8004E878 /end VAR_ADDRESS
 /end VAR_CHARACTERISTIC
 /begin VAR_CHARACTERISTIC TP_U8TMCpShftChgVehSpdInTrn[1] EngCalVariantCriterion
  /begin VAR_ADDRESS 0x8003A679 0x8003B479 0x8003C279 0x8003D079 0x8003DE79 0x8003EC79 0x8003FA79 0x80040879 0x80041679 0x80042479 0x80043279 0x80044079 0x80044E79 0x80045C79 0x80046A79 0x80047879 0x80048679 0x80049479 0x8004A279 0x8004B079 0x8004BE79 0x8004CC79 0x8004DA79 0x8004E879 /end VAR_ADDRESS
 /end VAR_CHARACTERISTIC
 /begin VAR_CHARACTERISTIC TP_U8TMCpShftChgVehSpdInTrn[2] EngCalVariantCriterion
  /begin VAR_ADDRESS 0x8003A67A 0x8003B47A 0x8003C27A 0x8003D07A 0x8003DE7A 0x8003EC7A 0x8003FA7A 0x8004087A 0x8004167A 0x8004247A 0x8004327A 0x8004407A 0x80044E7A 0x80045C7A 0x80046A7A 0x8004787A 0x8004867A 0x8004947A 0x8004A27A 0x8004B07A 0x8004BE7A 0x8004CC7A 0x8004DA7A 0x8004E87A /end VAR_ADDRESS
 /end VAR_CHARACTERISTIC
 /begin VAR_CHARACTERISTIC TP_U8TransEff_1 EngCalVariantCriterion
  /begin VAR_ADDRESS 0x8003A022 0x8003AE22 0x8003BC22 0x8003CA22 0x8003D822 0x8003E622 0x8003F422 0x80040222 0x80041022 0x80041E22 0x80042C22 0x80043A22 0x80044822 0x80045622 0x80046422 0x80047222 0x80048022 0x80048E22 0x80049C22 0x8004AA22 0x8004B822 0x8004C622 0x8004D422 0x8004E222 /end VAR_ADDRESS
 /end VAR_CHARACTERISTIC
 /begin VAR_CHARACTERISTIC TP_U8TransEff_2 EngCalVariantCriterion
  /begin VAR_ADDRESS 0x8003A023 0x8003AE23 0x8003BC23 0x8003CA23 0x8003D823 0x8003E623 0x8003F423 0x80040223 0x80041023 0x80041E23 0x80042C23 0x80043A23 0x80044823 0x80045623 0x80046423 0x80047223 0x80048023 0x80048E23 0x80049C23 0x8004AA23 0x8004B823 0x8004C623 0x8004D423 0x8004E223 /end VAR_ADDRESS
 /end VAR_CHARACTERISTIC
 /begin VAR_CHARACTERISTIC TP_U8TransEff_3 EngCalVariantCriterion
  /begin VAR_ADDRESS 0x8003A024 0x8003AE24 0x8003BC24 0x8003CA24 0x8003D824 0x8003E624 0x8003F424 0x80040224 0x80041024 0x80041E24 0x80042C24 0x80043A24 0x80044824 0x80045624 0x80046424 0x80047224 0x80048024 0x80048E24 0x80049C24 0x8004AA24 0x8004B824 0x8004C624 0x8004D424 0x8004E224 /end VAR_ADDRESS
 /end VAR_CHARACTERISTIC
 /begin VAR_CHARACTERISTIC TP_U8TransEff_4 EngCalVariantCriterion
  /begin VAR_ADDRESS 0x8003A025 0x8003AE25 0x8003BC25 0x8003CA25 0x8003D825 0x8003E625 0x8003F425 0x80040225 0x80041025 0x80041E25 0x80042C25 0x80043A25 0x80044825 0x80045625 0x80046425 0x80047225 0x80048025 0x80048E25 0x80049C25 0x8004AA25 0x8004B825 0x8004C625 0x8004D425 0x8004E225 /end VAR_ADDRESS
 /end VAR_CHARACTERISTIC
 /begin VAR_CHARACTERISTIC TP_U8TransEff_5 EngCalVariantCriterion
  /begin VAR_ADDRESS 0x8003A026 0x8003AE26 0x8003BC26 0x8003CA26 0x8003D826 0x8003E626 0x8003F426 0x80040226 0x80041026 0x80041E26 0x80042C26 0x80043A26 0x80044826 0x80045626 0x80046426 0x80047226 0x80048026 0x80048E26 0x80049C26 0x8004AA26 0x8004B826 0x8004C626 0x8004D426 0x8004E226 /end VAR_ADDRESS
 /end VAR_CHARACTERISTIC
 /begin VAR_CHARACTERISTIC TP_U8TransEff_6 EngCalVariantCriterion
  /begin VAR_ADDRESS 0x8003A027 0x8003AE27 0x8003BC27 0x8003CA27 0x8003D827 0x8003E627 0x8003F427 0x80040227 0x80041027 0x80041E27 0x80042C27 0x80043A27 0x80044827 0x80045627 0x80046427 0x80047227 0x80048027 0x80048E27 0x80049C27 0x8004AA27 0x8004B827 0x8004C627 0x8004D427 0x8004E227 /end VAR_ADDRESS
 /end VAR_CHARACTERISTIC
 /begin VAR_CHARACTERISTIC TP_U8TransEff_7 EngCalVariantCriterion
  /begin VAR_ADDRESS 0x8003A028 0x8003AE28 0x8003BC28 0x8003CA28 0x8003D828 0x8003E628 0x8003F428 0x80040228 0x80041028 0x80041E28 0x80042C28 0x80043A28 0x80044828 0x80045628 0x80046428 0x80047228 0x80048028 0x80048E28 0x80049C28 0x8004AA28 0x8004B828 0x8004C628 0x8004D428 0x8004E228 /end VAR_ADDRESS
 /end VAR_CHARACTERISTIC
 /begin VAR_CHARACTERISTIC TP_U8TransEff_8 EngCalVariantCriterion
  /begin VAR_ADDRESS 0x8003A029 0x8003AE29 0x8003BC29 0x8003CA29 0x8003D829 0x8003E629 0x8003F429 0x80040229 0x80041029 0x80041E29 0x80042C29 0x80043A29 0x80044829 0x80045629 0x80046429 0x80047229 0x80048029 0x80048E29 0x80049C29 0x8004AA29 0x8004B829 0x8004C629 0x8004D429 0x8004E229 /end VAR_ADDRESS
 /end VAR_CHARACTERISTIC
 /begin VAR_CHARACTERISTIC TP_U8TransEff_R EngCalVariantCriterion
  /begin VAR_ADDRESS 0x8003A02A 0x8003AE2A 0x8003BC2A 0x8003CA2A 0x8003D82A 0x8003E62A 0x8003F42A 0x8004022A 0x8004102A 0x80041E2A 0x80042C2A 0x80043A2A 0x8004482A 0x8004562A 0x8004642A 0x8004722A 0x8004802A 0x80048E2A 0x80049C2A 0x8004AA2A 0x8004B82A 0x8004C62A 0x8004D42A 0x8004E22A /end VAR_ADDRESS
 /end VAR_CHARACTERISTIC
 /begin VAR_CHARACTERISTIC TP_U8_1ST_CYCLE_UR_RISE_SCAN_MAX BrkCalVariantCriterion
  /begin VAR_ADDRESS 0x800205D5 0x800239D5 0x80026DD5 0x8002A1D5 0x8002D5D5 0x800309D5 0x80033DD5 0x800371D5 /end VAR_ADDRESS
 /end VAR_CHARACTERISTIC
 /begin VAR_CHARACTERISTIC TP_U8_1ST_CYCLE_UR_RISE_SCAN_MIN BrkCalVariantCriterion
  /begin VAR_ADDRESS 0x800205D6 0x800239D6 0x80026DD6 0x8002A1D6 0x8002D5D6 0x800309D6 0x80033DD6 0x800371D6 /end VAR_ADDRESS
 /end VAR_CHARACTERISTIC
 /begin VAR_CHARACTERISTIC TP_U8_1stDPRisePerDumpRatio_HMu_F BrkCalVariantCriterion
  /begin VAR_ADDRESS 0x800205D7 0x800239D7 0x80026DD7 0x8002A1D7 0x8002D5D7 0x800309D7 0x80033DD7 0x800371D7 /end VAR_ADDRESS
 /end VAR_CHARACTERISTIC
 /begin VAR_CHARACTERISTIC TP_U8_1stDPRisePerDumpRatio_HMu_R BrkCalVariantCriterion
  /begin VAR_ADDRESS 0x800205D8 0x800239D8 0x80026DD8 0x8002A1D8 0x8002D5D8 0x800309D8 0x80033DD8 0x800371D8 /end VAR_ADDRESS
 /end VAR_CHARACTERISTIC
 /begin VAR_CHARACTERISTIC TP_U8_1stDPRisePerDumpRatio_LMu_F BrkCalVariantCriterion
  /begin VAR_ADDRESS 0x800205D9 0x800239D9 0x80026DD9 0x8002A1D9 0x8002D5D9 0x800309D9 0x80033DD9 0x800371D9 /end VAR_ADDRESS
 /end VAR_CHARACTERISTIC
 /begin VAR_CHARACTERISTIC TP_U8_1stDPRisePerDumpRatio_LMu_R BrkCalVariantCriterion
  /begin VAR_ADDRESS 0x800205DA 0x800239DA 0x80026DDA 0x8002A1DA 0x8002D5DA 0x800309DA 0x80033DDA 0x800371DA /end VAR_ADDRESS
 /end VAR_CHARACTERISTIC
 /begin VAR_CHARACTERISTIC TP_U8_1stDPRisePerDumpRatio_MMu_F BrkCalVariantCriterion
  /begin VAR_ADDRESS 0x800205DB 0x800239DB 0x80026DDB 0x8002A1DB 0x8002D5DB 0x800309DB 0x80033DDB 0x800371DB /end VAR_ADDRESS
 /end VAR_CHARACTERISTIC
 /begin VAR_CHARACTERISTIC TP_U8_1stDPRisePerDumpRatio_MMu_R BrkCalVariantCriterion
  /begin VAR_ADDRESS 0x800205DC 0x800239DC 0x80026DDC 0x8002A1DC 0x8002D5DC 0x800309DC 0x80033DDC 0x800371DC /end VAR_ADDRESS
 /end VAR_CHARACTERISTIC
 /begin VAR_CHARACTERISTIC TP_U8_1st_Dumpscantime_EBD_R BrkCalVariantCriterion
  /begin VAR_ADDRESS 0x800206DC 0x80023ADC 0x80026EDC 0x8002A2DC 0x8002D6DC 0x80030ADC 0x80033EDC 0x800372DC /end VAR_ADDRESS
 /end VAR_CHARACTERISTIC
 /begin VAR_CHARACTERISTIC TP_U8_1st_Dumpscantime_HMu_HHDF_F BrkCalVariantCriterion
  /begin VAR_ADDRESS 0x80020499 0x80023899 0x80026C99 0x8002A099 0x8002D499 0x80030899 0x80033C99 0x80037099 /end VAR_ADDRESS
 /end VAR_CHARACTERISTIC
 /begin VAR_CHARACTERISTIC TP_U8_1st_Dumpscantime_HMu_HHDF_R BrkCalVariantCriterion
  /begin VAR_ADDRESS 0x8002049F 0x8002389F 0x80026C9F 0x8002A09F 0x8002D49F 0x8003089F 0x80033C9F 0x8003709F /end VAR_ADDRESS
 /end VAR_CHARACTERISTIC
 /begin VAR_CHARACTERISTIC TP_U8_1st_Dumpscantime_HMu_LHDF_F BrkCalVariantCriterion
  /begin VAR_ADDRESS 0x8002049A 0x8002389A 0x80026C9A 0x8002A09A 0x8002D49A 0x8003089A 0x80033C9A 0x8003709A /end VAR_ADDRESS
 /end VAR_CHARACTERISTIC
 /begin VAR_CHARACTERISTIC TP_U8_1st_Dumpscantime_HMu_LHDF_R BrkCalVariantCriterion
  /begin VAR_ADDRESS 0x800204A0 0x800238A0 0x80026CA0 0x8002A0A0 0x8002D4A0 0x800308A0 0x80033CA0 0x800370A0 /end VAR_ADDRESS
 /end VAR_CHARACTERISTIC
 /begin VAR_CHARACTERISTIC TP_U8_1st_Dumpscantime_HMu_LMHDF_F BrkCalVariantCriterion
  /begin VAR_ADDRESS 0x8002049B 0x8002389B 0x80026C9B 0x8002A09B 0x8002D49B 0x8003089B 0x80033C9B 0x8003709B /end VAR_ADDRESS
 /end VAR_CHARACTERISTIC
 /begin VAR_CHARACTERISTIC TP_U8_1st_Dumpscantime_HMu_MHDF_F BrkCalVariantCriterion
  /begin VAR_ADDRESS 0x8002049C 0x8002389C 0x80026C9C 0x8002A09C 0x8002D49C 0x8003089C 0x80033C9C 0x8003709C /end VAR_ADDRESS
 /end VAR_CHARACTERISTIC
 /begin VAR_CHARACTERISTIC TP_U8_1st_Dumpscantime_HMu_MHDF_R BrkCalVariantCriterion
  /begin VAR_ADDRESS 0x800204A1 0x800238A1 0x80026CA1 0x8002A0A1 0x8002D4A1 0x800308A1 0x80033CA1 0x800370A1 /end VAR_ADDRESS
 /end VAR_CHARACTERISTIC
 /begin VAR_CHARACTERISTIC TP_U8_1st_Dumpscantime_LMMu_F BrkCalVariantCriterion
  /begin VAR_ADDRESS 0x800204AA 0x800238AA 0x80026CAA 0x8002A0AA 0x8002D4AA 0x800308AA 0x80033CAA 0x800370AA /end VAR_ADDRESS
 /end VAR_CHARACTERISTIC
 /begin VAR_CHARACTERISTIC TP_U8_1st_Dumpscantime_LMMu_R BrkCalVariantCriterion
  /begin VAR_ADDRESS 0x800204AE 0x800238AE 0x80026CAE 0x8002A0AE 0x8002D4AE 0x800308AE 0x80033CAE 0x800370AE /end VAR_ADDRESS
 /end VAR_CHARACTERISTIC
 /begin VAR_CHARACTERISTIC TP_U8_1st_Dumpscantime_LMu_F BrkCalVariantCriterion
  /begin VAR_ADDRESS 0x800204B3 0x800238B3 0x80026CB3 0x8002A0B3 0x8002D4B3 0x800308B3 0x80033CB3 0x800370B3 /end VAR_ADDRESS
 /end VAR_CHARACTERISTIC
 /begin VAR_CHARACTERISTIC TP_U8_1st_Dumpscantime_LMu_R BrkCalVariantCriterion
  /begin VAR_ADDRESS 0x800204B9 0x800238B9 0x80026CB9 0x8002A0B9 0x8002D4B9 0x800308B9 0x80033CB9 0x800370B9 /end VAR_ADDRESS
 /end VAR_CHARACTERISTIC
 /begin VAR_CHARACTERISTIC TP_U8_1st_Dumpscantime_MMu_F BrkCalVariantCriterion
  /begin VAR_ADDRESS 0x800204A4 0x800238A4 0x80026CA4 0x8002A0A4 0x8002D4A4 0x800308A4 0x80033CA4 0x800370A4 /end VAR_ADDRESS
 /end VAR_CHARACTERISTIC
 /begin VAR_CHARACTERISTIC TP_U8_1st_Dumpscantime_MMu_R BrkCalVariantCriterion
  /begin VAR_ADDRESS 0x800204A7 0x800238A7 0x80026CA7 0x8002A0A7 0x8002D4A7 0x800308A7 0x80033CA7 0x800370A7 /end VAR_ADDRESS
 /end VAR_CHARACTERISTIC
 /begin VAR_CHARACTERISTIC TP_U8_1st_Dumptime_HMu_B_20_F BrkCalVariantCriterion
  /begin VAR_ADDRESS 0x8002049D 0x8002389D 0x80026C9D 0x8002A09D 0x8002D49D 0x8003089D 0x80033C9D 0x8003709D /end VAR_ADDRESS
 /end VAR_CHARACTERISTIC
 /begin VAR_CHARACTERISTIC TP_U8_1st_Dumptime_HMu_B_20_R BrkCalVariantCriterion
  /begin VAR_ADDRESS 0x800204A2 0x800238A2 0x80026CA2 0x8002A0A2 0x8002D4A2 0x800308A2 0x80033CA2 0x800370A2 /end VAR_ADDRESS
 /end VAR_CHARACTERISTIC
 /begin VAR_CHARACTERISTIC TP_U8_1st_Dumptime_HMu_LHDF_B_20_F BrkCalVariantCriterion
  /begin VAR_ADDRESS 0x8002049E 0x8002389E 0x80026C9E 0x8002A09E 0x8002D49E 0x8003089E 0x80033C9E 0x8003709E /end VAR_ADDRESS
 /end VAR_CHARACTERISTIC
 /begin VAR_CHARACTERISTIC TP_U8_1st_Dumptime_HMu_LHDF_B_20_R BrkCalVariantCriterion
  /begin VAR_ADDRESS 0x800204A3 0x800238A3 0x80026CA3 0x8002A0A3 0x8002D4A3 0x800308A3 0x80033CA3 0x800370A3 /end VAR_ADDRESS
 /end VAR_CHARACTERISTIC
 /begin VAR_CHARACTERISTIC TP_U8_2nd3rd_Dumpscantime_LMMu_F BrkCalVariantCriterion
  /begin VAR_ADDRESS 0x800204AB 0x800238AB 0x80026CAB 0x8002A0AB 0x8002D4AB 0x800308AB 0x80033CAB 0x800370AB /end VAR_ADDRESS
 /end VAR_CHARACTERISTIC
 /begin VAR_CHARACTERISTIC TP_U8_2nd3rd_Dumpscantime_LMMu_R BrkCalVariantCriterion
  /begin VAR_ADDRESS 0x800204AF 0x800238AF 0x80026CAF 0x8002A0AF 0x8002D4AF 0x800308AF 0x80033CAF 0x800370AF /end VAR_ADDRESS
 /end VAR_CHARACTERISTIC
 /begin VAR_CHARACTERISTIC TP_U8_2nd3rd_Dumpscantime_LMu_F BrkCalVariantCriterion
  /begin VAR_ADDRESS 0x800204B4 0x800238B4 0x80026CB4 0x8002A0B4 0x8002D4B4 0x800308B4 0x80033CB4 0x800370B4 /end VAR_ADDRESS
 /end VAR_CHARACTERISTIC
 /begin VAR_CHARACTERISTIC TP_U8_2nd3rd_Dumpscantime_LMu_R BrkCalVariantCriterion
  /begin VAR_ADDRESS 0x800204BA 0x800238BA 0x80026CBA 0x8002A0BA 0x8002D4BA 0x800308BA 0x80033CBA 0x800370BA /end VAR_ADDRESS
 /end VAR_CHARACTERISTIC
 /begin VAR_CHARACTERISTIC TP_U8_4th5th_Dumpscantime_LMMu_R BrkCalVariantCriterion
  /begin VAR_ADDRESS 0x800204B0 0x800238B0 0x80026CB0 0x8002A0B0 0x8002D4B0 0x800308B0 0x80033CB0 0x800370B0 /end VAR_ADDRESS
 /end VAR_CHARACTERISTIC
 /begin VAR_CHARACTERISTIC TP_U8_4th5th_Dumpscantime_LMu_F BrkCalVariantCriterion
  /begin VAR_ADDRESS 0x800204B5 0x800238B5 0x80026CB5 0x8002A0B5 0x8002D4B5 0x800308B5 0x80033CB5 0x800370B5 /end VAR_ADDRESS
 /end VAR_CHARACTERISTIC
 /begin VAR_CHARACTERISTIC TP_U8_4th5th_Dumpscantime_LMu_R BrkCalVariantCriterion
  /begin VAR_ADDRESS 0x800204BB 0x800238BB 0x80026CBB 0x8002A0BB 0x8002D4BB 0x800308BB 0x80033CBB 0x800370BB /end VAR_ADDRESS
 /end VAR_CHARACTERISTIC
 /begin VAR_CHARACTERISTIC TP_U8_ABS_ENTRANCE_LIMIT_BY_SLIP BrkCalVariantCriterion
  /begin VAR_ADDRESS 0x8002057E 0x8002397E 0x80026D7E 0x8002A17E 0x8002D57E 0x8003097E 0x80033D7E 0x8003717E /end VAR_ADDRESS
 /end VAR_CHARACTERISTIC
 /begin VAR_CHARACTERISTIC TP_U8_ACC_TH_VCA EngCalVariantCriterion
  /begin VAR_ADDRESS 0x8003A256 0x8003B056 0x8003BE56 0x8003CC56 0x8003DA56 0x8003E856 0x8003F656 0x80040456 0x80041256 0x80042056 0x80042E56 0x80043C56 0x80044A56 0x80045856 0x80046656 0x80047456 0x80048256 0x80049056 0x80049E56 0x8004AC56 0x8004BA56 0x8004C856 0x8004D656 0x8004E456 /end VAR_ADDRESS
 /end VAR_CHARACTERISTIC
 /begin VAR_CHARACTERISTIC TP_U8_BIG_DUMP_BY_LOWMU_FAST_RISE BrkCalVariantCriterion
  /begin VAR_ADDRESS 0x80020593 0x80023993 0x80026D93 0x8002A193 0x8002D593 0x80030993 0x80033D93 0x80037193 /end VAR_ADDRESS
 /end VAR_CHARACTERISTIC
 /begin VAR_CHARACTERISTIC TP_U8_BIG_DUMP_GAUGE_AT_LEVEL1 BrkCalVariantCriterion
  /begin VAR_ADDRESS 0x80020594 0x80023994 0x80026D94 0x8002A194 0x8002D594 0x80030994 0x80033D94 0x80037194 /end VAR_ADDRESS
 /end VAR_CHARACTERISTIC
 /begin VAR_CHARACTERISTIC TP_U8_BIG_DUMP_GAUGE_AT_LEVEL2 BrkCalVariantCriterion
  /begin VAR_ADDRESS 0x80020595 0x80023995 0x80026D95 0x8002A195 0x8002D595 0x80030995 0x80033D95 0x80037195 /end VAR_ADDRESS
 /end VAR_CHARACTERISTIC
 /begin VAR_CHARACTERISTIC TP_U8_BIG_DUMP_GAUGE_AT_LEVEL3 BrkCalVariantCriterion
  /begin VAR_ADDRESS 0x80020596 0x80023996 0x80026D96 0x8002A196 0x8002D596 0x80030996 0x80033D96 0x80037196 /end VAR_ADDRESS
 /end VAR_CHARACTERISTIC
 /begin VAR_CHARACTERISTIC TP_U8_BIG_RISE_DMP_COMP_DUTY BrkCalVariantCriterion
  /begin VAR_ADDRESS 0x80020597 0x80023997 0x80026D97 0x8002A197 0x8002D597 0x80030997 0x80033D97 0x80037197 /end VAR_ADDRESS
 /end VAR_CHARACTERISTIC
 /begin VAR_CHARACTERISTIC TP_U8_BRD_DETECTION_REF BrkCalVariantCriterion
  /begin VAR_ADDRESS 0x80020598 0x80023998 0x80026D98 0x8002A198 0x8002D598 0x80030998 0x80033D98 0x80037198 /end VAR_ADDRESS
 /end VAR_CHARACTERISTIC
 /begin VAR_CHARACTERISTIC TP_U8_BRD_DUMP_CNT_LEVEL1 BrkCalVariantCriterion
  /begin VAR_ADDRESS 0x80020599 0x80023999 0x80026D99 0x8002A199 0x8002D599 0x80030999 0x80033D99 0x80037199 /end VAR_ADDRESS
 /end VAR_CHARACTERISTIC
 /begin VAR_CHARACTERISTIC TP_U8_BRD_DUMP_CNT_LEVEL2 BrkCalVariantCriterion
  /begin VAR_ADDRESS 0x8002059A 0x8002399A 0x80026D9A 0x8002A19A 0x8002D59A 0x8003099A 0x80033D9A 0x8003719A /end VAR_ADDRESS
 /end VAR_CHARACTERISTIC
 /begin VAR_CHARACTERISTIC TP_U8_BRD_DUMP_CNT_LEVEL3 BrkCalVariantCriterion
  /begin VAR_ADDRESS 0x8002059B 0x8002399B 0x80026D9B 0x8002A19B 0x8002D59B 0x8003099B 0x80033D9B 0x8003719B /end VAR_ADDRESS
 /end VAR_CHARACTERISTIC
 /begin VAR_CHARACTERISTIC TP_U8_BUMP_MAX_DUMP_SCANS BrkCalVariantCriterion
  /begin VAR_ADDRESS 0x80020624 0x80023A24 0x80026E24 0x8002A224 0x8002D624 0x80030A24 0x80033E24 0x80037224 /end VAR_ADDRESS
 /end VAR_CHARACTERISTIC
 /begin VAR_CHARACTERISTIC TP_U8_B_10KPH_Dumpscantime_LMMu_R BrkCalVariantCriterion
  /begin VAR_ADDRESS 0x800204B2 0x800238B2 0x80026CB2 0x8002A0B2 0x8002D4B2 0x800308B2 0x80033CB2 0x800370B2 /end VAR_ADDRESS
 /end VAR_CHARACTERISTIC
 /begin VAR_CHARACTERISTIC TP_U8_B_10KPH_Dumpscantime_LMu_F BrkCalVariantCriterion
  /begin VAR_ADDRESS 0x800204B8 0x800238B8 0x80026CB8 0x8002A0B8 0x8002D4B8 0x800308B8 0x80033CB8 0x800370B8 /end VAR_ADDRESS
 /end VAR_CHARACTERISTIC
 /begin VAR_CHARACTERISTIC TP_U8_B_10KPH_Dumpscantime_LMu_R BrkCalVariantCriterion
  /begin VAR_ADDRESS 0x800204BD 0x800238BD 0x80026CBD 0x8002A0BD 0x8002D4BD 0x800308BD 0x80033CBD 0x800370BD /end VAR_ADDRESS
 /end VAR_CHARACTERISTIC
 /begin VAR_CHARACTERISTIC TP_U8_B_20KPH_Dumpscantime_LMMu_F BrkCalVariantCriterion
  /begin VAR_ADDRESS 0x800204AD 0x800238AD 0x80026CAD 0x8002A0AD 0x8002D4AD 0x800308AD 0x80033CAD 0x800370AD /end VAR_ADDRESS
 /end VAR_CHARACTERISTIC
 /begin VAR_CHARACTERISTIC TP_U8_B_20KPH_Dumpscantime_MMu_F BrkCalVariantCriterion
  /begin VAR_ADDRESS 0x800204A6 0x800238A6 0x80026CA6 0x8002A0A6 0x8002D4A6 0x800308A6 0x80033CA6 0x800370A6 /end VAR_ADDRESS
 /end VAR_CHARACTERISTIC
 /begin VAR_CHARACTERISTIC TP_U8_B_20KPH_Dumpscantime_MMu_R BrkCalVariantCriterion
  /begin VAR_ADDRESS 0x800204A9 0x800238A9 0x80026CA9 0x8002A0A9 0x8002D4A9 0x800308A9 0x80033CA9 0x800370A9 /end VAR_ADDRESS
 /end VAR_CHARACTERISTIC
 /begin VAR_CHARACTERISTIC TP_U8_CBC_AX_MPRES_FACTOR BrkCalVariantCriterion
  /begin VAR_ADDRESS 0x8002070E 0x80023B0E 0x80026F0E 0x8002A30E 0x8002D70E 0x80030B0E 0x80033F0E 0x8003730E /end VAR_ADDRESS
 /end VAR_CHARACTERISTIC
 /begin VAR_CHARACTERISTIC TP_U8_CBC_AY_EST_GAIN_SPD_H BrkCalVariantCriterion
  /begin VAR_ADDRESS 0x8002071A 0x80023B1A 0x80026F1A 0x8002A31A 0x8002D71A 0x80030B1A 0x80033F1A 0x8003731A /end VAR_ADDRESS
 /end VAR_CHARACTERISTIC
 /begin VAR_CHARACTERISTIC TP_U8_CBC_AY_EST_GAIN_SPD_M BrkCalVariantCriterion
  /begin VAR_ADDRESS 0x8002071B 0x80023B1B 0x80026F1B 0x8002A31B 0x8002D71B 0x80030B1B 0x80033F1B 0x8003731B /end VAR_ADDRESS
 /end VAR_CHARACTERISTIC
 /begin VAR_CHARACTERISTIC TP_U8_CBC_AY_EST_GAIN_SPD_S BrkCalVariantCriterion
  /begin VAR_ADDRESS 0x8002071C 0x80023B1C 0x80026F1C 0x8002A31C 0x8002D71C 0x80030B1C 0x80033F1C 0x8003731C /end VAR_ADDRESS
 /end VAR_CHARACTERISTIC
 /begin VAR_CHARACTERISTIC TP_U8_CBC_DUMPSCAN_TIME BrkCalVariantCriterion
  /begin VAR_ADDRESS 0x80020702 0x80023B02 0x80026F02 0x8002A302 0x8002D702 0x80030B02 0x80033F02 0x80037302 /end VAR_ADDRESS
 /end VAR_CHARACTERISTIC
 /begin VAR_CHARACTERISTIC TP_U8_CBC_DUMP_DEAD_PRESS BrkCalVariantCriterion
  /begin VAR_ADDRESS 0x8002078C 0x80023B8C 0x80026F8C 0x8002A38C 0x8002D78C 0x80030B8C 0x80033F8C 0x8003738C /end VAR_ADDRESS
 /end VAR_CHARACTERISTIC
 /begin VAR_CHARACTERISTIC TP_U8_CBC_DUMP_DEAD_PRESS_ABS BrkCalVariantCriterion
  /begin VAR_ADDRESS 0x80020704 0x80023B04 0x80026F04 0x8002A304 0x8002D704 0x80030B04 0x80033F04 0x80037304 /end VAR_ADDRESS
 /end VAR_CHARACTERISTIC
 /begin VAR_CHARACTERISTIC TP_U8_CBC_DUMP_DEAD_PRESS_FRONT BrkCalVariantCriterion
  /begin VAR_ADDRESS 0x8002078D 0x80023B8D 0x80026F8D 0x8002A38D 0x8002D78D 0x80030B8D 0x80033F8D 0x8003738D /end VAR_ADDRESS
 /end VAR_CHARACTERISTIC
 /begin VAR_CHARACTERISTIC TP_U8_CBC_MAX_HOLD_TIMER BrkCalVariantCriterion
  /begin VAR_ADDRESS 0x80020703 0x80023B03 0x80026F03 0x8002A303 0x8002D703 0x80030B03 0x80033F03 0x80037303 /end VAR_ADDRESS
 /end VAR_CHARACTERISTIC
 /begin VAR_CHARACTERISTIC TP_U8_CBC_PRESS_EST_FRONT_DUMP_GAIN BrkCalVariantCriterion
  /begin VAR_ADDRESS 0x8002070F 0x80023B0F 0x80026F0F 0x8002A30F 0x8002D70F 0x80030B0F 0x80033F0F 0x8003730F /end VAR_ADDRESS
 /end VAR_CHARACTERISTIC
 /begin VAR_CHARACTERISTIC TP_U8_CBC_PRESS_EST_FRONT_RISE_GAIN BrkCalVariantCriterion
  /begin VAR_ADDRESS 0x80020710 0x80023B10 0x80026F10 0x8002A310 0x8002D710 0x80030B10 0x80033F10 0x80037310 /end VAR_ADDRESS
 /end VAR_CHARACTERISTIC
 /begin VAR_CHARACTERISTIC TP_U8_CBC_PRESS_EST_REAR_DUMP_GAIN BrkCalVariantCriterion
  /begin VAR_ADDRESS 0x80020711 0x80023B11 0x80026F11 0x8002A311 0x8002D711 0x80030B11 0x80033F11 0x80037311 /end VAR_ADDRESS
 /end VAR_CHARACTERISTIC
 /begin VAR_CHARACTERISTIC TP_U8_CBC_PRESS_EST_REAR_RISE_GAIN BrkCalVariantCriterion
  /begin VAR_ADDRESS 0x80020712 0x80023B12 0x80026F12 0x8002A312 0x8002D712 0x80030B12 0x80033F12 0x80037312 /end VAR_ADDRESS
 /end VAR_CHARACTERISTIC
 /begin VAR_CHARACTERISTIC TP_U8_CBC_RISE_DEAD_PRESS BrkCalVariantCriterion
  /begin VAR_ADDRESS 0x8002078E 0x80023B8E 0x80026F8E 0x8002A38E 0x8002D78E 0x80030B8E 0x80033F8E 0x8003738E /end VAR_ADDRESS
 /end VAR_CHARACTERISTIC
 /begin VAR_CHARACTERISTIC TP_U8_CBC_RISE_DEAD_PRESS_ABS BrkCalVariantCriterion
  /begin VAR_ADDRESS 0x80020705 0x80023B05 0x80026F05 0x8002A305 0x8002D705 0x80030B05 0x80033F05 0x80037305 /end VAR_ADDRESS
 /end VAR_CHARACTERISTIC
 /begin VAR_CHARACTERISTIC TP_U8_CBC_RISE_DEAD_PRESS_FRONT BrkCalVariantCriterion
  /begin VAR_ADDRESS 0x8002078F 0x80023B8F 0x80026F8F 0x8002A38F 0x8002D78F 0x80030B8F 0x80033F8F 0x8003738F /end VAR_ADDRESS
 /end VAR_CHARACTERISTIC
 /begin VAR_CHARACTERISTIC TP_U8_Chess_Dump_Rise_Ref BrkCalVariantCriterion
  /begin VAR_ADDRESS 0x8002059C 0x8002399C 0x80026D9C 0x8002A19C 0x8002D59C 0x8003099C 0x80033D9C 0x8003719C /end VAR_ADDRESS
 /end VAR_CHARACTERISTIC
 /begin VAR_CHARACTERISTIC TP_U8_DEFAULT_DUMPSCANTIME BrkCalVariantCriterion
  /begin VAR_ADDRESS 0x800205E8 0x800239E8 0x80026DE8 0x8002A1E8 0x8002D5E8 0x800309E8 0x80033DE8 0x800371E8 /end VAR_ADDRESS
 /end VAR_CHARACTERISTIC
 /begin VAR_CHARACTERISTIC TP_U8_DPDutyCompRef_HighMuSkid BrkCalVariantCriterion
  /begin VAR_ADDRESS 0x80020556 0x80023956 0x80026D56 0x8002A156 0x8002D556 0x80030956 0x80033D56 0x80037156 /end VAR_ADDRESS
 /end VAR_CHARACTERISTIC
 /begin VAR_CHARACTERISTIC TP_U8_DPDutyCompRef_HighMuSkidR BrkCalVariantCriterion
  /begin VAR_ADDRESS 0x80020557 0x80023957 0x80026D57 0x8002A157 0x8002D557 0x80030957 0x80033D57 0x80037157 /end VAR_ADDRESS
 /end VAR_CHARACTERISTIC
 /begin VAR_CHARACTERISTIC TP_U8_DPDutyCompRef_MPVariation BrkCalVariantCriterion
  /begin VAR_ADDRESS 0x80020558 0x80023958 0x80026D58 0x8002A158 0x8002D558 0x80030958 0x80033D58 0x80037158 /end VAR_ADDRESS
 /end VAR_CHARACTERISTIC
 /begin VAR_CHARACTERISTIC TP_U8_DPDutyCompRef_MPVariationR BrkCalVariantCriterion
  /begin VAR_ADDRESS 0x80020559 0x80023959 0x80026D59 0x8002A159 0x8002D559 0x80030959 0x80033D59 0x80037159 /end VAR_ADDRESS
 /end VAR_CHARACTERISTIC
 /begin VAR_CHARACTERISTIC TP_U8_DPDutyCompRef_PDiffFromSkid BrkCalVariantCriterion
  /begin VAR_ADDRESS 0x8002055A 0x8002395A 0x80026D5A 0x8002A15A 0x8002D55A 0x8003095A 0x80033D5A 0x8003715A /end VAR_ADDRESS
 /end VAR_CHARACTERISTIC
 /begin VAR_CHARACTERISTIC TP_U8_DPDutyCompRef_PDiffFromSkidR BrkCalVariantCriterion
  /begin VAR_ADDRESS 0x8002055B 0x8002395B 0x80026D5B 0x8002A15B 0x8002D55B 0x8003095B 0x80033D5B 0x8003715B /end VAR_ADDRESS
 /end VAR_CHARACTERISTIC
 /begin VAR_CHARACTERISTIC TP_U8_DUMP_CNT_FOR_CLEAR_GMA_L1 BrkCalVariantCriterion
  /begin VAR_ADDRESS 0x800202AA 0x800236AA 0x80026AAA 0x80029EAA 0x8002D2AA 0x800306AA 0x80033AAA 0x80036EAA /end VAR_ADDRESS
 /end VAR_CHARACTERISTIC
 /begin VAR_CHARACTERISTIC TP_U8_DUTY_DIFF_FOR_FORCED_HOLD BrkCalVariantCriterion
  /begin VAR_ADDRESS 0x80020610 0x80023A10 0x80026E10 0x8002A210 0x8002D610 0x80030A10 0x80033E10 0x80037210 /end VAR_ADDRESS
 /end VAR_CHARACTERISTIC
 /begin VAR_CHARACTERISTIC TP_U8_DV_BASE_HIGH_FOR_F_OUT_ABS BrkCalVariantCriterion
  /begin VAR_ADDRESS 0x8002056A 0x8002396A 0x80026D6A 0x8002A16A 0x8002D56A 0x8003096A 0x80033D6A 0x8003716A /end VAR_ADDRESS
 /end VAR_CHARACTERISTIC
 /begin VAR_CHARACTERISTIC TP_U8_DV_BASE_HIGH_FOR_R_OUT_ABS BrkCalVariantCriterion
  /begin VAR_ADDRESS 0x8002056B 0x8002396B 0x80026D6B 0x8002A16B 0x8002D56B 0x8003096B 0x80033D6B 0x8003716B /end VAR_ADDRESS
 /end VAR_CHARACTERISTIC
 /begin VAR_CHARACTERISTIC TP_U8_DV_BASE_LOW_FOR_F_OUT_ABS BrkCalVariantCriterion
  /begin VAR_ADDRESS 0x8002056C 0x8002396C 0x80026D6C 0x8002A16C 0x8002D56C 0x8003096C 0x80033D6C 0x8003716C /end VAR_ADDRESS
 /end VAR_CHARACTERISTIC
 /begin VAR_CHARACTERISTIC TP_U8_DV_BASE_LOW_FOR_GMA BrkCalVariantCriterion
  /begin VAR_ADDRESS 0x8002056D 0x8002396D 0x80026D6D 0x8002A16D 0x8002D56D 0x8003096D 0x80033D6D 0x8003716D /end VAR_ADDRESS
 /end VAR_CHARACTERISTIC
 /begin VAR_CHARACTERISTIC TP_U8_DV_BASE_LOW_FOR_R_OUT_ABS BrkCalVariantCriterion
  /begin VAR_ADDRESS 0x8002056E 0x8002396E 0x80026D6E 0x8002A16E 0x8002D56E 0x8003096E 0x80033D6E 0x8003716E /end VAR_ADDRESS
 /end VAR_CHARACTERISTIC
 /begin VAR_CHARACTERISTIC TP_U8_DV_BASE_LOW_F_OUT_ABS_B40KPH BrkCalVariantCriterion
  /begin VAR_ADDRESS 0x8002056F 0x8002396F 0x80026D6F 0x8002A16F 0x8002D56F 0x8003096F 0x80033D6F 0x8003716F /end VAR_ADDRESS
 /end VAR_CHARACTERISTIC
 /begin VAR_CHARACTERISTIC TP_U8_DV_BASE_PRO_FOR_GMA_WL BrkCalVariantCriterion
  /begin VAR_ADDRESS 0x80020283 0x80023683 0x80026A83 0x80029E83 0x8002D283 0x80030683 0x80033A83 0x80036E83 /end VAR_ADDRESS
 /end VAR_CHARACTERISTIC
 /begin VAR_CHARACTERISTIC TP_U8_D_GAIN_DEC_FACTOR_IN_RR EngCalVariantCriterion
  /begin VAR_ADDRESS 0x8003A124 0x8003AF24 0x8003BD24 0x8003CB24 0x8003D924 0x8003E724 0x8003F524 0x80040324 0x80041124 0x80041F24 0x80042D24 0x80043B24 0x80044924 0x80045724 0x80046524 0x80047324 0x80048124 0x80048F24 0x80049D24 0x8004AB24 0x8004B924 0x8004C724 0x8004D524 0x8004E324 /end VAR_ADDRESS
 /end VAR_CHARACTERISTIC
 /begin VAR_CHARACTERISTIC TP_U8_EBD_Cut_Slip_100_150kph BrkCalVariantCriterion
  /begin VAR_ADDRESS 0x80020683 0x80023A83 0x80026E83 0x8002A283 0x8002D683 0x80030A83 0x80033E83 0x80037283 /end VAR_ADDRESS
 /end VAR_CHARACTERISTIC
 /begin VAR_CHARACTERISTIC TP_U8_EBD_Cut_Slip_20_40kph BrkCalVariantCriterion
  /begin VAR_ADDRESS 0x80020684 0x80023A84 0x80026E84 0x8002A284 0x8002D684 0x80030A84 0x80033E84 0x80037284 /end VAR_ADDRESS
 /end VAR_CHARACTERISTIC
 /begin VAR_CHARACTERISTIC TP_U8_EBD_Cut_Slip_40_60kph BrkCalVariantCriterion
  /begin VAR_ADDRESS 0x80020685 0x80023A85 0x80026E85 0x8002A285 0x8002D685 0x80030A85 0x80033E85 0x80037285 /end VAR_ADDRESS
 /end VAR_CHARACTERISTIC
 /begin VAR_CHARACTERISTIC TP_U8_EBD_Cut_Slip_60_100kph BrkCalVariantCriterion
  /begin VAR_ADDRESS 0x80020686 0x80023A86 0x80026E86 0x8002A286 0x8002D686 0x80030A86 0x80033E86 0x80037286 /end VAR_ADDRESS
 /end VAR_CHARACTERISTIC
 /begin VAR_CHARACTERISTIC TP_U8_EBD_Cut_Slip_Ab_150kph BrkCalVariantCriterion
  /begin VAR_ADDRESS 0x80020687 0x80023A87 0x80026E87 0x8002A287 0x8002D687 0x80030A87 0x80033E87 0x80037287 /end VAR_ADDRESS
 /end VAR_CHARACTERISTIC
 /begin VAR_CHARACTERISTIC TP_U8_EBD_Cut_Slip_B_20kph BrkCalVariantCriterion
  /begin VAR_ADDRESS 0x80020688 0x80023A88 0x80026E88 0x8002A288 0x8002D688 0x80030A88 0x80033E88 0x80037288 /end VAR_ADDRESS
 /end VAR_CHARACTERISTIC
 /begin VAR_CHARACTERISTIC TP_U8_EBD_HOLD_TIMER BrkCalVariantCriterion
  /begin VAR_ADDRESS 0x80020675 0x80023A75 0x80026E75 0x8002A275 0x8002D675 0x80030A75 0x80033E75 0x80037275 /end VAR_ADDRESS
 /end VAR_CHARACTERISTIC
 /begin VAR_CHARACTERISTIC TP_U8_EBD_STANDSTILL_HOLD_TIME BrkCalVariantCriterion
  /begin VAR_ADDRESS 0x80020676 0x80023A76 0x80026E76 0x8002A276 0x8002D676 0x80030A76 0x80033E76 0x80037276 /end VAR_ADDRESS
 /end VAR_CHARACTERISTIC
 /begin VAR_CHARACTERISTIC TP_U8_EDC_CONTROL_TIME_MAX EngCalVariantCriterion
  /begin VAR_ADDRESS 0x8003A148 0x8003AF48 0x8003BD48 0x8003CB48 0x8003D948 0x8003E748 0x8003F548 0x80040348 0x80041148 0x80041F48 0x80042D48 0x80043B48 0x80044948 0x80045748 0x80046548 0x80047348 0x80048148 0x80048F48 0x80049D48 0x8004AB48 0x8004B948 0x8004C748 0x8004D548 0x8004E348 /end VAR_ADDRESS
 /end VAR_CHARACTERISTIC
 /begin VAR_CHARACTERISTIC TP_U8_EDC_ENT_THR_DEL_YAW EngCalVariantCriterion
  /begin VAR_ADDRESS 0x8003A096 0x8003AE96 0x8003BC96 0x8003CA96 0x8003D896 0x8003E696 0x8003F496 0x80040296 0x80041096 0x80041E96 0x80042C96 0x80043A96 0x80044896 0x80045696 0x80046496 0x80047296 0x80048096 0x80048E96 0x80049C96 0x8004AA96 0x8004B896 0x8004C696 0x8004D496 0x8004E296 /end VAR_ADDRESS
 /end VAR_CHARACTERISTIC
 /begin VAR_CHARACTERISTIC TP_U8_EDC_GSD_ENABLE_FLG EngCalVariantCriterion
  /begin VAR_ADDRESS 0x8003A16A 0x8003AF6A 0x8003BD6A 0x8003CB6A 0x8003D96A 0x8003E76A 0x8003F56A 0x8004036A 0x8004116A 0x80041F6A 0x80042D6A 0x80043B6A 0x8004496A 0x8004576A 0x8004656A 0x8004736A 0x8004816A 0x80048F6A 0x80049D6A 0x8004AB6A 0x8004B96A 0x8004C76A 0x8004D56A 0x8004E36A /end VAR_ADDRESS
 /end VAR_CHARACTERISTIC
 /begin VAR_CHARACTERISTIC TP_U8_EDC_MTP_THR_FOR_EDC_INHIBIT EngCalVariantCriterion
  /begin VAR_ADDRESS 0x8003A128 0x8003AF28 0x8003BD28 0x8003CB28 0x8003D928 0x8003E728 0x8003F528 0x80040328 0x80041128 0x80041F28 0x80042D28 0x80043B28 0x80044928 0x80045728 0x80046528 0x80047328 0x80048128 0x80048F28 0x80049D28 0x8004AB28 0x8004B928 0x8004C728 0x8004D528 0x8004E328 /end VAR_ADDRESS
 /end VAR_CHARACTERISTIC
 /begin VAR_CHARACTERISTIC TP_U8_EDC_PHASE1_D_GAIN_ABS_S1 EngCalVariantCriterion
  /begin VAR_ADDRESS 0x8003A0E4 0x8003AEE4 0x8003BCE4 0x8003CAE4 0x8003D8E4 0x8003E6E4 0x8003F4E4 0x800402E4 0x800410E4 0x80041EE4 0x80042CE4 0x80043AE4 0x800448E4 0x800456E4 0x800464E4 0x800472E4 0x800480E4 0x80048EE4 0x80049CE4 0x8004AAE4 0x8004B8E4 0x8004C6E4 0x8004D4E4 0x8004E2E4 /end VAR_ADDRESS
 /end VAR_CHARACTERISTIC
 /begin VAR_CHARACTERISTIC TP_U8_EDC_PHASE1_D_GAIN_ABS_S2 EngCalVariantCriterion
  /begin VAR_ADDRESS 0x8003A0E5 0x8003AEE5 0x8003BCE5 0x8003CAE5 0x8003D8E5 0x8003E6E5 0x8003F4E5 0x800402E5 0x800410E5 0x80041EE5 0x80042CE5 0x80043AE5 0x800448E5 0x800456E5 0x800464E5 0x800472E5 0x800480E5 0x80048EE5 0x80049CE5 0x8004AAE5 0x8004B8E5 0x8004C6E5 0x8004D4E5 0x8004E2E5 /end VAR_ADDRESS
 /end VAR_CHARACTERISTIC
 /begin VAR_CHARACTERISTIC TP_U8_EDC_PHASE1_D_GAIN_ABS_S3 EngCalVariantCriterion
  /begin VAR_ADDRESS 0x8003A0E6 0x8003AEE6 0x8003BCE6 0x8003CAE6 0x8003D8E6 0x8003E6E6 0x8003F4E6 0x800402E6 0x800410E6 0x80041EE6 0x80042CE6 0x80043AE6 0x800448E6 0x800456E6 0x800464E6 0x800472E6 0x800480E6 0x80048EE6 0x80049CE6 0x8004AAE6 0x8004B8E6 0x8004C6E6 0x8004D4E6 0x8004E2E6 /end VAR_ADDRESS
 /end VAR_CHARACTERISTIC
 /begin VAR_CHARACTERISTIC TP_U8_EDC_PHASE1_D_GAIN_ABS_S4 EngCalVariantCriterion
  /begin VAR_ADDRESS 0x8003A0E7 0x8003AEE7 0x8003BCE7 0x8003CAE7 0x8003D8E7 0x8003E6E7 0x8003F4E7 0x800402E7 0x800410E7 0x80041EE7 0x80042CE7 0x80043AE7 0x800448E7 0x800456E7 0x800464E7 0x800472E7 0x800480E7 0x80048EE7 0x80049CE7 0x8004AAE7 0x8004B8E7 0x8004C6E7 0x8004D4E7 0x8004E2E7 /end VAR_ADDRESS
 /end VAR_CHARACTERISTIC
 /begin VAR_CHARACTERISTIC TP_U8_EDC_PHASE1_D_GAIN_ESC_S1 EngCalVariantCriterion
  /begin VAR_ADDRESS 0x8003A104 0x8003AF04 0x8003BD04 0x8003CB04 0x8003D904 0x8003E704 0x8003F504 0x80040304 0x80041104 0x80041F04 0x80042D04 0x80043B04 0x80044904 0x80045704 0x80046504 0x80047304 0x80048104 0x80048F04 0x80049D04 0x8004AB04 0x8004B904 0x8004C704 0x8004D504 0x8004E304 /end VAR_ADDRESS
 /end VAR_CHARACTERISTIC
 /begin VAR_CHARACTERISTIC TP_U8_EDC_PHASE1_D_GAIN_ESC_S2 EngCalVariantCriterion
  /begin VAR_ADDRESS 0x8003A105 0x8003AF05 0x8003BD05 0x8003CB05 0x8003D905 0x8003E705 0x8003F505 0x80040305 0x80041105 0x80041F05 0x80042D05 0x80043B05 0x80044905 0x80045705 0x80046505 0x80047305 0x80048105 0x80048F05 0x80049D05 0x8004AB05 0x8004B905 0x8004C705 0x8004D505 0x8004E305 /end VAR_ADDRESS
 /end VAR_CHARACTERISTIC
 /begin VAR_CHARACTERISTIC TP_U8_EDC_PHASE1_D_GAIN_ESC_S3 EngCalVariantCriterion
  /begin VAR_ADDRESS 0x8003A106 0x8003AF06 0x8003BD06 0x8003CB06 0x8003D906 0x8003E706 0x8003F506 0x80040306 0x80041106 0x80041F06 0x80042D06 0x80043B06 0x80044906 0x80045706 0x80046506 0x80047306 0x80048106 0x80048F06 0x80049D06 0x8004AB06 0x8004B906 0x8004C706 0x8004D506 0x8004E306 /end VAR_ADDRESS
 /end VAR_CHARACTERISTIC
 /begin VAR_CHARACTERISTIC TP_U8_EDC_PHASE1_D_GAIN_ESC_S4 EngCalVariantCriterion
  /begin VAR_ADDRESS 0x8003A107 0x8003AF07 0x8003BD07 0x8003CB07 0x8003D907 0x8003E707 0x8003F507 0x80040307 0x80041107 0x80041F07 0x80042D07 0x80043B07 0x80044907 0x80045707 0x80046507 0x80047307 0x80048107 0x80048F07 0x80049D07 0x8004AB07 0x8004B907 0x8004C707 0x8004D507 0x8004E307 /end VAR_ADDRESS
 /end VAR_CHARACTERISTIC
 /begin VAR_CHARACTERISTIC TP_U8_EDC_PHASE1_D_GAIN_S1 EngCalVariantCriterion
  /begin VAR_ADDRESS 0x8003A0C4 0x8003AEC4 0x8003BCC4 0x8003CAC4 0x8003D8C4 0x8003E6C4 0x8003F4C4 0x800402C4 0x800410C4 0x80041EC4 0x80042CC4 0x80043AC4 0x800448C4 0x800456C4 0x800464C4 0x800472C4 0x800480C4 0x80048EC4 0x80049CC4 0x8004AAC4 0x8004B8C4 0x8004C6C4 0x8004D4C4 0x8004E2C4 /end VAR_ADDRESS
 /end VAR_CHARACTERISTIC
 /begin VAR_CHARACTERISTIC TP_U8_EDC_PHASE1_D_GAIN_S2 EngCalVariantCriterion
  /begin VAR_ADDRESS 0x8003A0C5 0x8003AEC5 0x8003BCC5 0x8003CAC5 0x8003D8C5 0x8003E6C5 0x8003F4C5 0x800402C5 0x800410C5 0x80041EC5 0x80042CC5 0x80043AC5 0x800448C5 0x800456C5 0x800464C5 0x800472C5 0x800480C5 0x80048EC5 0x80049CC5 0x8004AAC5 0x8004B8C5 0x8004C6C5 0x8004D4C5 0x8004E2C5 /end VAR_ADDRESS
 /end VAR_CHARACTERISTIC
 /begin VAR_CHARACTERISTIC TP_U8_EDC_PHASE1_D_GAIN_S3 EngCalVariantCriterion
  /begin VAR_ADDRESS 0x8003A0C6 0x8003AEC6 0x8003BCC6 0x8003CAC6 0x8003D8C6 0x8003E6C6 0x8003F4C6 0x800402C6 0x800410C6 0x80041EC6 0x80042CC6 0x80043AC6 0x800448C6 0x800456C6 0x800464C6 0x800472C6 0x800480C6 0x80048EC6 0x80049CC6 0x8004AAC6 0x8004B8C6 0x8004C6C6 0x8004D4C6 0x8004E2C6 /end VAR_ADDRESS
 /end VAR_CHARACTERISTIC
 /begin VAR_CHARACTERISTIC TP_U8_EDC_PHASE1_D_GAIN_S4 EngCalVariantCriterion
  /begin VAR_ADDRESS 0x8003A0C7 0x8003AEC7 0x8003BCC7 0x8003CAC7 0x8003D8C7 0x8003E6C7 0x8003F4C7 0x800402C7 0x800410C7 0x80041EC7 0x80042CC7 0x80043AC7 0x800448C7 0x800456C7 0x800464C7 0x800472C7 0x800480C7 0x80048EC7 0x80049CC7 0x8004AAC7 0x8004B8C7 0x8004C6C7 0x8004D4C7 0x8004E2C7 /end VAR_ADDRESS
 /end VAR_CHARACTERISTIC
 /begin VAR_CHARACTERISTIC TP_U8_EDC_PHASE1_P_GAIN_ABS_S1 EngCalVariantCriterion
  /begin VAR_ADDRESS 0x8003A0E8 0x8003AEE8 0x8003BCE8 0x8003CAE8 0x8003D8E8 0x8003E6E8 0x8003F4E8 0x800402E8 0x800410E8 0x80041EE8 0x80042CE8 0x80043AE8 0x800448E8 0x800456E8 0x800464E8 0x800472E8 0x800480E8 0x80048EE8 0x80049CE8 0x8004AAE8 0x8004B8E8 0x8004C6E8 0x8004D4E8 0x8004E2E8 /end VAR_ADDRESS
 /end VAR_CHARACTERISTIC
 /begin VAR_CHARACTERISTIC TP_U8_EDC_PHASE1_P_GAIN_ABS_S2 EngCalVariantCriterion
  /begin VAR_ADDRESS 0x8003A0E9 0x8003AEE9 0x8003BCE9 0x8003CAE9 0x8003D8E9 0x8003E6E9 0x8003F4E9 0x800402E9 0x800410E9 0x80041EE9 0x80042CE9 0x80043AE9 0x800448E9 0x800456E9 0x800464E9 0x800472E9 0x800480E9 0x80048EE9 0x80049CE9 0x8004AAE9 0x8004B8E9 0x8004C6E9 0x8004D4E9 0x8004E2E9 /end VAR_ADDRESS
 /end VAR_CHARACTERISTIC
 /begin VAR_CHARACTERISTIC TP_U8_EDC_PHASE1_P_GAIN_ABS_S3 EngCalVariantCriterion
  /begin VAR_ADDRESS 0x8003A0EA 0x8003AEEA 0x8003BCEA 0x8003CAEA 0x8003D8EA 0x8003E6EA 0x8003F4EA 0x800402EA 0x800410EA 0x80041EEA 0x80042CEA 0x80043AEA 0x800448EA 0x800456EA 0x800464EA 0x800472EA 0x800480EA 0x80048EEA 0x80049CEA 0x8004AAEA 0x8004B8EA 0x8004C6EA 0x8004D4EA 0x8004E2EA /end VAR_ADDRESS
 /end VAR_CHARACTERISTIC
 /begin VAR_CHARACTERISTIC TP_U8_EDC_PHASE1_P_GAIN_ABS_S4 EngCalVariantCriterion
  /begin VAR_ADDRESS 0x8003A0EB 0x8003AEEB 0x8003BCEB 0x8003CAEB 0x8003D8EB 0x8003E6EB 0x8003F4EB 0x800402EB 0x800410EB 0x80041EEB 0x80042CEB 0x80043AEB 0x800448EB 0x800456EB 0x800464EB 0x800472EB 0x800480EB 0x80048EEB 0x80049CEB 0x8004AAEB 0x8004B8EB 0x8004C6EB 0x8004D4EB 0x8004E2EB /end VAR_ADDRESS
 /end VAR_CHARACTERISTIC
 /begin VAR_CHARACTERISTIC TP_U8_EDC_PHASE1_P_GAIN_ESC_S1 EngCalVariantCriterion
  /begin VAR_ADDRESS 0x8003A108 0x8003AF08 0x8003BD08 0x8003CB08 0x8003D908 0x8003E708 0x8003F508 0x80040308 0x80041108 0x80041F08 0x80042D08 0x80043B08 0x80044908 0x80045708 0x80046508 0x80047308 0x80048108 0x80048F08 0x80049D08 0x8004AB08 0x8004B908 0x8004C708 0x8004D508 0x8004E308 /end VAR_ADDRESS
 /end VAR_CHARACTERISTIC
 /begin VAR_CHARACTERISTIC TP_U8_EDC_PHASE1_P_GAIN_ESC_S2 EngCalVariantCriterion
  /begin VAR_ADDRESS 0x8003A109 0x8003AF09 0x8003BD09 0x8003CB09 0x8003D909 0x8003E709 0x8003F509 0x80040309 0x80041109 0x80041F09 0x80042D09 0x80043B09 0x80044909 0x80045709 0x80046509 0x80047309 0x80048109 0x80048F09 0x80049D09 0x8004AB09 0x8004B909 0x8004C709 0x8004D509 0x8004E309 /end VAR_ADDRESS
 /end VAR_CHARACTERISTIC
 /begin VAR_CHARACTERISTIC TP_U8_EDC_PHASE1_P_GAIN_ESC_S3 EngCalVariantCriterion
  /begin VAR_ADDRESS 0x8003A10A 0x8003AF0A 0x8003BD0A 0x8003CB0A 0x8003D90A 0x8003E70A 0x8003F50A 0x8004030A 0x8004110A 0x80041F0A 0x80042D0A 0x80043B0A 0x8004490A 0x8004570A 0x8004650A 0x8004730A 0x8004810A 0x80048F0A 0x80049D0A 0x8004AB0A 0x8004B90A 0x8004C70A 0x8004D50A 0x8004E30A /end VAR_ADDRESS
 /end VAR_CHARACTERISTIC
 /begin VAR_CHARACTERISTIC TP_U8_EDC_PHASE1_P_GAIN_ESC_S4 EngCalVariantCriterion
  /begin VAR_ADDRESS 0x8003A10B 0x8003AF0B 0x8003BD0B 0x8003CB0B 0x8003D90B 0x8003E70B 0x8003F50B 0x8004030B 0x8004110B 0x80041F0B 0x80042D0B 0x80043B0B 0x8004490B 0x8004570B 0x8004650B 0x8004730B 0x8004810B 0x80048F0B 0x80049D0B 0x8004AB0B 0x8004B90B 0x8004C70B 0x8004D50B 0x8004E30B /end VAR_ADDRESS
 /end VAR_CHARACTERISTIC
 /begin VAR_CHARACTERISTIC TP_U8_EDC_PHASE1_P_GAIN_S1 EngCalVariantCriterion
  /begin VAR_ADDRESS 0x8003A0C8 0x8003AEC8 0x8003BCC8 0x8003CAC8 0x8003D8C8 0x8003E6C8 0x8003F4C8 0x800402C8 0x800410C8 0x80041EC8 0x80042CC8 0x80043AC8 0x800448C8 0x800456C8 0x800464C8 0x800472C8 0x800480C8 0x80048EC8 0x80049CC8 0x8004AAC8 0x8004B8C8 0x8004C6C8 0x8004D4C8 0x8004E2C8 /end VAR_ADDRESS
 /end VAR_CHARACTERISTIC
 /begin VAR_CHARACTERISTIC TP_U8_EDC_PHASE1_P_GAIN_S2 EngCalVariantCriterion
  /begin VAR_ADDRESS 0x8003A0C9 0x8003AEC9 0x8003BCC9 0x8003CAC9 0x8003D8C9 0x8003E6C9 0x8003F4C9 0x800402C9 0x800410C9 0x80041EC9 0x80042CC9 0x80043AC9 0x800448C9 0x800456C9 0x800464C9 0x800472C9 0x800480C9 0x80048EC9 0x80049CC9 0x8004AAC9 0x8004B8C9 0x8004C6C9 0x8004D4C9 0x8004E2C9 /end VAR_ADDRESS
 /end VAR_CHARACTERISTIC
 /begin VAR_CHARACTERISTIC TP_U8_EDC_PHASE1_P_GAIN_S3 EngCalVariantCriterion
  /begin VAR_ADDRESS 0x8003A0CA 0x8003AECA 0x8003BCCA 0x8003CACA 0x8003D8CA 0x8003E6CA 0x8003F4CA 0x800402CA 0x800410CA 0x80041ECA 0x80042CCA 0x80043ACA 0x800448CA 0x800456CA 0x800464CA 0x800472CA 0x800480CA 0x80048ECA 0x80049CCA 0x8004AACA 0x8004B8CA 0x8004C6CA 0x8004D4CA 0x8004E2CA /end VAR_ADDRESS
 /end VAR_CHARACTERISTIC
 /begin VAR_CHARACTERISTIC TP_U8_EDC_PHASE1_P_GAIN_S4 EngCalVariantCriterion
  /begin VAR_ADDRESS 0x8003A0CB 0x8003AECB 0x8003BCCB 0x8003CACB 0x8003D8CB 0x8003E6CB 0x8003F4CB 0x800402CB 0x800410CB 0x80041ECB 0x80042CCB 0x80043ACB 0x800448CB 0x800456CB 0x800464CB 0x800472CB 0x800480CB 0x80048ECB 0x80049CCB 0x8004AACB 0x8004B8CB 0x8004C6CB 0x8004D4CB 0x8004E2CB /end VAR_ADDRESS
 /end VAR_CHARACTERISTIC
 /begin VAR_CHARACTERISTIC TP_U8_EDC_PHASE2_D_GAIN_ABS_S1 EngCalVariantCriterion
  /begin VAR_ADDRESS 0x8003A0EC 0x8003AEEC 0x8003BCEC 0x8003CAEC 0x8003D8EC 0x8003E6EC 0x8003F4EC 0x800402EC 0x800410EC 0x80041EEC 0x80042CEC 0x80043AEC 0x800448EC 0x800456EC 0x800464EC 0x800472EC 0x800480EC 0x80048EEC 0x80049CEC 0x8004AAEC 0x8004B8EC 0x8004C6EC 0x8004D4EC 0x8004E2EC /end VAR_ADDRESS
 /end VAR_CHARACTERISTIC
 /begin VAR_CHARACTERISTIC TP_U8_EDC_PHASE2_D_GAIN_ABS_S2 EngCalVariantCriterion
  /begin VAR_ADDRESS 0x8003A0ED 0x8003AEED 0x8003BCED 0x8003CAED 0x8003D8ED 0x8003E6ED 0x8003F4ED 0x800402ED 0x800410ED 0x80041EED 0x80042CED 0x80043AED 0x800448ED 0x800456ED 0x800464ED 0x800472ED 0x800480ED 0x80048EED 0x80049CED 0x8004AAED 0x8004B8ED 0x8004C6ED 0x8004D4ED 0x8004E2ED /end VAR_ADDRESS
 /end VAR_CHARACTERISTIC
 /begin VAR_CHARACTERISTIC TP_U8_EDC_PHASE2_D_GAIN_ABS_S3 EngCalVariantCriterion
  /begin VAR_ADDRESS 0x8003A0EE 0x8003AEEE 0x8003BCEE 0x8003CAEE 0x8003D8EE 0x8003E6EE 0x8003F4EE 0x800402EE 0x800410EE 0x80041EEE 0x80042CEE 0x80043AEE 0x800448EE 0x800456EE 0x800464EE 0x800472EE 0x800480EE 0x80048EEE 0x80049CEE 0x8004AAEE 0x8004B8EE 0x8004C6EE 0x8004D4EE 0x8004E2EE /end VAR_ADDRESS
 /end VAR_CHARACTERISTIC
 /begin VAR_CHARACTERISTIC TP_U8_EDC_PHASE2_D_GAIN_ABS_S4 EngCalVariantCriterion
  /begin VAR_ADDRESS 0x8003A0EF 0x8003AEEF 0x8003BCEF 0x8003CAEF 0x8003D8EF 0x8003E6EF 0x8003F4EF 0x800402EF 0x800410EF 0x80041EEF 0x80042CEF 0x80043AEF 0x800448EF 0x800456EF 0x800464EF 0x800472EF 0x800480EF 0x80048EEF 0x80049CEF 0x8004AAEF 0x8004B8EF 0x8004C6EF 0x8004D4EF 0x8004E2EF /end VAR_ADDRESS
 /end VAR_CHARACTERISTIC
 /begin VAR_CHARACTERISTIC TP_U8_EDC_PHASE2_D_GAIN_ESC_S1 EngCalVariantCriterion
  /begin VAR_ADDRESS 0x8003A10C 0x8003AF0C 0x8003BD0C 0x8003CB0C 0x8003D90C 0x8003E70C 0x8003F50C 0x8004030C 0x8004110C 0x80041F0C 0x80042D0C 0x80043B0C 0x8004490C 0x8004570C 0x8004650C 0x8004730C 0x8004810C 0x80048F0C 0x80049D0C 0x8004AB0C 0x8004B90C 0x8004C70C 0x8004D50C 0x8004E30C /end VAR_ADDRESS
 /end VAR_CHARACTERISTIC
 /begin VAR_CHARACTERISTIC TP_U8_EDC_PHASE2_D_GAIN_ESC_S2 EngCalVariantCriterion
  /begin VAR_ADDRESS 0x8003A10D 0x8003AF0D 0x8003BD0D 0x8003CB0D 0x8003D90D 0x8003E70D 0x8003F50D 0x8004030D 0x8004110D 0x80041F0D 0x80042D0D 0x80043B0D 0x8004490D 0x8004570D 0x8004650D 0x8004730D 0x8004810D 0x80048F0D 0x80049D0D 0x8004AB0D 0x8004B90D 0x8004C70D 0x8004D50D 0x8004E30D /end VAR_ADDRESS
 /end VAR_CHARACTERISTIC
 /begin VAR_CHARACTERISTIC TP_U8_EDC_PHASE2_D_GAIN_ESC_S3 EngCalVariantCriterion
  /begin VAR_ADDRESS 0x8003A10E 0x8003AF0E 0x8003BD0E 0x8003CB0E 0x8003D90E 0x8003E70E 0x8003F50E 0x8004030E 0x8004110E 0x80041F0E 0x80042D0E 0x80043B0E 0x8004490E 0x8004570E 0x8004650E 0x8004730E 0x8004810E 0x80048F0E 0x80049D0E 0x8004AB0E 0x8004B90E 0x8004C70E 0x8004D50E 0x8004E30E /end VAR_ADDRESS
 /end VAR_CHARACTERISTIC
 /begin VAR_CHARACTERISTIC TP_U8_EDC_PHASE2_D_GAIN_ESC_S4 EngCalVariantCriterion
  /begin VAR_ADDRESS 0x8003A10F 0x8003AF0F 0x8003BD0F 0x8003CB0F 0x8003D90F 0x8003E70F 0x8003F50F 0x8004030F 0x8004110F 0x80041F0F 0x80042D0F 0x80043B0F 0x8004490F 0x8004570F 0x8004650F 0x8004730F 0x8004810F 0x80048F0F 0x80049D0F 0x8004AB0F 0x8004B90F 0x8004C70F 0x8004D50F 0x8004E30F /end VAR_ADDRESS
 /end VAR_CHARACTERISTIC
 /begin VAR_CHARACTERISTIC TP_U8_EDC_PHASE2_D_GAIN_S1 EngCalVariantCriterion
  /begin VAR_ADDRESS 0x8003A0CC 0x8003AECC 0x8003BCCC 0x8003CACC 0x8003D8CC 0x8003E6CC 0x8003F4CC 0x800402CC 0x800410CC 0x80041ECC 0x80042CCC 0x80043ACC 0x800448CC 0x800456CC 0x800464CC 0x800472CC 0x800480CC 0x80048ECC 0x80049CCC 0x8004AACC 0x8004B8CC 0x8004C6CC 0x8004D4CC 0x8004E2CC /end VAR_ADDRESS
 /end VAR_CHARACTERISTIC
 /begin VAR_CHARACTERISTIC TP_U8_EDC_PHASE2_D_GAIN_S2 EngCalVariantCriterion
  /begin VAR_ADDRESS 0x8003A0CD 0x8003AECD 0x8003BCCD 0x8003CACD 0x8003D8CD 0x8003E6CD 0x8003F4CD 0x800402CD 0x800410CD 0x80041ECD 0x80042CCD 0x80043ACD 0x800448CD 0x800456CD 0x800464CD 0x800472CD 0x800480CD 0x80048ECD 0x80049CCD 0x8004AACD 0x8004B8CD 0x8004C6CD 0x8004D4CD 0x8004E2CD /end VAR_ADDRESS
 /end VAR_CHARACTERISTIC
 /begin VAR_CHARACTERISTIC TP_U8_EDC_PHASE2_D_GAIN_S3 EngCalVariantCriterion
  /begin VAR_ADDRESS 0x8003A0CE 0x8003AECE 0x8003BCCE 0x8003CACE 0x8003D8CE 0x8003E6CE 0x8003F4CE 0x800402CE 0x800410CE 0x80041ECE 0x80042CCE 0x80043ACE 0x800448CE 0x800456CE 0x800464CE 0x800472CE 0x800480CE 0x80048ECE 0x80049CCE 0x8004AACE 0x8004B8CE 0x8004C6CE 0x8004D4CE 0x8004E2CE /end VAR_ADDRESS
 /end VAR_CHARACTERISTIC
 /begin VAR_CHARACTERISTIC TP_U8_EDC_PHASE2_D_GAIN_S4 EngCalVariantCriterion
  /begin VAR_ADDRESS 0x8003A0CF 0x8003AECF 0x8003BCCF 0x8003CACF 0x8003D8CF 0x8003E6CF 0x8003F4CF 0x800402CF 0x800410CF 0x80041ECF 0x80042CCF 0x80043ACF 0x800448CF 0x800456CF 0x800464CF 0x800472CF 0x800480CF 0x80048ECF 0x80049CCF 0x8004AACF 0x8004B8CF 0x8004C6CF 0x8004D4CF 0x8004E2CF /end VAR_ADDRESS
 /end VAR_CHARACTERISTIC
 /begin VAR_CHARACTERISTIC TP_U8_EDC_PHASE2_P_GAIN_ABS_S1 EngCalVariantCriterion
  /begin VAR_ADDRESS 0x8003A0F0 0x8003AEF0 0x8003BCF0 0x8003CAF0 0x8003D8F0 0x8003E6F0 0x8003F4F0 0x800402F0 0x800410F0 0x80041EF0 0x80042CF0 0x80043AF0 0x800448F0 0x800456F0 0x800464F0 0x800472F0 0x800480F0 0x80048EF0 0x80049CF0 0x8004AAF0 0x8004B8F0 0x8004C6F0 0x8004D4F0 0x8004E2F0 /end VAR_ADDRESS
 /end VAR_CHARACTERISTIC
 /begin VAR_CHARACTERISTIC TP_U8_EDC_PHASE2_P_GAIN_ABS_S2 EngCalVariantCriterion
  /begin VAR_ADDRESS 0x8003A0F1 0x8003AEF1 0x8003BCF1 0x8003CAF1 0x8003D8F1 0x8003E6F1 0x8003F4F1 0x800402F1 0x800410F1 0x80041EF1 0x80042CF1 0x80043AF1 0x800448F1 0x800456F1 0x800464F1 0x800472F1 0x800480F1 0x80048EF1 0x80049CF1 0x8004AAF1 0x8004B8F1 0x8004C6F1 0x8004D4F1 0x8004E2F1 /end VAR_ADDRESS
 /end VAR_CHARACTERISTIC
 /begin VAR_CHARACTERISTIC TP_U8_EDC_PHASE2_P_GAIN_ABS_S3 EngCalVariantCriterion
  /begin VAR_ADDRESS 0x8003A0F2 0x8003AEF2 0x8003BCF2 0x8003CAF2 0x8003D8F2 0x8003E6F2 0x8003F4F2 0x800402F2 0x800410F2 0x80041EF2 0x80042CF2 0x80043AF2 0x800448F2 0x800456F2 0x800464F2 0x800472F2 0x800480F2 0x80048EF2 0x80049CF2 0x8004AAF2 0x8004B8F2 0x8004C6F2 0x8004D4F2 0x8004E2F2 /end VAR_ADDRESS
 /end VAR_CHARACTERISTIC
 /begin VAR_CHARACTERISTIC TP_U8_EDC_PHASE2_P_GAIN_ABS_S4 EngCalVariantCriterion
  /begin VAR_ADDRESS 0x8003A0F3 0x8003AEF3 0x8003BCF3 0x8003CAF3 0x8003D8F3 0x8003E6F3 0x8003F4F3 0x800402F3 0x800410F3 0x80041EF3 0x80042CF3 0x80043AF3 0x800448F3 0x800456F3 0x800464F3 0x800472F3 0x800480F3 0x80048EF3 0x80049CF3 0x8004AAF3 0x8004B8F3 0x8004C6F3 0x8004D4F3 0x8004E2F3 /end VAR_ADDRESS
 /end VAR_CHARACTERISTIC
 /begin VAR_CHARACTERISTIC TP_U8_EDC_PHASE2_P_GAIN_ESC_S1 EngCalVariantCriterion
  /begin VAR_ADDRESS 0x8003A110 0x8003AF10 0x8003BD10 0x8003CB10 0x8003D910 0x8003E710 0x8003F510 0x80040310 0x80041110 0x80041F10 0x80042D10 0x80043B10 0x80044910 0x80045710 0x80046510 0x80047310 0x80048110 0x80048F10 0x80049D10 0x8004AB10 0x8004B910 0x8004C710 0x8004D510 0x8004E310 /end VAR_ADDRESS
 /end VAR_CHARACTERISTIC
 /begin VAR_CHARACTERISTIC TP_U8_EDC_PHASE2_P_GAIN_ESC_S2 EngCalVariantCriterion
  /begin VAR_ADDRESS 0x8003A111 0x8003AF11 0x8003BD11 0x8003CB11 0x8003D911 0x8003E711 0x8003F511 0x80040311 0x80041111 0x80041F11 0x80042D11 0x80043B11 0x80044911 0x80045711 0x80046511 0x80047311 0x80048111 0x80048F11 0x80049D11 0x8004AB11 0x8004B911 0x8004C711 0x8004D511 0x8004E311 /end VAR_ADDRESS
 /end VAR_CHARACTERISTIC
 /begin VAR_CHARACTERISTIC TP_U8_EDC_PHASE2_P_GAIN_ESC_S3 EngCalVariantCriterion
  /begin VAR_ADDRESS 0x8003A112 0x8003AF12 0x8003BD12 0x8003CB12 0x8003D912 0x8003E712 0x8003F512 0x80040312 0x80041112 0x80041F12 0x80042D12 0x80043B12 0x80044912 0x80045712 0x80046512 0x80047312 0x80048112 0x80048F12 0x80049D12 0x8004AB12 0x8004B912 0x8004C712 0x8004D512 0x8004E312 /end VAR_ADDRESS
 /end VAR_CHARACTERISTIC
 /begin VAR_CHARACTERISTIC TP_U8_EDC_PHASE2_P_GAIN_ESC_S4 EngCalVariantCriterion
  /begin VAR_ADDRESS 0x8003A113 0x8003AF13 0x8003BD13 0x8003CB13 0x8003D913 0x8003E713 0x8003F513 0x80040313 0x80041113 0x80041F13 0x80042D13 0x80043B13 0x80044913 0x80045713 0x80046513 0x80047313 0x80048113 0x80048F13 0x80049D13 0x8004AB13 0x8004B913 0x8004C713 0x8004D513 0x8004E313 /end VAR_ADDRESS
 /end VAR_CHARACTERISTIC
 /begin VAR_CHARACTERISTIC TP_U8_EDC_PHASE2_P_GAIN_S1 EngCalVariantCriterion
  /begin VAR_ADDRESS 0x8003A0D0 0x8003AED0 0x8003BCD0 0x8003CAD0 0x8003D8D0 0x8003E6D0 0x8003F4D0 0x800402D0 0x800410D0 0x80041ED0 0x80042CD0 0x80043AD0 0x800448D0 0x800456D0 0x800464D0 0x800472D0 0x800480D0 0x80048ED0 0x80049CD0 0x8004AAD0 0x8004B8D0 0x8004C6D0 0x8004D4D0 0x8004E2D0 /end VAR_ADDRESS
 /end VAR_CHARACTERISTIC
 /begin VAR_CHARACTERISTIC TP_U8_EDC_PHASE2_P_GAIN_S2 EngCalVariantCriterion
  /begin VAR_ADDRESS 0x8003A0D1 0x8003AED1 0x8003BCD1 0x8003CAD1 0x8003D8D1 0x8003E6D1 0x8003F4D1 0x800402D1 0x800410D1 0x80041ED1 0x80042CD1 0x80043AD1 0x800448D1 0x800456D1 0x800464D1 0x800472D1 0x800480D1 0x80048ED1 0x80049CD1 0x8004AAD1 0x8004B8D1 0x8004C6D1 0x8004D4D1 0x8004E2D1 /end VAR_ADDRESS
 /end VAR_CHARACTERISTIC
 /begin VAR_CHARACTERISTIC TP_U8_EDC_PHASE2_P_GAIN_S3 EngCalVariantCriterion
  /begin VAR_ADDRESS 0x8003A0D2 0x8003AED2 0x8003BCD2 0x8003CAD2 0x8003D8D2 0x8003E6D2 0x8003F4D2 0x800402D2 0x800410D2 0x80041ED2 0x80042CD2 0x80043AD2 0x800448D2 0x800456D2 0x800464D2 0x800472D2 0x800480D2 0x80048ED2 0x80049CD2 0x8004AAD2 0x8004B8D2 0x8004C6D2 0x8004D4D2 0x8004E2D2 /end VAR_ADDRESS
 /end VAR_CHARACTERISTIC
 /begin VAR_CHARACTERISTIC TP_U8_EDC_PHASE2_P_GAIN_S4 EngCalVariantCriterion
  /begin VAR_ADDRESS 0x8003A0D3 0x8003AED3 0x8003BCD3 0x8003CAD3 0x8003D8D3 0x8003E6D3 0x8003F4D3 0x800402D3 0x800410D3 0x80041ED3 0x80042CD3 0x80043AD3 0x800448D3 0x800456D3 0x800464D3 0x800472D3 0x800480D3 0x80048ED3 0x80049CD3 0x8004AAD3 0x8004B8D3 0x8004C6D3 0x8004D4D3 0x8004E2D3 /end VAR_ADDRESS
 /end VAR_CHARACTERISTIC
 /begin VAR_CHARACTERISTIC TP_U8_EDC_PHASE3_D_GAIN_ABS_S1 EngCalVariantCriterion
  /begin VAR_ADDRESS 0x8003A0F4 0x8003AEF4 0x8003BCF4 0x8003CAF4 0x8003D8F4 0x8003E6F4 0x8003F4F4 0x800402F4 0x800410F4 0x80041EF4 0x80042CF4 0x80043AF4 0x800448F4 0x800456F4 0x800464F4 0x800472F4 0x800480F4 0x80048EF4 0x80049CF4 0x8004AAF4 0x8004B8F4 0x8004C6F4 0x8004D4F4 0x8004E2F4 /end VAR_ADDRESS
 /end VAR_CHARACTERISTIC
 /begin VAR_CHARACTERISTIC TP_U8_EDC_PHASE3_D_GAIN_ABS_S2 EngCalVariantCriterion
  /begin VAR_ADDRESS 0x8003A0F5 0x8003AEF5 0x8003BCF5 0x8003CAF5 0x8003D8F5 0x8003E6F5 0x8003F4F5 0x800402F5 0x800410F5 0x80041EF5 0x80042CF5 0x80043AF5 0x800448F5 0x800456F5 0x800464F5 0x800472F5 0x800480F5 0x80048EF5 0x80049CF5 0x8004AAF5 0x8004B8F5 0x8004C6F5 0x8004D4F5 0x8004E2F5 /end VAR_ADDRESS
 /end VAR_CHARACTERISTIC
 /begin VAR_CHARACTERISTIC TP_U8_EDC_PHASE3_D_GAIN_ABS_S3 EngCalVariantCriterion
  /begin VAR_ADDRESS 0x8003A0F6 0x8003AEF6 0x8003BCF6 0x8003CAF6 0x8003D8F6 0x8003E6F6 0x8003F4F6 0x800402F6 0x800410F6 0x80041EF6 0x80042CF6 0x80043AF6 0x800448F6 0x800456F6 0x800464F6 0x800472F6 0x800480F6 0x80048EF6 0x80049CF6 0x8004AAF6 0x8004B8F6 0x8004C6F6 0x8004D4F6 0x8004E2F6 /end VAR_ADDRESS
 /end VAR_CHARACTERISTIC
 /begin VAR_CHARACTERISTIC TP_U8_EDC_PHASE3_D_GAIN_ABS_S4 EngCalVariantCriterion
  /begin VAR_ADDRESS 0x8003A0F7 0x8003AEF7 0x8003BCF7 0x8003CAF7 0x8003D8F7 0x8003E6F7 0x8003F4F7 0x800402F7 0x800410F7 0x80041EF7 0x80042CF7 0x80043AF7 0x800448F7 0x800456F7 0x800464F7 0x800472F7 0x800480F7 0x80048EF7 0x80049CF7 0x8004AAF7 0x8004B8F7 0x8004C6F7 0x8004D4F7 0x8004E2F7 /end VAR_ADDRESS
 /end VAR_CHARACTERISTIC
 /begin VAR_CHARACTERISTIC TP_U8_EDC_PHASE3_D_GAIN_ESC_S1 EngCalVariantCriterion
  /begin VAR_ADDRESS 0x8003A114 0x8003AF14 0x8003BD14 0x8003CB14 0x8003D914 0x8003E714 0x8003F514 0x80040314 0x80041114 0x80041F14 0x80042D14 0x80043B14 0x80044914 0x80045714 0x80046514 0x80047314 0x80048114 0x80048F14 0x80049D14 0x8004AB14 0x8004B914 0x8004C714 0x8004D514 0x8004E314 /end VAR_ADDRESS
 /end VAR_CHARACTERISTIC
 /begin VAR_CHARACTERISTIC TP_U8_EDC_PHASE3_D_GAIN_ESC_S2 EngCalVariantCriterion
  /begin VAR_ADDRESS 0x8003A115 0x8003AF15 0x8003BD15 0x8003CB15 0x8003D915 0x8003E715 0x8003F515 0x80040315 0x80041115 0x80041F15 0x80042D15 0x80043B15 0x80044915 0x80045715 0x80046515 0x80047315 0x80048115 0x80048F15 0x80049D15 0x8004AB15 0x8004B915 0x8004C715 0x8004D515 0x8004E315 /end VAR_ADDRESS
 /end VAR_CHARACTERISTIC
 /begin VAR_CHARACTERISTIC TP_U8_EDC_PHASE3_D_GAIN_ESC_S3 EngCalVariantCriterion
  /begin VAR_ADDRESS 0x8003A116 0x8003AF16 0x8003BD16 0x8003CB16 0x8003D916 0x8003E716 0x8003F516 0x80040316 0x80041116 0x80041F16 0x80042D16 0x80043B16 0x80044916 0x80045716 0x80046516 0x80047316 0x80048116 0x80048F16 0x80049D16 0x8004AB16 0x8004B916 0x8004C716 0x8004D516 0x8004E316 /end VAR_ADDRESS
 /end VAR_CHARACTERISTIC
 /begin VAR_CHARACTERISTIC TP_U8_EDC_PHASE3_D_GAIN_ESC_S4 EngCalVariantCriterion
  /begin VAR_ADDRESS 0x8003A117 0x8003AF17 0x8003BD17 0x8003CB17 0x8003D917 0x8003E717 0x8003F517 0x80040317 0x80041117 0x80041F17 0x80042D17 0x80043B17 0x80044917 0x80045717 0x80046517 0x80047317 0x80048117 0x80048F17 0x80049D17 0x8004AB17 0x8004B917 0x8004C717 0x8004D517 0x8004E317 /end VAR_ADDRESS
 /end VAR_CHARACTERISTIC
 /begin VAR_CHARACTERISTIC TP_U8_EDC_PHASE3_D_GAIN_S1 EngCalVariantCriterion
  /begin VAR_ADDRESS 0x8003A0D4 0x8003AED4 0x8003BCD4 0x8003CAD4 0x8003D8D4 0x8003E6D4 0x8003F4D4 0x800402D4 0x800410D4 0x80041ED4 0x80042CD4 0x80043AD4 0x800448D4 0x800456D4 0x800464D4 0x800472D4 0x800480D4 0x80048ED4 0x80049CD4 0x8004AAD4 0x8004B8D4 0x8004C6D4 0x8004D4D4 0x8004E2D4 /end VAR_ADDRESS
 /end VAR_CHARACTERISTIC
 /begin VAR_CHARACTERISTIC TP_U8_EDC_PHASE3_D_GAIN_S2 EngCalVariantCriterion
  /begin VAR_ADDRESS 0x8003A0D5 0x8003AED5 0x8003BCD5 0x8003CAD5 0x8003D8D5 0x8003E6D5 0x8003F4D5 0x800402D5 0x800410D5 0x80041ED5 0x80042CD5 0x80043AD5 0x800448D5 0x800456D5 0x800464D5 0x800472D5 0x800480D5 0x80048ED5 0x80049CD5 0x8004AAD5 0x8004B8D5 0x8004C6D5 0x8004D4D5 0x8004E2D5 /end VAR_ADDRESS
 /end VAR_CHARACTERISTIC
 /begin VAR_CHARACTERISTIC TP_U8_EDC_PHASE3_D_GAIN_S3 EngCalVariantCriterion
  /begin VAR_ADDRESS 0x8003A0D6 0x8003AED6 0x8003BCD6 0x8003CAD6 0x8003D8D6 0x8003E6D6 0x8003F4D6 0x800402D6 0x800410D6 0x80041ED6 0x80042CD6 0x80043AD6 0x800448D6 0x800456D6 0x800464D6 0x800472D6 0x800480D6 0x80048ED6 0x80049CD6 0x8004AAD6 0x8004B8D6 0x8004C6D6 0x8004D4D6 0x8004E2D6 /end VAR_ADDRESS
 /end VAR_CHARACTERISTIC
 /begin VAR_CHARACTERISTIC TP_U8_EDC_PHASE3_D_GAIN_S4 EngCalVariantCriterion
  /begin VAR_ADDRESS 0x8003A0D7 0x8003AED7 0x8003BCD7 0x8003CAD7 0x8003D8D7 0x8003E6D7 0x8003F4D7 0x800402D7 0x800410D7 0x80041ED7 0x80042CD7 0x80043AD7 0x800448D7 0x800456D7 0x800464D7 0x800472D7 0x800480D7 0x80048ED7 0x80049CD7 0x8004AAD7 0x8004B8D7 0x8004C6D7 0x8004D4D7 0x8004E2D7 /end VAR_ADDRESS
 /end VAR_CHARACTERISTIC
 /begin VAR_CHARACTERISTIC TP_U8_EDC_PHASE3_P_GAIN_ABS_S1 EngCalVariantCriterion
  /begin VAR_ADDRESS 0x8003A0F8 0x8003AEF8 0x8003BCF8 0x8003CAF8 0x8003D8F8 0x8003E6F8 0x8003F4F8 0x800402F8 0x800410F8 0x80041EF8 0x80042CF8 0x80043AF8 0x800448F8 0x800456F8 0x800464F8 0x800472F8 0x800480F8 0x80048EF8 0x80049CF8 0x8004AAF8 0x8004B8F8 0x8004C6F8 0x8004D4F8 0x8004E2F8 /end VAR_ADDRESS
 /end VAR_CHARACTERISTIC
 /begin VAR_CHARACTERISTIC TP_U8_EDC_PHASE3_P_GAIN_ABS_S2 EngCalVariantCriterion
  /begin VAR_ADDRESS 0x8003A0F9 0x8003AEF9 0x8003BCF9 0x8003CAF9 0x8003D8F9 0x8003E6F9 0x8003F4F9 0x800402F9 0x800410F9 0x80041EF9 0x80042CF9 0x80043AF9 0x800448F9 0x800456F9 0x800464F9 0x800472F9 0x800480F9 0x80048EF9 0x80049CF9 0x8004AAF9 0x8004B8F9 0x8004C6F9 0x8004D4F9 0x8004E2F9 /end VAR_ADDRESS
 /end VAR_CHARACTERISTIC
 /begin VAR_CHARACTERISTIC TP_U8_EDC_PHASE3_P_GAIN_ABS_S3 EngCalVariantCriterion
  /begin VAR_ADDRESS 0x8003A0FA 0x8003AEFA 0x8003BCFA 0x8003CAFA 0x8003D8FA 0x8003E6FA 0x8003F4FA 0x800402FA 0x800410FA 0x80041EFA 0x80042CFA 0x80043AFA 0x800448FA 0x800456FA 0x800464FA 0x800472FA 0x800480FA 0x80048EFA 0x80049CFA 0x8004AAFA 0x8004B8FA 0x8004C6FA 0x8004D4FA 0x8004E2FA /end VAR_ADDRESS
 /end VAR_CHARACTERISTIC
 /begin VAR_CHARACTERISTIC TP_U8_EDC_PHASE3_P_GAIN_ABS_S4 EngCalVariantCriterion
  /begin VAR_ADDRESS 0x8003A0FB 0x8003AEFB 0x8003BCFB 0x8003CAFB 0x8003D8FB 0x8003E6FB 0x8003F4FB 0x800402FB 0x800410FB 0x80041EFB 0x80042CFB 0x80043AFB 0x800448FB 0x800456FB 0x800464FB 0x800472FB 0x800480FB 0x80048EFB 0x80049CFB 0x8004AAFB 0x8004B8FB 0x8004C6FB 0x8004D4FB 0x8004E2FB /end VAR_ADDRESS
 /end VAR_CHARACTERISTIC
 /begin VAR_CHARACTERISTIC TP_U8_EDC_PHASE3_P_GAIN_ESC_S1 EngCalVariantCriterion
  /begin VAR_ADDRESS 0x8003A118 0x8003AF18 0x8003BD18 0x8003CB18 0x8003D918 0x8003E718 0x8003F518 0x80040318 0x80041118 0x80041F18 0x80042D18 0x80043B18 0x80044918 0x80045718 0x80046518 0x80047318 0x80048118 0x80048F18 0x80049D18 0x8004AB18 0x8004B918 0x8004C718 0x8004D518 0x8004E318 /end VAR_ADDRESS
 /end VAR_CHARACTERISTIC
 /begin VAR_CHARACTERISTIC TP_U8_EDC_PHASE3_P_GAIN_ESC_S2 EngCalVariantCriterion
  /begin VAR_ADDRESS 0x8003A119 0x8003AF19 0x8003BD19 0x8003CB19 0x8003D919 0x8003E719 0x8003F519 0x80040319 0x80041119 0x80041F19 0x80042D19 0x80043B19 0x80044919 0x80045719 0x80046519 0x80047319 0x80048119 0x80048F19 0x80049D19 0x8004AB19 0x8004B919 0x8004C719 0x8004D519 0x8004E319 /end VAR_ADDRESS
 /end VAR_CHARACTERISTIC
 /begin VAR_CHARACTERISTIC TP_U8_EDC_PHASE3_P_GAIN_ESC_S3 EngCalVariantCriterion
  /begin VAR_ADDRESS 0x8003A11A 0x8003AF1A 0x8003BD1A 0x8003CB1A 0x8003D91A 0x8003E71A 0x8003F51A 0x8004031A 0x8004111A 0x80041F1A 0x80042D1A 0x80043B1A 0x8004491A 0x8004571A 0x8004651A 0x8004731A 0x8004811A 0x80048F1A 0x80049D1A 0x8004AB1A 0x8004B91A 0x8004C71A 0x8004D51A 0x8004E31A /end VAR_ADDRESS
 /end VAR_CHARACTERISTIC
 /begin VAR_CHARACTERISTIC TP_U8_EDC_PHASE3_P_GAIN_ESC_S4 EngCalVariantCriterion
  /begin VAR_ADDRESS 0x8003A11B 0x8003AF1B 0x8003BD1B 0x8003CB1B 0x8003D91B 0x8003E71B 0x8003F51B 0x8004031B 0x8004111B 0x80041F1B 0x80042D1B 0x80043B1B 0x8004491B 0x8004571B 0x8004651B 0x8004731B 0x8004811B 0x80048F1B 0x80049D1B 0x8004AB1B 0x8004B91B 0x8004C71B 0x8004D51B 0x8004E31B /end VAR_ADDRESS
 /end VAR_CHARACTERISTIC
 /begin VAR_CHARACTERISTIC TP_U8_EDC_PHASE3_P_GAIN_S1 EngCalVariantCriterion
  /begin VAR_ADDRESS 0x8003A0D8 0x8003AED8 0x8003BCD8 0x8003CAD8 0x8003D8D8 0x8003E6D8 0x8003F4D8 0x800402D8 0x800410D8 0x80041ED8 0x80042CD8 0x80043AD8 0x800448D8 0x800456D8 0x800464D8 0x800472D8 0x800480D8 0x80048ED8 0x80049CD8 0x8004AAD8 0x8004B8D8 0x8004C6D8 0x8004D4D8 0x8004E2D8 /end VAR_ADDRESS
 /end VAR_CHARACTERISTIC
 /begin VAR_CHARACTERISTIC TP_U8_EDC_PHASE3_P_GAIN_S2 EngCalVariantCriterion
  /begin VAR_ADDRESS 0x8003A0D9 0x8003AED9 0x8003BCD9 0x8003CAD9 0x8003D8D9 0x8003E6D9 0x8003F4D9 0x800402D9 0x800410D9 0x80041ED9 0x80042CD9 0x80043AD9 0x800448D9 0x800456D9 0x800464D9 0x800472D9 0x800480D9 0x80048ED9 0x80049CD9 0x8004AAD9 0x8004B8D9 0x8004C6D9 0x8004D4D9 0x8004E2D9 /end VAR_ADDRESS
 /end VAR_CHARACTERISTIC
 /begin VAR_CHARACTERISTIC TP_U8_EDC_PHASE3_P_GAIN_S3 EngCalVariantCriterion
  /begin VAR_ADDRESS 0x8003A0DA 0x8003AEDA 0x8003BCDA 0x8003CADA 0x8003D8DA 0x8003E6DA 0x8003F4DA 0x800402DA 0x800410DA 0x80041EDA 0x80042CDA 0x80043ADA 0x800448DA 0x800456DA 0x800464DA 0x800472DA 0x800480DA 0x80048EDA 0x80049CDA 0x8004AADA 0x8004B8DA 0x8004C6DA 0x8004D4DA 0x8004E2DA /end VAR_ADDRESS
 /end VAR_CHARACTERISTIC
 /begin VAR_CHARACTERISTIC TP_U8_EDC_PHASE3_P_GAIN_S4 EngCalVariantCriterion
  /begin VAR_ADDRESS 0x8003A0DB 0x8003AEDB 0x8003BCDB 0x8003CADB 0x8003D8DB 0x8003E6DB 0x8003F4DB 0x800402DB 0x800410DB 0x80041EDB 0x80042CDB 0x80043ADB 0x800448DB 0x800456DB 0x800464DB 0x800472DB 0x800480DB 0x80048EDB 0x80049CDB 0x8004AADB 0x8004B8DB 0x8004C6DB 0x8004D4DB 0x8004E2DB /end VAR_ADDRESS
 /end VAR_CHARACTERISTIC
 /begin VAR_CHARACTERISTIC TP_U8_EDC_PHASE4_D_GAIN_ABS_S1 EngCalVariantCriterion
  /begin VAR_ADDRESS 0x8003A0FC 0x8003AEFC 0x8003BCFC 0x8003CAFC 0x8003D8FC 0x8003E6FC 0x8003F4FC 0x800402FC 0x800410FC 0x80041EFC 0x80042CFC 0x80043AFC 0x800448FC 0x800456FC 0x800464FC 0x800472FC 0x800480FC 0x80048EFC 0x80049CFC 0x8004AAFC 0x8004B8FC 0x8004C6FC 0x8004D4FC 0x8004E2FC /end VAR_ADDRESS
 /end VAR_CHARACTERISTIC
 /begin VAR_CHARACTERISTIC TP_U8_EDC_PHASE4_D_GAIN_ABS_S2 EngCalVariantCriterion
  /begin VAR_ADDRESS 0x8003A0FD 0x8003AEFD 0x8003BCFD 0x8003CAFD 0x8003D8FD 0x8003E6FD 0x8003F4FD 0x800402FD 0x800410FD 0x80041EFD 0x80042CFD 0x80043AFD 0x800448FD 0x800456FD 0x800464FD 0x800472FD 0x800480FD 0x80048EFD 0x80049CFD 0x8004AAFD 0x8004B8FD 0x8004C6FD 0x8004D4FD 0x8004E2FD /end VAR_ADDRESS
 /end VAR_CHARACTERISTIC
 /begin VAR_CHARACTERISTIC TP_U8_EDC_PHASE4_D_GAIN_ABS_S3 EngCalVariantCriterion
  /begin VAR_ADDRESS 0x8003A0FE 0x8003AEFE 0x8003BCFE 0x8003CAFE 0x8003D8FE 0x8003E6FE 0x8003F4FE 0x800402FE 0x800410FE 0x80041EFE 0x80042CFE 0x80043AFE 0x800448FE 0x800456FE 0x800464FE 0x800472FE 0x800480FE 0x80048EFE 0x80049CFE 0x8004AAFE 0x8004B8FE 0x8004C6FE 0x8004D4FE 0x8004E2FE /end VAR_ADDRESS
 /end VAR_CHARACTERISTIC
 /begin VAR_CHARACTERISTIC TP_U8_EDC_PHASE4_D_GAIN_ABS_S4 EngCalVariantCriterion
  /begin VAR_ADDRESS 0x8003A0FF 0x8003AEFF 0x8003BCFF 0x8003CAFF 0x8003D8FF 0x8003E6FF 0x8003F4FF 0x800402FF 0x800410FF 0x80041EFF 0x80042CFF 0x80043AFF 0x800448FF 0x800456FF 0x800464FF 0x800472FF 0x800480FF 0x80048EFF 0x80049CFF 0x8004AAFF 0x8004B8FF 0x8004C6FF 0x8004D4FF 0x8004E2FF /end VAR_ADDRESS
 /end VAR_CHARACTERISTIC
 /begin VAR_CHARACTERISTIC TP_U8_EDC_PHASE4_D_GAIN_ESC_S1 EngCalVariantCriterion
  /begin VAR_ADDRESS 0x8003A11C 0x8003AF1C 0x8003BD1C 0x8003CB1C 0x8003D91C 0x8003E71C 0x8003F51C 0x8004031C 0x8004111C 0x80041F1C 0x80042D1C 0x80043B1C 0x8004491C 0x8004571C 0x8004651C 0x8004731C 0x8004811C 0x80048F1C 0x80049D1C 0x8004AB1C 0x8004B91C 0x8004C71C 0x8004D51C 0x8004E31C /end VAR_ADDRESS
 /end VAR_CHARACTERISTIC
 /begin VAR_CHARACTERISTIC TP_U8_EDC_PHASE4_D_GAIN_ESC_S2 EngCalVariantCriterion
  /begin VAR_ADDRESS 0x8003A11D 0x8003AF1D 0x8003BD1D 0x8003CB1D 0x8003D91D 0x8003E71D 0x8003F51D 0x8004031D 0x8004111D 0x80041F1D 0x80042D1D 0x80043B1D 0x8004491D 0x8004571D 0x8004651D 0x8004731D 0x8004811D 0x80048F1D 0x80049D1D 0x8004AB1D 0x8004B91D 0x8004C71D 0x8004D51D 0x8004E31D /end VAR_ADDRESS
 /end VAR_CHARACTERISTIC
 /begin VAR_CHARACTERISTIC TP_U8_EDC_PHASE4_D_GAIN_ESC_S3 EngCalVariantCriterion
  /begin VAR_ADDRESS 0x8003A11E 0x8003AF1E 0x8003BD1E 0x8003CB1E 0x8003D91E 0x8003E71E 0x8003F51E 0x8004031E 0x8004111E 0x80041F1E 0x80042D1E 0x80043B1E 0x8004491E 0x8004571E 0x8004651E 0x8004731E 0x8004811E 0x80048F1E 0x80049D1E 0x8004AB1E 0x8004B91E 0x8004C71E 0x8004D51E 0x8004E31E /end VAR_ADDRESS
 /end VAR_CHARACTERISTIC
 /begin VAR_CHARACTERISTIC TP_U8_EDC_PHASE4_D_GAIN_ESC_S4 EngCalVariantCriterion
  /begin VAR_ADDRESS 0x8003A11F 0x8003AF1F 0x8003BD1F 0x8003CB1F 0x8003D91F 0x8003E71F 0x8003F51F 0x8004031F 0x8004111F 0x80041F1F 0x80042D1F 0x80043B1F 0x8004491F 0x8004571F 0x8004651F 0x8004731F 0x8004811F 0x80048F1F 0x80049D1F 0x8004AB1F 0x8004B91F 0x8004C71F 0x8004D51F 0x8004E31F /end VAR_ADDRESS
 /end VAR_CHARACTERISTIC
 /begin VAR_CHARACTERISTIC TP_U8_EDC_PHASE4_D_GAIN_S1 EngCalVariantCriterion
  /begin VAR_ADDRESS 0x8003A0DC 0x8003AEDC 0x8003BCDC 0x8003CADC 0x8003D8DC 0x8003E6DC 0x8003F4DC 0x800402DC 0x800410DC 0x80041EDC 0x80042CDC 0x80043ADC 0x800448DC 0x800456DC 0x800464DC 0x800472DC 0x800480DC 0x80048EDC 0x80049CDC 0x8004AADC 0x8004B8DC 0x8004C6DC 0x8004D4DC 0x8004E2DC /end VAR_ADDRESS
 /end VAR_CHARACTERISTIC
 /begin VAR_CHARACTERISTIC TP_U8_EDC_PHASE4_D_GAIN_S2 EngCalVariantCriterion
  /begin VAR_ADDRESS 0x8003A0DD 0x8003AEDD 0x8003BCDD 0x8003CADD 0x8003D8DD 0x8003E6DD 0x8003F4DD 0x800402DD 0x800410DD 0x80041EDD 0x80042CDD 0x80043ADD 0x800448DD 0x800456DD 0x800464DD 0x800472DD 0x800480DD 0x80048EDD 0x80049CDD 0x8004AADD 0x8004B8DD 0x8004C6DD 0x8004D4DD 0x8004E2DD /end VAR_ADDRESS
 /end VAR_CHARACTERISTIC
 /begin VAR_CHARACTERISTIC TP_U8_EDC_PHASE4_D_GAIN_S3 EngCalVariantCriterion
  /begin VAR_ADDRESS 0x8003A0DE 0x8003AEDE 0x8003BCDE 0x8003CADE 0x8003D8DE 0x8003E6DE 0x8003F4DE 0x800402DE 0x800410DE 0x80041EDE 0x80042CDE 0x80043ADE 0x800448DE 0x800456DE 0x800464DE 0x800472DE 0x800480DE 0x80048EDE 0x80049CDE 0x8004AADE 0x8004B8DE 0x8004C6DE 0x8004D4DE 0x8004E2DE /end VAR_ADDRESS
 /end VAR_CHARACTERISTIC
 /begin VAR_CHARACTERISTIC TP_U8_EDC_PHASE4_D_GAIN_S4 EngCalVariantCriterion
  /begin VAR_ADDRESS 0x8003A0DF 0x8003AEDF 0x8003BCDF 0x8003CADF 0x8003D8DF 0x8003E6DF 0x8003F4DF 0x800402DF 0x800410DF 0x80041EDF 0x80042CDF 0x80043ADF 0x800448DF 0x800456DF 0x800464DF 0x800472DF 0x800480DF 0x80048EDF 0x80049CDF 0x8004AADF 0x8004B8DF 0x8004C6DF 0x8004D4DF 0x8004E2DF /end VAR_ADDRESS
 /end VAR_CHARACTERISTIC
 /begin VAR_CHARACTERISTIC TP_U8_EDC_PHASE4_P_GAIN_ABS_S1 EngCalVariantCriterion
  /begin VAR_ADDRESS 0x8003A100 0x8003AF00 0x8003BD00 0x8003CB00 0x8003D900 0x8003E700 0x8003F500 0x80040300 0x80041100 0x80041F00 0x80042D00 0x80043B00 0x80044900 0x80045700 0x80046500 0x80047300 0x80048100 0x80048F00 0x80049D00 0x8004AB00 0x8004B900 0x8004C700 0x8004D500 0x8004E300 /end VAR_ADDRESS
 /end VAR_CHARACTERISTIC
 /begin VAR_CHARACTERISTIC TP_U8_EDC_PHASE4_P_GAIN_ABS_S2 EngCalVariantCriterion
  /begin VAR_ADDRESS 0x8003A101 0x8003AF01 0x8003BD01 0x8003CB01 0x8003D901 0x8003E701 0x8003F501 0x80040301 0x80041101 0x80041F01 0x80042D01 0x80043B01 0x80044901 0x80045701 0x80046501 0x80047301 0x80048101 0x80048F01 0x80049D01 0x8004AB01 0x8004B901 0x8004C701 0x8004D501 0x8004E301 /end VAR_ADDRESS
 /end VAR_CHARACTERISTIC
 /begin VAR_CHARACTERISTIC TP_U8_EDC_PHASE4_P_GAIN_ABS_S3 EngCalVariantCriterion
  /begin VAR_ADDRESS 0x8003A102 0x8003AF02 0x8003BD02 0x8003CB02 0x8003D902 0x8003E702 0x8003F502 0x80040302 0x80041102 0x80041F02 0x80042D02 0x80043B02 0x80044902 0x80045702 0x80046502 0x80047302 0x80048102 0x80048F02 0x80049D02 0x8004AB02 0x8004B902 0x8004C702 0x8004D502 0x8004E302 /end VAR_ADDRESS
 /end VAR_CHARACTERISTIC
 /begin VAR_CHARACTERISTIC TP_U8_EDC_PHASE4_P_GAIN_ABS_S4 EngCalVariantCriterion
  /begin VAR_ADDRESS 0x8003A103 0x8003AF03 0x8003BD03 0x8003CB03 0x8003D903 0x8003E703 0x8003F503 0x80040303 0x80041103 0x80041F03 0x80042D03 0x80043B03 0x80044903 0x80045703 0x80046503 0x80047303 0x80048103 0x80048F03 0x80049D03 0x8004AB03 0x8004B903 0x8004C703 0x8004D503 0x8004E303 /end VAR_ADDRESS
 /end VAR_CHARACTERISTIC
 /begin VAR_CHARACTERISTIC TP_U8_EDC_PHASE4_P_GAIN_ESC_S1 EngCalVariantCriterion
  /begin VAR_ADDRESS 0x8003A120 0x8003AF20 0x8003BD20 0x8003CB20 0x8003D920 0x8003E720 0x8003F520 0x80040320 0x80041120 0x80041F20 0x80042D20 0x80043B20 0x80044920 0x80045720 0x80046520 0x80047320 0x80048120 0x80048F20 0x80049D20 0x8004AB20 0x8004B920 0x8004C720 0x8004D520 0x8004E320 /end VAR_ADDRESS
 /end VAR_CHARACTERISTIC
 /begin VAR_CHARACTERISTIC TP_U8_EDC_PHASE4_P_GAIN_ESC_S2 EngCalVariantCriterion
  /begin VAR_ADDRESS 0x8003A121 0x8003AF21 0x8003BD21 0x8003CB21 0x8003D921 0x8003E721 0x8003F521 0x80040321 0x80041121 0x80041F21 0x80042D21 0x80043B21 0x80044921 0x80045721 0x80046521 0x80047321 0x80048121 0x80048F21 0x80049D21 0x8004AB21 0x8004B921 0x8004C721 0x8004D521 0x8004E321 /end VAR_ADDRESS
 /end VAR_CHARACTERISTIC
 /begin VAR_CHARACTERISTIC TP_U8_EDC_PHASE4_P_GAIN_ESC_S3 EngCalVariantCriterion
  /begin VAR_ADDRESS 0x8003A122 0x8003AF22 0x8003BD22 0x8003CB22 0x8003D922 0x8003E722 0x8003F522 0x80040322 0x80041122 0x80041F22 0x80042D22 0x80043B22 0x80044922 0x80045722 0x80046522 0x80047322 0x80048122 0x80048F22 0x80049D22 0x8004AB22 0x8004B922 0x8004C722 0x8004D522 0x8004E322 /end VAR_ADDRESS
 /end VAR_CHARACTERISTIC
 /begin VAR_CHARACTERISTIC TP_U8_EDC_PHASE4_P_GAIN_ESC_S4 EngCalVariantCriterion
  /begin VAR_ADDRESS 0x8003A123 0x8003AF23 0x8003BD23 0x8003CB23 0x8003D923 0x8003E723 0x8003F523 0x80040323 0x80041123 0x80041F23 0x80042D23 0x80043B23 0x80044923 0x80045723 0x80046523 0x80047323 0x80048123 0x80048F23 0x80049D23 0x8004AB23 0x8004B923 0x8004C723 0x8004D523 0x8004E323 /end VAR_ADDRESS
 /end VAR_CHARACTERISTIC
 /begin VAR_CHARACTERISTIC TP_U8_EDC_PHASE4_P_GAIN_S1 EngCalVariantCriterion
  /begin VAR_ADDRESS 0x8003A0E0 0x8003AEE0 0x8003BCE0 0x8003CAE0 0x8003D8E0 0x8003E6E0 0x8003F4E0 0x800402E0 0x800410E0 0x80041EE0 0x80042CE0 0x80043AE0 0x800448E0 0x800456E0 0x800464E0 0x800472E0 0x800480E0 0x80048EE0 0x80049CE0 0x8004AAE0 0x8004B8E0 0x8004C6E0 0x8004D4E0 0x8004E2E0 /end VAR_ADDRESS
 /end VAR_CHARACTERISTIC
 /begin VAR_CHARACTERISTIC TP_U8_EDC_PHASE4_P_GAIN_S2 EngCalVariantCriterion
  /begin VAR_ADDRESS 0x8003A0E1 0x8003AEE1 0x8003BCE1 0x8003CAE1 0x8003D8E1 0x8003E6E1 0x8003F4E1 0x800402E1 0x800410E1 0x80041EE1 0x80042CE1 0x80043AE1 0x800448E1 0x800456E1 0x800464E1 0x800472E1 0x800480E1 0x80048EE1 0x80049CE1 0x8004AAE1 0x8004B8E1 0x8004C6E1 0x8004D4E1 0x8004E2E1 /end VAR_ADDRESS
 /end VAR_CHARACTERISTIC
 /begin VAR_CHARACTERISTIC TP_U8_EDC_PHASE4_P_GAIN_S3 EngCalVariantCriterion
  /begin VAR_ADDRESS 0x8003A0E2 0x8003AEE2 0x8003BCE2 0x8003CAE2 0x8003D8E2 0x8003E6E2 0x8003F4E2 0x800402E2 0x800410E2 0x80041EE2 0x80042CE2 0x80043AE2 0x800448E2 0x800456E2 0x800464E2 0x800472E2 0x800480E2 0x80048EE2 0x80049CE2 0x8004AAE2 0x8004B8E2 0x8004C6E2 0x8004D4E2 0x8004E2E2 /end VAR_ADDRESS
 /end VAR_CHARACTERISTIC
 /begin VAR_CHARACTERISTIC TP_U8_EDC_PHASE4_P_GAIN_S4 EngCalVariantCriterion
  /begin VAR_ADDRESS 0x8003A0E3 0x8003AEE3 0x8003BCE3 0x8003CAE3 0x8003D8E3 0x8003E6E3 0x8003F4E3 0x800402E3 0x800410E3 0x80041EE3 0x80042CE3 0x80043AE3 0x800448E3 0x800456E3 0x800464E3 0x800472E3 0x800480E3 0x80048EE3 0x80049CE3 0x8004AAE3 0x8004B8E3 0x8004C6E3 0x8004D4E3 0x8004E2E3 /end VAR_ADDRESS
 /end VAR_CHARACTERISTIC
 /begin VAR_CHARACTERISTIC TP_U8_EDC_SYS_ENABLE EngCalVariantCriterion
  /begin VAR_ADDRESS 0x8003A080 0x8003AE80 0x8003BC80 0x8003CA80 0x8003D880 0x8003E680 0x8003F480 0x80040280 0x80041080 0x80041E80 0x80042C80 0x80043A80 0x80044880 0x80045680 0x80046480 0x80047280 0x80048080 0x80048E80 0x80049C80 0x8004AA80 0x8004B880 0x8004C680 0x8004D480 0x8004E280 /end VAR_ADDRESS
 /end VAR_CHARACTERISTIC
 /begin VAR_CHARACTERISTIC TP_U8_EDC_TM_1_GEAR_RATIO EngCalVariantCriterion
  /begin VAR_ADDRESS 0x8003A138 0x8003AF38 0x8003BD38 0x8003CB38 0x8003D938 0x8003E738 0x8003F538 0x80040338 0x80041138 0x80041F38 0x80042D38 0x80043B38 0x80044938 0x80045738 0x80046538 0x80047338 0x80048138 0x80048F38 0x80049D38 0x8004AB38 0x8004B938 0x8004C738 0x8004D538 0x8004E338 /end VAR_ADDRESS
 /end VAR_CHARACTERISTIC
 /begin VAR_CHARACTERISTIC TP_U8_EDC_TM_2_GEAR_RATIO EngCalVariantCriterion
  /begin VAR_ADDRESS 0x8003A139 0x8003AF39 0x8003BD39 0x8003CB39 0x8003D939 0x8003E739 0x8003F539 0x80040339 0x80041139 0x80041F39 0x80042D39 0x80043B39 0x80044939 0x80045739 0x80046539 0x80047339 0x80048139 0x80048F39 0x80049D39 0x8004AB39 0x8004B939 0x8004C739 0x8004D539 0x8004E339 /end VAR_ADDRESS
 /end VAR_CHARACTERISTIC
 /begin VAR_CHARACTERISTIC TP_U8_EDC_TM_3_GEAR_RATIO EngCalVariantCriterion
  /begin VAR_ADDRESS 0x8003A13A 0x8003AF3A 0x8003BD3A 0x8003CB3A 0x8003D93A 0x8003E73A 0x8003F53A 0x8004033A 0x8004113A 0x80041F3A 0x80042D3A 0x80043B3A 0x8004493A 0x8004573A 0x8004653A 0x8004733A 0x8004813A 0x80048F3A 0x80049D3A 0x8004AB3A 0x8004B93A 0x8004C73A 0x8004D53A 0x8004E33A /end VAR_ADDRESS
 /end VAR_CHARACTERISTIC
 /begin VAR_CHARACTERISTIC TP_U8_EDC_TM_4_GEAR_RATIO EngCalVariantCriterion
  /begin VAR_ADDRESS 0x8003A13B 0x8003AF3B 0x8003BD3B 0x8003CB3B 0x8003D93B 0x8003E73B 0x8003F53B 0x8004033B 0x8004113B 0x80041F3B 0x80042D3B 0x80043B3B 0x8004493B 0x8004573B 0x8004653B 0x8004733B 0x8004813B 0x80048F3B 0x80049D3B 0x8004AB3B 0x8004B93B 0x8004C73B 0x8004D53B 0x8004E33B /end VAR_ADDRESS
 /end VAR_CHARACTERISTIC
 /begin VAR_CHARACTERISTIC TP_U8_EDC_TM_5_GEAR_RATIO EngCalVariantCriterion
  /begin VAR_ADDRESS 0x8003A13C 0x8003AF3C 0x8003BD3C 0x8003CB3C 0x8003D93C 0x8003E73C 0x8003F53C 0x8004033C 0x8004113C 0x80041F3C 0x80042D3C 0x80043B3C 0x8004493C 0x8004573C 0x8004653C 0x8004733C 0x8004813C 0x80048F3C 0x80049D3C 0x8004AB3C 0x8004B93C 0x8004C73C 0x8004D53C 0x8004E33C /end VAR_ADDRESS
 /end VAR_CHARACTERISTIC
 /begin VAR_CHARACTERISTIC TP_U8_EDC_TM_6_GEAR_RATIO EngCalVariantCriterion
  /begin VAR_ADDRESS 0x8003A13D 0x8003AF3D 0x8003BD3D 0x8003CB3D 0x8003D93D 0x8003E73D 0x8003F53D 0x8004033D 0x8004113D 0x80041F3D 0x80042D3D 0x80043B3D 0x8004493D 0x8004573D 0x8004653D 0x8004733D 0x8004813D 0x80048F3D 0x80049D3D 0x8004AB3D 0x8004B93D 0x8004C73D 0x8004D53D 0x8004E33D /end VAR_ADDRESS
 /end VAR_CHARACTERISTIC
 /begin VAR_CHARACTERISTIC TP_U8_EDC_TM_R_GEAR_RATIO EngCalVariantCriterion
  /begin VAR_ADDRESS 0x8003A13E 0x8003AF3E 0x8003BD3E 0x8003CB3E 0x8003D93E 0x8003E73E 0x8003F53E 0x8004033E 0x8004113E 0x80041F3E 0x80042D3E 0x80043B3E 0x8004493E 0x8004573E 0x8004653E 0x8004733E 0x8004813E 0x80048F3E 0x80049D3E 0x8004AB3E 0x8004B93E 0x8004C73E 0x8004D53E 0x8004E33E /end VAR_ADDRESS
 /end VAR_CHARACTERISTIC
 /begin VAR_CHARACTERISTIC TP_U8_EDC_TORQ_DEC_RATE EngCalVariantCriterion
  /begin VAR_ADDRESS 0x8003A129 0x8003AF29 0x8003BD29 0x8003CB29 0x8003D929 0x8003E729 0x8003F529 0x80040329 0x80041129 0x80041F29 0x80042D29 0x80043B29 0x80044929 0x80045729 0x80046529 0x80047329 0x80048129 0x80048F29 0x80049D29 0x8004AB29 0x8004B929 0x8004C729 0x8004D529 0x8004E329 /end VAR_ADDRESS
 /end VAR_CHARACTERISTIC
 /begin VAR_CHARACTERISTIC TP_U8_EDC_TORQ_DEC_RATE_EXIT_EAO EngCalVariantCriterion
  /begin VAR_ADDRESS 0x8003A12A 0x8003AF2A 0x8003BD2A 0x8003CB2A 0x8003D92A 0x8003E72A 0x8003F52A 0x8004032A 0x8004112A 0x80041F2A 0x80042D2A 0x80043B2A 0x8004492A 0x8004572A 0x8004652A 0x8004732A 0x8004812A 0x80048F2A 0x80049D2A 0x8004AB2A 0x8004B92A 0x8004C72A 0x8004D52A 0x8004E32A /end VAR_ADDRESS
 /end VAR_CHARACTERISTIC
 /begin VAR_CHARACTERISTIC TP_U8_EDC_TORQ_DEC_RATE_EXIT_EEO EngCalVariantCriterion
  /begin VAR_ADDRESS 0x8003A12B 0x8003AF2B 0x8003BD2B 0x8003CB2B 0x8003D92B 0x8003E72B 0x8003F52B 0x8004032B 0x8004112B 0x80041F2B 0x80042D2B 0x80043B2B 0x8004492B 0x8004572B 0x8004652B 0x8004732B 0x8004812B 0x80048F2B 0x80049D2B 0x8004AB2B 0x8004B92B 0x8004C72B 0x8004D52B 0x8004E32B /end VAR_ADDRESS
 /end VAR_CHARACTERISTIC
 /begin VAR_CHARACTERISTIC TP_U8_EDC_TORQ_DEC_RATE_EXIT_ESO EngCalVariantCriterion
  /begin VAR_ADDRESS 0x8003A12C 0x8003AF2C 0x8003BD2C 0x8003CB2C 0x8003D92C 0x8003E72C 0x8003F52C 0x8004032C 0x8004112C 0x80041F2C 0x80042D2C 0x80043B2C 0x8004492C 0x8004572C 0x8004652C 0x8004732C 0x8004812C 0x80048F2C 0x80049D2C 0x8004AB2C 0x8004B92C 0x8004C72C 0x8004D52C 0x8004E32C /end VAR_ADDRESS
 /end VAR_CHARACTERISTIC
 /begin VAR_CHARACTERISTIC TP_U8_EDC_TORQ_DEC_RATE_RPM EngCalVariantCriterion
  /begin VAR_ADDRESS 0x8003A12D 0x8003AF2D 0x8003BD2D 0x8003CB2D 0x8003D92D 0x8003E72D 0x8003F52D 0x8004032D 0x8004112D 0x80041F2D 0x80042D2D 0x80043B2D 0x8004492D 0x8004572D 0x8004652D 0x8004732D 0x8004812D 0x80048F2D 0x80049D2D 0x8004AB2D 0x8004B92D 0x8004C72D 0x8004D52D 0x8004E32D /end VAR_ADDRESS
 /end VAR_CHARACTERISTIC
 /begin VAR_CHARACTERISTIC TP_U8_EDC_TORQ_FAST_DEC_RATE_EXIT EngCalVariantCriterion
  /begin VAR_ADDRESS 0x8003A12E 0x8003AF2E 0x8003BD2E 0x8003CB2E 0x8003D92E 0x8003E72E 0x8003F52E 0x8004032E 0x8004112E 0x80041F2E 0x80042D2E 0x80043B2E 0x8004492E 0x8004572E 0x8004652E 0x8004732E 0x8004812E 0x80048F2E 0x80049D2E 0x8004AB2E 0x8004B92E 0x8004C72E 0x8004D52E 0x8004E32E /end VAR_ADDRESS
 /end VAR_CHARACTERISTIC
 /begin VAR_CHARACTERISTIC TP_U8_EDC_TORQ_SLOW_DEC_RATE_EXIT EngCalVariantCriterion
  /begin VAR_ADDRESS 0x8003A12F 0x8003AF2F 0x8003BD2F 0x8003CB2F 0x8003D92F 0x8003E72F 0x8003F52F 0x8004032F 0x8004112F 0x80041F2F 0x80042D2F 0x80043B2F 0x8004492F 0x8004572F 0x8004652F 0x8004732F 0x8004812F 0x80048F2F 0x80049D2F 0x8004AB2F 0x8004B92F 0x8004C72F 0x8004D52F 0x8004E32F /end VAR_ADDRESS
 /end VAR_CHARACTERISTIC
 /begin VAR_CHARACTERISTIC TP_U8_F_High_side_SL_dump_H_SPEED BrkCalVariantCriterion
  /begin VAR_ADDRESS 0x800205AF 0x800239AF 0x80026DAF 0x8002A1AF 0x8002D5AF 0x800309AF 0x80033DAF 0x800371AF /end VAR_ADDRESS
 /end VAR_CHARACTERISTIC
 /begin VAR_CHARACTERISTIC TP_U8_F_High_side_SL_dump_L_SPEED BrkCalVariantCriterion
  /begin VAR_ADDRESS 0x800205B0 0x800239B0 0x80026DB0 0x8002A1B0 0x8002D5B0 0x800309B0 0x80033DB0 0x800371B0 /end VAR_ADDRESS
 /end VAR_CHARACTERISTIC
 /begin VAR_CHARACTERISTIC TP_U8_F_High_side_SL_dump_M_SPEED BrkCalVariantCriterion
  /begin VAR_ADDRESS 0x800205B1 0x800239B1 0x80026DB1 0x8002A1B1 0x8002D5B1 0x800309B1 0x80033DB1 0x800371B1 /end VAR_ADDRESS
 /end VAR_CHARACTERISTIC
 /begin VAR_CHARACTERISTIC TP_U8_GAIN_DEC_FACTOR_IN_HIGH_MU EngCalVariantCriterion
  /begin VAR_ADDRESS 0x8003A125 0x8003AF25 0x8003BD25 0x8003CB25 0x8003D925 0x8003E725 0x8003F525 0x80040325 0x80041125 0x80041F25 0x80042D25 0x80043B25 0x80044925 0x80045725 0x80046525 0x80047325 0x80048125 0x80048F25 0x80049D25 0x8004AB25 0x8004B925 0x8004C725 0x8004D525 0x8004E325 /end VAR_ADDRESS
 /end VAR_CHARACTERISTIC
 /begin VAR_CHARACTERISTIC TP_U8_GMA_D_F_H_SPEED BrkCalVariantCriterion
  /begin VAR_ADDRESS 0x80020292 0x80023692 0x80026A92 0x80029E92 0x8002D292 0x80030692 0x80033A92 0x80036E92 /end VAR_ADDRESS
 /end VAR_CHARACTERISTIC
 /begin VAR_CHARACTERISTIC TP_U8_GMA_D_F_L_SPEED BrkCalVariantCriterion
  /begin VAR_ADDRESS 0x80020293 0x80023693 0x80026A93 0x80029E93 0x8002D293 0x80030693 0x80033A93 0x80036E93 /end VAR_ADDRESS
 /end VAR_CHARACTERISTIC
 /begin VAR_CHARACTERISTIC TP_U8_GMA_D_F_M_SPEED BrkCalVariantCriterion
  /begin VAR_ADDRESS 0x80020294 0x80023694 0x80026A94 0x80029E94 0x8002D294 0x80030694 0x80033A94 0x80036E94 /end VAR_ADDRESS
 /end VAR_CHARACTERISTIC
 /begin VAR_CHARACTERISTIC TP_U8_GMA_D_R_H_SPEED BrkCalVariantCriterion
  /begin VAR_ADDRESS 0x80020295 0x80023695 0x80026A95 0x80029E95 0x8002D295 0x80030695 0x80033A95 0x80036E95 /end VAR_ADDRESS
 /end VAR_CHARACTERISTIC
 /begin VAR_CHARACTERISTIC TP_U8_GMA_D_R_L_SPEED BrkCalVariantCriterion
  /begin VAR_ADDRESS 0x80020296 0x80023696 0x80026A96 0x80029E96 0x8002D296 0x80030696 0x80033A96 0x80036E96 /end VAR_ADDRESS
 /end VAR_CHARACTERISTIC
 /begin VAR_CHARACTERISTIC TP_U8_GMA_D_R_M_SPEED BrkCalVariantCriterion
  /begin VAR_ADDRESS 0x80020297 0x80023697 0x80026A97 0x80029E97 0x8002D297 0x80030697 0x80033A97 0x80036E97 /end VAR_ADDRESS
 /end VAR_CHARACTERISTIC
 /begin VAR_CHARACTERISTIC TP_U8_GMA_HOLD_Comp_for_HSPEED BrkCalVariantCriterion
  /begin VAR_ADDRESS 0x80020605 0x80023A05 0x80026E05 0x8002A205 0x8002D605 0x80030A05 0x80033E05 0x80037205 /end VAR_ADDRESS
 /end VAR_CHARACTERISTIC
 /begin VAR_CHARACTERISTIC TP_U8_GMA_HOLD_TIME_MAX BrkCalVariantCriterion
  /begin VAR_ADDRESS 0x80020604 0x80023A04 0x80026E04 0x8002A204 0x8002D604 0x80030A04 0x80033E04 0x80037204 /end VAR_ADDRESS
 /end VAR_CHARACTERISTIC
 /begin VAR_CHARACTERISTIC TP_U8_GMA_LFC_INIT_DUTY BrkCalVariantCriterion
  /begin VAR_ADDRESS 0x800202AB 0x800236AB 0x80026AAB 0x80029EAB 0x8002D2AB 0x800306AB 0x80033AAB 0x80036EAB /end VAR_ADDRESS
 /end VAR_CHARACTERISTIC
 /begin VAR_CHARACTERISTIC TP_U8_GMA_LFC_MP_COMP_DUTY BrkCalVariantCriterion
  /begin VAR_ADDRESS 0x800202AC 0x800236AC 0x80026AAC 0x80029EAC 0x8002D2AC 0x800306AC 0x80033AAC 0x80036EAC /end VAR_ADDRESS
 /end VAR_CHARACTERISTIC
 /begin VAR_CHARACTERISTIC TP_U8_GMA_LFC_PULSE_UP_TIME BrkCalVariantCriterion
  /begin VAR_ADDRESS 0x800202AD 0x800236AD 0x80026AAD 0x80029EAD 0x8002D2AD 0x800306AD 0x80033AAD 0x80036EAD /end VAR_ADDRESS
 /end VAR_CHARACTERISTIC
 /begin VAR_CHARACTERISTIC TP_U8_GMA_WL_DV_SET_COUNTER_REF BrkCalVariantCriterion
  /begin VAR_ADDRESS 0x80020284 0x80023684 0x80026A84 0x80029E84 0x8002D284 0x80030684 0x80033A84 0x80036E84 /end VAR_ADDRESS
 /end VAR_CHARACTERISTIC
 /begin VAR_CHARACTERISTIC TP_U8_H2SPLIT_SLIP_DIFF BrkCalVariantCriterion
  /begin VAR_ADDRESS 0x800205A7 0x800239A7 0x80026DA7 0x8002A1A7 0x8002D5A7 0x800309A7 0x80033DA7 0x800371A7 /end VAR_ADDRESS
 /end VAR_CHARACTERISTIC
 /begin VAR_CHARACTERISTIC TP_U8_H2SPLIT_VDIFF_F1 BrkCalVariantCriterion
  /begin VAR_ADDRESS 0x800205A8 0x800239A8 0x80026DA8 0x8002A1A8 0x8002D5A8 0x800309A8 0x80033DA8 0x800371A8 /end VAR_ADDRESS
 /end VAR_CHARACTERISTIC
 /begin VAR_CHARACTERISTIC TP_U8_H2SPLIT_VDIFF_F2 BrkCalVariantCriterion
  /begin VAR_ADDRESS 0x800205A9 0x800239A9 0x80026DA9 0x8002A1A9 0x8002D5A9 0x800309A9 0x80033DA9 0x800371A9 /end VAR_ADDRESS
 /end VAR_CHARACTERISTIC
 /begin VAR_CHARACTERISTIC TP_U8_H2SPLIT_VDIFF_R1 BrkCalVariantCriterion
  /begin VAR_ADDRESS 0x800205AA 0x800239AA 0x80026DAA 0x8002A1AA 0x8002D5AA 0x800309AA 0x80033DAA 0x800371AA /end VAR_ADDRESS
 /end VAR_CHARACTERISTIC
 /begin VAR_CHARACTERISTIC TP_U8_H2SPLIT_VDIFF_R2 BrkCalVariantCriterion
  /begin VAR_ADDRESS 0x800205AB 0x800239AB 0x80026DAB 0x8002A1AB 0x8002D5AB 0x800309AB 0x80033DAB 0x800371AB /end VAR_ADDRESS
 /end VAR_CHARACTERISTIC
 /begin VAR_CHARACTERISTIC TP_U8_H2SP_DET_LOW_MU BrkCalVariantCriterion
  /begin VAR_ADDRESS 0x800205A6 0x800239A6 0x80026DA6 0x8002A1A6 0x8002D5A6 0x800309A6 0x80033DA6 0x800371A6 /end VAR_ADDRESS
 /end VAR_CHARACTERISTIC
 /begin VAR_CHARACTERISTIC TP_U8_HIGH_MU BrkCalVariantCriterion
  /begin VAR_ADDRESS 0x80020568 0x80023968 0x80026D68 0x8002A168 0x8002D568 0x80030968 0x80033D68 0x80037168 /end VAR_ADDRESS
 /end VAR_CHARACTERISTIC
 /begin VAR_CHARACTERISTIC TP_U8_HOLD13 BrkCalVariantCriterion
  /begin VAR_ADDRESS 0x8002029D 0x8002369D 0x80026A9D 0x80029E9D 0x8002D29D 0x8003069D 0x80033A9D 0x80036E9D /end VAR_ADDRESS
 /end VAR_CHARACTERISTIC
 /begin VAR_CHARACTERISTIC TP_U8_HOLD13_H_SPEED BrkCalVariantCriterion
  /begin VAR_ADDRESS 0x80020298 0x80023698 0x80026A98 0x80029E98 0x8002D298 0x80030698 0x80033A98 0x80036E98 /end VAR_ADDRESS
 /end VAR_CHARACTERISTIC
 /begin VAR_CHARACTERISTIC TP_U8_HOLD45 BrkCalVariantCriterion
  /begin VAR_ADDRESS 0x8002029E 0x8002369E 0x80026A9E 0x80029E9E 0x8002D29E 0x8003069E 0x80033A9E 0x80036E9E /end VAR_ADDRESS
 /end VAR_CHARACTERISTIC
 /begin VAR_CHARACTERISTIC TP_U8_HOLD45_H_SPEED BrkCalVariantCriterion
  /begin VAR_ADDRESS 0x80020299 0x80023699 0x80026A99 0x80029E99 0x8002D299 0x80030699 0x80033A99 0x80036E99 /end VAR_ADDRESS
 /end VAR_CHARACTERISTIC
 /begin VAR_CHARACTERISTIC TP_U8_HOLD67 BrkCalVariantCriterion
  /begin VAR_ADDRESS 0x8002029F 0x8002369F 0x80026A9F 0x80029E9F 0x8002D29F 0x8003069F 0x80033A9F 0x80036E9F /end VAR_ADDRESS
 /end VAR_CHARACTERISTIC
 /begin VAR_CHARACTERISTIC TP_U8_HOLD67_H_SPEED BrkCalVariantCriterion
  /begin VAR_ADDRESS 0x8002029A 0x8002369A 0x80026A9A 0x80029E9A 0x8002D29A 0x8003069A 0x80033A9A 0x80036E9A /end VAR_ADDRESS
 /end VAR_CHARACTERISTIC
 /begin VAR_CHARACTERISTIC TP_U8_HOLD8 BrkCalVariantCriterion
  /begin VAR_ADDRESS 0x800202A0 0x800236A0 0x80026AA0 0x80029EA0 0x8002D2A0 0x800306A0 0x80033AA0 0x80036EA0 /end VAR_ADDRESS
 /end VAR_CHARACTERISTIC
 /begin VAR_CHARACTERISTIC TP_U8_HOLD8_H_SPEED BrkCalVariantCriterion
  /begin VAR_ADDRESS 0x8002029B 0x8002369B 0x80026A9B 0x80029E9B 0x8002D29B 0x8003069B 0x80033A9B 0x80036E9B /end VAR_ADDRESS
 /end VAR_CHARACTERISTIC
 /begin VAR_CHARACTERISTIC TP_U8_HOLD_0 BrkCalVariantCriterion
  /begin VAR_ADDRESS 0x800202A1 0x800236A1 0x80026AA1 0x80029EA1 0x8002D2A1 0x800306A1 0x80033AA1 0x80036EA1 /end VAR_ADDRESS
 /end VAR_CHARACTERISTIC
 /begin VAR_CHARACTERISTIC TP_U8_HOLD_0_H_SPEED BrkCalVariantCriterion
  /begin VAR_ADDRESS 0x8002029C 0x8002369C 0x80026A9C 0x80029E9C 0x8002D29C 0x8003069C 0x80033A9C 0x80036E9C /end VAR_ADDRESS
 /end VAR_CHARACTERISTIC
 /begin VAR_CHARACTERISTIC TP_U8_High_Vel_dV_Pro_BF_AFZOK_F BrkCalVariantCriterion
  /begin VAR_ADDRESS 0x80020228 0x80023628 0x80026A28 0x80029E28 0x8002D228 0x80030628 0x80033A28 0x80036E28 /end VAR_ADDRESS
 /end VAR_CHARACTERISTIC
 /begin VAR_CHARACTERISTIC TP_U8_High_Vel_dV_Pro_BF_AFZOK_R BrkCalVariantCriterion
  /begin VAR_ADDRESS 0x80020232 0x80023632 0x80026A32 0x80029E32 0x8002D232 0x80030632 0x80033A32 0x80036E32 /end VAR_ADDRESS
 /end VAR_CHARACTERISTIC
 /begin VAR_CHARACTERISTIC TP_U8_Hold_Timer_ABS_Limit_Speed BrkCalVariantCriterion
  /begin VAR_ADDRESS 0x800202B5 0x800236B5 0x80026AB5 0x80029EB5 0x8002D2B5 0x800306B5 0x80033AB5 0x80036EB5 /end VAR_ADDRESS
 /end VAR_CHARACTERISTIC
 /begin VAR_CHARACTERISTIC TP_U8_Hold_Timer_New_Ref_High BrkCalVariantCriterion
  /begin VAR_ADDRESS 0x800202B6 0x800236B6 0x80026AB6 0x80029EB6 0x8002D2B6 0x800306B6 0x80033AB6 0x80036EB6 /end VAR_ADDRESS
 /end VAR_CHARACTERISTIC
 /begin VAR_CHARACTERISTIC TP_U8_Hold_Timer_New_Ref_High_R BrkCalVariantCriterion
  /begin VAR_ADDRESS 0x800202B7 0x800236B7 0x80026AB7 0x80029EB7 0x8002D2B7 0x800306B7 0x80033AB7 0x80036EB7 /end VAR_ADDRESS
 /end VAR_CHARACTERISTIC
 /begin VAR_CHARACTERISTIC TP_U8_Hold_Timer_New_Ref_Initial BrkCalVariantCriterion
  /begin VAR_ADDRESS 0x800202B8 0x800236B8 0x80026AB8 0x80029EB8 0x8002D2B8 0x800306B8 0x80033AB8 0x80036EB8 /end VAR_ADDRESS
 /end VAR_CHARACTERISTIC
 /begin VAR_CHARACTERISTIC TP_U8_Hold_Timer_New_Ref_Low BrkCalVariantCriterion
  /begin VAR_ADDRESS 0x800202B9 0x800236B9 0x80026AB9 0x80029EB9 0x8002D2B9 0x800306B9 0x80033AB9 0x80036EB9 /end VAR_ADDRESS
 /end VAR_CHARACTERISTIC
 /begin VAR_CHARACTERISTIC TP_U8_Hold_Timer_New_Ref_Low_R BrkCalVariantCriterion
  /begin VAR_ADDRESS 0x800202BA 0x800236BA 0x80026ABA 0x80029EBA 0x8002D2BA 0x800306BA 0x80033ABA 0x80036EBA /end VAR_ADDRESS
 /end VAR_CHARACTERISTIC
 /begin VAR_CHARACTERISTIC TP_U8_Hold_Timer_New_Ref_Med BrkCalVariantCriterion
  /begin VAR_ADDRESS 0x800202BB 0x800236BB 0x80026ABB 0x80029EBB 0x8002D2BB 0x800306BB 0x80033ABB 0x80036EBB /end VAR_ADDRESS
 /end VAR_CHARACTERISTIC
 /begin VAR_CHARACTERISTIC TP_U8_Hold_Timer_New_Ref_Med_R BrkCalVariantCriterion
  /begin VAR_ADDRESS 0x800202BC 0x800236BC 0x80026ABC 0x80029EBC 0x8002D2BC 0x800306BC 0x80033ABC 0x80036EBC /end VAR_ADDRESS
 /end VAR_CHARACTERISTIC
 /begin VAR_CHARACTERISTIC TP_U8_Hold_Timer_New_Ref_SpHigh_F BrkCalVariantCriterion
  /begin VAR_ADDRESS 0x800202BD 0x800236BD 0x80026ABD 0x80029EBD 0x8002D2BD 0x800306BD 0x80033ABD 0x80036EBD /end VAR_ADDRESS
 /end VAR_CHARACTERISTIC
 /begin VAR_CHARACTERISTIC TP_U8_INIT_DUTY_ACTIVE_BRK_MAX BrkCalVariantCriterion
  /begin VAR_ADDRESS 0x8002055E 0x8002395E 0x80026D5E 0x8002A15E 0x8002D55E 0x8003095E 0x80033D5E 0x8003715E /end VAR_ADDRESS
 /end VAR_CHARACTERISTIC
 /begin VAR_CHARACTERISTIC TP_U8_INIT_DUTY_ACTIVE_BRK_MIN BrkCalVariantCriterion
  /begin VAR_ADDRESS 0x8002055F 0x8002395F 0x80026D5F 0x8002A15F 0x8002D55F 0x8003095F 0x80033D5F 0x8003715F /end VAR_ADDRESS
 /end VAR_CHARACTERISTIC
 /begin VAR_CHARACTERISTIC TP_U8_IN_GEAR_Vib_Acc_to_Dec_time BrkCalVariantCriterion
  /begin VAR_ADDRESS 0x800202E1 0x800236E1 0x80026AE1 0x80029EE1 0x8002D2E1 0x800306E1 0x80033AE1 0x80036EE1 /end VAR_ADDRESS
 /end VAR_CHARACTERISTIC
 /begin VAR_CHARACTERISTIC TP_U8_IN_GEAR_detect_Dec_Hump_cnt BrkCalVariantCriterion
  /begin VAR_ADDRESS 0x800202DF 0x800236DF 0x80026ADF 0x80029EDF 0x8002D2DF 0x800306DF 0x80033ADF 0x80036EDF /end VAR_ADDRESS
 /end VAR_CHARACTERISTIC
 /begin VAR_CHARACTERISTIC TP_U8_IN_GEAR_detect_Vib_cnt BrkCalVariantCriterion
  /begin VAR_ADDRESS 0x800202E0 0x800236E0 0x80026AE0 0x80029EE0 0x8002D2E0 0x800306E0 0x80033AE0 0x80036EE0 /end VAR_ADDRESS
 /end VAR_CHARACTERISTIC
 /begin VAR_CHARACTERISTIC TP_U8_IN_GEAR_detect_cycle BrkCalVariantCriterion
  /begin VAR_ADDRESS 0x800202DE 0x800236DE 0x80026ADE 0x80029EDE 0x8002D2DE 0x800306DE 0x80033ADE 0x80036EDE /end VAR_ADDRESS
 /end VAR_CHARACTERISTIC
 /begin VAR_CHARACTERISTIC TP_U8_Init_Duty_Rough_Sus_Comp_F BrkCalVariantCriterion
  /begin VAR_ADDRESS 0x800204D0 0x800238D0 0x80026CD0 0x8002A0D0 0x8002D4D0 0x800308D0 0x80033CD0 0x800370D0 /end VAR_ADDRESS
 /end VAR_CHARACTERISTIC
 /begin VAR_CHARACTERISTIC TP_U8_Init_Duty_Rough_Sus_Comp_R BrkCalVariantCriterion
  /begin VAR_ADDRESS 0x800204D1 0x800238D1 0x80026CD1 0x8002A0D1 0x8002D4D1 0x800308D1 0x80033CD1 0x800370D1 /end VAR_ADDRESS
 /end VAR_CHARACTERISTIC
 /begin VAR_CHARACTERISTIC TP_U8_Initial_Duty_Ratio_F BrkCalVariantCriterion
  /begin VAR_ADDRESS 0x800202B1 0x800236B1 0x80026AB1 0x80029EB1 0x8002D2B1 0x800306B1 0x80033AB1 0x80036EB1 /end VAR_ADDRESS
 /end VAR_CHARACTERISTIC
 /begin VAR_CHARACTERISTIC TP_U8_Initial_Duty_Ratio_R BrkCalVariantCriterion
  /begin VAR_ADDRESS 0x800202B2 0x800236B2 0x80026AB2 0x80029EB2 0x8002D2B2 0x800306B2 0x80033AB2 0x80036EB2 /end VAR_ADDRESS
 /end VAR_CHARACTERISTIC
 /begin VAR_CHARACTERISTIC TP_U8_Initial_Duty_Rough_Comp_F BrkCalVariantCriterion
  /begin VAR_ADDRESS 0x800204CE 0x800238CE 0x80026CCE 0x8002A0CE 0x8002D4CE 0x800308CE 0x80033CCE 0x800370CE /end VAR_ADDRESS
 /end VAR_CHARACTERISTIC
 /begin VAR_CHARACTERISTIC TP_U8_Initial_Duty_Rough_Comp_R BrkCalVariantCriterion
  /begin VAR_ADDRESS 0x800204CF 0x800238CF 0x80026CCF 0x8002A0CF 0x8002D4CF 0x800308CF 0x80033CCF 0x800370CF /end VAR_ADDRESS
 /end VAR_CHARACTERISTIC
 /begin VAR_CHARACTERISTIC TP_U8_L2H_DCT_DECEL_CNT_L BrkCalVariantCriterion
  /begin VAR_ADDRESS 0x80020651 0x80023A51 0x80026E51 0x8002A251 0x8002D651 0x80030A51 0x80033E51 0x80037251 /end VAR_ADDRESS
 /end VAR_CHARACTERISTIC
 /begin VAR_CHARACTERISTIC TP_U8_L2H_DCT_DECEL_CNT_S BrkCalVariantCriterion
  /begin VAR_ADDRESS 0x80020652 0x80023A52 0x80026E52 0x8002A252 0x8002D652 0x80030A52 0x80033E52 0x80037252 /end VAR_ADDRESS
 /end VAR_CHARACTERISTIC
 /begin VAR_CHARACTERISTIC TP_U8_L2H_DCT_WPRESS_DIFF BrkCalVariantCriterion
  /begin VAR_ADDRESS 0x80020658 0x80023A58 0x80026E58 0x8002A258 0x8002D658 0x80030A58 0x80033E58 0x80037258 /end VAR_ADDRESS
 /end VAR_CHARACTERISTIC
 /begin VAR_CHARACTERISTIC TP_U8_L2H_DCT_WPRESS_THRES1 BrkCalVariantCriterion
  /begin VAR_ADDRESS 0x80020659 0x80023A59 0x80026E59 0x8002A259 0x8002D659 0x80030A59 0x80033E59 0x80037259 /end VAR_ADDRESS
 /end VAR_CHARACTERISTIC
 /begin VAR_CHARACTERISTIC TP_U8_L2H_DCT_WPRESS_THRES2 BrkCalVariantCriterion
  /begin VAR_ADDRESS 0x8002065A 0x80023A5A 0x80026E5A 0x8002A25A 0x8002D65A 0x80030A5A 0x80033E5A 0x8003725A /end VAR_ADDRESS
 /end VAR_CHARACTERISTIC
 /begin VAR_CHARACTERISTIC TP_U8_L2H_STB_TIM_L_DECEL_F BrkCalVariantCriterion
  /begin VAR_ADDRESS 0x80020653 0x80023A53 0x80026E53 0x8002A253 0x8002D653 0x80030A53 0x80033E53 0x80037253 /end VAR_ADDRESS
 /end VAR_CHARACTERISTIC
 /begin VAR_CHARACTERISTIC TP_U8_L2H_STB_TIM_L_DECEL_R BrkCalVariantCriterion
  /begin VAR_ADDRESS 0x80020654 0x80023A54 0x80026E54 0x8002A254 0x8002D654 0x80030A54 0x80033E54 0x80037254 /end VAR_ADDRESS
 /end VAR_CHARACTERISTIC
 /begin VAR_CHARACTERISTIC TP_U8_L2H_STB_TIM_S_DECEL_F BrkCalVariantCriterion
  /begin VAR_ADDRESS 0x80020655 0x80023A55 0x80026E55 0x8002A255 0x8002D655 0x80030A55 0x80033E55 0x80037255 /end VAR_ADDRESS
 /end VAR_CHARACTERISTIC
 /begin VAR_CHARACTERISTIC TP_U8_L2H_STB_TIM_S_DECEL_R BrkCalVariantCriterion
  /begin VAR_ADDRESS 0x80020656 0x80023A56 0x80026E56 0x8002A256 0x8002D656 0x80030A56 0x80033E56 0x80037256 /end VAR_ADDRESS
 /end VAR_CHARACTERISTIC
 /begin VAR_CHARACTERISTIC TP_U8_L2Hsus_SP_STB_TIM_L_DEC_SUM BrkCalVariantCriterion
  /begin VAR_ADDRESS 0x80020643 0x80023A43 0x80026E43 0x8002A243 0x8002D643 0x80030A43 0x80033E43 0x80037243 /end VAR_ADDRESS
 /end VAR_CHARACTERISTIC
 /begin VAR_CHARACTERISTIC TP_U8_L2Hsus_SP_STB_TIM_S_DEC_SUM1 BrkCalVariantCriterion
  /begin VAR_ADDRESS 0x80020644 0x80023A44 0x80026E44 0x8002A244 0x8002D644 0x80030A44 0x80033E44 0x80037244 /end VAR_ADDRESS
 /end VAR_CHARACTERISTIC
 /begin VAR_CHARACTERISTIC TP_U8_L2Hsus_SP_STB_TIM_S_DEC_SUM2 BrkCalVariantCriterion
  /begin VAR_ADDRESS 0x80020645 0x80023A45 0x80026E45 0x8002A245 0x8002D645 0x80030A45 0x80033E45 0x80037245 /end VAR_ADDRESS
 /end VAR_CHARACTERISTIC
 /begin VAR_CHARACTERISTIC TP_U8_L2Hsus_STB_TIM_L_DECEL_F1 BrkCalVariantCriterion
  /begin VAR_ADDRESS 0x80020646 0x80023A46 0x80026E46 0x8002A246 0x8002D646 0x80030A46 0x80033E46 0x80037246 /end VAR_ADDRESS
 /end VAR_CHARACTERISTIC
 /begin VAR_CHARACTERISTIC TP_U8_L2Hsus_STB_TIM_L_DECEL_MIN BrkCalVariantCriterion
  /begin VAR_ADDRESS 0x80020647 0x80023A47 0x80026E47 0x8002A247 0x8002D647 0x80030A47 0x80033E47 0x80037247 /end VAR_ADDRESS
 /end VAR_CHARACTERISTIC
 /begin VAR_CHARACTERISTIC TP_U8_L2Hsus_STB_TIM_L_DECEL_R1 BrkCalVariantCriterion
  /begin VAR_ADDRESS 0x80020648 0x80023A48 0x80026E48 0x8002A248 0x8002D648 0x80030A48 0x80033E48 0x80037248 /end VAR_ADDRESS
 /end VAR_CHARACTERISTIC
 /begin VAR_CHARACTERISTIC TP_U8_L2Hsus_STB_TIM_L_DECEL_SUM BrkCalVariantCriterion
  /begin VAR_ADDRESS 0x80020649 0x80023A49 0x80026E49 0x8002A249 0x8002D649 0x80030A49 0x80033E49 0x80037249 /end VAR_ADDRESS
 /end VAR_CHARACTERISTIC
 /begin VAR_CHARACTERISTIC TP_U8_L2Hsus_STB_TIM_S_DECEL_F1 BrkCalVariantCriterion
  /begin VAR_ADDRESS 0x8002064A 0x80023A4A 0x80026E4A 0x8002A24A 0x8002D64A 0x80030A4A 0x80033E4A 0x8003724A /end VAR_ADDRESS
 /end VAR_CHARACTERISTIC
 /begin VAR_CHARACTERISTIC TP_U8_L2Hsus_STB_TIM_S_DECEL_F2 BrkCalVariantCriterion
  /begin VAR_ADDRESS 0x8002064B 0x80023A4B 0x80026E4B 0x8002A24B 0x8002D64B 0x80030A4B 0x80033E4B 0x8003724B /end VAR_ADDRESS
 /end VAR_CHARACTERISTIC
 /begin VAR_CHARACTERISTIC TP_U8_L2Hsus_STB_TIM_S_DECEL_MIN BrkCalVariantCriterion
  /begin VAR_ADDRESS 0x8002064C 0x80023A4C 0x80026E4C 0x8002A24C 0x8002D64C 0x80030A4C 0x80033E4C 0x8003724C /end VAR_ADDRESS
 /end VAR_CHARACTERISTIC
 /begin VAR_CHARACTERISTIC TP_U8_L2Hsus_STB_TIM_S_DECEL_R1 BrkCalVariantCriterion
  /begin VAR_ADDRESS 0x8002064D 0x80023A4D 0x80026E4D 0x8002A24D 0x8002D64D 0x80030A4D 0x80033E4D 0x8003724D /end VAR_ADDRESS
 /end VAR_CHARACTERISTIC
 /begin VAR_CHARACTERISTIC TP_U8_L2Hsus_STB_TIM_S_DECEL_R2 BrkCalVariantCriterion
  /begin VAR_ADDRESS 0x8002064E 0x80023A4E 0x80026E4E 0x8002A24E 0x8002D64E 0x80030A4E 0x80033E4E 0x8003724E /end VAR_ADDRESS
 /end VAR_CHARACTERISTIC
 /begin VAR_CHARACTERISTIC TP_U8_L2Hsus_STB_TIM_S_DECEL_SUM1 BrkCalVariantCriterion
  /begin VAR_ADDRESS 0x8002064F 0x80023A4F 0x80026E4F 0x8002A24F 0x8002D64F 0x80030A4F 0x80033E4F 0x8003724F /end VAR_ADDRESS
 /end VAR_CHARACTERISTIC
 /begin VAR_CHARACTERISTIC TP_U8_L2Hsus_STB_TIM_S_DECEL_SUM2 BrkCalVariantCriterion
  /begin VAR_ADDRESS 0x80020650 0x80023A50 0x80026E50 0x8002A250 0x8002D650 0x80030A50 0x80033E50 0x80037250 /end VAR_ADDRESS
 /end VAR_CHARACTERISTIC
 /begin VAR_CHARACTERISTIC TP_U8_LCB_MED_MU_DET_F_INS_SKID BrkCalVariantCriterion
  /begin VAR_ADDRESS 0x80020552 0x80023952 0x80026D52 0x8002A152 0x8002D552 0x80030952 0x80033D52 0x80037152 /end VAR_ADDRESS
 /end VAR_CHARACTERISTIC
 /begin VAR_CHARACTERISTIC TP_U8_LCB_MED_MU_DET_F_OUT_SKID BrkCalVariantCriterion
  /begin VAR_ADDRESS 0x80020553 0x80023953 0x80026D53 0x8002A153 0x8002D553 0x80030953 0x80033D53 0x80037153 /end VAR_ADDRESS
 /end VAR_CHARACTERISTIC
 /begin VAR_CHARACTERISTIC TP_U8_LFC_2ND_CYC_COMP_LOW BrkCalVariantCriterion
  /begin VAR_ADDRESS 0x800202D2 0x800236D2 0x80026AD2 0x80029ED2 0x8002D2D2 0x800306D2 0x80033AD2 0x80036ED2 /end VAR_ADDRESS
 /end VAR_CHARACTERISTIC
 /begin VAR_CHARACTERISTIC TP_U8_LFC_Dump_Scan_Jump_Mu BrkCalVariantCriterion
  /begin VAR_ADDRESS 0x800202D3 0x800236D3 0x80026AD3 0x80029ED3 0x8002D2D3 0x800306D3 0x80033AD3 0x80036ED3 /end VAR_ADDRESS
 /end VAR_CHARACTERISTIC
 /begin VAR_CHARACTERISTIC TP_U8_LFC_Dump_Scan_Rough_Road BrkCalVariantCriterion
  /begin VAR_ADDRESS 0x800202D4 0x800236D4 0x80026AD4 0x80029ED4 0x8002D2D4 0x800306D4 0x80033AD4 0x80036ED4 /end VAR_ADDRESS
 /end VAR_CHARACTERISTIC
 /begin VAR_CHARACTERISTIC TP_U8_LFC_H2L_DUMP_H_V BrkCalVariantCriterion
  /begin VAR_ADDRESS 0x8002058E 0x8002398E 0x80026D8E 0x8002A18E 0x8002D58E 0x8003098E 0x80033D8E 0x8003718E /end VAR_ADDRESS
 /end VAR_CHARACTERISTIC
 /begin VAR_CHARACTERISTIC TP_U8_LFC_HIGH_DUMP BrkCalVariantCriterion
  /begin VAR_ADDRESS 0x8002058F 0x8002398F 0x80026D8F 0x8002A18F 0x8002D58F 0x8003098F 0x80033D8F 0x8003718F /end VAR_ADDRESS
 /end VAR_CHARACTERISTIC
 /begin VAR_CHARACTERISTIC TP_U8_LFC_HIGH_UNSTABIL_TIME BrkCalVariantCriterion
  /begin VAR_ADDRESS 0x80020590 0x80023990 0x80026D90 0x8002A190 0x8002D590 0x80030990 0x80033D90 0x80037190 /end VAR_ADDRESS
 /end VAR_CHARACTERISTIC
 /begin VAR_CHARACTERISTIC TP_U8_LFC_Initial_Dump_Scan_Low BrkCalVariantCriterion
  /begin VAR_ADDRESS 0x800202CD 0x800236CD 0x80026ACD 0x80029ECD 0x8002D2CD 0x800306CD 0x80033ACD 0x80036ECD /end VAR_ADDRESS
 /end VAR_CHARACTERISTIC
 /begin VAR_CHARACTERISTIC TP_U8_LFC_Initial_Dump_Scan_Med BrkCalVariantCriterion
  /begin VAR_ADDRESS 0x800202CE 0x800236CE 0x80026ACE 0x80029ECE 0x8002D2CE 0x800306CE 0x80033ACE 0x80036ECE /end VAR_ADDRESS
 /end VAR_CHARACTERISTIC
 /begin VAR_CHARACTERISTIC TP_U8_LFC_Initial_Duty_Comp_Low_F BrkCalVariantCriterion
  /begin VAR_ADDRESS 0x800202B3 0x800236B3 0x80026AB3 0x80029EB3 0x8002D2B3 0x800306B3 0x80033AB3 0x80036EB3 /end VAR_ADDRESS
 /end VAR_CHARACTERISTIC
 /begin VAR_CHARACTERISTIC TP_U8_LFC_Initial_Duty_Comp_Low_R BrkCalVariantCriterion
  /begin VAR_ADDRESS 0x800202B4 0x800236B4 0x80026AB4 0x80029EB4 0x8002D2B4 0x800306B4 0x80033AB4 0x80036EB4 /end VAR_ADDRESS
 /end VAR_CHARACTERISTIC
 /begin VAR_CHARACTERISTIC TP_U8_LFC_Jump_Down_Comp_F BrkCalVariantCriterion
  /begin VAR_ADDRESS 0x800202D5 0x800236D5 0x80026AD5 0x80029ED5 0x8002D2D5 0x800306D5 0x80033AD5 0x80036ED5 /end VAR_ADDRESS
 /end VAR_CHARACTERISTIC
 /begin VAR_CHARACTERISTIC TP_U8_LFC_Jump_Down_Comp_R BrkCalVariantCriterion
  /begin VAR_ADDRESS 0x800202D6 0x800236D6 0x80026AD6 0x80029ED6 0x8002D2D6 0x800306D6 0x80033AD6 0x80036ED6 /end VAR_ADDRESS
 /end VAR_CHARACTERISTIC
 /begin VAR_CHARACTERISTIC TP_U8_LFC_L2H_Comp_F BrkCalVariantCriterion
  /begin VAR_ADDRESS 0x800202D7 0x800236D7 0x80026AD7 0x80029ED7 0x8002D2D7 0x800306D7 0x80033AD7 0x80036ED7 /end VAR_ADDRESS
 /end VAR_CHARACTERISTIC
 /begin VAR_CHARACTERISTIC TP_U8_LFC_L2H_Comp_R BrkCalVariantCriterion
  /begin VAR_ADDRESS 0x800202D8 0x800236D8 0x80026AD8 0x80029ED8 0x8002D2D8 0x800306D8 0x80033AD8 0x80036ED8 /end VAR_ADDRESS
 /end VAR_CHARACTERISTIC
 /begin VAR_CHARACTERISTIC TP_U8_LFC_L2H_Suspect_Comp_F BrkCalVariantCriterion
  /begin VAR_ADDRESS 0x800202D9 0x800236D9 0x80026AD9 0x80029ED9 0x8002D2D9 0x800306D9 0x80033AD9 0x80036ED9 /end VAR_ADDRESS
 /end VAR_CHARACTERISTIC
 /begin VAR_CHARACTERISTIC TP_U8_LFC_L2H_Suspect_Comp_R BrkCalVariantCriterion
  /begin VAR_ADDRESS 0x800202DA 0x800236DA 0x80026ADA 0x80029EDA 0x8002D2DA 0x800306DA 0x80033ADA 0x80036EDA /end VAR_ADDRESS
 /end VAR_CHARACTERISTIC
 /begin VAR_CHARACTERISTIC TP_U8_LFC_Long_Hold_Comp_Duty_F BrkCalVariantCriterion
  /begin VAR_ADDRESS 0x800202C8 0x800236C8 0x80026AC8 0x80029EC8 0x8002D2C8 0x800306C8 0x80033AC8 0x80036EC8 /end VAR_ADDRESS
 /end VAR_CHARACTERISTIC
 /begin VAR_CHARACTERISTIC TP_U8_LFC_Long_Hold_Comp_Duty_R BrkCalVariantCriterion
  /begin VAR_ADDRESS 0x800202C9 0x800236C9 0x80026AC9 0x80029EC9 0x8002D2C9 0x800306C9 0x80033AC9 0x80036EC9 /end VAR_ADDRESS
 /end VAR_CHARACTERISTIC
 /begin VAR_CHARACTERISTIC TP_U8_LFC_MED_DUMP BrkCalVariantCriterion
  /begin VAR_ADDRESS 0x80020591 0x80023991 0x80026D91 0x8002A191 0x8002D591 0x80030991 0x80033D91 0x80037191 /end VAR_ADDRESS
 /end VAR_CHARACTERISTIC
 /begin VAR_CHARACTERISTIC TP_U8_LFC_MED_UNSTABIL_TIME BrkCalVariantCriterion
  /begin VAR_ADDRESS 0x80020592 0x80023992 0x80026D92 0x8002A192 0x8002D592 0x80030992 0x80033D92 0x80037192 /end VAR_ADDRESS
 /end VAR_CHARACTERISTIC
 /begin VAR_CHARACTERISTIC TP_U8_LFC_built_cnt_F_High_Ref BrkCalVariantCriterion
  /begin VAR_ADDRESS 0x800202BE 0x800236BE 0x80026ABE 0x80029EBE 0x8002D2BE 0x800306BE 0x80033ABE 0x80036EBE /end VAR_ADDRESS
 /end VAR_CHARACTERISTIC
 /begin VAR_CHARACTERISTIC TP_U8_LFC_built_cnt_F_Low_B_15_Ref BrkCalVariantCriterion
  /begin VAR_ADDRESS 0x800202BF 0x800236BF 0x80026ABF 0x80029EBF 0x8002D2BF 0x800306BF 0x80033ABF 0x80036EBF /end VAR_ADDRESS
 /end VAR_CHARACTERISTIC
/end VARIANT_CODING
/end MODULE
/end PROJECT
