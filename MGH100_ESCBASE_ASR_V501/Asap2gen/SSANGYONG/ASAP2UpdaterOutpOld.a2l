ASAP2_VERSION 1 60
/begin PROJECT Master ""
/begin MODULE CPP ""
/begin MOD_COMMON "" BYTE_ORDER MSB_LAST ALIGNMENT_BYTE 1 ALIGNMENT_WORD 1 ALIGNMENT_LONG 1 ALIGNMENT_FLOAT32_IEEE 1 ALIGNMENT_FLOAT64_IEEE 1 ALIGNMENT_INT64 1 /end MOD_COMMON
/begin CHARACTERISTIC BAC_S16_BRAKE_DISK_FADE_TEMPERATURE "" VALUE 0x80020F70 CalPrmBrkAssisCoorrBrk_SWORD 0 T32 -1023.1808 1023.149575 SYMBOL_LINK "CalPrmBrkAssisCoorrBrk01.BAC_S16_BRAKE_DISK_FADE_TEMPERATURE" 0 /end CHARACTERISTIC
/begin CHARACTERISTIC BAC_S16_BRAKE_DISK_MONITOR_TEMPERATURE "" VALUE 0x80020F72 CalPrmBrkAssisCoorrBrk_SWORD 0 T32 -1023.1808 1023.149575 SYMBOL_LINK "CalPrmBrkAssisCoorrBrk01.BAC_S16_BRAKE_DISK_MONITOR_TEMPERATURE" 0 /end CHARACTERISTIC
/begin CHARACTERISTIC BAC_S16_BRAKE_High_MCPRESS "" VALUE 0x80020F74 CalPrmBrkAssisCoorrBrk_SWORD 0 P34 -3276.8 3276.7 SYMBOL_LINK "CalPrmBrkAssisCoorrBrk01.BAC_S16_BRAKE_High_MCPRESS" 0 /end CHARACTERISTIC
/begin CHARACTERISTIC BAC_S16_BRAKE_LOWMU_ABSPRESS "" VALUE 0x80020F76 CalPrmBrkAssisCoorrBrk_SWORD 0 P34 -3276.8 3276.7 SYMBOL_LINK "CalPrmBrkAssisCoorrBrk01.BAC_S16_BRAKE_LOWMU_ABSPRESS" 0 /end CHARACTERISTIC
/begin CHARACTERISTIC BAC_S16_BRAKE_Low_MCPRESS "" VALUE 0x80020F78 CalPrmBrkAssisCoorrBrk_SWORD 0 P34 -3276.8 3276.7 SYMBOL_LINK "CalPrmBrkAssisCoorrBrk01.BAC_S16_BRAKE_Low_MCPRESS" 0 /end CHARACTERISTIC
/begin CHARACTERISTIC BAC_S16_BRAKE_Med_MCPRESS "" VALUE 0x80020F7A CalPrmBrkAssisCoorrBrk_SWORD 0 P34 -3276.8 3276.7 SYMBOL_LINK "CalPrmBrkAssisCoorrBrk01.BAC_S16_BRAKE_Med_MCPRESS" 0 /end CHARACTERISTIC
/begin CHARACTERISTIC BAC_S16_FBC_ENTER_DECEL "" VALUE 0x80020F80 CalPrmBrkAssisCoorrBrk_SWORD 0 A42 -327.68 327.67 SYMBOL_LINK "CalPrmBrkAssisCoorrBrk01.BAC_S16_FBC_ENTER_DECEL" 0 /end CHARACTERISTIC
/begin CHARACTERISTIC BAC_S16_FBC_MAX_TARGET_PRESS "" VALUE 0x80020FA2 CalPrmBrkAssisCoorrBrk_SWORD 0 P34 -3276.8 3276.7 SYMBOL_LINK "CalPrmBrkAssisCoorrBrk01.BAC_S16_FBC_MAX_TARGET_PRESS" 0 /end CHARACTERISTIC
/begin CHARACTERISTIC BAC_S16_FBC_PRESS_ENTER_THR "" VALUE 0x80020F82 CalPrmBrkAssisCoorrBrk_SWORD 0 P34 -3276.8 3276.7 SYMBOL_LINK "CalPrmBrkAssisCoorrBrk01.BAC_S16_FBC_PRESS_ENTER_THR" 0 /end CHARACTERISTIC
/begin CHARACTERISTIC BAC_S16_FBC_PRESS_EXIT_THR1 "" VALUE 0x80020F88 CalPrmBrkAssisCoorrBrk_SWORD 0 P34 -3276.8 3276.7 SYMBOL_LINK "CalPrmBrkAssisCoorrBrk01.BAC_S16_FBC_PRESS_EXIT_THR1" 0 /end CHARACTERISTIC
/begin CHARACTERISTIC BAC_S16_FBC_PRESS_EXIT_THR2 "" VALUE 0x80020F8A CalPrmBrkAssisCoorrBrk_SWORD 0 P34 -3276.8 3276.7 SYMBOL_LINK "CalPrmBrkAssisCoorrBrk01.BAC_S16_FBC_PRESS_EXIT_THR2" 0 /end CHARACTERISTIC
/begin CHARACTERISTIC BAC_S16_FBC_PRESS_EXIT_THR3 "" VALUE 0x80020F8C CalPrmBrkAssisCoorrBrk_SWORD 0 P34 -3276.8 3276.7 SYMBOL_LINK "CalPrmBrkAssisCoorrBrk01.BAC_S16_FBC_PRESS_EXIT_THR3" 0 /end CHARACTERISTIC
/begin CHARACTERISTIC BAC_S16_FBC_PRESS_RATE_ENTER_THR "" VALUE 0x80020F84 CalPrmBrkAssisCoorrBrk_SWORD 0 PGrdt13 -3276.8 3276.7 SYMBOL_LINK "CalPrmBrkAssisCoorrBrk01.BAC_S16_FBC_PRESS_RATE_ENTER_THR" 0 /end CHARACTERISTIC
/begin CHARACTERISTIC BAC_S16_FBC_SPEED_ENTER_THR "" VALUE 0x80020F86 CalPrmBrkAssisCoorrBrk_SWORD 0 Spd12 -4096 4095.875 SYMBOL_LINK "CalPrmBrkAssisCoorrBrk01.BAC_S16_FBC_SPEED_ENTER_THR" 0 /end CHARACTERISTIC
/begin CHARACTERISTIC BAC_S16_FBC_SPEED_EXIT_THR "" VALUE 0x80020F8E CalPrmBrkAssisCoorrBrk_SWORD 0 Spd12 -4096 4095.875 SYMBOL_LINK "CalPrmBrkAssisCoorrBrk01.BAC_S16_FBC_SPEED_EXIT_THR" 0 /end CHARACTERISTIC
/begin CHARACTERISTIC BAC_S16_FBC_Temp1 "" VALUE 0x80020FA4 CalPrmBrkAssisCoorrBrk_SWORD 0 Fac31 -32768 32767 SYMBOL_LINK "CalPrmBrkAssisCoorrBrk01.BAC_S16_FBC_Temp1" 0 /end CHARACTERISTIC
/begin CHARACTERISTIC BAC_S16_FBC_Temp2 "" VALUE 0x80020FA6 CalPrmBrkAssisCoorrBrk_SWORD 0 Fac31 -32768 32767 SYMBOL_LINK "CalPrmBrkAssisCoorrBrk01.BAC_S16_FBC_Temp2" 0 /end CHARACTERISTIC
/begin CHARACTERISTIC BAC_S16_FBC_Temp3 "" VALUE 0x80020FA8 CalPrmBrkAssisCoorrBrk_SWORD 0 Fac31 -32768 32767 SYMBOL_LINK "CalPrmBrkAssisCoorrBrk01.BAC_S16_FBC_Temp3" 0 /end CHARACTERISTIC
/begin CHARACTERISTIC BAC_S16_FBC_Temp4 "" VALUE 0x80020FAA CalPrmBrkAssisCoorrBrk_SWORD 0 Fac31 -32768 32767 SYMBOL_LINK "CalPrmBrkAssisCoorrBrk01.BAC_S16_FBC_Temp4" 0 /end CHARACTERISTIC
/begin CHARACTERISTIC BAC_S16_FBC_Temp5 "" VALUE 0x80020FAC CalPrmBrkAssisCoorrBrk_SWORD 0 Fac31 -32768 32767 SYMBOL_LINK "CalPrmBrkAssisCoorrBrk01.BAC_S16_FBC_Temp5" 0 /end CHARACTERISTIC
/begin CHARACTERISTIC BAC_S16_LOW_MPRESS_FBC_ON_TIME_ACCEL "" VALUE 0x80020F92 CalPrmBrkAssisCoorrBrk_SWORD 0 Ti21 -327.68 327.67 SYMBOL_LINK "CalPrmBrkAssisCoorrBrk01.BAC_S16_LOW_MPRESS_FBC_ON_TIME_ACCEL" 0 /end CHARACTERISTIC
/begin CHARACTERISTIC BAC_S16_LOW_MPRESS_FBC_ON_TIME_BRAKING "" VALUE 0x80020F94 CalPrmBrkAssisCoorrBrk_SWORD 0 Ti21 -327.68 327.67 SYMBOL_LINK "CalPrmBrkAssisCoorrBrk01.BAC_S16_LOW_MPRESS_FBC_ON_TIME_BRAKING" 0 /end CHARACTERISTIC
/begin CHARACTERISTIC BAC_S16_LOW_MPRESS_FBC_ON_TIME_DEFAULT "" VALUE 0x80020F96 CalPrmBrkAssisCoorrBrk_SWORD 0 Ti21 -327.68 327.67 SYMBOL_LINK "CalPrmBrkAssisCoorrBrk01.BAC_S16_LOW_MPRESS_FBC_ON_TIME_DEFAULT" 0 /end CHARACTERISTIC
/begin CHARACTERISTIC BAC_U16_FBC_MAX_APPLY_TIME_BEFORE_ABS "" VALUE 0x80020F9C CalPrmBrkAssisCoorrBrk_UWORD 0 Ti21 0 655.35 SYMBOL_LINK "CalPrmBrkAssisCoorrBrk01.BAC_U16_FBC_MAX_APPLY_TIME_BEFORE_ABS" 0 /end CHARACTERISTIC
/begin CHARACTERISTIC BAC_U8_BRAKE_High_Decel "" VALUE 0x80020F7C CalPrmBrkAssisCoorrBrk_UBYTE 0 A42 0 2.55 SYMBOL_LINK "CalPrmBrkAssisCoorrBrk01.BAC_U8_BRAKE_High_Decel" 0 /end CHARACTERISTIC
/begin CHARACTERISTIC BAC_U8_BRAKE_Low_Decel "" VALUE 0x80020F7D CalPrmBrkAssisCoorrBrk_UBYTE 0 A42 0 2.55 SYMBOL_LINK "CalPrmBrkAssisCoorrBrk01.BAC_U8_BRAKE_Low_Decel" 0 /end CHARACTERISTIC
/begin CHARACTERISTIC BAC_U8_BRAKE_Med_Decel "" VALUE 0x80020F7E CalPrmBrkAssisCoorrBrk_UBYTE 0 A42 0 2.55 SYMBOL_LINK "CalPrmBrkAssisCoorrBrk01.BAC_U8_BRAKE_Med_Decel" 0 /end CHARACTERISTIC
/begin CHARACTERISTIC BAC_U8_FBC_APPLY_TIME "" VALUE 0x80020FA0 CalPrmBrkAssisCoorrBrk_UBYTE 0 Ti21 0 2.55 SYMBOL_LINK "CalPrmBrkAssisCoorrBrk01.BAC_U8_FBC_APPLY_TIME" 0 /end CHARACTERISTIC
/begin CHARACTERISTIC BAC_U8_FBC_DUMP_MODE_HOLD_TIME "" VALUE 0x80020F9E CalPrmBrkAssisCoorrBrk_UBYTE 0 Ti21 0 2.55 SYMBOL_LINK "CalPrmBrkAssisCoorrBrk01.BAC_U8_FBC_DUMP_MODE_HOLD_TIME" 0 /end CHARACTERISTIC
/begin CHARACTERISTIC BAC_U8_FBC_DUMP_MODE_MAX_TIME "" VALUE 0x80020F9F CalPrmBrkAssisCoorrBrk_UBYTE 0 Ti21 0 2.55 SYMBOL_LINK "CalPrmBrkAssisCoorrBrk01.BAC_U8_FBC_DUMP_MODE_MAX_TIME" 0 /end CHARACTERISTIC
/begin CHARACTERISTIC BAC_U8_FBC_EXIT_CONTROL_TIME "" VALUE 0x80020F9A CalPrmBrkAssisCoorrBrk_UBYTE 0 Ti21 0 2.55 SYMBOL_LINK "CalPrmBrkAssisCoorrBrk01.BAC_U8_FBC_EXIT_CONTROL_TIME" 0 /end CHARACTERISTIC
/begin CHARACTERISTIC BAC_U8_FBC_EXIT_MTP1 "" VALUE 0x80020F98 CalPrmBrkAssisCoorrBrk_UBYTE 0 Perc6 0 255 SYMBOL_LINK "CalPrmBrkAssisCoorrBrk01.BAC_U8_FBC_EXIT_MTP1" 0 /end CHARACTERISTIC
/begin CHARACTERISTIC BAC_U8_FBC_EXIT_MTP2 "" VALUE 0x80020F99 CalPrmBrkAssisCoorrBrk_UBYTE 0 Perc6 0 255 SYMBOL_LINK "CalPrmBrkAssisCoorrBrk01.BAC_U8_FBC_EXIT_MTP2" 0 /end CHARACTERISTIC
/begin CHARACTERISTIC BAC_U8_FBC_FADING_DCT_COUNT_MAX "" VALUE 0x80020F7F CalPrmBrkAssisCoorrBrk_UBYTE 0 Ti21 0 2.55 SYMBOL_LINK "CalPrmBrkAssisCoorrBrk01.BAC_U8_FBC_FADING_DCT_COUNT_MAX" 0 /end CHARACTERISTIC
/begin CHARACTERISTIC BAC_U8_FBC_PRESS_EXIT_THR3_TIMER "" VALUE 0x80020F90 CalPrmBrkAssisCoorrBrk_UBYTE 0 Ti21 0 2.55 SYMBOL_LINK "CalPrmBrkAssisCoorrBrk01.BAC_U8_FBC_PRESS_EXIT_THR3_TIMER" 0 /end CHARACTERISTIC
/begin CHARACTERISTIC S16_WPE_LFC_Hold_press_r_10th "Temp" VALUE 0x800216A4 CalPrmBrkTqCtrlrBrk_SWORD 0 P34 -3276.8 3276.7 SYMBOL_LINK "CalPrmBrkTqCtrlrBrk01.S16_WPE_LFC_Hold_press_r_10th" 0 /end CHARACTERISTIC
/begin CHARACTERISTIC S16_WPE_LFC_Hold_press_r_11th "Temp" VALUE 0x800216A6 CalPrmBrkTqCtrlrBrk_SWORD 0 P34 -3276.8 3276.7 SYMBOL_LINK "CalPrmBrkTqCtrlrBrk01.S16_WPE_LFC_Hold_press_r_11th" 0 /end CHARACTERISTIC
/begin CHARACTERISTIC S16_WPE_LFC_Hold_press_r_12th "Temp" VALUE 0x800216A8 CalPrmBrkTqCtrlrBrk_SWORD 0 P34 -3276.8 3276.7 SYMBOL_LINK "CalPrmBrkTqCtrlrBrk01.S16_WPE_LFC_Hold_press_r_12th" 0 /end CHARACTERISTIC
/begin CHARACTERISTIC S16_WPE_LFC_Hold_press_r_13th "Temp" VALUE 0x800216AA CalPrmBrkTqCtrlrBrk_SWORD 0 P34 -3276.8 3276.7 SYMBOL_LINK "CalPrmBrkTqCtrlrBrk01.S16_WPE_LFC_Hold_press_r_13th" 0 /end CHARACTERISTIC
/begin CHARACTERISTIC S16_WPE_LFC_Hold_press_r_14th "Temp" VALUE 0x800216AC CalPrmBrkTqCtrlrBrk_SWORD 0 P34 -3276.8 3276.7 SYMBOL_LINK "CalPrmBrkTqCtrlrBrk01.S16_WPE_LFC_Hold_press_r_14th" 0 /end CHARACTERISTIC
/begin CHARACTERISTIC S16_WPE_LFC_Hold_press_r_15th "Temp" VALUE 0x800216AE CalPrmBrkTqCtrlrBrk_SWORD 0 P34 -3276.8 3276.7 SYMBOL_LINK "CalPrmBrkTqCtrlrBrk01.S16_WPE_LFC_Hold_press_r_15th" 0 /end CHARACTERISTIC
/begin CHARACTERISTIC S16_WPE_LFC_Hold_press_r_16th "Temp" VALUE 0x800216B0 CalPrmBrkTqCtrlrBrk_SWORD 0 P34 -3276.8 3276.7 SYMBOL_LINK "CalPrmBrkTqCtrlrBrk01.S16_WPE_LFC_Hold_press_r_16th" 0 /end CHARACTERISTIC
/begin CHARACTERISTIC S16_WPE_LFC_Hold_press_r_1st "Temp" VALUE 0x80021692 CalPrmBrkTqCtrlrBrk_SWORD 0 P34 -3276.8 3276.7 SYMBOL_LINK "CalPrmBrkTqCtrlrBrk01.S16_WPE_LFC_Hold_press_r_1st" 0 /end CHARACTERISTIC
/begin CHARACTERISTIC S16_WPE_LFC_Hold_press_r_2nd "Temp" VALUE 0x80021694 CalPrmBrkTqCtrlrBrk_SWORD 0 P34 -3276.8 3276.7 SYMBOL_LINK "CalPrmBrkTqCtrlrBrk01.S16_WPE_LFC_Hold_press_r_2nd" 0 /end CHARACTERISTIC
/begin CHARACTERISTIC S16_WPE_LFC_Hold_press_r_3rd "Temp" VALUE 0x80021696 CalPrmBrkTqCtrlrBrk_SWORD 0 P34 -3276.8 3276.7 SYMBOL_LINK "CalPrmBrkTqCtrlrBrk01.S16_WPE_LFC_Hold_press_r_3rd" 0 /end CHARACTERISTIC
/begin CHARACTERISTIC S16_WPE_LFC_Hold_press_r_4th "Temp" VALUE 0x80021698 CalPrmBrkTqCtrlrBrk_SWORD 0 P34 -3276.8 3276.7 SYMBOL_LINK "CalPrmBrkTqCtrlrBrk01.S16_WPE_LFC_Hold_press_r_4th" 0 /end CHARACTERISTIC
/begin CHARACTERISTIC S16_WPE_LFC_Hold_press_r_5th "Temp" VALUE 0x8002169A CalPrmBrkTqCtrlrBrk_SWORD 0 P34 -3276.8 3276.7 SYMBOL_LINK "CalPrmBrkTqCtrlrBrk01.S16_WPE_LFC_Hold_press_r_5th" 0 /end CHARACTERISTIC
/begin CHARACTERISTIC S16_WPE_LFC_Hold_press_r_6th "Temp" VALUE 0x8002169C CalPrmBrkTqCtrlrBrk_SWORD 0 P34 -3276.8 3276.7 SYMBOL_LINK "CalPrmBrkTqCtrlrBrk01.S16_WPE_LFC_Hold_press_r_6th" 0 /end CHARACTERISTIC
/begin CHARACTERISTIC S16_WPE_LFC_Hold_press_r_7th "Temp" VALUE 0x8002169E CalPrmBrkTqCtrlrBrk_SWORD 0 P34 -3276.8 3276.7 SYMBOL_LINK "CalPrmBrkTqCtrlrBrk01.S16_WPE_LFC_Hold_press_r_7th" 0 /end CHARACTERISTIC
/begin CHARACTERISTIC S16_WPE_LFC_Hold_press_r_8th "Temp" VALUE 0x800216A0 CalPrmBrkTqCtrlrBrk_SWORD 0 P34 -3276.8 3276.7 SYMBOL_LINK "CalPrmBrkTqCtrlrBrk01.S16_WPE_LFC_Hold_press_r_8th" 0 /end CHARACTERISTIC
/begin CHARACTERISTIC S16_WPE_LFC_Hold_press_r_9th "Temp" VALUE 0x800216A2 CalPrmBrkTqCtrlrBrk_SWORD 0 P34 -3276.8 3276.7 SYMBOL_LINK "CalPrmBrkTqCtrlrBrk01.S16_WPE_LFC_Hold_press_r_9th" 0 /end CHARACTERISTIC
/begin CHARACTERISTIC S16_WPE_LFC_Rise_Gain_f_10th "Temp" VALUE 0x800216D0 CalPrmBrkTqCtrlrBrk_SWORD 0 Perc6 -32768 32767 SYMBOL_LINK "CalPrmBrkTqCtrlrBrk01.S16_WPE_LFC_Rise_Gain_f_10th" 0 /end CHARACTERISTIC
/begin CHARACTERISTIC S16_WPE_LFC_Rise_Gain_f_11th "Temp" VALUE 0x800216D2 CalPrmBrkTqCtrlrBrk_SWORD 0 Perc6 -32768 32767 SYMBOL_LINK "CalPrmBrkTqCtrlrBrk01.S16_WPE_LFC_Rise_Gain_f_11th" 0 /end CHARACTERISTIC
/begin CHARACTERISTIC S16_WPE_LFC_Rise_Gain_f_1st "Temp" VALUE 0x800216BE CalPrmBrkTqCtrlrBrk_SWORD 0 Perc6 -32768 32767 SYMBOL_LINK "CalPrmBrkTqCtrlrBrk01.S16_WPE_LFC_Rise_Gain_f_1st" 0 /end CHARACTERISTIC
/begin CHARACTERISTIC S16_WPE_LFC_Rise_Gain_f_2nd "Temp" VALUE 0x800216C0 CalPrmBrkTqCtrlrBrk_SWORD 0 Perc6 -32768 32767 SYMBOL_LINK "CalPrmBrkTqCtrlrBrk01.S16_WPE_LFC_Rise_Gain_f_2nd" 0 /end CHARACTERISTIC
/begin CHARACTERISTIC S16_WPE_LFC_Rise_Gain_f_3rd "Temp" VALUE 0x800216C2 CalPrmBrkTqCtrlrBrk_SWORD 0 Perc6 -32768 32767 SYMBOL_LINK "CalPrmBrkTqCtrlrBrk01.S16_WPE_LFC_Rise_Gain_f_3rd" 0 /end CHARACTERISTIC
/begin CHARACTERISTIC S16_WPE_LFC_Rise_Gain_f_4th "Temp" VALUE 0x800216C4 CalPrmBrkTqCtrlrBrk_SWORD 0 Perc6 -32768 32767 SYMBOL_LINK "CalPrmBrkTqCtrlrBrk01.S16_WPE_LFC_Rise_Gain_f_4th" 0 /end CHARACTERISTIC
/begin CHARACTERISTIC S16_WPE_LFC_Rise_Gain_f_5th "Temp" VALUE 0x800216C6 CalPrmBrkTqCtrlrBrk_SWORD 0 Perc6 -32768 32767 SYMBOL_LINK "CalPrmBrkTqCtrlrBrk01.S16_WPE_LFC_Rise_Gain_f_5th" 0 /end CHARACTERISTIC
/begin CHARACTERISTIC S16_WPE_LFC_Rise_Gain_f_6th "Temp" VALUE 0x800216C8 CalPrmBrkTqCtrlrBrk_SWORD 0 Perc6 -32768 32767 SYMBOL_LINK "CalPrmBrkTqCtrlrBrk01.S16_WPE_LFC_Rise_Gain_f_6th" 0 /end CHARACTERISTIC
/begin CHARACTERISTIC S16_WPE_LFC_Rise_Gain_f_7th "Temp" VALUE 0x800216CA CalPrmBrkTqCtrlrBrk_SWORD 0 Perc6 -32768 32767 SYMBOL_LINK "CalPrmBrkTqCtrlrBrk01.S16_WPE_LFC_Rise_Gain_f_7th" 0 /end CHARACTERISTIC
/begin CHARACTERISTIC S16_WPE_LFC_Rise_Gain_f_8th "Temp" VALUE 0x800216CC CalPrmBrkTqCtrlrBrk_SWORD 0 Perc6 -32768 32767 SYMBOL_LINK "CalPrmBrkTqCtrlrBrk01.S16_WPE_LFC_Rise_Gain_f_8th" 0 /end CHARACTERISTIC
/begin CHARACTERISTIC S16_WPE_LFC_Rise_Gain_f_9th "Temp" VALUE 0x800216CE CalPrmBrkTqCtrlrBrk_SWORD 0 Perc6 -32768 32767 SYMBOL_LINK "CalPrmBrkTqCtrlrBrk01.S16_WPE_LFC_Rise_Gain_f_9th" 0 /end CHARACTERISTIC
/begin CHARACTERISTIC S16_WPE_TC_Rels_Comp_Gain_f_1 "Temp" VALUE 0x8002162E CalPrmBrkTqCtrlrBrk_SWORD 0 Perc6 -32768 32767 SYMBOL_LINK "CalPrmBrkTqCtrlrBrk01.S16_WPE_TC_Rels_Comp_Gain_f_1" 0 /end CHARACTERISTIC
/begin CHARACTERISTIC S16_WPE_TC_Rels_Comp_Gain_f_2 "Temp" VALUE 0x80021630 CalPrmBrkTqCtrlrBrk_SWORD 0 Perc6 -32768 32767 SYMBOL_LINK "CalPrmBrkTqCtrlrBrk01.S16_WPE_TC_Rels_Comp_Gain_f_2" 0 /end CHARACTERISTIC
/begin CHARACTERISTIC S16_WPE_TC_Rels_Comp_Gain_f_3 "Temp" VALUE 0x80021632 CalPrmBrkTqCtrlrBrk_SWORD 0 Perc6 -32768 32767 SYMBOL_LINK "CalPrmBrkTqCtrlrBrk01.S16_WPE_TC_Rels_Comp_Gain_f_3" 0 /end CHARACTERISTIC
/begin CHARACTERISTIC S16_WPE_TC_Rels_Comp_Gain_f_4 "Temp" VALUE 0x80021634 CalPrmBrkTqCtrlrBrk_SWORD 0 Perc6 -32768 32767 SYMBOL_LINK "CalPrmBrkTqCtrlrBrk01.S16_WPE_TC_Rels_Comp_Gain_f_4" 0 /end CHARACTERISTIC
/begin CHARACTERISTIC S16_WPE_TC_Rels_Comp_Gain_f_5 "Temp" VALUE 0x80021636 CalPrmBrkTqCtrlrBrk_SWORD 0 Perc6 -32768 32767 SYMBOL_LINK "CalPrmBrkTqCtrlrBrk01.S16_WPE_TC_Rels_Comp_Gain_f_5" 0 /end CHARACTERISTIC
/begin CHARACTERISTIC S16_WPE_TC_Rels_Comp_Gain_f_6 "Temp" VALUE 0x80021638 CalPrmBrkTqCtrlrBrk_SWORD 0 Perc6 -32768 32767 SYMBOL_LINK "CalPrmBrkTqCtrlrBrk01.S16_WPE_TC_Rels_Comp_Gain_f_6" 0 /end CHARACTERISTIC
/begin CHARACTERISTIC S16_WPE_TC_Rels_Comp_Press_f_1 "Temp" VALUE 0x80021622 CalPrmBrkTqCtrlrBrk_SWORD 0 P34 -3276.8 3276.7 SYMBOL_LINK "CalPrmBrkTqCtrlrBrk01.S16_WPE_TC_Rels_Comp_Press_f_1" 0 /end CHARACTERISTIC
/begin CHARACTERISTIC S16_WPE_TC_Rels_Comp_Press_f_2 "Temp" VALUE 0x80021624 CalPrmBrkTqCtrlrBrk_SWORD 0 P34 -3276.8 3276.7 SYMBOL_LINK "CalPrmBrkTqCtrlrBrk01.S16_WPE_TC_Rels_Comp_Press_f_2" 0 /end CHARACTERISTIC
/begin CHARACTERISTIC S16_WPE_TC_Rels_Comp_Press_f_3 "Temp" VALUE 0x80021626 CalPrmBrkTqCtrlrBrk_SWORD 0 P34 -3276.8 3276.7 SYMBOL_LINK "CalPrmBrkTqCtrlrBrk01.S16_WPE_TC_Rels_Comp_Press_f_3" 0 /end CHARACTERISTIC
/begin CHARACTERISTIC S16_WPE_TC_Rels_Comp_Press_f_4 "Temp" VALUE 0x80021628 CalPrmBrkTqCtrlrBrk_SWORD 0 P34 -3276.8 3276.7 SYMBOL_LINK "CalPrmBrkTqCtrlrBrk01.S16_WPE_TC_Rels_Comp_Press_f_4" 0 /end CHARACTERISTIC
/begin CHARACTERISTIC S16_WPE_TC_Rels_Comp_Press_f_5 "Temp" VALUE 0x8002162A CalPrmBrkTqCtrlrBrk_SWORD 0 P34 -3276.8 3276.7 SYMBOL_LINK "CalPrmBrkTqCtrlrBrk01.S16_WPE_TC_Rels_Comp_Press_f_5" 0 /end CHARACTERISTIC
/begin CHARACTERISTIC S16_WPE_TC_Rels_Comp_Press_f_6 "Temp" VALUE 0x8002162C CalPrmBrkTqCtrlrBrk_SWORD 0 P34 -3276.8 3276.7 SYMBOL_LINK "CalPrmBrkTqCtrlrBrk01.S16_WPE_TC_Rels_Comp_Press_f_6" 0 /end CHARACTERISTIC
/begin CHARACTERISTIC S16_WPE_TC_Valve_Hold_Duty_V_1 "Temp" VALUE 0x800214F2 CalPrmBrkTqCtrlrBrk_SWORD 0 Perc9 -3276.8 3276.7 SYMBOL_LINK "CalPrmBrkTqCtrlrBrk01.S16_WPE_TC_Valve_Hold_Duty_V_1" 0 /end CHARACTERISTIC
/begin CHARACTERISTIC S16_WPE_TC_Valve_Hold_Duty_V_10 "Temp" VALUE 0x80021504 CalPrmBrkTqCtrlrBrk_SWORD 0 Perc9 -3276.8 3276.7 SYMBOL_LINK "CalPrmBrkTqCtrlrBrk01.S16_WPE_TC_Valve_Hold_Duty_V_10" 0 /end CHARACTERISTIC
/begin CHARACTERISTIC S16_WPE_TC_Valve_Hold_Duty_V_11 "Temp" VALUE 0x80021506 CalPrmBrkTqCtrlrBrk_SWORD 0 Perc9 -3276.8 3276.7 SYMBOL_LINK "CalPrmBrkTqCtrlrBrk01.S16_WPE_TC_Valve_Hold_Duty_V_11" 0 /end CHARACTERISTIC
/begin CHARACTERISTIC S16_WPE_TC_Valve_Hold_Duty_V_12 "Temp" VALUE 0x80021508 CalPrmBrkTqCtrlrBrk_SWORD 0 Perc9 -3276.8 3276.7 SYMBOL_LINK "CalPrmBrkTqCtrlrBrk01.S16_WPE_TC_Valve_Hold_Duty_V_12" 0 /end CHARACTERISTIC
/begin CHARACTERISTIC S16_WPE_TC_Valve_Hold_Duty_V_13 "Temp" VALUE 0x8002150A CalPrmBrkTqCtrlrBrk_SWORD 0 Perc9 -3276.8 3276.7 SYMBOL_LINK "CalPrmBrkTqCtrlrBrk01.S16_WPE_TC_Valve_Hold_Duty_V_13" 0 /end CHARACTERISTIC
/begin CHARACTERISTIC S16_WPE_TC_Valve_Hold_Duty_V_14 "Temp" VALUE 0x8002150C CalPrmBrkTqCtrlrBrk_SWORD 0 Perc9 -3276.8 3276.7 SYMBOL_LINK "CalPrmBrkTqCtrlrBrk01.S16_WPE_TC_Valve_Hold_Duty_V_14" 0 /end CHARACTERISTIC
/begin CHARACTERISTIC S16_WPE_TC_Valve_Hold_Duty_V_15 "Temp" VALUE 0x8002150E CalPrmBrkTqCtrlrBrk_SWORD 0 Perc9 -3276.8 3276.7 SYMBOL_LINK "CalPrmBrkTqCtrlrBrk01.S16_WPE_TC_Valve_Hold_Duty_V_15" 0 /end CHARACTERISTIC
/begin CHARACTERISTIC S16_WPE_TC_Valve_Hold_Duty_V_16 "Temp" VALUE 0x80021510 CalPrmBrkTqCtrlrBrk_SWORD 0 Perc9 -3276.8 3276.7 SYMBOL_LINK "CalPrmBrkTqCtrlrBrk01.S16_WPE_TC_Valve_Hold_Duty_V_16" 0 /end CHARACTERISTIC
/begin CHARACTERISTIC S16_WPE_TC_Valve_Hold_Duty_V_2 "Temp" VALUE 0x800214F4 CalPrmBrkTqCtrlrBrk_SWORD 0 Perc9 -3276.8 3276.7 SYMBOL_LINK "CalPrmBrkTqCtrlrBrk01.S16_WPE_TC_Valve_Hold_Duty_V_2" 0 /end CHARACTERISTIC
/begin CHARACTERISTIC S16_WPE_TC_Valve_Hold_Duty_V_3 "Temp" VALUE 0x800214F6 CalPrmBrkTqCtrlrBrk_SWORD 0 Perc9 -3276.8 3276.7 SYMBOL_LINK "CalPrmBrkTqCtrlrBrk01.S16_WPE_TC_Valve_Hold_Duty_V_3" 0 /end CHARACTERISTIC
/begin CHARACTERISTIC S16_WPE_TC_Valve_Hold_Duty_V_4 "Temp" VALUE 0x800214F8 CalPrmBrkTqCtrlrBrk_SWORD 0 Perc9 -3276.8 3276.7 SYMBOL_LINK "CalPrmBrkTqCtrlrBrk01.S16_WPE_TC_Valve_Hold_Duty_V_4" 0 /end CHARACTERISTIC
/begin CHARACTERISTIC S16_WPE_TC_Valve_Hold_Duty_V_5 "Temp" VALUE 0x800214FA CalPrmBrkTqCtrlrBrk_SWORD 0 Perc9 -3276.8 3276.7 SYMBOL_LINK "CalPrmBrkTqCtrlrBrk01.S16_WPE_TC_Valve_Hold_Duty_V_5" 0 /end CHARACTERISTIC
/begin CHARACTERISTIC S16_WPE_TC_Valve_Hold_Duty_V_6 "Temp" VALUE 0x800214FC CalPrmBrkTqCtrlrBrk_SWORD 0 Perc9 -3276.8 3276.7 SYMBOL_LINK "CalPrmBrkTqCtrlrBrk01.S16_WPE_TC_Valve_Hold_Duty_V_6" 0 /end CHARACTERISTIC
/begin CHARACTERISTIC S16_WPE_TC_Valve_Hold_Duty_V_7 "Temp" VALUE 0x800214FE CalPrmBrkTqCtrlrBrk_SWORD 0 Perc9 -3276.8 3276.7 SYMBOL_LINK "CalPrmBrkTqCtrlrBrk01.S16_WPE_TC_Valve_Hold_Duty_V_7" 0 /end CHARACTERISTIC
/begin CHARACTERISTIC S16_WPE_TC_Valve_Hold_Duty_V_8 "Temp" VALUE 0x80021500 CalPrmBrkTqCtrlrBrk_SWORD 0 Perc9 -3276.8 3276.7 SYMBOL_LINK "CalPrmBrkTqCtrlrBrk01.S16_WPE_TC_Valve_Hold_Duty_V_8" 0 /end CHARACTERISTIC
/begin CHARACTERISTIC S16_WPE_TC_Valve_Hold_Duty_V_9 "Temp" VALUE 0x80021502 CalPrmBrkTqCtrlrBrk_SWORD 0 Perc9 -3276.8 3276.7 SYMBOL_LINK "CalPrmBrkTqCtrlrBrk01.S16_WPE_TC_Valve_Hold_Duty_V_9" 0 /end CHARACTERISTIC
/begin CHARACTERISTIC S16_WPE_TC_Valve_Hold_Press_V_1 "Temp" VALUE 0x80021512 CalPrmBrkTqCtrlrBrk_SWORD 0 P32 -327.68 327.67 SYMBOL_LINK "CalPrmBrkTqCtrlrBrk01.S16_WPE_TC_Valve_Hold_Press_V_1" 0 /end CHARACTERISTIC
/begin CHARACTERISTIC S16_WPE_TC_Valve_Hold_Press_V_10 "Temp" VALUE 0x80021524 CalPrmBrkTqCtrlrBrk_SWORD 0 P32 -327.68 327.67 SYMBOL_LINK "CalPrmBrkTqCtrlrBrk01.S16_WPE_TC_Valve_Hold_Press_V_10" 0 /end CHARACTERISTIC
/begin CHARACTERISTIC S16_WPE_TC_Valve_Hold_Press_V_11 "Temp" VALUE 0x80021526 CalPrmBrkTqCtrlrBrk_SWORD 0 P32 -327.68 327.67 SYMBOL_LINK "CalPrmBrkTqCtrlrBrk01.S16_WPE_TC_Valve_Hold_Press_V_11" 0 /end CHARACTERISTIC
/begin CHARACTERISTIC S16_WPE_TC_Valve_Hold_Press_V_12 "Temp" VALUE 0x80021528 CalPrmBrkTqCtrlrBrk_SWORD 0 P32 -327.68 327.67 SYMBOL_LINK "CalPrmBrkTqCtrlrBrk01.S16_WPE_TC_Valve_Hold_Press_V_12" 0 /end CHARACTERISTIC
/begin CHARACTERISTIC S16_WPE_TC_Valve_Hold_Press_V_13 "Temp" VALUE 0x8002152A CalPrmBrkTqCtrlrBrk_SWORD 0 P32 -327.68 327.67 SYMBOL_LINK "CalPrmBrkTqCtrlrBrk01.S16_WPE_TC_Valve_Hold_Press_V_13" 0 /end CHARACTERISTIC
/begin CHARACTERISTIC S16_WPE_TC_Valve_Hold_Press_V_14 "Temp" VALUE 0x8002152C CalPrmBrkTqCtrlrBrk_SWORD 0 P32 -327.68 327.67 SYMBOL_LINK "CalPrmBrkTqCtrlrBrk01.S16_WPE_TC_Valve_Hold_Press_V_14" 0 /end CHARACTERISTIC
/begin CHARACTERISTIC S16_WPE_TC_Valve_Hold_Press_V_15 "Temp" VALUE 0x8002152E CalPrmBrkTqCtrlrBrk_SWORD 0 P32 -327.68 327.67 SYMBOL_LINK "CalPrmBrkTqCtrlrBrk01.S16_WPE_TC_Valve_Hold_Press_V_15" 0 /end CHARACTERISTIC
/begin CHARACTERISTIC S16_WPE_TC_Valve_Hold_Press_V_16 "Temp" VALUE 0x80021530 CalPrmBrkTqCtrlrBrk_SWORD 0 P32 -327.68 327.67 SYMBOL_LINK "CalPrmBrkTqCtrlrBrk01.S16_WPE_TC_Valve_Hold_Press_V_16" 0 /end CHARACTERISTIC
/begin CHARACTERISTIC S16_WPE_TC_Valve_Hold_Press_V_2 "Temp" VALUE 0x80021514 CalPrmBrkTqCtrlrBrk_SWORD 0 P32 -327.68 327.67 SYMBOL_LINK "CalPrmBrkTqCtrlrBrk01.S16_WPE_TC_Valve_Hold_Press_V_2" 0 /end CHARACTERISTIC
/begin CHARACTERISTIC S16_WPE_TC_Valve_Hold_Press_V_3 "Temp" VALUE 0x80021516 CalPrmBrkTqCtrlrBrk_SWORD 0 P32 -327.68 327.67 SYMBOL_LINK "CalPrmBrkTqCtrlrBrk01.S16_WPE_TC_Valve_Hold_Press_V_3" 0 /end CHARACTERISTIC
/begin CHARACTERISTIC S16_WPE_TC_Valve_Hold_Press_V_4 "Temp" VALUE 0x80021518 CalPrmBrkTqCtrlrBrk_SWORD 0 P32 -327.68 327.67 SYMBOL_LINK "CalPrmBrkTqCtrlrBrk01.S16_WPE_TC_Valve_Hold_Press_V_4" 0 /end CHARACTERISTIC
/begin CHARACTERISTIC S16_WPE_TC_Valve_Hold_Press_V_5 "Temp" VALUE 0x8002151A CalPrmBrkTqCtrlrBrk_SWORD 0 P32 -327.68 327.67 SYMBOL_LINK "CalPrmBrkTqCtrlrBrk01.S16_WPE_TC_Valve_Hold_Press_V_5" 0 /end CHARACTERISTIC
/begin CHARACTERISTIC S16_WPE_TC_Valve_Hold_Press_V_6 "Temp" VALUE 0x8002151C CalPrmBrkTqCtrlrBrk_SWORD 0 P32 -327.68 327.67 SYMBOL_LINK "CalPrmBrkTqCtrlrBrk01.S16_WPE_TC_Valve_Hold_Press_V_6" 0 /end CHARACTERISTIC
/begin CHARACTERISTIC S16_WPE_TC_Valve_Hold_Press_V_7 "Temp" VALUE 0x8002151E CalPrmBrkTqCtrlrBrk_SWORD 0 P32 -327.68 327.67 SYMBOL_LINK "CalPrmBrkTqCtrlrBrk01.S16_WPE_TC_Valve_Hold_Press_V_7" 0 /end CHARACTERISTIC
/begin CHARACTERISTIC S16_WPE_TC_Valve_Hold_Press_V_8 "Temp" VALUE 0x80021520 CalPrmBrkTqCtrlrBrk_SWORD 0 P32 -327.68 327.67 SYMBOL_LINK "CalPrmBrkTqCtrlrBrk01.S16_WPE_TC_Valve_Hold_Press_V_8" 0 /end CHARACTERISTIC
/begin CHARACTERISTIC S16_WPE_TC_Valve_Hold_Press_V_9 "Temp" VALUE 0x80021522 CalPrmBrkTqCtrlrBrk_SWORD 0 P32 -327.68 327.67 SYMBOL_LINK "CalPrmBrkTqCtrlrBrk01.S16_WPE_TC_Valve_Hold_Press_V_9" 0 /end CHARACTERISTIC
/begin CHARACTERISTIC S16_WPE_WPE_Max_TCMF_Hold_Press "Temp" VALUE 0x8002161A CalPrmBrkTqCtrlrBrk_SWORD 0 P32 -327.68 327.67 SYMBOL_LINK "CalPrmBrkTqCtrlrBrk01.S16_WPE_WPE_Max_TCMF_Hold_Press" 0 /end CHARACTERISTIC
/begin CHARACTERISTIC SSM_S16_AVH_ISG_IDLETOQ_INHIBIT_TIME "" VALUE 0x8003A73C CalPrmSsmEng_SWORD 0 Ti21 -327.68 327.67 SYMBOL_LINK "CalPrmSsmEng01.SSM_S16_AVH_ISG_IDLETOQ_INHIBIT_TIME" 0 /end CHARACTERISTIC
/begin CHARACTERISTIC SSM_S16_HSA_ENTER_HM_LIMIT_MPRESS "" VALUE 0x8003A708 CalPrmSsmEng_SWORD 0 P34 -3276.8 3276.7 SYMBOL_LINK "CalPrmSsmEng01.SSM_S16_HSA_ENTER_HM_LIMIT_MPRESS" 0 /end CHARACTERISTIC
/begin CHARACTERISTIC SSM_S16_HSA_ENTER_INBIT_MPRESS "" VALUE 0x8003A702 CalPrmSsmEng_SWORD 0 P34 -3276.8 3276.7 SYMBOL_LINK "CalPrmSsmEng01.SSM_S16_HSA_ENTER_INBIT_MPRESS" 0 /end CHARACTERISTIC
/begin CHARACTERISTIC SSM_S16_HSA_ENTER_LIMIT_SPEED "" VALUE 0x8003A704 CalPrmSsmEng_SWORD 0 Spd12 -4096 4095.875 SYMBOL_LINK "CalPrmSsmEng01.SSM_S16_HSA_ENTER_LIMIT_SPEED" 0 /end CHARACTERISTIC
/begin CHARACTERISTIC SSM_S16_HSA_ENTER_LM_LIMIT_MPRESS "" VALUE 0x8003A706 CalPrmSsmEng_SWORD 0 P34 -3276.8 3276.7 SYMBOL_LINK "CalPrmSsmEng01.SSM_S16_HSA_ENTER_LM_LIMIT_MPRESS" 0 /end CHARACTERISTIC
/begin CHARACTERISTIC SSM_S16_HSA_ENTER_MAX_LIMIT_MPRESS "" VALUE 0x8003A70A CalPrmSsmEng_SWORD 0 P34 -3276.8 3276.7 SYMBOL_LINK "CalPrmSsmEng01.SSM_S16_HSA_ENTER_MAX_LIMIT_MPRESS" 0 /end CHARACTERISTIC
/begin CHARACTERISTIC SSM_S16_HSA_EXIT_SPEED "" VALUE 0x8003A70C CalPrmSsmEng_SWORD 0 Spd12 -4096 4095.875 SYMBOL_LINK "CalPrmSsmEng01.SSM_S16_HSA_EXIT_SPEED" 0 /end CHARACTERISTIC
/begin CHARACTERISTIC SSM_S16_HSA_FLAT_THR_FORWARD "" VALUE 0x8003A6EA CalPrmSsmEng_SWORD 0 A42 -327.68 327.67 SYMBOL_LINK "CalPrmSsmEng01.SSM_S16_HSA_FLAT_THR_FORWARD" 0 /end CHARACTERISTIC
/begin CHARACTERISTIC SSM_S16_HSA_FLAT_THR_REVERSE "" VALUE 0x8003A6EC CalPrmSsmEng_SWORD 0 A42 -327.68 327.67 SYMBOL_LINK "CalPrmSsmEng01.SSM_S16_HSA_FLAT_THR_REVERSE" 0 /end CHARACTERISTIC
/begin CHARACTERISTIC SSM_S16_HSA_MIN_SLOPE_FORWARD "" VALUE 0x8003A6E4 CalPrmSsmEng_SWORD 0 A42 -327.68 327.67 SYMBOL_LINK "CalPrmSsmEng01.SSM_S16_HSA_MIN_SLOPE_FORWARD" 0 /end CHARACTERISTIC
/begin CHARACTERISTIC SSM_S16_HSA_MIN_SLOPE_REVERSE "" VALUE 0x8003A6E6 CalPrmSsmEng_SWORD 0 A42 -327.68 327.67 SYMBOL_LINK "CalPrmSsmEng01.SSM_S16_HSA_MIN_SLOPE_REVERSE" 0 /end CHARACTERISTIC
/begin CHARACTERISTIC SSM_S16_HSA_RISE_PRESS "" VALUE 0x8003A716 CalPrmSsmEng_SWORD 0 P34 -3276.8 3276.7 SYMBOL_LINK "CalPrmSsmEng01.SSM_S16_HSA_RISE_PRESS" 0 /end CHARACTERISTIC
/begin CHARACTERISTIC SSM_S16_HSA_RISE_TIME "" VALUE 0x8003A714 CalPrmSsmEng_SWORD 0 Ti21 -327.68 327.67 SYMBOL_LINK "CalPrmSsmEng01.SSM_S16_HSA_RISE_TIME" 0 /end CHARACTERISTIC
/begin CHARACTERISTIC SSM_S16_HSA_RISE_WL_SPD_TH "" VALUE 0x8003A710 CalPrmSsmEng_SWORD 0 Spd12 -4096 4095.875 SYMBOL_LINK "CalPrmSsmEng01.SSM_S16_HSA_RISE_WL_SPD_TH" 0 /end CHARACTERISTIC
/begin CHARACTERISTIC SSM_S16_HSA_STOP_ON_HILL_MIN_SPD "" VALUE 0x8003A6EE CalPrmSsmEng_SWORD 0 Spd12 -4096 4095.875 SYMBOL_LINK "CalPrmSsmEng01.SSM_S16_HSA_STOP_ON_HILL_MIN_SPD" 0 /end CHARACTERISTIC
/begin CHARACTERISTIC SSM_S16_HSA_TEMP_1 "" VALUE 0x8003A71C CalPrmSsmEng_SWORD 0 Fac31 -32768 32767 SYMBOL_LINK "CalPrmSsmEng01.SSM_S16_HSA_TEMP_1" 0 /end CHARACTERISTIC
/begin CHARACTERISTIC SSM_S16_HSA_TEMP_2 "" VALUE 0x8003A71E CalPrmSsmEng_SWORD 0 Fac31 -32768 32767 SYMBOL_LINK "CalPrmSsmEng01.SSM_S16_HSA_TEMP_2" 0 /end CHARACTERISTIC
/begin CHARACTERISTIC SSM_S16_HSA_T_P_TEMP_1 "" VALUE 0x8003A722 CalPrmSsmEng_SWORD 0 Fac31 -32768 32767 SYMBOL_LINK "CalPrmSsmEng01.SSM_S16_HSA_T_P_TEMP_1" 0 /end CHARACTERISTIC
/begin CHARACTERISTIC SSM_S16_HSA_T_P_TEMP_10 "" VALUE 0x8003A724 CalPrmSsmEng_SWORD 0 Fac31 -32768 32767 SYMBOL_LINK "CalPrmSsmEng01.SSM_S16_HSA_T_P_TEMP_10" 0 /end CHARACTERISTIC
/begin CHARACTERISTIC SSM_S16_HSA_T_P_TEMP_2 "" VALUE 0x8003A726 CalPrmSsmEng_SWORD 0 Fac31 -32768 32767 SYMBOL_LINK "CalPrmSsmEng01.SSM_S16_HSA_T_P_TEMP_2" 0 /end CHARACTERISTIC
/begin CHARACTERISTIC SSM_S16_HSA_T_P_TEMP_3 "" VALUE 0x8003A728 CalPrmSsmEng_SWORD 0 Fac31 -32768 32767 SYMBOL_LINK "CalPrmSsmEng01.SSM_S16_HSA_T_P_TEMP_3" 0 /end CHARACTERISTIC
/begin CHARACTERISTIC SSM_S16_HSA_T_P_TEMP_4 "" VALUE 0x8003A72A CalPrmSsmEng_SWORD 0 Fac31 -32768 32767 SYMBOL_LINK "CalPrmSsmEng01.SSM_S16_HSA_T_P_TEMP_4" 0 /end CHARACTERISTIC
/begin CHARACTERISTIC SSM_S16_HSA_T_P_TEMP_5 "" VALUE 0x8003A72C CalPrmSsmEng_SWORD 0 Fac31 -32768 32767 SYMBOL_LINK "CalPrmSsmEng01.SSM_S16_HSA_T_P_TEMP_5" 0 /end CHARACTERISTIC
/begin CHARACTERISTIC SSM_S16_HSA_T_P_TEMP_6 "" VALUE 0x8003A72E CalPrmSsmEng_SWORD 0 Fac31 -32768 32767 SYMBOL_LINK "CalPrmSsmEng01.SSM_S16_HSA_T_P_TEMP_6" 0 /end CHARACTERISTIC
/begin CHARACTERISTIC SSM_S16_HSA_T_P_TEMP_7 "" VALUE 0x8003A730 CalPrmSsmEng_SWORD 0 Fac31 -32768 32767 SYMBOL_LINK "CalPrmSsmEng01.SSM_S16_HSA_T_P_TEMP_7" 0 /end CHARACTERISTIC
/begin CHARACTERISTIC SSM_S16_HSA_T_P_TEMP_8 "" VALUE 0x8003A732 CalPrmSsmEng_SWORD 0 Fac31 -32768 32767 SYMBOL_LINK "CalPrmSsmEng01.SSM_S16_HSA_T_P_TEMP_8" 0 /end CHARACTERISTIC
/begin CHARACTERISTIC SSM_S16_HSA_T_P_TEMP_9 "" VALUE 0x8003A734 CalPrmSsmEng_SWORD 0 Fac31 -32768 32767 SYMBOL_LINK "CalPrmSsmEng01.SSM_S16_HSA_T_P_TEMP_9" 0 /end CHARACTERISTIC
/begin CHARACTERISTIC SSM_S16_HSA_c_MaxLongG "" VALUE 0x8003A6E8 CalPrmSsmEng_SWORD 0 A42 -327.68 327.67 SYMBOL_LINK "CalPrmSsmEng01.SSM_S16_HSA_c_MaxLongG" 0 /end CHARACTERISTIC
/begin CHARACTERISTIC SSM_S16_ISG_End_RPM_Th "" VALUE 0x8003A736 CalPrmSsmEng_SWORD 0 N10 -32768 32767 SYMBOL_LINK "CalPrmSsmEng01.SSM_S16_ISG_End_RPM_Th" 0 /end CHARACTERISTIC
/begin CHARACTERISTIC SSM_S8_ISG_HSA_ON_AX_TH_GEAR_D "" VALUE 0x8003A738 CalPrmSsmEng_SBYTE 0 A42 -1.28 1.27 SYMBOL_LINK "CalPrmSsmEng01.SSM_S8_ISG_HSA_ON_AX_TH_GEAR_D" 0 /end CHARACTERISTIC
/begin CHARACTERISTIC SSM_U8_HSA_AutoStart_delay_time "" VALUE 0x8003A73B CalPrmSsmEng_UBYTE 0 Ti21 0 2.55 SYMBOL_LINK "CalPrmSsmEng01.SSM_U8_HSA_AutoStart_delay_time" 0 /end CHARACTERISTIC
/begin CHARACTERISTIC SSM_U8_HSA_DCT_OVERLOAD_RISE_NUM "" VALUE 0x8003A718 CalPrmSsmEng_UBYTE 0 Nr2 0 255 SYMBOL_LINK "CalPrmSsmEng01.SSM_U8_HSA_DCT_OVERLOAD_RISE_NUM" 0 /end CHARACTERISTIC
/begin CHARACTERISTIC SSM_U8_HSA_Disable "" VALUE 0x8003A70E CalPrmSsmEng_UBYTE 0 OnOff1 0 255 SYMBOL_LINK "CalPrmSsmEng01.SSM_U8_HSA_Disable" 0 /end CHARACTERISTIC
/begin CHARACTERISTIC SSM_U8_HSA_FAST_EXIT_MTP_TH "" VALUE 0x8003A6FB CalPrmSsmEng_UBYTE 0 Perc6 0 255 SYMBOL_LINK "CalPrmSsmEng01.SSM_U8_HSA_FAST_EXIT_MTP_TH" 0 /end CHARACTERISTIC
/begin CHARACTERISTIC SSM_U8_HSA_HOLDTIME_HIGHMED_HILL "" VALUE 0x8003A6F1 CalPrmSsmEng_UBYTE 0 A42 0 2.55 SYMBOL_LINK "CalPrmSsmEng01.SSM_U8_HSA_HOLDTIME_HIGHMED_HILL" 0 /end CHARACTERISTIC
/begin CHARACTERISTIC SSM_U8_HSA_HOLDTIME_LOWMED_HILL "" VALUE 0x8003A6F2 CalPrmSsmEng_UBYTE 0 A42 0 2.55 SYMBOL_LINK "CalPrmSsmEng01.SSM_U8_HSA_HOLDTIME_LOWMED_HILL" 0 /end CHARACTERISTIC
/begin CHARACTERISTIC SSM_U8_HSA_HighMedLongG "" VALUE 0x8003A6FC CalPrmSsmEng_UBYTE 0 A42 0 2.55 SYMBOL_LINK "CalPrmSsmEng01.SSM_U8_HSA_HighMedLongG" 0 /end CHARACTERISTIC
/begin CHARACTERISTIC SSM_U8_HSA_INDICATION_ON_AX_TH "" VALUE 0x8003A719 CalPrmSsmEng_UBYTE 0 A42 0 2.55 SYMBOL_LINK "CalPrmSsmEng01.SSM_U8_HSA_INDICATION_ON_AX_TH" 0 /end CHARACTERISTIC
/begin CHARACTERISTIC SSM_U8_HSA_LowMedLongG "" VALUE 0x8003A6FD CalPrmSsmEng_UBYTE 0 A42 0 2.55 SYMBOL_LINK "CalPrmSsmEng01.SSM_U8_HSA_LowMedLongG" 0 /end CHARACTERISTIC
/begin CHARACTERISTIC SSM_U8_HSA_MAX_HOLDTIME_1 "" VALUE 0x8003A6F3 CalPrmSsmEng_UBYTE 0 Ti21 0 2.55 SYMBOL_LINK "CalPrmSsmEng01.SSM_U8_HSA_MAX_HOLDTIME_1" 0 /end CHARACTERISTIC
/begin CHARACTERISTIC SSM_U8_HSA_MAX_HOLDTIME_2 "" VALUE 0x8003A6F4 CalPrmSsmEng_UBYTE 0 Ti21 0 2.55 SYMBOL_LINK "CalPrmSsmEng01.SSM_U8_HSA_MAX_HOLDTIME_2" 0 /end CHARACTERISTIC
/begin CHARACTERISTIC SSM_U8_HSA_MAX_HOLDTIME_3 "" VALUE 0x8003A6F5 CalPrmSsmEng_UBYTE 0 Ti21 0 2.55 SYMBOL_LINK "CalPrmSsmEng01.SSM_U8_HSA_MAX_HOLDTIME_3" 0 /end CHARACTERISTIC
/begin CHARACTERISTIC SSM_U8_HSA_MAX_HOLDTIME_4 "" VALUE 0x8003A6F6 CalPrmSsmEng_UBYTE 0 Ti21 0 2.55 SYMBOL_LINK "CalPrmSsmEng01.SSM_U8_HSA_MAX_HOLDTIME_4" 0 /end CHARACTERISTIC
/begin CHARACTERISTIC SSM_U8_HSA_MAX_HOLDTIME_RVS_1 "" VALUE 0x8003A6F7 CalPrmSsmEng_UBYTE 0 Ti21 0 2.55 SYMBOL_LINK "CalPrmSsmEng01.SSM_U8_HSA_MAX_HOLDTIME_RVS_1" 0 /end CHARACTERISTIC
/begin CHARACTERISTIC SSM_U8_HSA_MAX_HOLDTIME_RVS_2 "" VALUE 0x8003A6F8 CalPrmSsmEng_UBYTE 0 Ti21 0 2.55 SYMBOL_LINK "CalPrmSsmEng01.SSM_U8_HSA_MAX_HOLDTIME_RVS_2" 0 /end CHARACTERISTIC
/begin CHARACTERISTIC SSM_U8_HSA_MAX_HOLDTIME_RVS_3 "" VALUE 0x8003A6F9 CalPrmSsmEng_UBYTE 0 Ti21 0 2.55 SYMBOL_LINK "CalPrmSsmEng01.SSM_U8_HSA_MAX_HOLDTIME_RVS_3" 0 /end CHARACTERISTIC
/begin CHARACTERISTIC SSM_U8_HSA_MAX_HOLDTIME_RVS_4 "" VALUE 0x8003A6FA CalPrmSsmEng_UBYTE 0 Ti21 0 2.55 SYMBOL_LINK "CalPrmSsmEng01.SSM_U8_HSA_MAX_HOLDTIME_RVS_4" 0 /end CHARACTERISTIC
/begin CHARACTERISTIC SSM_U8_HSA_ONHILL_SET_REF_AX_OK_T "" VALUE 0x8003A71A CalPrmSsmEng_UBYTE 0 Ti21 0 2.55 SYMBOL_LINK "CalPrmSsmEng01.SSM_U8_HSA_ONHILL_SET_REF_AX_OK_T" 0 /end CHARACTERISTIC
/begin CHARACTERISTIC SSM_U8_HSA_RELEASE_TIME_DEFAULT "" VALUE 0x8003A701 CalPrmSsmEng_UBYTE 0 Ti41 0 1.275 SYMBOL_LINK "CalPrmSsmEng01.SSM_U8_HSA_RELEASE_TIME_DEFAULT" 0 /end CHARACTERISTIC
/begin CHARACTERISTIC SSM_U8_HSA_RELEASE_TIME_NOT_HILL "" VALUE 0x8003A6FE CalPrmSsmEng_UBYTE 0 Ti41 0 1.275 SYMBOL_LINK "CalPrmSsmEng01.SSM_U8_HSA_RELEASE_TIME_NOT_HILL" 0 /end CHARACTERISTIC
/begin CHARACTERISTIC SSM_U8_HSA_RELEASE_TIME_PB_ACTIVE "" VALUE 0x8003A6FF CalPrmSsmEng_UBYTE 0 Ti41 0 1.275 SYMBOL_LINK "CalPrmSsmEng01.SSM_U8_HSA_RELEASE_TIME_PB_ACTIVE" 0 /end CHARACTERISTIC
/begin CHARACTERISTIC SSM_U8_HSA_RELEASE_TIME_UNLATCHED "" VALUE 0x8003A700 CalPrmSsmEng_UBYTE 0 Ti41 0 1.275 SYMBOL_LINK "CalPrmSsmEng01.SSM_U8_HSA_RELEASE_TIME_UNLATCHED" 0 /end CHARACTERISTIC
/begin CHARACTERISTIC SSM_U8_HSA_RISE_ENABLE "" VALUE 0x8003A70F CalPrmSsmEng_UBYTE 0 OnOff1 0 255 SYMBOL_LINK "CalPrmSsmEng01.SSM_U8_HSA_RISE_ENABLE" 0 /end CHARACTERISTIC
/begin CHARACTERISTIC SSM_U8_HSA_RISE_NUM_OF_WL "" VALUE 0x8003A712 CalPrmSsmEng_UBYTE 0 Nr2 0 255 SYMBOL_LINK "CalPrmSsmEng01.SSM_U8_HSA_RISE_NUM_OF_WL" 0 /end CHARACTERISTIC
/begin CHARACTERISTIC SSM_U8_HSA_TEMP_3 "" VALUE 0x8003A720 CalPrmSsmEng_UBYTE 0 Fac31 0 255 SYMBOL_LINK "CalPrmSsmEng01.SSM_U8_HSA_TEMP_3" 0 /end CHARACTERISTIC
/begin CHARACTERISTIC SSM_U8_ISG_End_RPM_OK_delay_time "" VALUE 0x8003A739 CalPrmSsmEng_UBYTE 0 Ti21 0 2.55 SYMBOL_LINK "CalPrmSsmEng01.SSM_U8_ISG_End_RPM_OK_delay_time" 0 /end CHARACTERISTIC
/begin CHARACTERISTIC SSM_U8_ISG_ON_MAX_SLOP_HOLD_PRESS "" VALUE 0x8003A73A CalPrmSsmEng_UBYTE 0 P34 0 25.5 SYMBOL_LINK "CalPrmSsmEng01.SSM_U8_ISG_ON_MAX_SLOP_HOLD_PRESS" 0 /end CHARACTERISTIC
/begin CHARACTERISTIC SSM_U8_MPlessHSA_ENTER_SPD_OK_TIME "" VALUE 0x8003A6F0 CalPrmSsmEng_UBYTE 0 Ti21 0 2.55 SYMBOL_LINK "CalPrmSsmEng01.SSM_U8_MPlessHSA_ENTER_SPD_OK_TIME" 0 /end CHARACTERISTIC
/begin CHARACTERISTIC TP_S16TCSCpADDTh4ESC "" VALUE 0x8003A17E CalPrmWspcEng_SWORD 0 Spd12 -4096 4095.875 SYMBOL_LINK "CalPrmWspcEng01.TP_S16TCSCpADDTh4ESC" 0 /end CHARACTERISTIC
/begin CHARACTERISTIC TP_S16TCSCpADDTh4RTA "" VALUE 0x8003A182 CalPrmWspcEng_SWORD 0 Spd12 -4096 4095.875 SYMBOL_LINK "CalPrmWspcEng01.TP_S16TCSCpADDTh4RTA" 0 /end CHARACTERISTIC
/begin CHARACTERISTIC TP_S16TCSCpADDTh4RoughRoad "" VALUE 0x8003A180 CalPrmWspcEng_SWORD 0 Spd12 -4096 4095.875 SYMBOL_LINK "CalPrmWspcEng01.TP_S16TCSCpADDTh4RoughRoad" 0 /end CHARACTERISTIC
/begin CHARACTERISTIC TP_S16TCSCpFadeOutCtrlHghPreTunTh_RA "" VALUE 0x8003A1D8 CalPrmWspcEng_SWORD 0 P34 -3276.8 3276.7 SYMBOL_LINK "CalPrmWspcEng01.TP_S16TCSCpFadeOutCtrlHghPreTunTh_RA" 0 /end CHARACTERISTIC
/begin CHARACTERISTIC TP_S16TCSCpFadeOutCtrlLowPreTunTh_RA "" VALUE 0x8003A1E0 CalPrmWspcEng_SWORD 0 P34 -3276.8 3276.7 SYMBOL_LINK "CalPrmWspcEng01.TP_S16TCSCpFadeOutCtrlLowPreTunTh_RA" 0 /end CHARACTERISTIC
/begin CHARACTERISTIC TP_S16TCSCpFadeOutDecTQ4HghPreTurn_RA "" VALUE 0x8003A1E8 CalPrmWspcEng_SWORD 0 TqGrdt10 -32768 32767 SYMBOL_LINK "CalPrmWspcEng01.TP_S16TCSCpFadeOutDecTQ4HghPreTurn_RA" 0 /end CHARACTERISTIC
/begin CHARACTERISTIC TP_S16TCSCpFadeOutDecTQ4LowPreTurn_RA "" VALUE 0x8003A1F0 CalPrmWspcEng_SWORD 0 TqGrdt10 -32768 32767 SYMBOL_LINK "CalPrmWspcEng01.TP_S16TCSCpFadeOutDecTQ4LowPreTurn_RA" 0 /end CHARACTERISTIC
/begin CHARACTERISTIC TP_S16_CBC_COMP_MAX_DEL_YAW "reference del yaw for S16_CBC_COMP_MAX_PRESS(default : 3)" VALUE 0x8002076C CalPrmWslcBrk_SWORD 0 AgSpd31 -327.68 327.67 SYMBOL_LINK "CalPrmWslcBrk01.TP_S16_CBC_COMP_MAX_DEL_YAW" 0 /end CHARACTERISTIC
/begin CHARACTERISTIC TP_S16_CBC_COMP_MAX_PRESS "Additional pressure to reduce target pressure at max del yaw" VALUE 0x8002076E CalPrmWslcBrk_SWORD 0 P34 -3276.8 3276.7 SYMBOL_LINK "CalPrmWslcBrk01.TP_S16_CBC_COMP_MAX_PRESS" 0 /end CHARACTERISTIC
/begin CHARACTERISTIC TP_S16_CBC_COMP_MIN_DEL_YAW "reference del yaw for S16_CBC_COMP_MIN_PRESS(default : 2)" VALUE 0x80020770 CalPrmWslcBrk_SWORD 0 AgSpd31 -327.68 327.67 SYMBOL_LINK "CalPrmWslcBrk01.TP_S16_CBC_COMP_MIN_DEL_YAW" 0 /end CHARACTERISTIC
/begin CHARACTERISTIC TP_S16_CBC_COMP_MIN_PRESS "Additional pressure to reduce target pressure at min del yaw" VALUE 0x80020772 CalPrmWslcBrk_SWORD 0 P34 -3276.8 3276.7 SYMBOL_LINK "CalPrmWslcBrk01.TP_S16_CBC_COMP_MIN_PRESS" 0 /end CHARACTERISTIC
/begin CHARACTERISTIC TP_S16_CBC_DELTA_PRESS_ALAT_H_Spd_H "Rear delta pressure at high Ay level and high speed" VALUE 0x80020774 CalPrmWslcBrk_SWORD 0 P34 -3276.8 3276.7 SYMBOL_LINK "CalPrmWslcBrk01.TP_S16_CBC_DELTA_PRESS_ALAT_H_Spd_H" 0 /end CHARACTERISTIC
/begin CHARACTERISTIC TP_S16_CBC_DELTA_PRESS_ALAT_H_Spd_M "Rear delta pressure at high Ay level and middle speed" VALUE 0x80020776 CalPrmWslcBrk_SWORD 0 P34 -3276.8 3276.7 SYMBOL_LINK "CalPrmWslcBrk01.TP_S16_CBC_DELTA_PRESS_ALAT_H_Spd_M" 0 /end CHARACTERISTIC
/begin CHARACTERISTIC TP_S16_CBC_DELTA_PRESS_ALAT_H_Spd_S "Rear delta pressure at high Ay level and low speed" VALUE 0x80020778 CalPrmWslcBrk_SWORD 0 P34 -3276.8 3276.7 SYMBOL_LINK "CalPrmWslcBrk01.TP_S16_CBC_DELTA_PRESS_ALAT_H_Spd_S" 0 /end CHARACTERISTIC
/begin CHARACTERISTIC TP_S16_CBC_DELTA_PRESS_ALAT_M_Spd_H "Rear delta pressure at middle Ay level and high speed" VALUE 0x8002077A CalPrmWslcBrk_SWORD 0 P34 -3276.8 3276.7 SYMBOL_LINK "CalPrmWslcBrk01.TP_S16_CBC_DELTA_PRESS_ALAT_M_Spd_H" 0 /end CHARACTERISTIC
/begin CHARACTERISTIC TP_S16_CBC_DELTA_PRESS_ALAT_M_Spd_M "Rear delta pressure at middle Ay level and middle speed" VALUE 0x8002077C CalPrmWslcBrk_SWORD 0 P34 -3276.8 3276.7 SYMBOL_LINK "CalPrmWslcBrk01.TP_S16_CBC_DELTA_PRESS_ALAT_M_Spd_M" 0 /end CHARACTERISTIC
/begin CHARACTERISTIC TP_S16_CBC_DELTA_PRESS_ALAT_M_Spd_S "Rear delta pressure at middle Ay level and low speed" VALUE 0x8002077E CalPrmWslcBrk_SWORD 0 P34 -3276.8 3276.7 SYMBOL_LINK "CalPrmWslcBrk01.TP_S16_CBC_DELTA_PRESS_ALAT_M_Spd_S" 0 /end CHARACTERISTIC
/begin CHARACTERISTIC TP_S16_CBC_DELTA_PRESS_ALAT_S_Spd_H "Rear delta pressure at small Ay level and high speed" VALUE 0x80020780 CalPrmWslcBrk_SWORD 0 P34 -3276.8 3276.7 SYMBOL_LINK "CalPrmWslcBrk01.TP_S16_CBC_DELTA_PRESS_ALAT_S_Spd_H" 0 /end CHARACTERISTIC
/begin CHARACTERISTIC TP_S16_CBC_DELTA_PRESS_ALAT_S_Spd_M "Rear delta pressure at small Ay level and middle speed" VALUE 0x80020782 CalPrmWslcBrk_SWORD 0 P34 -3276.8 3276.7 SYMBOL_LINK "CalPrmWslcBrk01.TP_S16_CBC_DELTA_PRESS_ALAT_S_Spd_M" 0 /end CHARACTERISTIC
/begin CHARACTERISTIC TP_S16_CBC_DELTA_PRESS_ALAT_S_Spd_S "Rear delta pressure at small Ay level and low speed" VALUE 0x80020784 CalPrmWslcBrk_SWORD 0 P34 -3276.8 3276.7 SYMBOL_LINK "CalPrmWslcBrk01.TP_S16_CBC_DELTA_PRESS_ALAT_S_Spd_S" 0 /end CHARACTERISTIC
/begin CHARACTERISTIC TP_S16_CBC_DELTA_PRES_MAX_DUMP "Minimum pressure difference for full dump" VALUE 0x80020786 CalPrmWslcBrk_SWORD 0 P34 -3276.8 3276.7 SYMBOL_LINK "CalPrmWslcBrk01.TP_S16_CBC_DELTA_PRES_MAX_DUMP" 0 /end CHARACTERISTIC
/begin CHARACTERISTIC TP_S16_CBC_DELTA_PRES_MAX_DUMP_ABS "Minimum pressure difference for full dump" VALUE 0x800206FC CalPrmWslcBrk_SWORD 0 P34 -3276.8 3276.7 SYMBOL_LINK "CalPrmWslcBrk01.TP_S16_CBC_DELTA_PRES_MAX_DUMP_ABS" 0 /end CHARACTERISTIC
/begin CHARACTERISTIC TP_S16_CBC_DELTA_PRES_MAX_RISE "Minimum pressure difference for full rise" VALUE 0x80020788 CalPrmWslcBrk_SWORD 0 P34 -3276.8 3276.7 SYMBOL_LINK "CalPrmWslcBrk01.TP_S16_CBC_DELTA_PRES_MAX_RISE" 0 /end CHARACTERISTIC
/begin CHARACTERISTIC TP_S16_CBC_DELTA_PRES_MAX_RISE_ABS "Minimum pressure difference for full rise" VALUE 0x800206FE CalPrmWslcBrk_SWORD 0 P34 -3276.8 3276.7 SYMBOL_LINK "CalPrmWslcBrk01.TP_S16_CBC_DELTA_PRES_MAX_RISE_ABS" 0 /end CHARACTERISTIC
/begin CHARACTERISTIC TP_S16_CBC_FADE_OUT_HOLD_SCAN_ABS "Hold scan for pulse up rise at fade out mode" VALUE 0x80020706 CalPrmWslcBrk_SWORD 0 Gain -32768 32767 SYMBOL_LINK "CalPrmWslcBrk01.TP_S16_CBC_FADE_OUT_HOLD_SCAN_ABS" 0 /end CHARACTERISTIC
/begin CHARACTERISTIC TP_S16_CBC_FADE_OUT_TIME_ABS "Time length for fade out mode after CBC reset" VALUE 0x80020708 CalPrmWslcBrk_SWORD 0 Ti21 -327.68 327.67 SYMBOL_LINK "CalPrmWslcBrk01.TP_S16_CBC_FADE_OUT_TIME_ABS" 0 /end CHARACTERISTIC
/begin CHARACTERISTIC TP_S16_Decel_Gain_HMu_100_150kph_R "Decel Gain, High Mu Detect, 100-150kph, Decel State, Rear wheels" VALUE 0x80020338 CalPrmWslcBrk_SWORD 0 Gain -32768 32767 SYMBOL_LINK "CalPrmWslcBrk01.TP_S16_Decel_Gain_HMu_100_150kph_R" 0 /end CHARACTERISTIC
/begin CHARACTERISTIC TP_S16_Decel_Gain_HMu_10_20kph_R "Decel Gain, High Mu Detect, 10-20kph, Decel State, Rear Wheels" VALUE 0x8002033A CalPrmWslcBrk_SWORD 0 Gain -32768 32767 SYMBOL_LINK "CalPrmWslcBrk01.TP_S16_Decel_Gain_HMu_10_20kph_R" 0 /end CHARACTERISTIC
/begin CHARACTERISTIC TP_S16_Decel_Gain_HMu_20_40kph_R "Decel Gain, High Mu Detect, 20-40kph, Decel State, Rear Wheels" VALUE 0x8002033C CalPrmWslcBrk_SWORD 0 Gain -32768 32767 SYMBOL_LINK "CalPrmWslcBrk01.TP_S16_Decel_Gain_HMu_20_40kph_R" 0 /end CHARACTERISTIC
/begin CHARACTERISTIC TP_S16_Decel_Gain_HMu_40_60kph_R "Decel Gain, High Mu Detect, 40-60kph, Decel State, Rear Wheels" VALUE 0x8002033E CalPrmWslcBrk_SWORD 0 Gain -32768 32767 SYMBOL_LINK "CalPrmWslcBrk01.TP_S16_Decel_Gain_HMu_40_60kph_R" 0 /end CHARACTERISTIC
/begin CHARACTERISTIC TP_S16_Decel_Gain_HMu_60_100kph_R "Decel Gain, High Mu Detect, 60-100kph, Decel State, Rear Wheels" VALUE 0x80020340 CalPrmWslcBrk_SWORD 0 Gain -32768 32767 SYMBOL_LINK "CalPrmWslcBrk01.TP_S16_Decel_Gain_HMu_60_100kph_R" 0 /end CHARACTERISTIC
/begin CHARACTERISTIC TP_S16_Decel_Gain_HMu_Ab_150kph_R "Decel Gain, High Mu Detect, Above 150kph, Decel State, Rear Wheels" VALUE 0x80020342 CalPrmWslcBrk_SWORD 0 Gain -32768 32767 SYMBOL_LINK "CalPrmWslcBrk01.TP_S16_Decel_Gain_HMu_Ab_150kph_R" 0 /end CHARACTERISTIC
/begin CHARACTERISTIC TP_S16_Decel_Gain_HMu_B_10kph_R "Decel Gain, High Mu Detect, Below 10kph, Decel State, Rear Wheels" VALUE 0x80020344 CalPrmWslcBrk_SWORD 0 Gain -32768 32767 SYMBOL_LINK "CalPrmWslcBrk01.TP_S16_Decel_Gain_HMu_B_10kph_R" 0 /end CHARACTERISTIC
/begin CHARACTERISTIC TP_S16_Decel_Gain_MMu_100_150kph_F "Decel Gain, Medium Mu Detect, 100-150kph, Decel State, Front wheels" VALUE 0x80020354 CalPrmWslcBrk_SWORD 0 Gain -32768 32767 SYMBOL_LINK "CalPrmWslcBrk01.TP_S16_Decel_Gain_MMu_100_150kph_F" 0 /end CHARACTERISTIC
/begin CHARACTERISTIC TP_S16_Decel_Gain_MMu_10_20kph_F "Decel Gain, Medium Mu Detect, 10-20kph, Decel State, Front wheels" VALUE 0x80020356 CalPrmWslcBrk_SWORD 0 Gain -32768 32767 SYMBOL_LINK "CalPrmWslcBrk01.TP_S16_Decel_Gain_MMu_10_20kph_F" 0 /end CHARACTERISTIC
/begin CHARACTERISTIC TP_S16_Decel_Gain_MMu_20_40kph_F "Decel Gain, Medium Mu Detect, 20-40kph, Decel State, Front wheels" VALUE 0x80020358 CalPrmWslcBrk_SWORD 0 Gain -32768 32767 SYMBOL_LINK "CalPrmWslcBrk01.TP_S16_Decel_Gain_MMu_20_40kph_F" 0 /end CHARACTERISTIC
/begin CHARACTERISTIC TP_S16_Decel_Gain_MMu_40_60kph_F "Decel Gain, Medium Mu Detect, 40-60kph, Decel State, Front wheels" VALUE 0x8002035A CalPrmWslcBrk_SWORD 0 Gain -32768 32767 SYMBOL_LINK "CalPrmWslcBrk01.TP_S16_Decel_Gain_MMu_40_60kph_F" 0 /end CHARACTERISTIC
/begin CHARACTERISTIC TP_S16_Decel_Gain_MMu_60_100kph_F "Decel Gain, Medium Mu Detect, 60-100kph, Decel State, Front wheels" VALUE 0x8002035C CalPrmWslcBrk_SWORD 0 Gain -32768 32767 SYMBOL_LINK "CalPrmWslcBrk01.TP_S16_Decel_Gain_MMu_60_100kph_F" 0 /end CHARACTERISTIC
/begin CHARACTERISTIC TP_S16_Decel_Gain_MMu_Ab_150kph_F "Decel Gain, Medium Mu Detect, Above 150kph, Decel State, Front wheels" VALUE 0x8002035E CalPrmWslcBrk_SWORD 0 Gain -32768 32767 SYMBOL_LINK "CalPrmWslcBrk01.TP_S16_Decel_Gain_MMu_Ab_150kph_F" 0 /end CHARACTERISTIC
/begin CHARACTERISTIC TP_S16_Decel_Gain_MMu_B_10kph_F "Decel Gain, Medium Mu Detect, Below 10kph, Decel State, Front wheels" VALUE 0x80020360 CalPrmWslcBrk_SWORD 0 Gain -32768 32767 SYMBOL_LINK "CalPrmWslcBrk01.TP_S16_Decel_Gain_MMu_B_10kph_F" 0 /end CHARACTERISTIC
/begin CHARACTERISTIC TP_S16_EBD_KNEE_POINT "EBD cut-in point, Master pressure" VALUE 0x800206DE CalPrmWslcBrk_SWORD 0 P34 -3276.8 3276.7 SYMBOL_LINK "CalPrmWslcBrk01.TP_S16_EBD_KNEE_POINT" 0 /end CHARACTERISTIC
/begin CHARACTERISTIC TP_S16_FRNT_GMA_STB_DMP_THR_YDF_B_L "Front Yaw-Dump factor threshold below low speed during GMA pulse up (default : 400). If Yaw-Dump Factor is bigger than this value, stable dump is applied" VALUE 0x80020532 CalPrmWslcBrk_SWORD 0 Gain -32768 32767 SYMBOL_LINK "CalPrmWslcBrk01.TP_S16_FRNT_GMA_STB_DMP_THR_YDF_B_L" 0 /end CHARACTERISTIC
/begin CHARACTERISTIC TP_S16_FRNT_GMA_STB_DMP_THR_YDF_H "Front Yaw-Dump factor threshold above high speed during GMA pulse up (default : 300). If Yaw-Dump Factor is bigger than this value, stable dump is applied" VALUE 0x80020534 CalPrmWslcBrk_SWORD 0 Gain -32768 32767 SYMBOL_LINK "CalPrmWslcBrk01.TP_S16_FRNT_GMA_STB_DMP_THR_YDF_H" 0 /end CHARACTERISTIC
/begin CHARACTERISTIC TP_S16_FRNT_GMA_STB_DMP_THR_YDF_L "Front Yaw-Dump factor threshold above low speed during GMA pulse up (default : 400). If Yaw-Dump Factor is bigger than this value, stable dump is applied" VALUE 0x80020536 CalPrmWslcBrk_SWORD 0 Gain -32768 32767 SYMBOL_LINK "CalPrmWslcBrk01.TP_S16_FRNT_GMA_STB_DMP_THR_YDF_L" 0 /end CHARACTERISTIC
/begin CHARACTERISTIC TP_S16_FRNT_GMA_STB_DMP_THR_YDF_M "Front Yaw-Dump factor threshold above med speed during GMA pulse up (default : 300). If Yaw-Dump Factor is bigger than this value, stable dump is applied" VALUE 0x80020538 CalPrmWslcBrk_SWORD 0 Gain -32768 32767 SYMBOL_LINK "CalPrmWslcBrk01.TP_S16_FRNT_GMA_STB_DMP_THR_YDF_M" 0 /end CHARACTERISTIC
/begin CHARACTERISTIC TP_S16_HDF_REF_MMu_40_60kph_R "HDF reference, condition for special 1st cycle dump" VALUE 0x800205C8 CalPrmWslcBrk_SWORD 0 Gain -32768 32767 SYMBOL_LINK "CalPrmWslcBrk01.TP_S16_HDF_REF_MMu_40_60kph_R" 0 /end CHARACTERISTIC
/begin CHARACTERISTIC TP_S16_HDF_REF_MMu_Ab_60kph_R "HDF reference, condition for special 1st cycle dump" VALUE 0x800205CA CalPrmWslcBrk_SWORD 0 Gain -32768 32767 SYMBOL_LINK "CalPrmWslcBrk01.TP_S16_HDF_REF_MMu_Ab_60kph_R" 0 /end CHARACTERISTIC
/begin CHARACTERISTIC TP_S16_HDF_REF_MMu_B_40kph_R "HDF reference, condition for special 1st cycle dump" VALUE 0x800205CC CalPrmWslcBrk_SWORD 0 Gain -32768 32767 SYMBOL_LINK "CalPrmWslcBrk01.TP_S16_HDF_REF_MMu_B_40kph_R" 0 /end CHARACTERISTIC
/begin CHARACTERISTIC TP_S16_Slip_Gain_HMu_100_150kph_R "Slip Gain, High Mu Detect, 100-150kph, Decel State, Rear Wheels" VALUE 0x80020346 CalPrmWslcBrk_SWORD 0 Gain -32768 32767 SYMBOL_LINK "CalPrmWslcBrk01.TP_S16_Slip_Gain_HMu_100_150kph_R" 0 /end CHARACTERISTIC
/begin CHARACTERISTIC TP_S16_Slip_Gain_HMu_10_20kph_R "Slip Gain, High Mu Detect, 10-20kph, Decel State, Rear Wheels" VALUE 0x80020348 CalPrmWslcBrk_SWORD 0 Gain -32768 32767 SYMBOL_LINK "CalPrmWslcBrk01.TP_S16_Slip_Gain_HMu_10_20kph_R" 0 /end CHARACTERISTIC
/begin CHARACTERISTIC TP_S16_Slip_Gain_HMu_20_40kph_R "Slip Gain, High Mu Detect, 20-40kph, Decel State,Rear Wheels" VALUE 0x8002034A CalPrmWslcBrk_SWORD 0 Gain -32768 32767 SYMBOL_LINK "CalPrmWslcBrk01.TP_S16_Slip_Gain_HMu_20_40kph_R" 0 /end CHARACTERISTIC
/begin CHARACTERISTIC TP_S16_Slip_Gain_HMu_40_60kph_R "Slip Gain, High Mu Detect, 40-60kph, Decel State, Rear Wheels" VALUE 0x8002034C CalPrmWslcBrk_SWORD 0 Gain -32768 32767 SYMBOL_LINK "CalPrmWslcBrk01.TP_S16_Slip_Gain_HMu_40_60kph_R" 0 /end CHARACTERISTIC
/begin CHARACTERISTIC TP_S16_Slip_Gain_HMu_60_100kph_R "Slip Gain, High Mu Detect, 60-100kph, Decel State, Rear Wheels" VALUE 0x8002034E CalPrmWslcBrk_SWORD 0 Gain -32768 32767 SYMBOL_LINK "CalPrmWslcBrk01.TP_S16_Slip_Gain_HMu_60_100kph_R" 0 /end CHARACTERISTIC
/begin CHARACTERISTIC TP_S16_Slip_Gain_HMu_Ab_150kph_R "Slip Gain, High Mu Detect, Above 150kph, Decel State, Rear Wheels" VALUE 0x80020350 CalPrmWslcBrk_SWORD 0 Gain -32768 32767 SYMBOL_LINK "CalPrmWslcBrk01.TP_S16_Slip_Gain_HMu_Ab_150kph_R" 0 /end CHARACTERISTIC
/begin CHARACTERISTIC TP_S16_Slip_Gain_HMu_B_10kph_R "Slip Gain, High Mu Detect, Below 10kph, Decel State, Rear Wheels" VALUE 0x80020352 CalPrmWslcBrk_SWORD 0 Gain -32768 32767 SYMBOL_LINK "CalPrmWslcBrk01.TP_S16_Slip_Gain_HMu_B_10kph_R" 0 /end CHARACTERISTIC
/begin CHARACTERISTIC TP_S16_Slip_Gain_MMu_100_150kph_F "Slip Gain, Medium Mu Detect, 100-150kph, Decel State, Front wheels" VALUE 0x80020362 CalPrmWslcBrk_SWORD 0 Gain -32768 32767 SYMBOL_LINK "CalPrmWslcBrk01.TP_S16_Slip_Gain_MMu_100_150kph_F" 0 /end CHARACTERISTIC
/begin CHARACTERISTIC TP_S16_Slip_Gain_MMu_10_20kph_F "Slip Gain, Medium Mu Detect, 10-20kph, Decel State, Front wheels" VALUE 0x80020364 CalPrmWslcBrk_SWORD 0 Gain -32768 32767 SYMBOL_LINK "CalPrmWslcBrk01.TP_S16_Slip_Gain_MMu_10_20kph_F" 0 /end CHARACTERISTIC
/begin CHARACTERISTIC TP_S16_Slip_Gain_MMu_20_40kph_F "Slip Gain, Medium Mu Detect, 20-40kph, Decel State, Front wheels" VALUE 0x80020366 CalPrmWslcBrk_SWORD 0 Gain -32768 32767 SYMBOL_LINK "CalPrmWslcBrk01.TP_S16_Slip_Gain_MMu_20_40kph_F" 0 /end CHARACTERISTIC
/begin CHARACTERISTIC TP_S16_Slip_Gain_MMu_40_60kph_F "Slip Gain, Medium Mu Detect, 40-60kph, Decel State, Front wheels" VALUE 0x80020368 CalPrmWslcBrk_SWORD 0 Gain -32768 32767 SYMBOL_LINK "CalPrmWslcBrk01.TP_S16_Slip_Gain_MMu_40_60kph_F" 0 /end CHARACTERISTIC
/begin CHARACTERISTIC TP_S16_Slip_Gain_MMu_60_100kph_F "Slip Gain, Medium Mu Detect, 60-100kph, Decel State, Front Wheels" VALUE 0x8002036A CalPrmWslcBrk_SWORD 0 Gain -32768 32767 SYMBOL_LINK "CalPrmWslcBrk01.TP_S16_Slip_Gain_MMu_60_100kph_F" 0 /end CHARACTERISTIC
/begin CHARACTERISTIC TP_S16_Slip_Gain_MMu_Ab_150kph_F "Slip Gain, Medium Mu Detect, Above 150kph, Decel State, Front wheels" VALUE 0x8002036C CalPrmWslcBrk_SWORD 0 Gain -32768 32767 SYMBOL_LINK "CalPrmWslcBrk01.TP_S16_Slip_Gain_MMu_Ab_150kph_F" 0 /end CHARACTERISTIC
/begin CHARACTERISTIC TP_S16_Slip_Gain_MMu_B_10kph_F "Slip Gain, Medium Mu Detect, Below 10kph, Decel State, Front wheels" VALUE 0x8002036E CalPrmWslcBrk_SWORD 0 Gain -32768 32767 SYMBOL_LINK "CalPrmWslcBrk01.TP_S16_Slip_Gain_MMu_B_10kph_F" 0 /end CHARACTERISTIC
/begin CHARACTERISTIC TP_S16_YDF_STB_HLD_TIME_MAX "Stable hold max. time at yaw rate 10deg/s in split mu(split tendancy), wheel flags: 111" VALUE 0x8002051A CalPrmWslcBrk_SWORD 0 Gain -32768 32767 SYMBOL_LINK "CalPrmWslcBrk01.TP_S16_YDF_STB_HLD_TIME_MAX" 0 /end CHARACTERISTIC
/begin CHARACTERISTIC TP_S16_YDF_STB_HLD_TIME_MAX_F_OINR "Stable hold max. time at yaw rate 10deg/s in normal mu, wheel flags: 111" VALUE 0x8002051C CalPrmWslcBrk_SWORD 0 Gain -32768 32767 SYMBOL_LINK "CalPrmWslcBrk01.TP_S16_YDF_STB_HLD_TIME_MAX_F_OINR" 0 /end CHARACTERISTIC
/begin CHARACTERISTIC TP_S8_Arad_1stPoint_100_150KPH "1st reference point to set the reference EBD cut slip depending on wheel acceleration, 100-150KPH" VALUE 0x800206A5 CalPrmWslcBrk_SBYTE 0 A20 -32 31.75 SYMBOL_LINK "CalPrmWslcBrk01.TP_S8_Arad_1stPoint_100_150KPH" 0 /end CHARACTERISTIC
/begin CHARACTERISTIC TP_S8_Arad_1stPoint_60_100KPH "1st reference point to set the reference EBD cut slip depending on wheel acceleration, 60-100KPH" VALUE 0x8002069E CalPrmWslcBrk_SBYTE 0 A20 -32 31.75 SYMBOL_LINK "CalPrmWslcBrk01.TP_S8_Arad_1stPoint_60_100KPH" 0 /end CHARACTERISTIC
/begin CHARACTERISTIC TP_S8_Arad_2ndPoint_100_150KPH "2nd reference point to set the reference EBD cut slip depending on wheel acceleration, 100-150KPH" VALUE 0x800206A6 CalPrmWslcBrk_SBYTE 0 A20 -32 31.75 SYMBOL_LINK "CalPrmWslcBrk01.TP_S8_Arad_2ndPoint_100_150KPH" 0 /end CHARACTERISTIC
/begin CHARACTERISTIC TP_S8_Arad_2ndPoint_60_100KPH "2nd reference point to set the reference EBD cut slip depending on wheel acceleration, 60-100KPH" VALUE 0x8002069F CalPrmWslcBrk_SBYTE 0 A20 -32 31.75 SYMBOL_LINK "CalPrmWslcBrk01.TP_S8_Arad_2ndPoint_60_100KPH" 0 /end CHARACTERISTIC
/begin CHARACTERISTIC TP_S8_Arad_3rdPoint_100_150KPH "3rd reference point to set the reference EBD cut slip depending on wheel acceleration, 100-150KPH" VALUE 0x800206A7 CalPrmWslcBrk_SBYTE 0 A20 -32 31.75 SYMBOL_LINK "CalPrmWslcBrk01.TP_S8_Arad_3rdPoint_100_150KPH" 0 /end CHARACTERISTIC
/begin CHARACTERISTIC TP_S8_Arad_3rdPoint_60_100KPH "3rd reference point to set the reference EBD cut slip depending on wheel acceleration, 60-100KPH" VALUE 0x800206A0 CalPrmWslcBrk_SBYTE 0 A20 -32 31.75 SYMBOL_LINK "CalPrmWslcBrk01.TP_S8_Arad_3rdPoint_60_100KPH" 0 /end CHARACTERISTIC
/begin CHARACTERISTIC TP_S8_Arad_Fact_1_2P_100_150KPH "subtracting value from initial cut slip at wheel acceleration between Arad_1stPoint ~ Arad_2ndPoint, 100-150KPH" VALUE 0x800206A8 CalPrmWslcBrk_SBYTE 0 Perc6 -128 127 SYMBOL_LINK "CalPrmWslcBrk01.TP_S8_Arad_Fact_1_2P_100_150KPH" 0 /end CHARACTERISTIC
/begin CHARACTERISTIC TP_S8_Arad_Fact_1_2P_60_100KPH "subtracting value from initial cut slip at wheel acceleration between Arad_1stPoint ~ Arad_2ndPoint, 60-100KPH" VALUE 0x800206A1 CalPrmWslcBrk_SBYTE 0 Perc6 -128 127 SYMBOL_LINK "CalPrmWslcBrk01.TP_S8_Arad_Fact_1_2P_60_100KPH" 0 /end CHARACTERISTIC
/begin CHARACTERISTIC TP_S8_Arad_Fact_2_3P_100_150KPH "subtracting value from initial cut slip at wheel acceleration between Arad_2ndPoint ~ Arad_3rdPoint, 100-150KPH" VALUE 0x800206A9 CalPrmWslcBrk_SBYTE 0 Perc6 -128 127 SYMBOL_LINK "CalPrmWslcBrk01.TP_S8_Arad_Fact_2_3P_100_150KPH" 0 /end CHARACTERISTIC
/begin CHARACTERISTIC TP_S8_Arad_Fact_2_3P_60_100KPH "subtracting value from initial cut slip at wheel acceleration between Arad_2ndPoint ~ Arad_3rdPoint, 60-100KPH" VALUE 0x800206A2 CalPrmWslcBrk_SBYTE 0 Perc6 -128 127 SYMBOL_LINK "CalPrmWslcBrk01.TP_S8_Arad_Fact_2_3P_60_100KPH" 0 /end CHARACTERISTIC
/begin CHARACTERISTIC TP_S8_Arad_Fact_Ab_3P_100_150KPH "subtracting value from initial cut slip at wheel acceleration above Arad_3rdPoint, 100-150KPH" VALUE 0x800206AA CalPrmWslcBrk_SBYTE 0 Perc6 -128 127 SYMBOL_LINK "CalPrmWslcBrk01.TP_S8_Arad_Fact_Ab_3P_100_150KPH" 0 /end CHARACTERISTIC
/begin CHARACTERISTIC TP_S8_Arad_Fact_Ab_3P_60_100KPH "subtracting value from initial cut slip at wheel acceleration above Arad_3rdPoint, 60-100KPH" VALUE 0x800206A3 CalPrmWslcBrk_SBYTE 0 Perc6 -128 127 SYMBOL_LINK "CalPrmWslcBrk01.TP_S8_Arad_Fact_Ab_3P_60_100KPH" 0 /end CHARACTERISTIC
/begin CHARACTERISTIC TP_S8_Arad_Fact_B_1P_100_150KPH "subtracting value from initial cut slip at wheel acceleration below Arad_1stPoint, 100-150KPH" VALUE 0x800206AB CalPrmWslcBrk_SBYTE 0 Perc6 -128 127 SYMBOL_LINK "CalPrmWslcBrk01.TP_S8_Arad_Fact_B_1P_100_150KPH" 0 /end CHARACTERISTIC
/begin CHARACTERISTIC TP_S8_Arad_Fact_B_1P_60_100KPH "subtracting value from initial cut slip at wheel acceleration below Arad_1stPoint, 60-100KPH" VALUE 0x800206A4 CalPrmWslcBrk_SBYTE 0 Perc6 -128 127 SYMBOL_LINK "CalPrmWslcBrk01.TP_S8_Arad_Fact_B_1P_60_100KPH" 0 /end CHARACTERISTIC
/begin CHARACTERISTIC TP_S8_CBC_REAPPLY_TIME_ABS_R "Rear conventional reapply time of one pulse up for CBC" VALUE 0x80020700 CalPrmWslcBrk_SBYTE 0 Gain -128 127 SYMBOL_LINK "CalPrmWslcBrk01.TP_S8_CBC_REAPPLY_TIME_ABS_R" 0 /end CHARACTERISTIC
/begin CHARACTERISTIC TP_S8_CBC_REAPPLY_TIME_FADEOUT_ABS_R "Rear conventional reapply time of one pulse up for CBC fade out" VALUE 0x80020701 CalPrmWslcBrk_SBYTE 0 Gain -128 127 SYMBOL_LINK "CalPrmWslcBrk01.TP_S8_CBC_REAPPLY_TIME_FADEOUT_ABS_R" 0 /end CHARACTERISTIC
/begin CHARACTERISTIC TP_S8_CBC_REAPPLY_TIME_FADEOUT_R "Rear conventional reapply time of one pulse up for CBC fade out" VALUE 0x8002078A CalPrmWslcBrk_SBYTE 0 Gain -128 127 SYMBOL_LINK "CalPrmWslcBrk01.TP_S8_CBC_REAPPLY_TIME_FADEOUT_R" 0 /end CHARACTERISTIC
/begin CHARACTERISTIC TP_S8_CBC_REAPPLY_TIME_R "Rear conventional reapply time of one pulse up for CBC" VALUE 0x8002078B CalPrmWslcBrk_SBYTE 0 Gain -128 127 SYMBOL_LINK "CalPrmWslcBrk01.TP_S8_CBC_REAPPLY_TIME_R" 0 /end CHARACTERISTIC
/begin CHARACTERISTIC TP_S8_CBC_SLIP_THRES_COMP_H "CBC start slip ratio condition compensation at high vehicle speed" VALUE 0x8002075C CalPrmWslcBrk_SBYTE 0 Perc6 -128 127 SYMBOL_LINK "CalPrmWslcBrk01.TP_S8_CBC_SLIP_THRES_COMP_H" 0 /end CHARACTERISTIC
/begin CHARACTERISTIC TP_S8_CBC_SLIP_THRES_COMP_M "CBC start slip ratio condition compensation at med vehicle speed" VALUE 0x8002075D CalPrmWslcBrk_SBYTE 0 Perc6 -128 127 SYMBOL_LINK "CalPrmWslcBrk01.TP_S8_CBC_SLIP_THRES_COMP_M" 0 /end CHARACTERISTIC
/begin CHARACTERISTIC TP_S8_CBC_SLIP_THRES_H "CBC start slip ratio threshold at high Ay level" VALUE 0x8002075E CalPrmWslcBrk_SBYTE 0 Perc6 -128 127 SYMBOL_LINK "CalPrmWslcBrk01.TP_S8_CBC_SLIP_THRES_H" 0 /end CHARACTERISTIC
/begin CHARACTERISTIC TP_S8_CBC_SLIP_THRES_L "CBC start slip ratio threshold at low Ay level" VALUE 0x8002075F CalPrmWslcBrk_SBYTE 0 Perc6 -128 127 SYMBOL_LINK "CalPrmWslcBrk01.TP_S8_CBC_SLIP_THRES_L" 0 /end CHARACTERISTIC
/begin CHARACTERISTIC TP_S8_CBC_SLIP_THRES_M "CBC start slip ratio threshold at med Ay level" VALUE 0x80020760 CalPrmWslcBrk_SBYTE 0 Perc6 -128 127 SYMBOL_LINK "CalPrmWslcBrk01.TP_S8_CBC_SLIP_THRES_M" 0 /end CHARACTERISTIC
/begin CHARACTERISTIC TP_S8_Clear_GMA_Max_Accel1 "Max.Wheel Accel Reference to Clear GMA Ctrl (default:15g)" VALUE 0x800202A8 CalPrmWslcBrk_SBYTE 0 A20 -32 31.75 SYMBOL_LINK "CalPrmWslcBrk01.TP_S8_Clear_GMA_Max_Accel1" 0 /end CHARACTERISTIC
/begin CHARACTERISTIC TP_S8_Clear_GMA_Max_Accel2 "Max.Wheel Accel Reference to Clear GMA Ctrl When Dump scans is fewer than 15 (default:10g)" VALUE 0x800202A9 CalPrmWslcBrk_SBYTE 0 A20 -32 31.75 SYMBOL_LINK "CalPrmWslcBrk01.TP_S8_Clear_GMA_Max_Accel2" 0 /end CHARACTERISTIC
/begin CHARACTERISTIC TP_S8_Comp_Duty_For_H2SP_Hside_F "Compensation Duty for H2SP, High-side Front wheel" VALUE 0x800205AE CalPrmWslcBrk_SBYTE 0 Gain -128 127 SYMBOL_LINK "CalPrmWslcBrk01.TP_S8_Comp_Duty_For_H2SP_Hside_F" 0 /end CHARACTERISTIC
/begin CHARACTERISTIC TP_S8_F_WL_Fact_ASum1G_SlipAb5P "Cut slip compensation value if : avg.Front wheel slip <-5%, AND Front arad sum > -1g" VALUE 0x800206BC CalPrmWslcBrk_SBYTE 0 Perc6 -128 127 SYMBOL_LINK "CalPrmWslcBrk01.TP_S8_F_WL_Fact_ASum1G_SlipAb5P" 0 /end CHARACTERISTIC
/begin CHARACTERISTIC TP_S8_F_WL_Fact_ASum3G_SlipAb5P "Cut slip compensation value if : avg.Front wheel slip <-5%, AND -1g > Front arad sum > -3g" VALUE 0x800206BD CalPrmWslcBrk_SBYTE 0 Perc6 -128 127 SYMBOL_LINK "CalPrmWslcBrk01.TP_S8_F_WL_Fact_ASum3G_SlipAb5P" 0 /end CHARACTERISTIC
/begin CHARACTERISTIC TP_S8_F_WL_Fact_ASumAb3G_SlipAb5P "Cut slip compensation value if : avg.Front wheel slip <-5%, AND Front arad sum < -3g" VALUE 0x800206BE CalPrmWslcBrk_SBYTE 0 Perc6 -128 127 SYMBOL_LINK "CalPrmWslcBrk01.TP_S8_F_WL_Fact_ASumAb3G_SlipAb5P" 0 /end CHARACTERISTIC
/begin CHARACTERISTIC TP_S8_L2H_DCT_WPRESS_MIN_TIME "L2H by wheel press detection time" VALUE 0x80020657 CalPrmWslcBrk_SBYTE 0 Gain -128 127 SYMBOL_LINK "CalPrmWslcBrk01.TP_S8_L2H_DCT_WPRESS_MIN_TIME" 0 /end CHARACTERISTIC
/begin CHARACTERISTIC TP_S8_LFC_Dump_Slip_Jump_Mu "Reference dump slip for High-to-Low mu detection, N th cycle" VALUE 0x800202CF CalPrmWslcBrk_SBYTE 0 Perc6 -128 127 SYMBOL_LINK "CalPrmWslcBrk01.TP_S8_LFC_Dump_Slip_Jump_Mu" 0 /end CHARACTERISTIC
/begin CHARACTERISTIC TP_S8_LFC_Initial_Dump_Slip_Low "Reference dump slip for Low mu detection, 1st cycle" VALUE 0x800202CA CalPrmWslcBrk_SBYTE 0 Perc6 -128 127 SYMBOL_LINK "CalPrmWslcBrk01.TP_S8_LFC_Initial_Dump_Slip_Low" 0 /end CHARACTERISTIC
/begin CHARACTERISTIC TP_S8_LFC_Initial_Peak_Slip_Low "Reference peak slip for Low mu detection, 1st cycle" VALUE 0x800202CB CalPrmWslcBrk_SBYTE 0 Perc6 -128 127 SYMBOL_LINK "CalPrmWslcBrk01.TP_S8_LFC_Initial_Peak_Slip_Low" 0 /end CHARACTERISTIC
/begin CHARACTERISTIC TP_S8_LFC_Initial_Slip_Ratio_Low "Reference ratio of peak slip to dump slip for Low mu detection, 1st cycle" VALUE 0x800202CC CalPrmWslcBrk_SBYTE 0 Gain -128 127 SYMBOL_LINK "CalPrmWslcBrk01.TP_S8_LFC_Initial_Slip_Ratio_Low" 0 /end CHARACTERISTIC
/begin CHARACTERISTIC TP_S8_LFC_Peak_Slip_Jump_Mu "Reference peak slip for High-to-Low mu detection, N th cycle" VALUE 0x800202D0 CalPrmWslcBrk_SBYTE 0 Perc6 -128 127 SYMBOL_LINK "CalPrmWslcBrk01.TP_S8_LFC_Peak_Slip_Jump_Mu" 0 /end CHARACTERISTIC
/begin CHARACTERISTIC TP_S8_LFC_Slip_Ratio_Jump_Mu "Reference ratio of peak slip to dump slip for High-to-Low mu detection, N th cycle" VALUE 0x800202D1 CalPrmWslcBrk_SBYTE 0 Gain -128 127 SYMBOL_LINK "CalPrmWslcBrk01.TP_S8_LFC_Slip_Ratio_Jump_Mu" 0 /end CHARACTERISTIC
/begin CHARACTERISTIC TP_U8TCSCpBrkTorqDecPcntOfEngStl "" VALUE 0x8003A275 CalPrmWspcEng_UBYTE 0 Perc6 0 255 SYMBOL_LINK "CalPrmWspcEng01.TP_U8TCSCpBrkTorqDecPcntOfEngStl" 0 /end CHARACTERISTIC
/begin CHARACTERISTIC TP_U8TCSCpBrkTorqDecRateOfEngStl "" VALUE 0x8003A277 CalPrmWspcEng_UBYTE 0 TqGrdt10 0 255 SYMBOL_LINK "CalPrmWspcEng01.TP_U8TCSCpBrkTorqDecRateOfEngStl" 0 /end CHARACTERISTIC
/begin CHARACTERISTIC TP_U8TCSCpBrkTorqRecPcntOfEngStl "" VALUE 0x8003A27A CalPrmWspcEng_UBYTE 0 Perc6 0 255 SYMBOL_LINK "CalPrmWspcEng01.TP_U8TCSCpBrkTorqRecPcntOfEngStl" 0 /end CHARACTERISTIC
/begin CHARACTERISTIC TP_U8TCSCpTBrkTorqDec4SymInStall "" VALUE 0x8003A359 CalPrmWspcEng_UBYTE 0 Gain 0 255 SYMBOL_LINK "CalPrmWspcEng01.TP_U8TCSCpTBrkTorqDec4SymInStall" 0 /end CHARACTERISTIC
/begin CHARACTERISTIC TP_U8TCSCpTarBrkTqMaxByDrvrTqFac "" VALUE 0x8003A347 CalPrmWspcEng_UBYTE 0 Perc6 0 255 SYMBOL_LINK "CalPrmWspcEng01.TP_U8TCSCpTarBrkTqMaxByDrvrTqFac" 0 /end CHARACTERISTIC
/begin CHARACTERISTIC TP_U8TCSCpTarBrkTqMaxBySplitHillFac "" VALUE 0x8003A348 CalPrmWspcEng_UBYTE 0 Perc6 0 255 SYMBOL_LINK "CalPrmWspcEng01.TP_U8TCSCpTarBrkTqMaxBySplitHillFac" 0 /end CHARACTERISTIC
/begin CHARACTERISTIC TP_U8TCSCpTarWhlPreTurnMax[0] "" VALUE 0x8003A349 CalPrmWspcEng_UBYTE 0 P34 0 25.5 SYMBOL_LINK "CalPrmWspcEng01.TP_U8TCSCpTarWhlPreTurnMax[0]" 0 /end CHARACTERISTIC
/begin CHARACTERISTIC TP_U8TCSCpTarWhlPreTurnMax[1] "" VALUE 0x8003A34A CalPrmWspcEng_UBYTE 0 P34 0 25.5 SYMBOL_LINK "CalPrmWspcEng01.TP_U8TCSCpTarWhlPreTurnMax[1]" 0 /end CHARACTERISTIC
/begin CHARACTERISTIC TP_U8TCSCpTarWhlPreTurnMax[2] "" VALUE 0x8003A34B CalPrmWspcEng_UBYTE 0 P34 0 25.5 SYMBOL_LINK "CalPrmWspcEng01.TP_U8TCSCpTarWhlPreTurnMax[2]" 0 /end CHARACTERISTIC
/begin CHARACTERISTIC TP_U8TCSCpTarWhlPreTurnMax[3] "" VALUE 0x8003A34C CalPrmWspcEng_UBYTE 0 P34 0 25.5 SYMBOL_LINK "CalPrmWspcEng01.TP_U8TCSCpTarWhlPreTurnMax[3]" 0 /end CHARACTERISTIC
/begin CHARACTERISTIC TP_U8TCSCpTarWhlPreTurnMax[4] "" VALUE 0x8003A34D CalPrmWspcEng_UBYTE 0 P34 0 25.5 SYMBOL_LINK "CalPrmWspcEng01.TP_U8TCSCpTarWhlPreTurnMax[4]" 0 /end CHARACTERISTIC
/begin CHARACTERISTIC TP_U8_1st_Dumpscantime_LMMu_F "Time of 1st dump-scan in Low~Low-medium mu, Front Wheels" VALUE 0x800204AA CalPrmWslcBrk_UBYTE 0 Gain 0 255 SYMBOL_LINK "CalPrmWslcBrk01.TP_U8_1st_Dumpscantime_LMMu_F" 0 /end CHARACTERISTIC
/begin CHARACTERISTIC TP_U8_1st_Dumpscantime_MMu_R "Time of 1st dump-scan in Low-med~medium mu, Rear Wheels" VALUE 0x800204A7 CalPrmWslcBrk_UBYTE 0 Gain 0 255 SYMBOL_LINK "CalPrmWslcBrk01.TP_U8_1st_Dumpscantime_MMu_R" 0 /end CHARACTERISTIC
/begin CHARACTERISTIC TP_U8_2nd3rd_Dumpscantime_LMMu_F "Time of 2nd and 3rd dump-scan in Low~Under-Low-Medium mu, Front Wheels" VALUE 0x800204AB CalPrmWslcBrk_UBYTE 0 Gain 0 255 SYMBOL_LINK "CalPrmWslcBrk01.TP_U8_2nd3rd_Dumpscantime_LMMu_F" 0 /end CHARACTERISTIC
/begin CHARACTERISTIC TP_U8_BIG_DUMP_BY_LOWMU_FAST_RISE "Ref. Dump counter, Deep slip cycle detection, Low-mu(Ice,Ceramic, etc ), default 16,min 10" VALUE 0x80020593 CalPrmWslcBrk_UBYTE 0 Gain 0 255 SYMBOL_LINK "CalPrmWslcBrk01.TP_U8_BIG_DUMP_BY_LOWMU_FAST_RISE" 0 /end CHARACTERISTIC
/begin CHARACTERISTIC TP_U8_BIG_DUMP_GAUGE_AT_LEVEL1 "Threshold increment by U8_BRD_DUMP_CNT_LEVEL1, Deep slip cycle detection" VALUE 0x80020594 CalPrmWslcBrk_UBYTE 0 Gain 0 255 SYMBOL_LINK "CalPrmWslcBrk01.TP_U8_BIG_DUMP_GAUGE_AT_LEVEL1" 0 /end CHARACTERISTIC
/begin CHARACTERISTIC TP_U8_BIG_DUMP_GAUGE_AT_LEVEL2 "Threshold increment by U8_BRD_DUMP_CNT_LEVEL2, Deep slip cycle detection" VALUE 0x80020595 CalPrmWslcBrk_UBYTE 0 Gain 0 255 SYMBOL_LINK "CalPrmWslcBrk01.TP_U8_BIG_DUMP_GAUGE_AT_LEVEL2" 0 /end CHARACTERISTIC
/begin CHARACTERISTIC TP_U8_BIG_DUMP_GAUGE_AT_LEVEL3 "Threshold increment by U8_BRD_DUMP_CNT_LEVEL3, Deep slip cycle detection" VALUE 0x80020596 CalPrmWslcBrk_UBYTE 0 Gain 0 255 SYMBOL_LINK "CalPrmWslcBrk01.TP_U8_BIG_DUMP_GAUGE_AT_LEVEL3" 0 /end CHARACTERISTIC
/begin CHARACTERISTIC TP_U8_BIG_RISE_DMP_COMP_DUTY "Compensation Duty by Deep slip cycle detection" VALUE 0x80020597 CalPrmWslcBrk_UBYTE 0 Gain 0 255 SYMBOL_LINK "CalPrmWslcBrk01.TP_U8_BIG_RISE_DMP_COMP_DUTY" 0 /end CHARACTERISTIC
/begin CHARACTERISTIC TP_U8_BRD_DETECTION_REF "Ref. Sum of BIG_DUMP_GAUGE, Deep slip cycle detection" VALUE 0x80020598 CalPrmWslcBrk_UBYTE 0 Gain 0 255 SYMBOL_LINK "CalPrmWslcBrk01.TP_U8_BRD_DETECTION_REF" 0 /end CHARACTERISTIC
/begin CHARACTERISTIC TP_U8_BRD_DUMP_CNT_LEVEL1 "Ref. Dump counter for BIG_DUMP_GAUGE_AT_LEVEL1, Deep slip cycle detection" VALUE 0x80020599 CalPrmWslcBrk_UBYTE 0 Gain 0 255 SYMBOL_LINK "CalPrmWslcBrk01.TP_U8_BRD_DUMP_CNT_LEVEL1" 0 /end CHARACTERISTIC
/begin CHARACTERISTIC TP_U8_BRD_DUMP_CNT_LEVEL2 "Ref. Dump counter for BIG_DUMP_GAUGE_AT_LEVEL2, Deep slip cycle detection" VALUE 0x8002059A CalPrmWslcBrk_UBYTE 0 Gain 0 255 SYMBOL_LINK "CalPrmWslcBrk01.TP_U8_BRD_DUMP_CNT_LEVEL2" 0 /end CHARACTERISTIC
/begin CHARACTERISTIC TP_U8_BRD_DUMP_CNT_LEVEL3 "Ref. Dump counter for BIG_DUMP_GAUGE_AT_LEVEL3, Deep slip cycle detection" VALUE 0x8002059B CalPrmWslcBrk_UBYTE 0 Gain 0 255 SYMBOL_LINK "CalPrmWslcBrk01.TP_U8_BRD_DUMP_CNT_LEVEL3" 0 /end CHARACTERISTIC
/begin CHARACTERISTIC TP_U8_B_20KPH_Dumpscantime_MMu_R "Time of dump-scan in Medium mu below 20kph, Rear Wheels" VALUE 0x800204A9 CalPrmWslcBrk_UBYTE 0 Gain 0 255 SYMBOL_LINK "CalPrmWslcBrk01.TP_U8_B_20KPH_Dumpscantime_MMu_R" 0 /end CHARACTERISTIC
/begin CHARACTERISTIC TP_U8_CBC_DUMPSCAN_TIME "CBC dump scan time" VALUE 0x80020702 CalPrmWslcBrk_UBYTE 0 Gain 0 255 SYMBOL_LINK "CalPrmWslcBrk01.TP_U8_CBC_DUMPSCAN_TIME" 0 /end CHARACTERISTIC
/begin CHARACTERISTIC TP_U8_CBC_DUMP_DEAD_PRESS "Actuation Dead band for ESC-CBC pressure dump mode, rear wheel" VALUE 0x8002078C CalPrmWslcBrk_UBYTE 0 P34 0 25.5 SYMBOL_LINK "CalPrmWslcBrk01.TP_U8_CBC_DUMP_DEAD_PRESS" 0 /end CHARACTERISTIC
/begin CHARACTERISTIC TP_U8_CBC_DUMP_DEAD_PRESS_ABS "Actuation Dead band for ABS-CBC pressure dump mode, rear wheel" VALUE 0x80020704 CalPrmWslcBrk_UBYTE 0 P34 0 25.5 SYMBOL_LINK "CalPrmWslcBrk01.TP_U8_CBC_DUMP_DEAD_PRESS_ABS" 0 /end CHARACTERISTIC
/begin CHARACTERISTIC TP_U8_CBC_DUMP_DEAD_PRESS_FRONT "Actuation Dead band for ESC-CBC pressure dump mode, front wheel" VALUE 0x8002078D CalPrmWslcBrk_UBYTE 0 P34 0 25.5 SYMBOL_LINK "CalPrmWslcBrk01.TP_U8_CBC_DUMP_DEAD_PRESS_FRONT" 0 /end CHARACTERISTIC
/begin CHARACTERISTIC TP_U8_CBC_MAX_HOLD_TIMER "CBC max. hold timer" VALUE 0x80020703 CalPrmWslcBrk_UBYTE 0 Gain 0 255 SYMBOL_LINK "CalPrmWslcBrk01.TP_U8_CBC_MAX_HOLD_TIMER" 0 /end CHARACTERISTIC
/begin CHARACTERISTIC TP_U8_CBC_RISE_DEAD_PRESS "Actuation Dead band for ESC-CBC pressure rise mode, rear wheel" VALUE 0x8002078E CalPrmWslcBrk_UBYTE 0 P34 0 25.5 SYMBOL_LINK "CalPrmWslcBrk01.TP_U8_CBC_RISE_DEAD_PRESS" 0 /end CHARACTERISTIC
/begin CHARACTERISTIC TP_U8_CBC_RISE_DEAD_PRESS_ABS "Actuation Dead band for ABS-CBC pressure rise mode, rear wheel" VALUE 0x80020705 CalPrmWslcBrk_UBYTE 0 P34 0 25.5 SYMBOL_LINK "CalPrmWslcBrk01.TP_U8_CBC_RISE_DEAD_PRESS_ABS" 0 /end CHARACTERISTIC
/begin CHARACTERISTIC TP_U8_CBC_RISE_DEAD_PRESS_FRONT "Actuation Dead band for ESC-CBC pressure rise mode, front wheel" VALUE 0x8002078F CalPrmWslcBrk_UBYTE 0 P34 0 25.5 SYMBOL_LINK "CalPrmWslcBrk01.TP_U8_CBC_RISE_DEAD_PRESS_FRONT" 0 /end CHARACTERISTIC
/begin CHARACTERISTIC TP_U8_Chess_Dump_Rise_Ref "Chess detection reference by using Dump_Rise_Factor" VALUE 0x8002059C CalPrmWslcBrk_UBYTE 0 Gain 0 255 SYMBOL_LINK "CalPrmWslcBrk01.TP_U8_Chess_Dump_Rise_Ref" 0 /end CHARACTERISTIC
/begin CHARACTERISTIC TP_U8_DUMP_CNT_FOR_CLEAR_GMA_L1 "Ref. Dump counter for clear GMA state, Split low side Front wheel" VALUE 0x800202AA CalPrmWslcBrk_UBYTE 0 Gain 0 255 SYMBOL_LINK "CalPrmWslcBrk01.TP_U8_DUMP_CNT_FOR_CLEAR_GMA_L1" 0 /end CHARACTERISTIC
/begin CHARACTERISTIC TP_U8_F_High_side_SL_dump_H_SPEED "High side forced dump scans on H-to-split, Above S16_GMA_H_SPEED" VALUE 0x800205AF CalPrmWslcBrk_UBYTE 0 Gain 0 255 SYMBOL_LINK "CalPrmWslcBrk01.TP_U8_F_High_side_SL_dump_H_SPEED" 0 /end CHARACTERISTIC
/begin CHARACTERISTIC TP_U8_F_High_side_SL_dump_L_SPEED "High side forced dump scans on H-to-split, Below S16_GMA_L_SPEED" VALUE 0x800205B0 CalPrmWslcBrk_UBYTE 0 Gain 0 255 SYMBOL_LINK "CalPrmWslcBrk01.TP_U8_F_High_side_SL_dump_L_SPEED" 0 /end CHARACTERISTIC
/begin CHARACTERISTIC TP_U8_F_High_side_SL_dump_M_SPEED "High side forced dump scans on H-to-split, @S16_GMA_M_SPEED" VALUE 0x800205B1 CalPrmWslcBrk_UBYTE 0 Gain 0 255 SYMBOL_LINK "CalPrmWslcBrk01.TP_U8_F_High_side_SL_dump_M_SPEED" 0 /end CHARACTERISTIC
/begin CHARACTERISTIC TP_U8_GMA_HOLD_Comp_for_HSPEED "GMA hold time compensation For High Speed, default 28, min 14, max 56" VALUE 0x80020605 CalPrmWslcBrk_UBYTE 0 Gain 0 255 SYMBOL_LINK "CalPrmWslcBrk01.TP_U8_GMA_HOLD_Comp_for_HSPEED" 0 /end CHARACTERISTIC
/begin CHARACTERISTIC TP_U8_L2H_DCT_WPRESS_DIFF "Wheel est. pressure difference between FL and FR with U8_L2H_DCT_WPRESS_THRES2 condition(ESC only)" VALUE 0x80020658 CalPrmWslcBrk_UBYTE 0 P34 0 25.5 SYMBOL_LINK "CalPrmWslcBrk01.TP_U8_L2H_DCT_WPRESS_DIFF" 0 /end CHARACTERISTIC
/begin CHARACTERISTIC TP_U8_L2H_DCT_WPRESS_THRES1 "FL and FR wheel est. pressure increased after previous skid level for L2H detection(ESC only)" VALUE 0x80020659 CalPrmWslcBrk_UBYTE 0 P34 0 25.5 SYMBOL_LINK "CalPrmWslcBrk01.TP_U8_L2H_DCT_WPRESS_THRES1" 0 /end CHARACTERISTIC
/begin CHARACTERISTIC TP_U8_L2H_DCT_WPRESS_THRES2 "FL and FR wheel est. pressure increased after previous skid level for L2H detection(ESC only)" VALUE 0x8002065A CalPrmWslcBrk_UBYTE 0 P34 0 25.5 SYMBOL_LINK "CalPrmWslcBrk01.TP_U8_L2H_DCT_WPRESS_THRES2" 0 /end CHARACTERISTIC
/begin CHARACTERISTIC TP_U8_LFC_2ND_CYC_COMP_LOW "2nd deep slip Compensation Duty after initial deep slip detection" VALUE 0x800202D2 CalPrmWslcBrk_UBYTE 0 Gain 0 255 SYMBOL_LINK "CalPrmWslcBrk01.TP_U8_LFC_2ND_CYC_COMP_LOW" 0 /end CHARACTERISTIC
/begin CHARACTERISTIC TP_U8_LFC_Dump_Scan_Jump_Mu "Reference minimum dump scan for High-to-Low mu detection" VALUE 0x800202D3 CalPrmWslcBrk_UBYTE 0 Gain 0 255 SYMBOL_LINK "CalPrmWslcBrk01.TP_U8_LFC_Dump_Scan_Jump_Mu" 0 /end CHARACTERISTIC
/begin CHARACTERISTIC TP_U8_LFC_Dump_Scan_Rough_Road "Reference maximum dump scan for inhibit High-to-Low mu detection at Rough road" VALUE 0x800202D4 CalPrmWslcBrk_UBYTE 0 Gain 0 255 SYMBOL_LINK "CalPrmWslcBrk01.TP_U8_LFC_Dump_Scan_Rough_Road" 0 /end CHARACTERISTIC
/begin CHARACTERISTIC TP_U8_LFC_Initial_Dump_Scan_Low "Reference dump scan for Low mu detection, 1st cycle" VALUE 0x800202CD CalPrmWslcBrk_UBYTE 0 Gain 0 255 SYMBOL_LINK "CalPrmWslcBrk01.TP_U8_LFC_Initial_Dump_Scan_Low" 0 /end CHARACTERISTIC
/begin CHARACTERISTIC TP_U8_LFC_Initial_Dump_Scan_Med "Reference minimum dump scan for Low mu detection, 1st cycle" VALUE 0x800202CE CalPrmWslcBrk_UBYTE 0 Gain 0 255 SYMBOL_LINK "CalPrmWslcBrk01.TP_U8_LFC_Initial_Dump_Scan_Med" 0 /end CHARACTERISTIC
/begin CHARACTERISTIC TP_U8_LFC_Jump_Down_Comp_F "Compensation Duty for High-to-Low mu, Front wheels" VALUE 0x800202D5 CalPrmWslcBrk_UBYTE 0 Gain 0 255 SYMBOL_LINK "CalPrmWslcBrk01.TP_U8_LFC_Jump_Down_Comp_F" 0 /end CHARACTERISTIC
/begin CHARACTERISTIC TP_U8_LFC_Jump_Down_Comp_R "Compensation Duty for High-to-Low mu, Rear wheels" VALUE 0x800202D6 CalPrmWslcBrk_UBYTE 0 Gain 0 255 SYMBOL_LINK "CalPrmWslcBrk01.TP_U8_LFC_Jump_Down_Comp_R" 0 /end CHARACTERISTIC
/begin CHARACTERISTIC TP_U8_Low_Mu_Dump_Rise_Factor "Not check H-to-split condition at low-mu road" VALUE 0x8002059D CalPrmWslcBrk_UBYTE 0 Gain 0 255 SYMBOL_LINK "CalPrmWslcBrk01.TP_U8_Low_Mu_Dump_Rise_Factor" 0 /end CHARACTERISTIC
/begin CHARACTERISTIC TP_U8_STB_DMP_MAX_HIGH_UnderOutF "Stable Dump limitation level for Under Outside Front Wheel, High-mu (default : 1)" VALUE 0x8002052E CalPrmWslcBrk_UBYTE 0 Gain 0 255 SYMBOL_LINK "CalPrmWslcBrk01.TP_U8_STB_DMP_MAX_HIGH_UnderOutF" 0 /end CHARACTERISTIC
/begin CHARACTERISTIC TP_U8_STB_DMP_MAX_LOW_UnderOutF "Stable Dump limitation level for Under Outside Front Wheel, low-mu (default : 4)" VALUE 0x8002052F CalPrmWslcBrk_UBYTE 0 Gain 0 255 SYMBOL_LINK "CalPrmWslcBrk01.TP_U8_STB_DMP_MAX_LOW_UnderOutF" 0 /end CHARACTERISTIC
/begin CHARACTERISTIC TP_U8_STB_DMP_MAX_MED_UnderOutF "Stable Dump limitation level for Under Outside Front Wheel, med-mu (default : 4)" VALUE 0x80020530 CalPrmWslcBrk_UBYTE 0 Gain 0 255 SYMBOL_LINK "CalPrmWslcBrk01.TP_U8_STB_DMP_MAX_MED_UnderOutF" 0 /end CHARACTERISTIC
/begin CHARACTERISTIC TP_U8_STB_DMP_MAX_SP_UnderOutF "Stable Dump limitation level for Under Outside Front Wheel, Split-mu (default : 0)" VALUE 0x80020531 CalPrmWslcBrk_UBYTE 0 Gain 0 255 SYMBOL_LINK "CalPrmWslcBrk01.TP_U8_STB_DMP_MAX_SP_UnderOutF" 0 /end CHARACTERISTIC
/begin CHARACTERISTIC TP_U8_nth_Dumpscantime_LMMu_F "Time of nth dump-scan in Low-med mu, Front Wheels" VALUE 0x800204AC CalPrmWslcBrk_UBYTE 0 Gain 0 255 SYMBOL_LINK "CalPrmWslcBrk01.TP_U8_nth_Dumpscantime_LMMu_F" 0 /end CHARACTERISTIC
/begin CHARACTERISTIC TP_U8_nth_Dumpscantime_MMu_R "Time of nth dump-scan in Low-med~medium mu, Rear Wheels" VALUE 0x800204A8 CalPrmWslcBrk_UBYTE 0 Gain 0 255 SYMBOL_LINK "CalPrmWslcBrk01.TP_U8_nth_Dumpscantime_MMu_R" 0 /end CHARACTERISTIC
/begin CHARACTERISTIC TQMass_height "" VALUE 0x800209C2 CalPrmLatDynsCoorrBrk_SWORD 0 Gain -32768 32767 SYMBOL_LINK "CalPrmLatDynsCoorrBrk01.TQMass_height" 0 /end CHARACTERISTIC
/begin CHARACTERISTIC TQRadius_Wheel "" VALUE 0x800209C4 CalPrmLatDynsCoorrBrk_SWORD 0 Gain -32768 32767 SYMBOL_LINK "CalPrmLatDynsCoorrBrk01.TQRadius_Wheel" 0 /end CHARACTERISTIC
/begin CHARACTERISTIC TQS16_AYC_1ST_CYCLE_D_IN_WEG "" VALUE 0x80020BCC CalPrmLatDynsCoorrBrk_SWORD 0 Gain -32768 32767 SYMBOL_LINK "CalPrmLatDynsCoorrBrk01.TQS16_AYC_1ST_CYCLE_D_IN_WEG" 0 /end CHARACTERISTIC
/begin CHARACTERISTIC TQS16_AYC_1ST_CYCLE_D_OUT_WEG "" VALUE 0x80020BCE CalPrmLatDynsCoorrBrk_SWORD 0 Gain -32768 32767 SYMBOL_LINK "CalPrmLatDynsCoorrBrk01.TQS16_AYC_1ST_CYCLE_D_OUT_WEG" 0 /end CHARACTERISTIC
/begin CHARACTERISTIC TQS16_AYC_1ST_CYCLE_P_IN_WEG "" VALUE 0x80020BD0 CalPrmLatDynsCoorrBrk_SWORD 0 Gain -32768 32767 SYMBOL_LINK "CalPrmLatDynsCoorrBrk01.TQS16_AYC_1ST_CYCLE_P_IN_WEG" 0 /end CHARACTERISTIC
/begin CHARACTERISTIC TQS16_AYC_1ST_CYCLE_P_OUT_WEG "" VALUE 0x80020BD2 CalPrmLatDynsCoorrBrk_SWORD 0 Gain -32768 32767 SYMBOL_LINK "CalPrmLatDynsCoorrBrk01.TQS16_AYC_1ST_CYCLE_P_OUT_WEG" 0 /end CHARACTERISTIC
/begin CHARACTERISTIC TQS16_AYC_D_GAIN_INSIDE_DEC "" VALUE 0x80020B7C CalPrmLatDynsCoorrBrk_SWORD 0 Gain -32768 32767 SYMBOL_LINK "CalPrmLatDynsCoorrBrk01.TQS16_AYC_D_GAIN_INSIDE_DEC" 0 /end CHARACTERISTIC
/begin CHARACTERISTIC TQS16_AYC_D_GAIN_INSIDE_INC "" VALUE 0x80020B7E CalPrmLatDynsCoorrBrk_SWORD 0 Gain -32768 32767 SYMBOL_LINK "CalPrmLatDynsCoorrBrk01.TQS16_AYC_D_GAIN_INSIDE_INC" 0 /end CHARACTERISTIC
/begin CHARACTERISTIC TQS16_AYC_D_GAIN_OUTSIDE_DEC "" VALUE 0x80020B74 CalPrmLatDynsCoorrBrk_SWORD 0 Gain -32768 32767 SYMBOL_LINK "CalPrmLatDynsCoorrBrk01.TQS16_AYC_D_GAIN_OUTSIDE_DEC" 0 /end CHARACTERISTIC
/begin CHARACTERISTIC TQS16_AYC_D_GAIN_OUTSIDE_INC "" VALUE 0x80020B76 CalPrmLatDynsCoorrBrk_SWORD 0 Gain -32768 32767 SYMBOL_LINK "CalPrmLatDynsCoorrBrk01.TQS16_AYC_D_GAIN_OUTSIDE_INC" 0 /end CHARACTERISTIC
/begin CHARACTERISTIC TQS16_AYC_MQ_WEG_VEL_100K "" VALUE 0x80020B84 CalPrmLatDynsCoorrBrk_SWORD 0 Gain -32768 32767 SYMBOL_LINK "CalPrmLatDynsCoorrBrk01.TQS16_AYC_MQ_WEG_VEL_100K" 0 /end CHARACTERISTIC
/begin CHARACTERISTIC TQS16_AYC_MQ_WEG_VEL_20K "" VALUE 0x80020B86 CalPrmLatDynsCoorrBrk_SWORD 0 Gain -32768 32767 SYMBOL_LINK "CalPrmLatDynsCoorrBrk01.TQS16_AYC_MQ_WEG_VEL_20K" 0 /end CHARACTERISTIC
/begin CHARACTERISTIC TQS16_AYC_MQ_WEG_VEL_40K "" VALUE 0x80020B88 CalPrmLatDynsCoorrBrk_SWORD 0 Gain -32768 32767 SYMBOL_LINK "CalPrmLatDynsCoorrBrk01.TQS16_AYC_MQ_WEG_VEL_40K" 0 /end CHARACTERISTIC
/begin CHARACTERISTIC TQS16_AYC_MQ_WEG_VEL_60K "" VALUE 0x80020B8A CalPrmLatDynsCoorrBrk_SWORD 0 Gain -32768 32767 SYMBOL_LINK "CalPrmLatDynsCoorrBrk01.TQS16_AYC_MQ_WEG_VEL_60K" 0 /end CHARACTERISTIC
/begin CHARACTERISTIC TQS16_AYC_MQ_WEG_VEL_80K "" VALUE 0x80020B8C CalPrmLatDynsCoorrBrk_SWORD 0 Gain -32768 32767 SYMBOL_LINK "CalPrmLatDynsCoorrBrk01.TQS16_AYC_MQ_WEG_VEL_80K" 0 /end CHARACTERISTIC
/begin CHARACTERISTIC TQS16_AYC_P_GAIN_INSIDE_DEC "" VALUE 0x80020B80 CalPrmLatDynsCoorrBrk_SWORD 0 Gain -32768 32767 SYMBOL_LINK "CalPrmLatDynsCoorrBrk01.TQS16_AYC_P_GAIN_INSIDE_DEC" 0 /end CHARACTERISTIC
/begin CHARACTERISTIC TQS16_AYC_P_GAIN_INSIDE_INC "" VALUE 0x80020B82 CalPrmLatDynsCoorrBrk_SWORD 0 Gain -32768 32767 SYMBOL_LINK "CalPrmLatDynsCoorrBrk01.TQS16_AYC_P_GAIN_INSIDE_INC" 0 /end CHARACTERISTIC
/begin CHARACTERISTIC TQS16_AYC_P_GAIN_OUTSIDE_DEC "" VALUE 0x80020B78 CalPrmLatDynsCoorrBrk_SWORD 0 Gain -32768 32767 SYMBOL_LINK "CalPrmLatDynsCoorrBrk01.TQS16_AYC_P_GAIN_OUTSIDE_DEC" 0 /end CHARACTERISTIC
/begin CHARACTERISTIC TQS16_AYC_P_GAIN_OUTSIDE_INC "" VALUE 0x80020B7A CalPrmLatDynsCoorrBrk_SWORD 0 Gain -32768 32767 SYMBOL_LINK "CalPrmLatDynsCoorrBrk01.TQS16_AYC_P_GAIN_OUTSIDE_INC" 0 /end CHARACTERISTIC
/begin CHARACTERISTIC TQS16_AY_P_GAIN_FED_FOWR "" VALUE 0x80020B72 CalPrmLatDynsCoorrBrk_SWORD 0 Gain -32768 32767 SYMBOL_LINK "CalPrmLatDynsCoorrBrk01.TQS16_AY_P_GAIN_FED_FOWR" 0 /end CHARACTERISTIC
/begin CHARACTERISTIC TQS16_AY_REF_DYN_WEG_VEL_100K "" VALUE 0x80020B8E CalPrmLatDynsCoorrBrk_SWORD 0 Gain -32768 32767 SYMBOL_LINK "CalPrmLatDynsCoorrBrk01.TQS16_AY_REF_DYN_WEG_VEL_100K" 0 /end CHARACTERISTIC
/begin CHARACTERISTIC TQS16_AY_REF_DYN_WEG_VEL_20K "" VALUE 0x80020B90 CalPrmLatDynsCoorrBrk_SWORD 0 Gain -32768 32767 SYMBOL_LINK "CalPrmLatDynsCoorrBrk01.TQS16_AY_REF_DYN_WEG_VEL_20K" 0 /end CHARACTERISTIC
/begin CHARACTERISTIC TQS16_AY_REF_DYN_WEG_VEL_40K "" VALUE 0x80020B92 CalPrmLatDynsCoorrBrk_SWORD 0 Gain -32768 32767 SYMBOL_LINK "CalPrmLatDynsCoorrBrk01.TQS16_AY_REF_DYN_WEG_VEL_40K" 0 /end CHARACTERISTIC
/begin CHARACTERISTIC TQS16_AY_REF_DYN_WEG_VEL_60K "" VALUE 0x80020B94 CalPrmLatDynsCoorrBrk_SWORD 0 Gain -32768 32767 SYMBOL_LINK "CalPrmLatDynsCoorrBrk01.TQS16_AY_REF_DYN_WEG_VEL_60K" 0 /end CHARACTERISTIC
/begin CHARACTERISTIC TQS16_AY_REF_DYN_WEG_VEL_80K "" VALUE 0x80020B96 CalPrmLatDynsCoorrBrk_SWORD 0 Gain -32768 32767 SYMBOL_LINK "CalPrmLatDynsCoorrBrk01.TQS16_AY_REF_DYN_WEG_VEL_80K" 0 /end CHARACTERISTIC
/begin CHARACTERISTIC TQS16_AY_REF_MAX_OFFSET "" VALUE 0x80020B98 CalPrmLatDynsCoorrBrk_SWORD 0 Gain -32768 32767 SYMBOL_LINK "CalPrmLatDynsCoorrBrk01.TQS16_AY_REF_MAX_OFFSET" 0 /end CHARACTERISTIC
/begin CHARACTERISTIC TQS16_AY_REF_MIN_OFFSET "" VALUE 0x80020B9A CalPrmLatDynsCoorrBrk_SWORD 0 Gain -32768 32767 SYMBOL_LINK "CalPrmLatDynsCoorrBrk01.TQS16_AY_REF_MIN_OFFSET" 0 /end CHARACTERISTIC
/begin CHARACTERISTIC TQS16_AY_REF_WEG_VEL_100K "" VALUE 0x80020B9C CalPrmLatDynsCoorrBrk_SWORD 0 Gain -32768 32767 SYMBOL_LINK "CalPrmLatDynsCoorrBrk01.TQS16_AY_REF_WEG_VEL_100K" 0 /end CHARACTERISTIC
/begin CHARACTERISTIC TQS16_AY_REF_WEG_VEL_20K "" VALUE 0x80020B9E CalPrmLatDynsCoorrBrk_SWORD 0 Gain -32768 32767 SYMBOL_LINK "CalPrmLatDynsCoorrBrk01.TQS16_AY_REF_WEG_VEL_20K" 0 /end CHARACTERISTIC
/begin CHARACTERISTIC TQS16_AY_REF_WEG_VEL_40K "" VALUE 0x80020BA0 CalPrmLatDynsCoorrBrk_SWORD 0 Gain -32768 32767 SYMBOL_LINK "CalPrmLatDynsCoorrBrk01.TQS16_AY_REF_WEG_VEL_40K" 0 /end CHARACTERISTIC
/begin CHARACTERISTIC TQS16_AY_REF_WEG_VEL_60K "" VALUE 0x80020BA2 CalPrmLatDynsCoorrBrk_SWORD 0 Gain -32768 32767 SYMBOL_LINK "CalPrmLatDynsCoorrBrk01.TQS16_AY_REF_WEG_VEL_60K" 0 /end CHARACTERISTIC
/begin CHARACTERISTIC TQS16_AY_REF_WEG_VEL_80K "" VALUE 0x80020BA4 CalPrmLatDynsCoorrBrk_SWORD 0 Gain -32768 32767 SYMBOL_LINK "CalPrmLatDynsCoorrBrk01.TQS16_AY_REF_WEG_VEL_80K" 0 /end CHARACTERISTIC
/begin CHARACTERISTIC TQS16_BRK_TORQ_D_GAIN "" VALUE 0x8002081C CalPrmLatDynsCoorrBrk_SWORD 0 Gain -32768 32767 SYMBOL_LINK "CalPrmLatDynsCoorrBrk01.TQS16_BRK_TORQ_D_GAIN" 0 /end CHARACTERISTIC
/begin CHARACTERISTIC TQS16_BRK_TORQ_P_GAIN "" VALUE 0x8002081A CalPrmLatDynsCoorrBrk_SWORD 0 Gain -32768 32767 SYMBOL_LINK "CalPrmLatDynsCoorrBrk01.TQS16_BRK_TORQ_P_GAIN" 0 /end CHARACTERISTIC
/begin CHARACTERISTIC TQS16_BRK_TORQ_P_GAIN_SLIP_X1_HMU "" VALUE 0x80020E64 CalPrmLatDynsCoorrBrk_SWORD 0 Gain -32768 32767 SYMBOL_LINK "CalPrmLatDynsCoorrBrk01.TQS16_BRK_TORQ_P_GAIN_SLIP_X1_HMU" 0 /end CHARACTERISTIC
/begin CHARACTERISTIC TQS16_BRK_TORQ_P_GAIN_SLIP_X1_LMU "" VALUE 0x80020E58 CalPrmLatDynsCoorrBrk_SWORD 0 Gain -32768 32767 SYMBOL_LINK "CalPrmLatDynsCoorrBrk01.TQS16_BRK_TORQ_P_GAIN_SLIP_X1_LMU" 0 /end CHARACTERISTIC
/begin CHARACTERISTIC TQS16_BRK_TORQ_P_GAIN_SLIP_X1_MMU "" VALUE 0x80020E5E CalPrmLatDynsCoorrBrk_SWORD 0 Gain -32768 32767 SYMBOL_LINK "CalPrmLatDynsCoorrBrk01.TQS16_BRK_TORQ_P_GAIN_SLIP_X1_MMU" 0 /end CHARACTERISTIC
/begin CHARACTERISTIC TQS16_BRK_TORQ_P_GAIN_SLIP_X2_HMU "" VALUE 0x80020E66 CalPrmLatDynsCoorrBrk_SWORD 0 Gain -32768 32767 SYMBOL_LINK "CalPrmLatDynsCoorrBrk01.TQS16_BRK_TORQ_P_GAIN_SLIP_X2_HMU" 0 /end CHARACTERISTIC
/begin CHARACTERISTIC TQS16_BRK_TORQ_P_GAIN_SLIP_X2_LMU "" VALUE 0x80020E5A CalPrmLatDynsCoorrBrk_SWORD 0 Gain -32768 32767 SYMBOL_LINK "CalPrmLatDynsCoorrBrk01.TQS16_BRK_TORQ_P_GAIN_SLIP_X2_LMU" 0 /end CHARACTERISTIC
/begin CHARACTERISTIC TQS16_BRK_TORQ_P_GAIN_SLIP_X2_MMU "" VALUE 0x80020E60 CalPrmLatDynsCoorrBrk_SWORD 0 Gain -32768 32767 SYMBOL_LINK "CalPrmLatDynsCoorrBrk01.TQS16_BRK_TORQ_P_GAIN_SLIP_X2_MMU" 0 /end CHARACTERISTIC
/begin CHARACTERISTIC TQS16_BRK_TORQ_P_GAIN_SLIP_X3_HMU "" VALUE 0x80020E68 CalPrmLatDynsCoorrBrk_SWORD 0 Gain -32768 32767 SYMBOL_LINK "CalPrmLatDynsCoorrBrk01.TQS16_BRK_TORQ_P_GAIN_SLIP_X3_HMU" 0 /end CHARACTERISTIC
/begin CHARACTERISTIC TQS16_BRK_TORQ_P_GAIN_SLIP_X3_LMU "" VALUE 0x80020E5C CalPrmLatDynsCoorrBrk_SWORD 0 Gain -32768 32767 SYMBOL_LINK "CalPrmLatDynsCoorrBrk01.TQS16_BRK_TORQ_P_GAIN_SLIP_X3_LMU" 0 /end CHARACTERISTIC
/begin CHARACTERISTIC TQS16_BRK_TORQ_P_GAIN_SLIP_X3_MMU "" VALUE 0x80020E62 CalPrmLatDynsCoorrBrk_SWORD 0 Gain -32768 32767 SYMBOL_LINK "CalPrmLatDynsCoorrBrk01.TQS16_BRK_TORQ_P_GAIN_SLIP_X3_MMU" 0 /end CHARACTERISTIC
/begin CHARACTERISTIC TQS16_BRK_TORQ_P_HV_HMU "" VALUE 0x80020E44 CalPrmLatDynsCoorrBrk_SWORD 0 Gain -32768 32767 SYMBOL_LINK "CalPrmLatDynsCoorrBrk01.TQS16_BRK_TORQ_P_HV_HMU" 0 /end CHARACTERISTIC
/begin CHARACTERISTIC TQS16_BRK_TORQ_P_HV_LMU "" VALUE 0x80020E38 CalPrmLatDynsCoorrBrk_SWORD 0 Gain -32768 32767 SYMBOL_LINK "CalPrmLatDynsCoorrBrk01.TQS16_BRK_TORQ_P_HV_LMU" 0 /end CHARACTERISTIC
/begin CHARACTERISTIC TQS16_BRK_TORQ_P_HV_MMU "" VALUE 0x80020E3E CalPrmLatDynsCoorrBrk_SWORD 0 Gain -32768 32767 SYMBOL_LINK "CalPrmLatDynsCoorrBrk01.TQS16_BRK_TORQ_P_HV_MMU" 0 /end CHARACTERISTIC
/begin CHARACTERISTIC TQS16_BRK_TORQ_P_LV_HMU "" VALUE 0x80020E40 CalPrmLatDynsCoorrBrk_SWORD 0 Gain -32768 32767 SYMBOL_LINK "CalPrmLatDynsCoorrBrk01.TQS16_BRK_TORQ_P_LV_HMU" 0 /end CHARACTERISTIC
/begin CHARACTERISTIC TQS16_BRK_TORQ_P_LV_LMU "" VALUE 0x80020E34 CalPrmLatDynsCoorrBrk_SWORD 0 Gain -32768 32767 SYMBOL_LINK "CalPrmLatDynsCoorrBrk01.TQS16_BRK_TORQ_P_LV_LMU" 0 /end CHARACTERISTIC
/begin CHARACTERISTIC TQS16_BRK_TORQ_P_LV_MMU "" VALUE 0x80020E3A CalPrmLatDynsCoorrBrk_SWORD 0 Gain -32768 32767 SYMBOL_LINK "CalPrmLatDynsCoorrBrk01.TQS16_BRK_TORQ_P_LV_MMU" 0 /end CHARACTERISTIC
/begin CHARACTERISTIC TQS16_BRK_TORQ_P_MV_HMU "" VALUE 0x80020E42 CalPrmLatDynsCoorrBrk_SWORD 0 Gain -32768 32767 SYMBOL_LINK "CalPrmLatDynsCoorrBrk01.TQS16_BRK_TORQ_P_MV_HMU" 0 /end CHARACTERISTIC
/begin CHARACTERISTIC TQS16_BRK_TORQ_P_MV_LMU "" VALUE 0x80020E36 CalPrmLatDynsCoorrBrk_SWORD 0 Gain -32768 32767 SYMBOL_LINK "CalPrmLatDynsCoorrBrk01.TQS16_BRK_TORQ_P_MV_LMU" 0 /end CHARACTERISTIC
/begin CHARACTERISTIC TQS16_BRK_TORQ_P_MV_MMU "" VALUE 0x80020E3C CalPrmLatDynsCoorrBrk_SWORD 0 Gain -32768 32767 SYMBOL_LINK "CalPrmLatDynsCoorrBrk01.TQS16_BRK_TORQ_P_MV_MMU" 0 /end CHARACTERISTIC
/begin CHARACTERISTIC TQS16_DELM_ADD_TH_X1 "" VALUE 0x80020CCA CalPrmLatDynsCoorrBrk_SWORD 0 Gain -32768 32767 SYMBOL_LINK "CalPrmLatDynsCoorrBrk01.TQS16_DELM_ADD_TH_X1" 0 /end CHARACTERISTIC
/begin CHARACTERISTIC TQS16_DELM_ADD_TH_X2 "" VALUE 0x80020CCC CalPrmLatDynsCoorrBrk_SWORD 0 Gain -32768 32767 SYMBOL_LINK "CalPrmLatDynsCoorrBrk01.TQS16_DELM_ADD_TH_X2" 0 /end CHARACTERISTIC
/begin CHARACTERISTIC TQS16_DELM_ADD_TH_X3 "" VALUE 0x80020CCE CalPrmLatDynsCoorrBrk_SWORD 0 Gain -32768 32767 SYMBOL_LINK "CalPrmLatDynsCoorrBrk01.TQS16_DELM_ADD_TH_X3" 0 /end CHARACTERISTIC
/begin CHARACTERISTIC TQS16_EHC_CAL_TQ_MAX_HM "" VALUE 0x80020F1A CalPrmLatDynsCoorrBrk_SWORD 0 Gain -32768 32767 SYMBOL_LINK "CalPrmLatDynsCoorrBrk01.TQS16_EHC_CAL_TQ_MAX_HM" 0 /end CHARACTERISTIC
/begin CHARACTERISTIC TQS16_EHC_CAL_TQ_MAX_MM "" VALUE 0x80020F18 CalPrmLatDynsCoorrBrk_SWORD 0 Gain -32768 32767 SYMBOL_LINK "CalPrmLatDynsCoorrBrk01.TQS16_EHC_CAL_TQ_MAX_MM" 0 /end CHARACTERISTIC
/begin CHARACTERISTIC TQS16_EHC_CAL_TQ_MIN_HM "" VALUE 0x80020F1E CalPrmLatDynsCoorrBrk_SWORD 0 Gain -32768 32767 SYMBOL_LINK "CalPrmLatDynsCoorrBrk01.TQS16_EHC_CAL_TQ_MIN_HM" 0 /end CHARACTERISTIC
/begin CHARACTERISTIC TQS16_EHC_CAL_TQ_MIN_MM "" VALUE 0x80020F1C CalPrmLatDynsCoorrBrk_SWORD 0 Gain -32768 32767 SYMBOL_LINK "CalPrmLatDynsCoorrBrk01.TQS16_EHC_CAL_TQ_MIN_MM" 0 /end CHARACTERISTIC
/begin CHARACTERISTIC TQS16_EHC_TORQ_DEC_100K "" VALUE 0x80020D14 CalPrmLatDynsCoorrBrk_SWORD 0 Gain -32768 32767 SYMBOL_LINK "CalPrmLatDynsCoorrBrk01.TQS16_EHC_TORQ_DEC_100K" 0 /end CHARACTERISTIC
/begin CHARACTERISTIC TQS16_EHC_TORQ_DEC_40K "" VALUE 0x80020D0E CalPrmLatDynsCoorrBrk_SWORD 0 Gain -32768 32767 SYMBOL_LINK "CalPrmLatDynsCoorrBrk01.TQS16_EHC_TORQ_DEC_40K" 0 /end CHARACTERISTIC
/begin CHARACTERISTIC TQS16_EHC_TORQ_DEC_60K "" VALUE 0x80020D10 CalPrmLatDynsCoorrBrk_SWORD 0 Gain -32768 32767 SYMBOL_LINK "CalPrmLatDynsCoorrBrk01.TQS16_EHC_TORQ_DEC_60K" 0 /end CHARACTERISTIC
/begin CHARACTERISTIC TQS16_EHC_TORQ_DEC_80K "" VALUE 0x80020D12 CalPrmLatDynsCoorrBrk_SWORD 0 Gain -32768 32767 SYMBOL_LINK "CalPrmLatDynsCoorrBrk01.TQS16_EHC_TORQ_DEC_80K" 0 /end CHARACTERISTIC
/begin CHARACTERISTIC TQS16_EHC_TORQ_MAX "" VALUE 0x80020CDC CalPrmLatDynsCoorrBrk_SWORD 0 Gain -32768 32767 SYMBOL_LINK "CalPrmLatDynsCoorrBrk01.TQS16_EHC_TORQ_MAX" 0 /end CHARACTERISTIC
/begin CHARACTERISTIC TQS16_EHC_TORQ_WEG_WSTRD "" VALUE 0x80020D20 CalPrmLatDynsCoorrBrk_SWORD 0 Gain -32768 32767 SYMBOL_LINK "CalPrmLatDynsCoorrBrk01.TQS16_EHC_TORQ_WEG_WSTRD" 0 /end CHARACTERISTIC
/begin CHARACTERISTIC TQS16_EHC_TORQ_WEG_YAWD "" VALUE 0x80020D1E CalPrmLatDynsCoorrBrk_SWORD 0 Gain -32768 32767 SYMBOL_LINK "CalPrmLatDynsCoorrBrk01.TQS16_EHC_TORQ_WEG_YAWD" 0 /end CHARACTERISTIC
/begin CHARACTERISTIC TQS16_EHC_TORQ_WSTR_WEG_HM_100K "" VALUE 0x80020EF0 CalPrmLatDynsCoorrBrk_SWORD 0 Gain -32768 32767 SYMBOL_LINK "CalPrmLatDynsCoorrBrk01.TQS16_EHC_TORQ_WSTR_WEG_HM_100K" 0 /end CHARACTERISTIC
/begin CHARACTERISTIC TQS16_EHC_TORQ_WSTR_WEG_HM_40K "" VALUE 0x80020EEA CalPrmLatDynsCoorrBrk_SWORD 0 Gain -32768 32767 SYMBOL_LINK "CalPrmLatDynsCoorrBrk01.TQS16_EHC_TORQ_WSTR_WEG_HM_40K" 0 /end CHARACTERISTIC
/begin CHARACTERISTIC TQS16_EHC_TORQ_WSTR_WEG_HM_60K "" VALUE 0x80020EEC CalPrmLatDynsCoorrBrk_SWORD 0 Gain -32768 32767 SYMBOL_LINK "CalPrmLatDynsCoorrBrk01.TQS16_EHC_TORQ_WSTR_WEG_HM_60K" 0 /end CHARACTERISTIC
/begin CHARACTERISTIC TQS16_EHC_TORQ_WSTR_WEG_HM_80K "" VALUE 0x80020EEE CalPrmLatDynsCoorrBrk_SWORD 0 Gain -32768 32767 SYMBOL_LINK "CalPrmLatDynsCoorrBrk01.TQS16_EHC_TORQ_WSTR_WEG_HM_80K" 0 /end CHARACTERISTIC
/begin CHARACTERISTIC TQS16_EHC_TORQ_WSTR_WEG_MM_100K "" VALUE 0x80020EF8 CalPrmLatDynsCoorrBrk_SWORD 0 Gain -32768 32767 SYMBOL_LINK "CalPrmLatDynsCoorrBrk01.TQS16_EHC_TORQ_WSTR_WEG_MM_100K" 0 /end CHARACTERISTIC
/begin CHARACTERISTIC TQS16_EHC_TORQ_WSTR_WEG_MM_40K "" VALUE 0x80020EF2 CalPrmLatDynsCoorrBrk_SWORD 0 Gain -32768 32767 SYMBOL_LINK "CalPrmLatDynsCoorrBrk01.TQS16_EHC_TORQ_WSTR_WEG_MM_40K" 0 /end CHARACTERISTIC
/begin CHARACTERISTIC TQS16_EHC_TORQ_WSTR_WEG_MM_60K "" VALUE 0x80020EF4 CalPrmLatDynsCoorrBrk_SWORD 0 Gain -32768 32767 SYMBOL_LINK "CalPrmLatDynsCoorrBrk01.TQS16_EHC_TORQ_WSTR_WEG_MM_60K" 0 /end CHARACTERISTIC
/begin CHARACTERISTIC TQS16_EHC_TORQ_WSTR_WEG_MM_80K "" VALUE 0x80020EF6 CalPrmLatDynsCoorrBrk_SWORD 0 Gain -32768 32767 SYMBOL_LINK "CalPrmLatDynsCoorrBrk01.TQS16_EHC_TORQ_WSTR_WEG_MM_80K" 0 /end CHARACTERISTIC
/begin CHARACTERISTIC TQS16_EHC_TQ_DEC_RATE_1 "" VALUE 0x80020F10 CalPrmLatDynsCoorrBrk_SWORD 0 Gain -32768 32767 SYMBOL_LINK "CalPrmLatDynsCoorrBrk01.TQS16_EHC_TQ_DEC_RATE_1" 0 /end CHARACTERISTIC
/begin CHARACTERISTIC TQS16_EHC_TQ_DEC_RATE_2 "" VALUE 0x80020F12 CalPrmLatDynsCoorrBrk_SWORD 0 Gain -32768 32767 SYMBOL_LINK "CalPrmLatDynsCoorrBrk01.TQS16_EHC_TQ_DEC_RATE_2" 0 /end CHARACTERISTIC
/begin CHARACTERISTIC TQS16_EHC_TQ_DEC_RATE_3 "" VALUE 0x80020F14 CalPrmLatDynsCoorrBrk_SWORD 0 Gain -32768 32767 SYMBOL_LINK "CalPrmLatDynsCoorrBrk01.TQS16_EHC_TQ_DEC_RATE_3" 0 /end CHARACTERISTIC
/begin CHARACTERISTIC TQS16_EHC_TQ_DEC_YAW_TH_1 "" VALUE 0x80020F0A CalPrmLatDynsCoorrBrk_SWORD 0 Gain -32768 32767 SYMBOL_LINK "CalPrmLatDynsCoorrBrk01.TQS16_EHC_TQ_DEC_YAW_TH_1" 0 /end CHARACTERISTIC
/begin CHARACTERISTIC TQS16_EHC_TQ_DEC_YAW_TH_2 "" VALUE 0x80020F0C CalPrmLatDynsCoorrBrk_SWORD 0 Gain -32768 32767 SYMBOL_LINK "CalPrmLatDynsCoorrBrk01.TQS16_EHC_TQ_DEC_YAW_TH_2" 0 /end CHARACTERISTIC
/begin CHARACTERISTIC TQS16_EHC_TQ_DEC_YAW_TH_3 "" VALUE 0x80020F0E CalPrmLatDynsCoorrBrk_SWORD 0 Gain -32768 32767 SYMBOL_LINK "CalPrmLatDynsCoorrBrk01.TQS16_EHC_TQ_DEC_YAW_TH_3" 0 /end CHARACTERISTIC
/begin CHARACTERISTIC TQS16_OS2W_CTRL_ENTER_TH "" VALUE 0x80020D52 CalPrmLatDynsCoorrBrk_SWORD 0 Gain -32768 32767 SYMBOL_LINK "CalPrmLatDynsCoorrBrk01.TQS16_OS2W_CTRL_ENTER_TH" 0 /end CHARACTERISTIC
/begin CHARACTERISTIC TQS16_OS2W_CTRL_EXIT_TH "" VALUE 0x80020D54 CalPrmLatDynsCoorrBrk_SWORD 0 Gain -32768 32767 SYMBOL_LINK "CalPrmLatDynsCoorrBrk01.TQS16_OS2W_CTRL_EXIT_TH" 0 /end CHARACTERISTIC
/begin CHARACTERISTIC TQS16_OS2W_CTRL_SLIP_WEG "" VALUE 0x80020D4E CalPrmLatDynsCoorrBrk_SWORD 0 Gain -32768 32767 SYMBOL_LINK "CalPrmLatDynsCoorrBrk01.TQS16_OS2W_CTRL_SLIP_WEG" 0 /end CHARACTERISTIC
/begin CHARACTERISTIC TQS16_OS2W_ENTER_TAR_FX_OFFSET "" VALUE 0x80020816 CalPrmLatDynsCoorrBrk_SWORD 0 Gain -32768 32767 SYMBOL_LINK "CalPrmLatDynsCoorrBrk01.TQS16_OS2W_ENTER_TAR_FX_OFFSET" 0 /end CHARACTERISTIC
/begin CHARACTERISTIC TQS16_OS_FRT_TAR_PRESS_MIN_HMU "" VALUE 0x80020E6E CalPrmLatDynsCoorrBrk_SWORD 0 Gain -32768 32767 SYMBOL_LINK "CalPrmLatDynsCoorrBrk01.TQS16_OS_FRT_TAR_PRESS_MIN_HMU" 0 /end CHARACTERISTIC
/begin CHARACTERISTIC TQS16_OS_FRT_TAR_PRESS_MIN_LMU "" VALUE 0x80020E6A CalPrmLatDynsCoorrBrk_SWORD 0 Gain -32768 32767 SYMBOL_LINK "CalPrmLatDynsCoorrBrk01.TQS16_OS_FRT_TAR_PRESS_MIN_LMU" 0 /end CHARACTERISTIC
/begin CHARACTERISTIC TQS16_OS_FRT_TAR_PRESS_MIN_MMU "" VALUE 0x80020E6C CalPrmLatDynsCoorrBrk_SWORD 0 Gain -32768 32767 SYMBOL_LINK "CalPrmLatDynsCoorrBrk01.TQS16_OS_FRT_TAR_PRESS_MIN_MMU" 0 /end CHARACTERISTIC
/begin CHARACTERISTIC TQS16_RI_THRES_WEG_IN_ESC_OFF "" VALUE 0x80020C48 CalPrmLatDynsCoorrBrk_SWORD 0 Gain -32768 32767 SYMBOL_LINK "CalPrmLatDynsCoorrBrk01.TQS16_RI_THRES_WEG_IN_ESC_OFF" 0 /end CHARACTERISTIC
/begin CHARACTERISTIC TQS16_ROP_2ND_ENGAGE_SPEED_V1 "" VALUE 0x80020C54 CalPrmLatDynsCoorrBrk_SWORD 0 Gain -32768 32767 SYMBOL_LINK "CalPrmLatDynsCoorrBrk01.TQS16_ROP_2ND_ENGAGE_SPEED_V1" 0 /end CHARACTERISTIC
/begin CHARACTERISTIC TQS16_ROP_2ND_ENGAGE_SPEED_V2 "" VALUE 0x80020C56 CalPrmLatDynsCoorrBrk_SWORD 0 Gain -32768 32767 SYMBOL_LINK "CalPrmLatDynsCoorrBrk01.TQS16_ROP_2ND_ENGAGE_SPEED_V2" 0 /end CHARACTERISTIC
/begin CHARACTERISTIC TQS16_ROP_AY_DOT_TH_1st "" VALUE 0x80020C16 CalPrmLatDynsCoorrBrk_SWORD 0 Gain -32768 32767 SYMBOL_LINK "CalPrmLatDynsCoorrBrk01.TQS16_ROP_AY_DOT_TH_1st" 0 /end CHARACTERISTIC
/begin CHARACTERISTIC TQS16_ROP_AY_DOT_TH_2nd "" VALUE 0x80020C18 CalPrmLatDynsCoorrBrk_SWORD 0 Gain -32768 32767 SYMBOL_LINK "CalPrmLatDynsCoorrBrk01.TQS16_ROP_AY_DOT_TH_2nd" 0 /end CHARACTERISTIC
/begin CHARACTERISTIC TQS16_ROP_DUMP_ALAT_1st "" VALUE 0x80020BA6 CalPrmLatDynsCoorrBrk_SWORD 0 Gain -32768 32767 SYMBOL_LINK "CalPrmLatDynsCoorrBrk01.TQS16_ROP_DUMP_ALAT_1st" 0 /end CHARACTERISTIC
/begin CHARACTERISTIC TQS16_ROP_DUMP_ALAT_2nd "" VALUE 0x80020BA8 CalPrmLatDynsCoorrBrk_SWORD 0 Gain -32768 32767 SYMBOL_LINK "CalPrmLatDynsCoorrBrk01.TQS16_ROP_DUMP_ALAT_2nd" 0 /end CHARACTERISTIC
/begin CHARACTERISTIC TQS16_ROP_DUMP_ALAT_3rd "" VALUE 0x80020BAA CalPrmLatDynsCoorrBrk_SWORD 0 Gain -32768 32767 SYMBOL_LINK "CalPrmLatDynsCoorrBrk01.TQS16_ROP_DUMP_ALAT_3rd" 0 /end CHARACTERISTIC
/begin CHARACTERISTIC TQS16_ROP_DUMP_DYN_WEG_VEL_100K "" VALUE 0x80020BB8 CalPrmLatDynsCoorrBrk_SWORD 0 Gain -32768 32767 SYMBOL_LINK "CalPrmLatDynsCoorrBrk01.TQS16_ROP_DUMP_DYN_WEG_VEL_100K" 0 /end CHARACTERISTIC
/begin CHARACTERISTIC TQS16_ROP_DUMP_DYN_WEG_VEL_20K "" VALUE 0x80020BBA CalPrmLatDynsCoorrBrk_SWORD 0 Gain -32768 32767 SYMBOL_LINK "CalPrmLatDynsCoorrBrk01.TQS16_ROP_DUMP_DYN_WEG_VEL_20K" 0 /end CHARACTERISTIC
/begin CHARACTERISTIC TQS16_ROP_DUMP_DYN_WEG_VEL_40K "" VALUE 0x80020BBC CalPrmLatDynsCoorrBrk_SWORD 0 Gain -32768 32767 SYMBOL_LINK "CalPrmLatDynsCoorrBrk01.TQS16_ROP_DUMP_DYN_WEG_VEL_40K" 0 /end CHARACTERISTIC
/begin CHARACTERISTIC TQS16_ROP_DUMP_DYN_WEG_VEL_60K "" VALUE 0x80020BBE CalPrmLatDynsCoorrBrk_SWORD 0 Gain -32768 32767 SYMBOL_LINK "CalPrmLatDynsCoorrBrk01.TQS16_ROP_DUMP_DYN_WEG_VEL_60K" 0 /end CHARACTERISTIC
/begin CHARACTERISTIC TQS16_ROP_DUMP_DYN_WEG_VEL_80K "" VALUE 0x80020BC0 CalPrmLatDynsCoorrBrk_SWORD 0 Gain -32768 32767 SYMBOL_LINK "CalPrmLatDynsCoorrBrk01.TQS16_ROP_DUMP_DYN_WEG_VEL_80K" 0 /end CHARACTERISTIC
/begin CHARACTERISTIC TQS16_ROP_DUMP_RATE_1st "" VALUE 0x80020BAC CalPrmLatDynsCoorrBrk_SWORD 0 Gain -32768 32767 SYMBOL_LINK "CalPrmLatDynsCoorrBrk01.TQS16_ROP_DUMP_RATE_1st" 0 /end CHARACTERISTIC
/begin CHARACTERISTIC TQS16_ROP_DUMP_RATE_2nd "" VALUE 0x80020BAE CalPrmLatDynsCoorrBrk_SWORD 0 Gain -32768 32767 SYMBOL_LINK "CalPrmLatDynsCoorrBrk01.TQS16_ROP_DUMP_RATE_2nd" 0 /end CHARACTERISTIC
/begin CHARACTERISTIC TQS16_ROP_DUMP_RATE_3rd "" VALUE 0x80020BB0 CalPrmLatDynsCoorrBrk_SWORD 0 Gain -32768 32767 SYMBOL_LINK "CalPrmLatDynsCoorrBrk01.TQS16_ROP_DUMP_RATE_3rd" 0 /end CHARACTERISTIC
/begin CHARACTERISTIC TQS16_ROP_DUMP_RATE_ADD "" VALUE 0x80020BB2 CalPrmLatDynsCoorrBrk_SWORD 0 Gain -32768 32767 SYMBOL_LINK "CalPrmLatDynsCoorrBrk01.TQS16_ROP_DUMP_RATE_ADD" 0 /end CHARACTERISTIC
/begin CHARACTERISTIC TQS16_ROP_DUMP_RATE_SLIP_MAX "" VALUE 0x80020BB4 CalPrmLatDynsCoorrBrk_SWORD 0 Gain -32768 32767 SYMBOL_LINK "CalPrmLatDynsCoorrBrk01.TQS16_ROP_DUMP_RATE_SLIP_MAX" 0 /end CHARACTERISTIC
/begin CHARACTERISTIC TQS16_ROP_DUMP_RATE_SLIP_MIN "" VALUE 0x80020BB6 CalPrmLatDynsCoorrBrk_SWORD 0 Gain -32768 32767 SYMBOL_LINK "CalPrmLatDynsCoorrBrk01.TQS16_ROP_DUMP_RATE_SLIP_MIN" 0 /end CHARACTERISTIC
/begin CHARACTERISTIC TQS16_ROP_DUMP_WEG_VEL_100K "" VALUE 0x80020BC2 CalPrmLatDynsCoorrBrk_SWORD 0 Gain -32768 32767 SYMBOL_LINK "CalPrmLatDynsCoorrBrk01.TQS16_ROP_DUMP_WEG_VEL_100K" 0 /end CHARACTERISTIC
/begin CHARACTERISTIC TQS16_ROP_DUMP_WEG_VEL_20K "" VALUE 0x80020BC4 CalPrmLatDynsCoorrBrk_SWORD 0 Gain -32768 32767 SYMBOL_LINK "CalPrmLatDynsCoorrBrk01.TQS16_ROP_DUMP_WEG_VEL_20K" 0 /end CHARACTERISTIC
/begin CHARACTERISTIC TQS16_ROP_DUMP_WEG_VEL_40K "" VALUE 0x80020BC6 CalPrmLatDynsCoorrBrk_SWORD 0 Gain -32768 32767 SYMBOL_LINK "CalPrmLatDynsCoorrBrk01.TQS16_ROP_DUMP_WEG_VEL_40K" 0 /end CHARACTERISTIC
/begin CHARACTERISTIC TQS16_ROP_DUMP_WEG_VEL_60K "" VALUE 0x80020BC8 CalPrmLatDynsCoorrBrk_SWORD 0 Gain -32768 32767 SYMBOL_LINK "CalPrmLatDynsCoorrBrk01.TQS16_ROP_DUMP_WEG_VEL_60K" 0 /end CHARACTERISTIC
/begin CHARACTERISTIC TQS16_ROP_DUMP_WEG_VEL_80K "" VALUE 0x80020BCA CalPrmLatDynsCoorrBrk_SWORD 0 Gain -32768 32767 SYMBOL_LINK "CalPrmLatDynsCoorrBrk01.TQS16_ROP_DUMP_WEG_VEL_80K" 0 /end CHARACTERISTIC
/begin CHARACTERISTIC TQS16_ROP_FRT_PRESS_MIN "" VALUE 0x80020C3A CalPrmLatDynsCoorrBrk_SWORD 0 Gain -32768 32767 SYMBOL_LINK "CalPrmLatDynsCoorrBrk01.TQS16_ROP_FRT_PRESS_MIN" 0 /end CHARACTERISTIC
/begin CHARACTERISTIC TQS16_ROP_IN_ESC_OFF_D_GAIN_WEG "" VALUE 0x80020C4A CalPrmLatDynsCoorrBrk_SWORD 0 Gain -32768 32767 SYMBOL_LINK "CalPrmLatDynsCoorrBrk01.TQS16_ROP_IN_ESC_OFF_D_GAIN_WEG" 0 /end CHARACTERISTIC
/begin CHARACTERISTIC TQS16_ROP_IN_ESC_OFF_P_GAIN_WEG "" VALUE 0x80020C4C CalPrmLatDynsCoorrBrk_SWORD 0 Gain -32768 32767 SYMBOL_LINK "CalPrmLatDynsCoorrBrk01.TQS16_ROP_IN_ESC_OFF_P_GAIN_WEG" 0 /end CHARACTERISTIC
/begin CHARACTERISTIC TQS16_ROP_IN_ESC_OFF_VEL_ENT_TH "" VALUE 0x80020C4E CalPrmLatDynsCoorrBrk_SWORD 0 Gain -32768 32767 SYMBOL_LINK "CalPrmLatDynsCoorrBrk01.TQS16_ROP_IN_ESC_OFF_VEL_ENT_TH" 0 /end CHARACTERISTIC
/begin CHARACTERISTIC TQS16_ROP_PREFILL_MPRESS_TH "" VALUE 0x80020C1A CalPrmLatDynsCoorrBrk_SWORD 0 Gain -32768 32767 SYMBOL_LINK "CalPrmLatDynsCoorrBrk01.TQS16_ROP_PREFILL_MPRESS_TH" 0 /end CHARACTERISTIC
/begin CHARACTERISTIC TQS16_ROP_PREFILL_MQ_WEG_VEL_100K "" VALUE 0x80020C0C CalPrmLatDynsCoorrBrk_SWORD 0 Gain -32768 32767 SYMBOL_LINK "CalPrmLatDynsCoorrBrk01.TQS16_ROP_PREFILL_MQ_WEG_VEL_100K" 0 /end CHARACTERISTIC
/begin CHARACTERISTIC TQS16_ROP_PREFILL_MQ_WEG_VEL_20K "" VALUE 0x80020C0E CalPrmLatDynsCoorrBrk_SWORD 0 Gain -32768 32767 SYMBOL_LINK "CalPrmLatDynsCoorrBrk01.TQS16_ROP_PREFILL_MQ_WEG_VEL_20K" 0 /end CHARACTERISTIC
/begin CHARACTERISTIC TQS16_ROP_PREFILL_MQ_WEG_VEL_40K "" VALUE 0x80020C10 CalPrmLatDynsCoorrBrk_SWORD 0 Gain -32768 32767 SYMBOL_LINK "CalPrmLatDynsCoorrBrk01.TQS16_ROP_PREFILL_MQ_WEG_VEL_40K" 0 /end CHARACTERISTIC
/begin CHARACTERISTIC TQS16_ROP_PREFILL_MQ_WEG_VEL_60K "" VALUE 0x80020C12 CalPrmLatDynsCoorrBrk_SWORD 0 Gain -32768 32767 SYMBOL_LINK "CalPrmLatDynsCoorrBrk01.TQS16_ROP_PREFILL_MQ_WEG_VEL_60K" 0 /end CHARACTERISTIC
/begin CHARACTERISTIC TQS16_ROP_PREFILL_MQ_WEG_VEL_80K "" VALUE 0x80020C14 CalPrmLatDynsCoorrBrk_SWORD 0 Gain -32768 32767 SYMBOL_LINK "CalPrmLatDynsCoorrBrk01.TQS16_ROP_PREFILL_MQ_WEG_VEL_80K" 0 /end CHARACTERISTIC
/begin CHARACTERISTIC TQS16_ROP_PRESS_RISE_1ST_LMT "" VALUE 0x80020C3C CalPrmLatDynsCoorrBrk_SWORD 0 Gain -32768 32767 SYMBOL_LINK "CalPrmLatDynsCoorrBrk01.TQS16_ROP_PRESS_RISE_1ST_LMT" 0 /end CHARACTERISTIC
/begin CHARACTERISTIC TQS16_ROP_PRESS_RISE_2ND_LMT "" VALUE 0x80020C3E CalPrmLatDynsCoorrBrk_SWORD 0 Gain -32768 32767 SYMBOL_LINK "CalPrmLatDynsCoorrBrk01.TQS16_ROP_PRESS_RISE_2ND_LMT" 0 /end CHARACTERISTIC
/begin CHARACTERISTIC TQS16_ROP_PRE_FRT_CTRL_MIN "" VALUE 0x80020C40 CalPrmLatDynsCoorrBrk_SWORD 0 Gain -32768 32767 SYMBOL_LINK "CalPrmLatDynsCoorrBrk01.TQS16_ROP_PRE_FRT_CTRL_MIN" 0 /end CHARACTERISTIC
/begin CHARACTERISTIC TQS16_ROP_PRE_FRT_ENT_WSTR_TH_V1 "" VALUE 0x80020C58 CalPrmLatDynsCoorrBrk_SWORD 0 Gain -32768 32767 SYMBOL_LINK "CalPrmLatDynsCoorrBrk01.TQS16_ROP_PRE_FRT_ENT_WSTR_TH_V1" 0 /end CHARACTERISTIC
/begin CHARACTERISTIC TQS16_ROP_PRE_FRT_ENT_WSTR_TH_V2 "" VALUE 0x80020C5A CalPrmLatDynsCoorrBrk_SWORD 0 Gain -32768 32767 SYMBOL_LINK "CalPrmLatDynsCoorrBrk01.TQS16_ROP_PRE_FRT_ENT_WSTR_TH_V2" 0 /end CHARACTERISTIC
/begin CHARACTERISTIC TQS16_ROP_PROACTIVE_DEL_SLIP_R "" VALUE 0x80020C42 CalPrmLatDynsCoorrBrk_SWORD 0 Gain -32768 32767 SYMBOL_LINK "CalPrmLatDynsCoorrBrk01.TQS16_ROP_PROACTIVE_DEL_SLIP_R" 0 /end CHARACTERISTIC
/begin CHARACTERISTIC TQS16_ROP_PULSE_UP_INI_DUTY_REAR "" VALUE 0x80020C44 CalPrmLatDynsCoorrBrk_SWORD 0 Gain -32768 32767 SYMBOL_LINK "CalPrmLatDynsCoorrBrk01.TQS16_ROP_PULSE_UP_INI_DUTY_REAR" 0 /end CHARACTERISTIC
/begin CHARACTERISTIC TQS16_ROP_Pre_Frt_Alatm_TH "" VALUE 0x80020C1C CalPrmLatDynsCoorrBrk_SWORD 0 Gain -32768 32767 SYMBOL_LINK "CalPrmLatDynsCoorrBrk01.TQS16_ROP_Pre_Frt_Alatm_TH" 0 /end CHARACTERISTIC
/begin CHARACTERISTIC TQS16_ROP_Pre_Frt_Vel_TH "" VALUE 0x80020C1E CalPrmLatDynsCoorrBrk_SWORD 0 Gain -32768 32767 SYMBOL_LINK "CalPrmLatDynsCoorrBrk01.TQS16_ROP_Pre_Frt_Vel_TH" 0 /end CHARACTERISTIC
/begin CHARACTERISTIC TQS16_ROP_REAR_RISE_PRESS_BAR "" VALUE 0x80020C46 CalPrmLatDynsCoorrBrk_SWORD 0 Gain -32768 32767 SYMBOL_LINK "CalPrmLatDynsCoorrBrk01.TQS16_ROP_REAR_RISE_PRESS_BAR" 0 /end CHARACTERISTIC
/begin CHARACTERISTIC TQS16_SATBLE_FRT_TAR_SLIP_WEG "" VALUE 0x80020D4A CalPrmLatDynsCoorrBrk_SWORD 0 Gain -32768 32767 SYMBOL_LINK "CalPrmLatDynsCoorrBrk01.TQS16_SATBLE_FRT_TAR_SLIP_WEG" 0 /end CHARACTERISTIC
/begin CHARACTERISTIC TQS16_SHAFT_TORQ_WEG "" VALUE 0x8002081E CalPrmLatDynsCoorrBrk_SWORD 0 Gain -32768 32767 SYMBOL_LINK "CalPrmLatDynsCoorrBrk01.TQS16_SHAFT_TORQ_WEG" 0 /end CHARACTERISTIC
/begin CHARACTERISTIC TQS16_SLIP_TAR_X1_HMU "" VALUE 0x80020E52 CalPrmLatDynsCoorrBrk_SWORD 0 Gain -32768 32767 SYMBOL_LINK "CalPrmLatDynsCoorrBrk01.TQS16_SLIP_TAR_X1_HMU" 0 /end CHARACTERISTIC
/begin CHARACTERISTIC TQS16_SLIP_TAR_X1_LMU "" VALUE 0x80020E46 CalPrmLatDynsCoorrBrk_SWORD 0 Gain -32768 32767 SYMBOL_LINK "CalPrmLatDynsCoorrBrk01.TQS16_SLIP_TAR_X1_LMU" 0 /end CHARACTERISTIC
/begin CHARACTERISTIC TQS16_SLIP_TAR_X1_MMU "" VALUE 0x80020E4C CalPrmLatDynsCoorrBrk_SWORD 0 Gain -32768 32767 SYMBOL_LINK "CalPrmLatDynsCoorrBrk01.TQS16_SLIP_TAR_X1_MMU" 0 /end CHARACTERISTIC
/begin CHARACTERISTIC TQS16_SLIP_TAR_X2_HMU "" VALUE 0x80020E54 CalPrmLatDynsCoorrBrk_SWORD 0 Gain -32768 32767 SYMBOL_LINK "CalPrmLatDynsCoorrBrk01.TQS16_SLIP_TAR_X2_HMU" 0 /end CHARACTERISTIC
/begin CHARACTERISTIC TQS16_SLIP_TAR_X2_LMU "" VALUE 0x80020E48 CalPrmLatDynsCoorrBrk_SWORD 0 Gain -32768 32767 SYMBOL_LINK "CalPrmLatDynsCoorrBrk01.TQS16_SLIP_TAR_X2_LMU" 0 /end CHARACTERISTIC
/begin CHARACTERISTIC TQS16_SLIP_TAR_X2_MMU "" VALUE 0x80020E4E CalPrmLatDynsCoorrBrk_SWORD 0 Gain -32768 32767 SYMBOL_LINK "CalPrmLatDynsCoorrBrk01.TQS16_SLIP_TAR_X2_MMU" 0 /end CHARACTERISTIC
/begin CHARACTERISTIC TQS16_SLIP_TAR_X3_HMU "" VALUE 0x80020E56 CalPrmLatDynsCoorrBrk_SWORD 0 Gain -32768 32767 SYMBOL_LINK "CalPrmLatDynsCoorrBrk01.TQS16_SLIP_TAR_X3_HMU" 0 /end CHARACTERISTIC
/begin CHARACTERISTIC TQS16_SLIP_TAR_X3_LMU "" VALUE 0x80020E4A CalPrmLatDynsCoorrBrk_SWORD 0 Gain -32768 32767 SYMBOL_LINK "CalPrmLatDynsCoorrBrk01.TQS16_SLIP_TAR_X3_LMU" 0 /end CHARACTERISTIC
/begin CHARACTERISTIC TQS16_SLIP_TAR_X3_MMU "" VALUE 0x80020E50 CalPrmLatDynsCoorrBrk_SWORD 0 Gain -32768 32767 SYMBOL_LINK "CalPrmLatDynsCoorrBrk01.TQS16_SLIP_TAR_X3_MMU" 0 /end CHARACTERISTIC
/begin CHARACTERISTIC TQS16_SPLIT_FRT_TAR_SLIP_MAX "" VALUE 0x80020824 CalPrmLatDynsCoorrBrk_SWORD 0 Gain -32768 32767 SYMBOL_LINK "CalPrmLatDynsCoorrBrk01.TQS16_SPLIT_FRT_TAR_SLIP_MAX" 0 /end CHARACTERISTIC
/begin CHARACTERISTIC TQS16_SPLIT_REAR_TAR_SLIP_MAX "" VALUE 0x80020826 CalPrmLatDynsCoorrBrk_SWORD 0 Gain -32768 32767 SYMBOL_LINK "CalPrmLatDynsCoorrBrk01.TQS16_SPLIT_REAR_TAR_SLIP_MAX" 0 /end CHARACTERISTIC
/begin CHARACTERISTIC TQS16_STABLE_FRT_TAR_SLIP_MAX "" VALUE 0x80020D4C CalPrmLatDynsCoorrBrk_SWORD 0 Gain -32768 32767 SYMBOL_LINK "CalPrmLatDynsCoorrBrk01.TQS16_STABLE_FRT_TAR_SLIP_MAX" 0 /end CHARACTERISTIC
/begin CHARACTERISTIC TQS16_STABLE_OS2W_REAR_TAR_PRESS_MAX "" VALUE 0x80020C9C CalPrmLatDynsCoorrBrk_SWORD 0 Gain -32768 32767 SYMBOL_LINK "CalPrmLatDynsCoorrBrk01.TQS16_STABLE_OS2W_REAR_TAR_PRESS_MAX" 0 /end CHARACTERISTIC
/begin CHARACTERISTIC TQS16_STABLE_REAR_TAR_SLIP_MAX "" VALUE 0x80020C9A CalPrmLatDynsCoorrBrk_SWORD 0 Gain -32768 32767 SYMBOL_LINK "CalPrmLatDynsCoorrBrk01.TQS16_STABLE_REAR_TAR_SLIP_MAX" 0 /end CHARACTERISTIC
/begin CHARACTERISTIC TQS16_STEER_FRT_TAR_PRESS_MAX "" VALUE 0x80020C9E CalPrmLatDynsCoorrBrk_SWORD 0 Gain -32768 32767 SYMBOL_LINK "CalPrmLatDynsCoorrBrk01.TQS16_STEER_FRT_TAR_PRESS_MAX" 0 /end CHARACTERISTIC
/begin CHARACTERISTIC TQS16_STEER_FRT_TAR_SLIP_MAX "" VALUE 0x80020820 CalPrmLatDynsCoorrBrk_SWORD 0 Gain -32768 32767 SYMBOL_LINK "CalPrmLatDynsCoorrBrk01.TQS16_STEER_FRT_TAR_SLIP_MAX" 0 /end CHARACTERISTIC
/begin CHARACTERISTIC TQS16_STEER_REAR_TAR_PRESS_MAX "" VALUE 0x80020CA0 CalPrmLatDynsCoorrBrk_SWORD 0 Gain -32768 32767 SYMBOL_LINK "CalPrmLatDynsCoorrBrk01.TQS16_STEER_REAR_TAR_PRESS_MAX" 0 /end CHARACTERISTIC
/begin CHARACTERISTIC TQS16_STEER_REAR_TAR_SLIP_MAX "" VALUE 0x80020822 CalPrmLatDynsCoorrBrk_SWORD 0 Gain -32768 32767 SYMBOL_LINK "CalPrmLatDynsCoorrBrk01.TQS16_STEER_REAR_TAR_SLIP_MAX" 0 /end CHARACTERISTIC
/begin CHARACTERISTIC TQS16_TORQ_GRDT_ADD_CNT_HMU "" VALUE 0x80020C96 CalPrmLatDynsCoorrBrk_SWORD 0 Gain -32768 32767 SYMBOL_LINK "CalPrmLatDynsCoorrBrk01.TQS16_TORQ_GRDT_ADD_CNT_HMU" 0 /end CHARACTERISTIC
/begin CHARACTERISTIC TQS16_TORQ_GRDT_ADD_CNT_LMU "" VALUE 0x80020C92 CalPrmLatDynsCoorrBrk_SWORD 0 Gain -32768 32767 SYMBOL_LINK "CalPrmLatDynsCoorrBrk01.TQS16_TORQ_GRDT_ADD_CNT_LMU" 0 /end CHARACTERISTIC
/begin CHARACTERISTIC TQS16_TORQ_GRDT_ADD_CNT_MMU "" VALUE 0x80020C94 CalPrmLatDynsCoorrBrk_SWORD 0 Gain -32768 32767 SYMBOL_LINK "CalPrmLatDynsCoorrBrk01.TQS16_TORQ_GRDT_ADD_CNT_MMU" 0 /end CHARACTERISTIC
/begin CHARACTERISTIC TQS16_TORQ_GRDT_ADD_X2_F_HMU "" VALUE 0x80020C8E CalPrmLatDynsCoorrBrk_SWORD 0 Gain -32768 32767 SYMBOL_LINK "CalPrmLatDynsCoorrBrk01.TQS16_TORQ_GRDT_ADD_X2_F_HMU" 0 /end CHARACTERISTIC
/begin CHARACTERISTIC TQS16_TORQ_GRDT_ADD_X2_F_LMU "" VALUE 0x80020C86 CalPrmLatDynsCoorrBrk_SWORD 0 Gain -32768 32767 SYMBOL_LINK "CalPrmLatDynsCoorrBrk01.TQS16_TORQ_GRDT_ADD_X2_F_LMU" 0 /end CHARACTERISTIC
/begin CHARACTERISTIC TQS16_TORQ_GRDT_ADD_X2_F_MMU "" VALUE 0x80020C8A CalPrmLatDynsCoorrBrk_SWORD 0 Gain -32768 32767 SYMBOL_LINK "CalPrmLatDynsCoorrBrk01.TQS16_TORQ_GRDT_ADD_X2_F_MMU" 0 /end CHARACTERISTIC
/begin CHARACTERISTIC TQS16_TORQ_GRDT_ADD_X3_F_HMU "" VALUE 0x80020C90 CalPrmLatDynsCoorrBrk_SWORD 0 Gain -32768 32767 SYMBOL_LINK "CalPrmLatDynsCoorrBrk01.TQS16_TORQ_GRDT_ADD_X3_F_HMU" 0 /end CHARACTERISTIC
/begin CHARACTERISTIC TQS16_TORQ_GRDT_ADD_X3_F_LMU "" VALUE 0x80020C88 CalPrmLatDynsCoorrBrk_SWORD 0 Gain -32768 32767 SYMBOL_LINK "CalPrmLatDynsCoorrBrk01.TQS16_TORQ_GRDT_ADD_X3_F_LMU" 0 /end CHARACTERISTIC
/begin CHARACTERISTIC TQS16_TORQ_GRDT_ADD_X3_F_MMU "" VALUE 0x80020C8C CalPrmLatDynsCoorrBrk_SWORD 0 Gain -32768 32767 SYMBOL_LINK "CalPrmLatDynsCoorrBrk01.TQS16_TORQ_GRDT_ADD_X3_F_MMU" 0 /end CHARACTERISTIC
/begin CHARACTERISTIC TQS16_TORQ_GRDT_DELM_ADD_X2 "" VALUE 0x80020CD0 CalPrmLatDynsCoorrBrk_SWORD 0 Gain -32768 32767 SYMBOL_LINK "CalPrmLatDynsCoorrBrk01.TQS16_TORQ_GRDT_DELM_ADD_X2" 0 /end CHARACTERISTIC
/begin CHARACTERISTIC TQS16_TORQ_GRDT_DELM_ADD_X3 "" VALUE 0x80020CD2 CalPrmLatDynsCoorrBrk_SWORD 0 Gain -32768 32767 SYMBOL_LINK "CalPrmLatDynsCoorrBrk01.TQS16_TORQ_GRDT_DELM_ADD_X3" 0 /end CHARACTERISTIC
/begin CHARACTERISTIC TQS16_TORQ_GRDT_F_LIMT_HMU_HSP "" VALUE 0x80020CB8 CalPrmLatDynsCoorrBrk_SWORD 0 Gain -32768 32767 SYMBOL_LINK "CalPrmLatDynsCoorrBrk01.TQS16_TORQ_GRDT_F_LIMT_HMU_HSP" 0 /end CHARACTERISTIC
/begin CHARACTERISTIC TQS16_TORQ_GRDT_F_LIMT_HMU_LSP "" VALUE 0x80020CB4 CalPrmLatDynsCoorrBrk_SWORD 0 Gain -32768 32767 SYMBOL_LINK "CalPrmLatDynsCoorrBrk01.TQS16_TORQ_GRDT_F_LIMT_HMU_LSP" 0 /end CHARACTERISTIC
/begin CHARACTERISTIC TQS16_TORQ_GRDT_F_LIMT_HMU_MSP "" VALUE 0x80020CB6 CalPrmLatDynsCoorrBrk_SWORD 0 Gain -32768 32767 SYMBOL_LINK "CalPrmLatDynsCoorrBrk01.TQS16_TORQ_GRDT_F_LIMT_HMU_MSP" 0 /end CHARACTERISTIC
/begin CHARACTERISTIC TQS16_TORQ_GRDT_F_LIMT_LMU_HSP "" VALUE 0x80020CAC CalPrmLatDynsCoorrBrk_SWORD 0 Gain -32768 32767 SYMBOL_LINK "CalPrmLatDynsCoorrBrk01.TQS16_TORQ_GRDT_F_LIMT_LMU_HSP" 0 /end CHARACTERISTIC
/begin CHARACTERISTIC TQS16_TORQ_GRDT_F_LIMT_LMU_LSP "" VALUE 0x80020CA8 CalPrmLatDynsCoorrBrk_SWORD 0 Gain -32768 32767 SYMBOL_LINK "CalPrmLatDynsCoorrBrk01.TQS16_TORQ_GRDT_F_LIMT_LMU_LSP" 0 /end CHARACTERISTIC
/begin CHARACTERISTIC TQS16_TORQ_GRDT_F_LIMT_LMU_MSP "" VALUE 0x80020CAA CalPrmLatDynsCoorrBrk_SWORD 0 Gain -32768 32767 SYMBOL_LINK "CalPrmLatDynsCoorrBrk01.TQS16_TORQ_GRDT_F_LIMT_LMU_MSP" 0 /end CHARACTERISTIC
/begin CHARACTERISTIC TQS16_TORQ_GRDT_F_LIMT_MMU_HSP "" VALUE 0x80020CB2 CalPrmLatDynsCoorrBrk_SWORD 0 Gain -32768 32767 SYMBOL_LINK "CalPrmLatDynsCoorrBrk01.TQS16_TORQ_GRDT_F_LIMT_MMU_HSP" 0 /end CHARACTERISTIC
/begin CHARACTERISTIC TQS16_TORQ_GRDT_F_LIMT_MMU_LSP "" VALUE 0x80020CAE CalPrmLatDynsCoorrBrk_SWORD 0 Gain -32768 32767 SYMBOL_LINK "CalPrmLatDynsCoorrBrk01.TQS16_TORQ_GRDT_F_LIMT_MMU_LSP" 0 /end CHARACTERISTIC
/begin CHARACTERISTIC TQS16_TORQ_GRDT_F_LIMT_MMU_MSP "" VALUE 0x80020CB0 CalPrmLatDynsCoorrBrk_SWORD 0 Gain -32768 32767 SYMBOL_LINK "CalPrmLatDynsCoorrBrk01.TQS16_TORQ_GRDT_F_LIMT_MMU_MSP" 0 /end CHARACTERISTIC
/begin CHARACTERISTIC TQS16_TORQ_GRDT_F_MAX_HMU "" VALUE 0x80020CD4 CalPrmLatDynsCoorrBrk_SWORD 0 Gain -32768 32767 SYMBOL_LINK "CalPrmLatDynsCoorrBrk01.TQS16_TORQ_GRDT_F_MAX_HMU" 0 /end CHARACTERISTIC
/begin CHARACTERISTIC TQS16_TORQ_GRDT_F_MAX_LMU "" VALUE 0x80020CD8 CalPrmLatDynsCoorrBrk_SWORD 0 Gain -32768 32767 SYMBOL_LINK "CalPrmLatDynsCoorrBrk01.TQS16_TORQ_GRDT_F_MAX_LMU" 0 /end CHARACTERISTIC
/begin CHARACTERISTIC TQS16_TORQ_GRDT_F_MAX_MMU "" VALUE 0x80020CD6 CalPrmLatDynsCoorrBrk_SWORD 0 Gain -32768 32767 SYMBOL_LINK "CalPrmLatDynsCoorrBrk01.TQS16_TORQ_GRDT_F_MAX_MMU" 0 /end CHARACTERISTIC
/begin CHARACTERISTIC TQS16_TORQ_GRDT_US2W_F_HMU "" VALUE 0x80020D48 CalPrmLatDynsCoorrBrk_SWORD 0 Gain -32768 32767 SYMBOL_LINK "CalPrmLatDynsCoorrBrk01.TQS16_TORQ_GRDT_US2W_F_HMU" 0 /end CHARACTERISTIC
/begin CHARACTERISTIC TQS16_TORQ_GRDT_US2W_F_LMU "" VALUE 0x80020D44 CalPrmLatDynsCoorrBrk_SWORD 0 Gain -32768 32767 SYMBOL_LINK "CalPrmLatDynsCoorrBrk01.TQS16_TORQ_GRDT_US2W_F_LMU" 0 /end CHARACTERISTIC
/begin CHARACTERISTIC TQS16_TORQ_GRDT_US2W_F_MMU "" VALUE 0x80020D46 CalPrmLatDynsCoorrBrk_SWORD 0 Gain -32768 32767 SYMBOL_LINK "CalPrmLatDynsCoorrBrk01.TQS16_TORQ_GRDT_US2W_F_MMU" 0 /end CHARACTERISTIC
/begin CHARACTERISTIC TQS16_TVBB_CTRL_MOMENT_HIGH "" VALUE 0x80020DEA CalPrmLatDynsCoorrBrk_SWORD 0 Gain -32768 32767 SYMBOL_LINK "CalPrmLatDynsCoorrBrk01.TQS16_TVBB_CTRL_MOMENT_HIGH" 0 /end CHARACTERISTIC
/begin CHARACTERISTIC TQS16_TVBB_CTRL_MOMENT_LOW "" VALUE 0x80020DE4 CalPrmLatDynsCoorrBrk_SWORD 0 Gain -32768 32767 SYMBOL_LINK "CalPrmLatDynsCoorrBrk01.TQS16_TVBB_CTRL_MOMENT_LOW" 0 /end CHARACTERISTIC
/begin CHARACTERISTIC TQS16_TVBB_CTRL_MOMENT_MEDHIGH "" VALUE 0x80020DE8 CalPrmLatDynsCoorrBrk_SWORD 0 Gain -32768 32767 SYMBOL_LINK "CalPrmLatDynsCoorrBrk01.TQS16_TVBB_CTRL_MOMENT_MEDHIGH" 0 /end CHARACTERISTIC
/begin CHARACTERISTIC TQS16_TVBB_CTRL_MOMENT_MEDLOW "" VALUE 0x80020DE6 CalPrmLatDynsCoorrBrk_SWORD 0 Gain -32768 32767 SYMBOL_LINK "CalPrmLatDynsCoorrBrk01.TQS16_TVBB_CTRL_MOMENT_MEDLOW" 0 /end CHARACTERISTIC
/begin CHARACTERISTIC TQS16_TVBB_CTRL_REF_WHL_SLIP_HMU_1 "" VALUE 0x80020DC2 CalPrmLatDynsCoorrBrk_SWORD 0 Gain -32768 32767 SYMBOL_LINK "CalPrmLatDynsCoorrBrk01.TQS16_TVBB_CTRL_REF_WHL_SLIP_HMU_1" 0 /end CHARACTERISTIC
/begin CHARACTERISTIC TQS16_TVBB_CTRL_REF_WHL_SLIP_HMU_2 "" VALUE 0x80020DC4 CalPrmLatDynsCoorrBrk_SWORD 0 Gain -32768 32767 SYMBOL_LINK "CalPrmLatDynsCoorrBrk01.TQS16_TVBB_CTRL_REF_WHL_SLIP_HMU_2" 0 /end CHARACTERISTIC
/begin CHARACTERISTIC TQS16_TVBB_CTRL_REF_WHL_SLIP_HMU_3 "" VALUE 0x80020DC6 CalPrmLatDynsCoorrBrk_SWORD 0 Gain -32768 32767 SYMBOL_LINK "CalPrmLatDynsCoorrBrk01.TQS16_TVBB_CTRL_REF_WHL_SLIP_HMU_3" 0 /end CHARACTERISTIC
/begin CHARACTERISTIC TQS16_TVBB_CTRL_REF_WHL_SLIP_HMU_4 "" VALUE 0x80020DC8 CalPrmLatDynsCoorrBrk_SWORD 0 Gain -32768 32767 SYMBOL_LINK "CalPrmLatDynsCoorrBrk01.TQS16_TVBB_CTRL_REF_WHL_SLIP_HMU_4" 0 /end CHARACTERISTIC
/begin CHARACTERISTIC TQS16_TVBB_CTRL_REF_WHL_SLIP_HMU_5 "" VALUE 0x80020DCA CalPrmLatDynsCoorrBrk_SWORD 0 Gain -32768 32767 SYMBOL_LINK "CalPrmLatDynsCoorrBrk01.TQS16_TVBB_CTRL_REF_WHL_SLIP_HMU_5" 0 /end CHARACTERISTIC
/begin CHARACTERISTIC TQS16_TVBB_CTRL_TAR_TQ_HIGH "" VALUE 0x80020DF2 CalPrmLatDynsCoorrBrk_SWORD 0 Gain -32768 32767 SYMBOL_LINK "CalPrmLatDynsCoorrBrk01.TQS16_TVBB_CTRL_TAR_TQ_HIGH" 0 /end CHARACTERISTIC
/begin CHARACTERISTIC TQS16_TVBB_CTRL_TAR_TQ_LOW "" VALUE 0x80020DEC CalPrmLatDynsCoorrBrk_SWORD 0 Gain -32768 32767 SYMBOL_LINK "CalPrmLatDynsCoorrBrk01.TQS16_TVBB_CTRL_TAR_TQ_LOW" 0 /end CHARACTERISTIC
/begin CHARACTERISTIC TQS16_TVBB_CTRL_TAR_TQ_MEDHIGH "" VALUE 0x80020DF0 CalPrmLatDynsCoorrBrk_SWORD 0 Gain -32768 32767 SYMBOL_LINK "CalPrmLatDynsCoorrBrk01.TQS16_TVBB_CTRL_TAR_TQ_MEDHIGH" 0 /end CHARACTERISTIC
/begin CHARACTERISTIC TQS16_TVBB_CTRL_TAR_TQ_MEDLOW "" VALUE 0x80020DEE CalPrmLatDynsCoorrBrk_SWORD 0 Gain -32768 32767 SYMBOL_LINK "CalPrmLatDynsCoorrBrk01.TQS16_TVBB_CTRL_TAR_TQ_MEDLOW" 0 /end CHARACTERISTIC
/begin CHARACTERISTIC TQS16_TVBB_FADE_DEC_GRDT "" VALUE 0x80020E30 CalPrmLatDynsCoorrBrk_SWORD 0 Gain -32768 32767 SYMBOL_LINK "CalPrmLatDynsCoorrBrk01.TQS16_TVBB_FADE_DEC_GRDT" 0 /end CHARACTERISTIC
/begin CHARACTERISTIC TQS16_TVBB_FADE_TORQ_TH "" VALUE 0x80020E32 CalPrmLatDynsCoorrBrk_SWORD 0 Gain -32768 32767 SYMBOL_LINK "CalPrmLatDynsCoorrBrk01.TQS16_TVBB_FADE_TORQ_TH" 0 /end CHARACTERISTIC
/begin CHARACTERISTIC TQS16_TVBB_YC_D_GAIN_DEC_HM "" VALUE 0x80020D8C CalPrmLatDynsCoorrBrk_SWORD 0 Gain -32768 32767 SYMBOL_LINK "CalPrmLatDynsCoorrBrk01.TQS16_TVBB_YC_D_GAIN_DEC_HM" 0 /end CHARACTERISTIC
/begin CHARACTERISTIC TQS16_TVBB_YC_D_GAIN_DEC_LM "" VALUE 0x80020D90 CalPrmLatDynsCoorrBrk_SWORD 0 Gain -32768 32767 SYMBOL_LINK "CalPrmLatDynsCoorrBrk01.TQS16_TVBB_YC_D_GAIN_DEC_LM" 0 /end CHARACTERISTIC
/begin CHARACTERISTIC TQS16_TVBB_YC_D_GAIN_DEC_MM "" VALUE 0x80020D8E CalPrmLatDynsCoorrBrk_SWORD 0 Gain -32768 32767 SYMBOL_LINK "CalPrmLatDynsCoorrBrk01.TQS16_TVBB_YC_D_GAIN_DEC_MM" 0 /end CHARACTERISTIC
/begin CHARACTERISTIC TQS16_TVBB_YC_D_GAIN_INC_HM "" VALUE 0x80020D80 CalPrmLatDynsCoorrBrk_SWORD 0 Gain -32768 32767 SYMBOL_LINK "CalPrmLatDynsCoorrBrk01.TQS16_TVBB_YC_D_GAIN_INC_HM" 0 /end CHARACTERISTIC
/begin CHARACTERISTIC TQS16_TVBB_YC_D_GAIN_INC_LM "" VALUE 0x80020D84 CalPrmLatDynsCoorrBrk_SWORD 0 Gain -32768 32767 SYMBOL_LINK "CalPrmLatDynsCoorrBrk01.TQS16_TVBB_YC_D_GAIN_INC_LM" 0 /end CHARACTERISTIC
/begin CHARACTERISTIC TQS16_TVBB_YC_D_GAIN_INC_MM "" VALUE 0x80020D82 CalPrmLatDynsCoorrBrk_SWORD 0 Gain -32768 32767 SYMBOL_LINK "CalPrmLatDynsCoorrBrk01.TQS16_TVBB_YC_D_GAIN_INC_MM" 0 /end CHARACTERISTIC
/begin CHARACTERISTIC TQS16_TVBB_YC_P_GAIN_DEC_HM "" VALUE 0x80020D86 CalPrmLatDynsCoorrBrk_SWORD 0 Gain -32768 32767 SYMBOL_LINK "CalPrmLatDynsCoorrBrk01.TQS16_TVBB_YC_P_GAIN_DEC_HM" 0 /end CHARACTERISTIC
/begin CHARACTERISTIC TQS16_TVBB_YC_P_GAIN_DEC_LM "" VALUE 0x80020D8A CalPrmLatDynsCoorrBrk_SWORD 0 Gain -32768 32767 SYMBOL_LINK "CalPrmLatDynsCoorrBrk01.TQS16_TVBB_YC_P_GAIN_DEC_LM" 0 /end CHARACTERISTIC
/begin CHARACTERISTIC TQS16_TVBB_YC_P_GAIN_DEC_MM "" VALUE 0x80020D88 CalPrmLatDynsCoorrBrk_SWORD 0 Gain -32768 32767 SYMBOL_LINK "CalPrmLatDynsCoorrBrk01.TQS16_TVBB_YC_P_GAIN_DEC_MM" 0 /end CHARACTERISTIC
/begin CHARACTERISTIC TQS16_TVBB_YC_P_GAIN_INC_HM "" VALUE 0x80020D7A CalPrmLatDynsCoorrBrk_SWORD 0 Gain -32768 32767 SYMBOL_LINK "CalPrmLatDynsCoorrBrk01.TQS16_TVBB_YC_P_GAIN_INC_HM" 0 /end CHARACTERISTIC
/begin CHARACTERISTIC TQS16_TVBB_YC_P_GAIN_INC_LM "" VALUE 0x80020D7E CalPrmLatDynsCoorrBrk_SWORD 0 Gain -32768 32767 SYMBOL_LINK "CalPrmLatDynsCoorrBrk01.TQS16_TVBB_YC_P_GAIN_INC_LM" 0 /end CHARACTERISTIC
/begin CHARACTERISTIC TQS16_TVBB_YC_P_GAIN_INC_MM "" VALUE 0x80020D7C CalPrmLatDynsCoorrBrk_SWORD 0 Gain -32768 32767 SYMBOL_LINK "CalPrmLatDynsCoorrBrk01.TQS16_TVBB_YC_P_GAIN_INC_MM" 0 /end CHARACTERISTIC
/begin CHARACTERISTIC TQS16_UNDER_ENT_DEL_YAW_HMU_HSP "" VALUE 0x80020862 CalPrmLatDynsCoorrBrk_SWORD 0 Gain -32768 32767 SYMBOL_LINK "CalPrmLatDynsCoorrBrk01.TQS16_UNDER_ENT_DEL_YAW_HMU_HSP" 0 /end CHARACTERISTIC
/begin CHARACTERISTIC TQS16_UNDER_ENT_DEL_YAW_HMU_LSP "" VALUE 0x80020864 CalPrmLatDynsCoorrBrk_SWORD 0 Gain -32768 32767 SYMBOL_LINK "CalPrmLatDynsCoorrBrk01.TQS16_UNDER_ENT_DEL_YAW_HMU_LSP" 0 /end CHARACTERISTIC
/begin CHARACTERISTIC TQS16_UNDER_ENT_DEL_YAW_HMU_MSP "" VALUE 0x80020866 CalPrmLatDynsCoorrBrk_SWORD 0 Gain -32768 32767 SYMBOL_LINK "CalPrmLatDynsCoorrBrk01.TQS16_UNDER_ENT_DEL_YAW_HMU_MSP" 0 /end CHARACTERISTIC
/begin CHARACTERISTIC TQS16_UNDER_ENT_DEL_YAW_LMU_HSP "" VALUE 0x8002084A CalPrmLatDynsCoorrBrk_SWORD 0 Gain -32768 32767 SYMBOL_LINK "CalPrmLatDynsCoorrBrk01.TQS16_UNDER_ENT_DEL_YAW_LMU_HSP" 0 /end CHARACTERISTIC
/begin CHARACTERISTIC TQS16_UNDER_ENT_DEL_YAW_LMU_LSP "" VALUE 0x8002084C CalPrmLatDynsCoorrBrk_SWORD 0 Gain -32768 32767 SYMBOL_LINK "CalPrmLatDynsCoorrBrk01.TQS16_UNDER_ENT_DEL_YAW_LMU_LSP" 0 /end CHARACTERISTIC
/begin CHARACTERISTIC TQS16_UNDER_ENT_DEL_YAW_LMU_MSP "" VALUE 0x8002084E CalPrmLatDynsCoorrBrk_SWORD 0 Gain -32768 32767 SYMBOL_LINK "CalPrmLatDynsCoorrBrk01.TQS16_UNDER_ENT_DEL_YAW_LMU_MSP" 0 /end CHARACTERISTIC
/begin CHARACTERISTIC TQS16_UNDER_ENT_DEL_YAW_MMU_HSP "" VALUE 0x80020856 CalPrmLatDynsCoorrBrk_SWORD 0 Gain -32768 32767 SYMBOL_LINK "CalPrmLatDynsCoorrBrk01.TQS16_UNDER_ENT_DEL_YAW_MMU_HSP" 0 /end CHARACTERISTIC
/begin CHARACTERISTIC TQS16_UNDER_ENT_DEL_YAW_MMU_LSP "" VALUE 0x80020858 CalPrmLatDynsCoorrBrk_SWORD 0 Gain -32768 32767 SYMBOL_LINK "CalPrmLatDynsCoorrBrk01.TQS16_UNDER_ENT_DEL_YAW_MMU_LSP" 0 /end CHARACTERISTIC
/begin CHARACTERISTIC TQS16_UNDER_ENT_DEL_YAW_MMU_MSP "" VALUE 0x8002085A CalPrmLatDynsCoorrBrk_SWORD 0 Gain -32768 32767 SYMBOL_LINK "CalPrmLatDynsCoorrBrk01.TQS16_UNDER_ENT_DEL_YAW_MMU_MSP" 0 /end CHARACTERISTIC
/begin CHARACTERISTIC TQS16_UNDER_EXT_DEL_YAW_HMU_HSP "" VALUE 0x80020868 CalPrmLatDynsCoorrBrk_SWORD 0 Gain -32768 32767 SYMBOL_LINK "CalPrmLatDynsCoorrBrk01.TQS16_UNDER_EXT_DEL_YAW_HMU_HSP" 0 /end CHARACTERISTIC
/begin CHARACTERISTIC TQS16_UNDER_EXT_DEL_YAW_HMU_LSP "" VALUE 0x8002086A CalPrmLatDynsCoorrBrk_SWORD 0 Gain -32768 32767 SYMBOL_LINK "CalPrmLatDynsCoorrBrk01.TQS16_UNDER_EXT_DEL_YAW_HMU_LSP" 0 /end CHARACTERISTIC
/begin CHARACTERISTIC TQS16_UNDER_EXT_DEL_YAW_HMU_MSP "" VALUE 0x8002086C CalPrmLatDynsCoorrBrk_SWORD 0 Gain -32768 32767 SYMBOL_LINK "CalPrmLatDynsCoorrBrk01.TQS16_UNDER_EXT_DEL_YAW_HMU_MSP" 0 /end CHARACTERISTIC
/begin CHARACTERISTIC TQS16_UNDER_EXT_DEL_YAW_LMU_HSP "" VALUE 0x80020850 CalPrmLatDynsCoorrBrk_SWORD 0 Gain -32768 32767 SYMBOL_LINK "CalPrmLatDynsCoorrBrk01.TQS16_UNDER_EXT_DEL_YAW_LMU_HSP" 0 /end CHARACTERISTIC
/begin CHARACTERISTIC TQS16_UNDER_EXT_DEL_YAW_LMU_LSP "" VALUE 0x80020852 CalPrmLatDynsCoorrBrk_SWORD 0 Gain -32768 32767 SYMBOL_LINK "CalPrmLatDynsCoorrBrk01.TQS16_UNDER_EXT_DEL_YAW_LMU_LSP" 0 /end CHARACTERISTIC
/begin CHARACTERISTIC TQS16_UNDER_EXT_DEL_YAW_LMU_MSP "" VALUE 0x80020854 CalPrmLatDynsCoorrBrk_SWORD 0 Gain -32768 32767 SYMBOL_LINK "CalPrmLatDynsCoorrBrk01.TQS16_UNDER_EXT_DEL_YAW_LMU_MSP" 0 /end CHARACTERISTIC
/begin CHARACTERISTIC TQS16_UNDER_EXT_DEL_YAW_MMU_HSP "" VALUE 0x8002085C CalPrmLatDynsCoorrBrk_SWORD 0 Gain -32768 32767 SYMBOL_LINK "CalPrmLatDynsCoorrBrk01.TQS16_UNDER_EXT_DEL_YAW_MMU_HSP" 0 /end CHARACTERISTIC
/begin CHARACTERISTIC TQS16_UNDER_EXT_DEL_YAW_MMU_LSP "" VALUE 0x8002085E CalPrmLatDynsCoorrBrk_SWORD 0 Gain -32768 32767 SYMBOL_LINK "CalPrmLatDynsCoorrBrk01.TQS16_UNDER_EXT_DEL_YAW_MMU_LSP" 0 /end CHARACTERISTIC
/begin CHARACTERISTIC TQS16_UNDER_EXT_DEL_YAW_MMU_MSP "" VALUE 0x80020860 CalPrmLatDynsCoorrBrk_SWORD 0 Gain -32768 32767 SYMBOL_LINK "CalPrmLatDynsCoorrBrk01.TQS16_UNDER_EXT_DEL_YAW_MMU_MSP" 0 /end CHARACTERISTIC
/begin CHARACTERISTIC TQS16_US2W_CTRL_ENTER_TH "" VALUE 0x80020D56 CalPrmLatDynsCoorrBrk_SWORD 0 Gain -32768 32767 SYMBOL_LINK "CalPrmLatDynsCoorrBrk01.TQS16_US2W_CTRL_ENTER_TH" 0 /end CHARACTERISTIC
/begin CHARACTERISTIC TQS16_US2W_CTRL_EXIT_TH "" VALUE 0x80020D58 CalPrmLatDynsCoorrBrk_SWORD 0 Gain -32768 32767 SYMBOL_LINK "CalPrmLatDynsCoorrBrk01.TQS16_US2W_CTRL_EXIT_TH" 0 /end CHARACTERISTIC
/begin CHARACTERISTIC TQS16_US2W_CTRL_SLIP_WEG "" VALUE 0x80020D50 CalPrmLatDynsCoorrBrk_SWORD 0 Gain -32768 32767 SYMBOL_LINK "CalPrmLatDynsCoorrBrk01.TQS16_US2W_CTRL_SLIP_WEG" 0 /end CHARACTERISTIC
/begin CHARACTERISTIC TQS16_US2W_ENTER_TAR_FX_OFFSET "" VALUE 0x80020818 CalPrmLatDynsCoorrBrk_SWORD 0 Gain -32768 32767 SYMBOL_LINK "CalPrmLatDynsCoorrBrk01.TQS16_US2W_ENTER_TAR_FX_OFFSET" 0 /end CHARACTERISTIC
/begin CHARACTERISTIC TQS16_YAW_ACCEL_TH_X1 "" VALUE 0x80020C80 CalPrmLatDynsCoorrBrk_SWORD 0 Gain -32768 32767 SYMBOL_LINK "CalPrmLatDynsCoorrBrk01.TQS16_YAW_ACCEL_TH_X1" 0 /end CHARACTERISTIC
/begin CHARACTERISTIC TQS16_YAW_ACCEL_TH_X2 "" VALUE 0x80020C82 CalPrmLatDynsCoorrBrk_SWORD 0 Gain -32768 32767 SYMBOL_LINK "CalPrmLatDynsCoorrBrk01.TQS16_YAW_ACCEL_TH_X2" 0 /end CHARACTERISTIC
/begin CHARACTERISTIC TQS16_YAW_ACCEL_TH_X3 "" VALUE 0x80020C84 CalPrmLatDynsCoorrBrk_SWORD 0 Gain -32768 32767 SYMBOL_LINK "CalPrmLatDynsCoorrBrk01.TQS16_YAW_ACCEL_TH_X3" 0 /end CHARACTERISTIC
/begin CHARACTERISTIC TQS16_YC_AR_LIMIT_HIG_SPD_H_MU "" VALUE 0x80020C7E CalPrmLatDynsCoorrBrk_SWORD 0 Gain -32768 32767 SYMBOL_LINK "CalPrmLatDynsCoorrBrk01.TQS16_YC_AR_LIMIT_HIG_SPD_H_MU" 0 /end CHARACTERISTIC
/begin CHARACTERISTIC TQS16_YC_AR_LIMIT_HIG_SPD_L_MU "" VALUE 0x80020C72 CalPrmLatDynsCoorrBrk_SWORD 0 Gain -32768 32767 SYMBOL_LINK "CalPrmLatDynsCoorrBrk01.TQS16_YC_AR_LIMIT_HIG_SPD_L_MU" 0 /end CHARACTERISTIC
/begin CHARACTERISTIC TQS16_YC_AR_LIMIT_HIG_SPD_M_MU "" VALUE 0x80020C78 CalPrmLatDynsCoorrBrk_SWORD 0 Gain -32768 32767 SYMBOL_LINK "CalPrmLatDynsCoorrBrk01.TQS16_YC_AR_LIMIT_HIG_SPD_M_MU" 0 /end CHARACTERISTIC
/begin CHARACTERISTIC TQS16_YC_AR_LIMIT_LOW_SPD_H_MU "" VALUE 0x80020C7A CalPrmLatDynsCoorrBrk_SWORD 0 Gain -32768 32767 SYMBOL_LINK "CalPrmLatDynsCoorrBrk01.TQS16_YC_AR_LIMIT_LOW_SPD_H_MU" 0 /end CHARACTERISTIC
/begin CHARACTERISTIC TQS16_YC_AR_LIMIT_LOW_SPD_L_MU "" VALUE 0x80020C6E CalPrmLatDynsCoorrBrk_SWORD 0 Gain -32768 32767 SYMBOL_LINK "CalPrmLatDynsCoorrBrk01.TQS16_YC_AR_LIMIT_LOW_SPD_L_MU" 0 /end CHARACTERISTIC
/begin CHARACTERISTIC TQS16_YC_AR_LIMIT_LOW_SPD_M_MU "" VALUE 0x80020C74 CalPrmLatDynsCoorrBrk_SWORD 0 Gain -32768 32767 SYMBOL_LINK "CalPrmLatDynsCoorrBrk01.TQS16_YC_AR_LIMIT_LOW_SPD_M_MU" 0 /end CHARACTERISTIC
/begin CHARACTERISTIC TQS16_YC_AR_LIMIT_MED_SPD_H_MU "" VALUE 0x80020C7C CalPrmLatDynsCoorrBrk_SWORD 0 Gain -32768 32767 SYMBOL_LINK "CalPrmLatDynsCoorrBrk01.TQS16_YC_AR_LIMIT_MED_SPD_H_MU" 0 /end CHARACTERISTIC
/begin CHARACTERISTIC TQS16_YC_AR_LIMIT_MED_SPD_L_MU "" VALUE 0x80020C70 CalPrmLatDynsCoorrBrk_SWORD 0 Gain -32768 32767 SYMBOL_LINK "CalPrmLatDynsCoorrBrk01.TQS16_YC_AR_LIMIT_MED_SPD_L_MU" 0 /end CHARACTERISTIC
/begin CHARACTERISTIC TQS16_YC_AR_LIMIT_MED_SPD_M_MU "" VALUE 0x80020C76 CalPrmLatDynsCoorrBrk_SWORD 0 Gain -32768 32767 SYMBOL_LINK "CalPrmLatDynsCoorrBrk01.TQS16_YC_AR_LIMIT_MED_SPD_M_MU" 0 /end CHARACTERISTIC
/begin CHARACTERISTIC TQS16_YC_AR_M_DEL_YAW_TH_H "" VALUE 0x8002086E CalPrmLatDynsCoorrBrk_SWORD 0 Gain -32768 32767 SYMBOL_LINK "CalPrmLatDynsCoorrBrk01.TQS16_YC_AR_M_DEL_YAW_TH_H" 0 /end CHARACTERISTIC
/begin CHARACTERISTIC TQS16_YC_AR_M_DEL_YAW_TH_L "" VALUE 0x80020872 CalPrmLatDynsCoorrBrk_SWORD 0 Gain -32768 32767 SYMBOL_LINK "CalPrmLatDynsCoorrBrk01.TQS16_YC_AR_M_DEL_YAW_TH_L" 0 /end CHARACTERISTIC
/begin CHARACTERISTIC TQS16_YC_AR_M_DEL_YAW_TH_M "" VALUE 0x80020870 CalPrmLatDynsCoorrBrk_SWORD 0 Gain -32768 32767 SYMBOL_LINK "CalPrmLatDynsCoorrBrk01.TQS16_YC_AR_M_DEL_YAW_TH_M" 0 /end CHARACTERISTIC
/begin CHARACTERISTIC TQS16_YC_AR_M_DEP_DYAW_WEG_H "" VALUE 0x80020874 CalPrmLatDynsCoorrBrk_SWORD 0 Gain -32768 32767 SYMBOL_LINK "CalPrmLatDynsCoorrBrk01.TQS16_YC_AR_M_DEP_DYAW_WEG_H" 0 /end CHARACTERISTIC
/begin CHARACTERISTIC TQS16_YC_AR_M_DEP_DYAW_WEG_L "" VALUE 0x80020878 CalPrmLatDynsCoorrBrk_SWORD 0 Gain -32768 32767 SYMBOL_LINK "CalPrmLatDynsCoorrBrk01.TQS16_YC_AR_M_DEP_DYAW_WEG_L" 0 /end CHARACTERISTIC
/begin CHARACTERISTIC TQS16_YC_AR_M_DEP_DYAW_WEG_M "" VALUE 0x80020876 CalPrmLatDynsCoorrBrk_SWORD 0 Gain -32768 32767 SYMBOL_LINK "CalPrmLatDynsCoorrBrk01.TQS16_YC_AR_M_DEP_DYAW_WEG_M" 0 /end CHARACTERISTIC
/begin CHARACTERISTIC TQS16_YC_AR_P_GAIN_HIG_MU "" VALUE 0x80020890 CalPrmLatDynsCoorrBrk_SWORD 0 Gain -32768 32767 SYMBOL_LINK "CalPrmLatDynsCoorrBrk01.TQS16_YC_AR_P_GAIN_HIG_MU" 0 /end CHARACTERISTIC
/begin CHARACTERISTIC TQS16_YC_AR_P_GAIN_LOW_MU "" VALUE 0x8002088C CalPrmLatDynsCoorrBrk_SWORD 0 Gain -32768 32767 SYMBOL_LINK "CalPrmLatDynsCoorrBrk01.TQS16_YC_AR_P_GAIN_LOW_MU" 0 /end CHARACTERISTIC
/begin CHARACTERISTIC TQS16_YC_AR_P_GAIN_MED_MU "" VALUE 0x8002088E CalPrmLatDynsCoorrBrk_SWORD 0 Gain -32768 32767 SYMBOL_LINK "CalPrmLatDynsCoorrBrk01.TQS16_YC_AR_P_GAIN_MED_MU" 0 /end CHARACTERISTIC
/begin CHARACTERISTIC TQS16_YC_AR_THRES_HIG_SPD_H_MU "" VALUE 0x80020886 CalPrmLatDynsCoorrBrk_SWORD 0 Gain -32768 32767 SYMBOL_LINK "CalPrmLatDynsCoorrBrk01.TQS16_YC_AR_THRES_HIG_SPD_H_MU" 0 /end CHARACTERISTIC
/begin CHARACTERISTIC TQS16_YC_AR_THRES_HIG_SPD_L_MU "" VALUE 0x8002087A CalPrmLatDynsCoorrBrk_SWORD 0 Gain -32768 32767 SYMBOL_LINK "CalPrmLatDynsCoorrBrk01.TQS16_YC_AR_THRES_HIG_SPD_L_MU" 0 /end CHARACTERISTIC
/begin CHARACTERISTIC TQS16_YC_AR_THRES_HIG_SPD_M_MU "" VALUE 0x80020880 CalPrmLatDynsCoorrBrk_SWORD 0 Gain -32768 32767 SYMBOL_LINK "CalPrmLatDynsCoorrBrk01.TQS16_YC_AR_THRES_HIG_SPD_M_MU" 0 /end CHARACTERISTIC
/begin CHARACTERISTIC TQS16_YC_AR_THRES_LOW_SPD_H_MU "" VALUE 0x8002088A CalPrmLatDynsCoorrBrk_SWORD 0 Gain -32768 32767 SYMBOL_LINK "CalPrmLatDynsCoorrBrk01.TQS16_YC_AR_THRES_LOW_SPD_H_MU" 0 /end CHARACTERISTIC
/begin CHARACTERISTIC TQS16_YC_AR_THRES_LOW_SPD_L_MU "" VALUE 0x8002087E CalPrmLatDynsCoorrBrk_SWORD 0 Gain -32768 32767 SYMBOL_LINK "CalPrmLatDynsCoorrBrk01.TQS16_YC_AR_THRES_LOW_SPD_L_MU" 0 /end CHARACTERISTIC
/begin CHARACTERISTIC TQS16_YC_AR_THRES_LOW_SPD_M_MU "" VALUE 0x80020884 CalPrmLatDynsCoorrBrk_SWORD 0 Gain -32768 32767 SYMBOL_LINK "CalPrmLatDynsCoorrBrk01.TQS16_YC_AR_THRES_LOW_SPD_M_MU" 0 /end CHARACTERISTIC
/begin CHARACTERISTIC TQS16_YC_AR_THRES_MED_SPD_H_MU "" VALUE 0x80020888 CalPrmLatDynsCoorrBrk_SWORD 0 Gain -32768 32767 SYMBOL_LINK "CalPrmLatDynsCoorrBrk01.TQS16_YC_AR_THRES_MED_SPD_H_MU" 0 /end CHARACTERISTIC
/begin CHARACTERISTIC TQS16_YC_AR_THRES_MED_SPD_L_MU "" VALUE 0x8002087C CalPrmLatDynsCoorrBrk_SWORD 0 Gain -32768 32767 SYMBOL_LINK "CalPrmLatDynsCoorrBrk01.TQS16_YC_AR_THRES_MED_SPD_L_MU" 0 /end CHARACTERISTIC
/begin CHARACTERISTIC TQS16_YC_AR_THRES_MED_SPD_M_MU "" VALUE 0x80020882 CalPrmLatDynsCoorrBrk_SWORD 0 Gain -32768 32767 SYMBOL_LINK "CalPrmLatDynsCoorrBrk01.TQS16_YC_AR_THRES_MED_SPD_M_MU" 0 /end CHARACTERISTIC
/begin CHARACTERISTIC TQS16_YC_SPEED_DEP_HIG_VH_GAIN "" VALUE 0x80020A56 CalPrmLatDynsCoorrBrk_SWORD 0 Gain -32768 32767 SYMBOL_LINK "CalPrmLatDynsCoorrBrk01.TQS16_YC_SPEED_DEP_HIG_VH_GAIN" 0 /end CHARACTERISTIC
/begin CHARACTERISTIC TQS16_YC_SPEED_DEP_LOW_VH_GAIN "" VALUE 0x80020A58 CalPrmLatDynsCoorrBrk_SWORD 0 Gain -32768 32767 SYMBOL_LINK "CalPrmLatDynsCoorrBrk01.TQS16_YC_SPEED_DEP_LOW_VH_GAIN" 0 /end CHARACTERISTIC
/begin CHARACTERISTIC TQS16_YC_SPEED_DEP_MED_VH_GAIN "" VALUE 0x80020A5A CalPrmLatDynsCoorrBrk_SWORD 0 Gain -32768 32767 SYMBOL_LINK "CalPrmLatDynsCoorrBrk01.TQS16_YC_SPEED_DEP_MED_VH_GAIN" 0 /end CHARACTERISTIC
/begin CHARACTERISTIC TQS16_YC_SPEED_DEP_VER_HIG_VH_GAIN "" VALUE 0x80020A5C CalPrmLatDynsCoorrBrk_SWORD 0 Gain -32768 32767 SYMBOL_LINK "CalPrmLatDynsCoorrBrk01.TQS16_YC_SPEED_DEP_VER_HIG_VH_GAIN" 0 /end CHARACTERISTIC
/begin CHARACTERISTIC TQS16_YC_SPEED_DEP_VLOW_VH_GAIN "" VALUE 0x80020A5E CalPrmLatDynsCoorrBrk_SWORD 0 Gain -32768 32767 SYMBOL_LINK "CalPrmLatDynsCoorrBrk01.TQS16_YC_SPEED_DEP_VLOW_VH_GAIN" 0 /end CHARACTERISTIC
/begin CHARACTERISTIC TQS8_DR_2ND_F_ENT_PRESS_OF_OUT_F "" VALUE 0x80020C50 CalPrmLatDynsCoorrBrk_SBYTE 0 Gain -128 127 SYMBOL_LINK "CalPrmLatDynsCoorrBrk01.TQS8_DR_2ND_F_ENT_PRESS_OF_OUT_F" 0 /end CHARACTERISTIC
/begin CHARACTERISTIC TQS8_DR_2ND_F_LMT_DEL_SLIP "" VALUE 0x80020C51 CalPrmLatDynsCoorrBrk_SBYTE 0 Gain -128 127 SYMBOL_LINK "CalPrmLatDynsCoorrBrk01.TQS8_DR_2ND_F_LMT_DEL_SLIP" 0 /end CHARACTERISTIC
/begin CHARACTERISTIC TQS8_DR_2ND_R_ENT_PRESS_OF_OUT_F "" VALUE 0x80020C52 CalPrmLatDynsCoorrBrk_SBYTE 0 Gain -128 127 SYMBOL_LINK "CalPrmLatDynsCoorrBrk01.TQS8_DR_2ND_R_ENT_PRESS_OF_OUT_F" 0 /end CHARACTERISTIC
/begin CHARACTERISTIC TQS8_DR_2ND_R_EXT_PRESS_OF_OUT_F "" VALUE 0x80020C53 CalPrmLatDynsCoorrBrk_SBYTE 0 Gain -128 127 SYMBOL_LINK "CalPrmLatDynsCoorrBrk01.TQS8_DR_2ND_R_EXT_PRESS_OF_OUT_F" 0 /end CHARACTERISTIC
/begin CHARACTERISTIC TQTQESC_OS_2W_Inhibit "" VALUE 0x80020C98 CalPrmLatDynsCoorrBrk_UBYTE 0 Gain 0 255 SYMBOL_LINK "CalPrmLatDynsCoorrBrk01.TQTQESC_OS_2W_Inhibit" 0 /end CHARACTERISTIC
/begin CHARACTERISTIC TQTQESC_US_2W_Inhibit "" VALUE 0x80020C99 CalPrmLatDynsCoorrBrk_UBYTE 0 Gain 0 255 SYMBOL_LINK "CalPrmLatDynsCoorrBrk01.TQTQESC_US_2W_Inhibit" 0 /end CHARACTERISTIC
/begin CHARACTERISTIC TQU8_DEL_M_THR_ENTER_FRONT_HM_HS "" VALUE 0x800208B0 CalPrmLatDynsCoorrBrk_UBYTE 0 Gain 0 255 SYMBOL_LINK "CalPrmLatDynsCoorrBrk01.TQU8_DEL_M_THR_ENTER_FRONT_HM_HS" 0 /end CHARACTERISTIC
/begin CHARACTERISTIC TQU8_DEL_M_THR_ENTER_FRONT_HM_LS "" VALUE 0x800208B1 CalPrmLatDynsCoorrBrk_UBYTE 0 Gain 0 255 SYMBOL_LINK "CalPrmLatDynsCoorrBrk01.TQU8_DEL_M_THR_ENTER_FRONT_HM_LS" 0 /end CHARACTERISTIC
/begin CHARACTERISTIC TQU8_DEL_M_THR_ENTER_FRONT_HM_MS "" VALUE 0x800208B2 CalPrmLatDynsCoorrBrk_UBYTE 0 Gain 0 255 SYMBOL_LINK "CalPrmLatDynsCoorrBrk01.TQU8_DEL_M_THR_ENTER_FRONT_HM_MS" 0 /end CHARACTERISTIC
/begin CHARACTERISTIC TQU8_DEL_M_THR_ENTER_FRONT_LM_HS "" VALUE 0x800208A4 CalPrmLatDynsCoorrBrk_UBYTE 0 Gain 0 255 SYMBOL_LINK "CalPrmLatDynsCoorrBrk01.TQU8_DEL_M_THR_ENTER_FRONT_LM_HS" 0 /end CHARACTERISTIC
/begin CHARACTERISTIC TQU8_DEL_M_THR_ENTER_FRONT_LM_LS "" VALUE 0x800208A5 CalPrmLatDynsCoorrBrk_UBYTE 0 Gain 0 255 SYMBOL_LINK "CalPrmLatDynsCoorrBrk01.TQU8_DEL_M_THR_ENTER_FRONT_LM_LS" 0 /end CHARACTERISTIC
/begin CHARACTERISTIC TQU8_DEL_M_THR_ENTER_FRONT_LM_MS "" VALUE 0x800208A6 CalPrmLatDynsCoorrBrk_UBYTE 0 Gain 0 255 SYMBOL_LINK "CalPrmLatDynsCoorrBrk01.TQU8_DEL_M_THR_ENTER_FRONT_LM_MS" 0 /end CHARACTERISTIC
/begin CHARACTERISTIC TQU8_DEL_M_THR_ENTER_FRONT_MM_HS "" VALUE 0x800208AA CalPrmLatDynsCoorrBrk_UBYTE 0 Gain 0 255 SYMBOL_LINK "CalPrmLatDynsCoorrBrk01.TQU8_DEL_M_THR_ENTER_FRONT_MM_HS" 0 /end CHARACTERISTIC
/begin CHARACTERISTIC TQU8_DEL_M_THR_ENTER_FRONT_MM_LS "" VALUE 0x800208AB CalPrmLatDynsCoorrBrk_UBYTE 0 Gain 0 255 SYMBOL_LINK "CalPrmLatDynsCoorrBrk01.TQU8_DEL_M_THR_ENTER_FRONT_MM_LS" 0 /end CHARACTERISTIC
/begin CHARACTERISTIC TQU8_DEL_M_THR_ENTER_FRONT_MM_MS "" VALUE 0x800208AC CalPrmLatDynsCoorrBrk_UBYTE 0 Gain 0 255 SYMBOL_LINK "CalPrmLatDynsCoorrBrk01.TQU8_DEL_M_THR_ENTER_FRONT_MM_MS" 0 /end CHARACTERISTIC
/begin CHARACTERISTIC TQU8_DEL_M_THR_ENTER_REAR_HM_HS "" VALUE 0x8002089E CalPrmLatDynsCoorrBrk_UBYTE 0 Gain 0 255 SYMBOL_LINK "CalPrmLatDynsCoorrBrk01.TQU8_DEL_M_THR_ENTER_REAR_HM_HS" 0 /end CHARACTERISTIC
/begin CHARACTERISTIC TQU8_DEL_M_THR_ENTER_REAR_HM_LS "" VALUE 0x8002089F CalPrmLatDynsCoorrBrk_UBYTE 0 Gain 0 255 SYMBOL_LINK "CalPrmLatDynsCoorrBrk01.TQU8_DEL_M_THR_ENTER_REAR_HM_LS" 0 /end CHARACTERISTIC
/begin CHARACTERISTIC TQU8_DEL_M_THR_ENTER_REAR_HM_MS "" VALUE 0x800208A0 CalPrmLatDynsCoorrBrk_UBYTE 0 Gain 0 255 SYMBOL_LINK "CalPrmLatDynsCoorrBrk01.TQU8_DEL_M_THR_ENTER_REAR_HM_MS" 0 /end CHARACTERISTIC
/begin CHARACTERISTIC TQU8_DEL_M_THR_ENTER_REAR_LM_HS "" VALUE 0x80020892 CalPrmLatDynsCoorrBrk_UBYTE 0 Gain 0 255 SYMBOL_LINK "CalPrmLatDynsCoorrBrk01.TQU8_DEL_M_THR_ENTER_REAR_LM_HS" 0 /end CHARACTERISTIC
/begin CHARACTERISTIC TQU8_DEL_M_THR_ENTER_REAR_LM_LS "" VALUE 0x80020893 CalPrmLatDynsCoorrBrk_UBYTE 0 Gain 0 255 SYMBOL_LINK "CalPrmLatDynsCoorrBrk01.TQU8_DEL_M_THR_ENTER_REAR_LM_LS" 0 /end CHARACTERISTIC
/begin CHARACTERISTIC TQU8_DEL_M_THR_ENTER_REAR_LM_MS "" VALUE 0x80020894 CalPrmLatDynsCoorrBrk_UBYTE 0 Gain 0 255 SYMBOL_LINK "CalPrmLatDynsCoorrBrk01.TQU8_DEL_M_THR_ENTER_REAR_LM_MS" 0 /end CHARACTERISTIC
/begin CHARACTERISTIC TQU8_DEL_M_THR_ENTER_REAR_MM_HS "" VALUE 0x80020898 CalPrmLatDynsCoorrBrk_UBYTE 0 Gain 0 255 SYMBOL_LINK "CalPrmLatDynsCoorrBrk01.TQU8_DEL_M_THR_ENTER_REAR_MM_HS" 0 /end CHARACTERISTIC
/begin CHARACTERISTIC TQU8_DEL_M_THR_ENTER_REAR_MM_LS "" VALUE 0x80020899 CalPrmLatDynsCoorrBrk_UBYTE 0 Gain 0 255 SYMBOL_LINK "CalPrmLatDynsCoorrBrk01.TQU8_DEL_M_THR_ENTER_REAR_MM_LS" 0 /end CHARACTERISTIC
/begin CHARACTERISTIC TQU8_DEL_M_THR_ENTER_REAR_MM_MS "" VALUE 0x8002089A CalPrmLatDynsCoorrBrk_UBYTE 0 Gain 0 255 SYMBOL_LINK "CalPrmLatDynsCoorrBrk01.TQU8_DEL_M_THR_ENTER_REAR_MM_MS" 0 /end CHARACTERISTIC
/begin CHARACTERISTIC TQU8_DEL_M_THR_EXIT_FRONT_HM_HS "" VALUE 0x800208B3 CalPrmLatDynsCoorrBrk_UBYTE 0 Gain 0 255 SYMBOL_LINK "CalPrmLatDynsCoorrBrk01.TQU8_DEL_M_THR_EXIT_FRONT_HM_HS" 0 /end CHARACTERISTIC
/begin CHARACTERISTIC TQU8_DEL_M_THR_EXIT_FRONT_HM_LS "" VALUE 0x800208B4 CalPrmLatDynsCoorrBrk_UBYTE 0 Gain 0 255 SYMBOL_LINK "CalPrmLatDynsCoorrBrk01.TQU8_DEL_M_THR_EXIT_FRONT_HM_LS" 0 /end CHARACTERISTIC
/begin CHARACTERISTIC TQU8_DEL_M_THR_EXIT_FRONT_HM_MS "" VALUE 0x800208B5 CalPrmLatDynsCoorrBrk_UBYTE 0 Gain 0 255 SYMBOL_LINK "CalPrmLatDynsCoorrBrk01.TQU8_DEL_M_THR_EXIT_FRONT_HM_MS" 0 /end CHARACTERISTIC
/begin CHARACTERISTIC TQU8_DEL_M_THR_EXIT_FRONT_LM_HS "" VALUE 0x800208A7 CalPrmLatDynsCoorrBrk_UBYTE 0 Gain 0 255 SYMBOL_LINK "CalPrmLatDynsCoorrBrk01.TQU8_DEL_M_THR_EXIT_FRONT_LM_HS" 0 /end CHARACTERISTIC
/begin CHARACTERISTIC TQU8_DEL_M_THR_EXIT_FRONT_LM_LS "" VALUE 0x800208A8 CalPrmLatDynsCoorrBrk_UBYTE 0 Gain 0 255 SYMBOL_LINK "CalPrmLatDynsCoorrBrk01.TQU8_DEL_M_THR_EXIT_FRONT_LM_LS" 0 /end CHARACTERISTIC
/begin CHARACTERISTIC TQU8_DEL_M_THR_EXIT_FRONT_LM_MS "" VALUE 0x800208A9 CalPrmLatDynsCoorrBrk_UBYTE 0 Gain 0 255 SYMBOL_LINK "CalPrmLatDynsCoorrBrk01.TQU8_DEL_M_THR_EXIT_FRONT_LM_MS" 0 /end CHARACTERISTIC
/begin CHARACTERISTIC TQU8_DEL_M_THR_EXIT_FRONT_MM_HS "" VALUE 0x800208AD CalPrmLatDynsCoorrBrk_UBYTE 0 Gain 0 255 SYMBOL_LINK "CalPrmLatDynsCoorrBrk01.TQU8_DEL_M_THR_EXIT_FRONT_MM_HS" 0 /end CHARACTERISTIC
/begin CHARACTERISTIC TQU8_DEL_M_THR_EXIT_FRONT_MM_LS "" VALUE 0x800208AE CalPrmLatDynsCoorrBrk_UBYTE 0 Gain 0 255 SYMBOL_LINK "CalPrmLatDynsCoorrBrk01.TQU8_DEL_M_THR_EXIT_FRONT_MM_LS" 0 /end CHARACTERISTIC
/begin CHARACTERISTIC TQU8_DEL_M_THR_EXIT_FRONT_MM_MS "" VALUE 0x800208AF CalPrmLatDynsCoorrBrk_UBYTE 0 Gain 0 255 SYMBOL_LINK "CalPrmLatDynsCoorrBrk01.TQU8_DEL_M_THR_EXIT_FRONT_MM_MS" 0 /end CHARACTERISTIC
/begin CHARACTERISTIC TQU8_DEL_M_THR_EXIT_REAR_HM_HS "" VALUE 0x800208A1 CalPrmLatDynsCoorrBrk_UBYTE 0 Gain 0 255 SYMBOL_LINK "CalPrmLatDynsCoorrBrk01.TQU8_DEL_M_THR_EXIT_REAR_HM_HS" 0 /end CHARACTERISTIC
/begin CHARACTERISTIC TQU8_DEL_M_THR_EXIT_REAR_HM_LS "" VALUE 0x800208A2 CalPrmLatDynsCoorrBrk_UBYTE 0 Gain 0 255 SYMBOL_LINK "CalPrmLatDynsCoorrBrk01.TQU8_DEL_M_THR_EXIT_REAR_HM_LS" 0 /end CHARACTERISTIC
/begin CHARACTERISTIC TQU8_DEL_M_THR_EXIT_REAR_HM_MS "" VALUE 0x800208A3 CalPrmLatDynsCoorrBrk_UBYTE 0 Gain 0 255 SYMBOL_LINK "CalPrmLatDynsCoorrBrk01.TQU8_DEL_M_THR_EXIT_REAR_HM_MS" 0 /end CHARACTERISTIC
/begin CHARACTERISTIC TQU8_DEL_M_THR_EXIT_REAR_LM_HS "" VALUE 0x80020895 CalPrmLatDynsCoorrBrk_UBYTE 0 Gain 0 255 SYMBOL_LINK "CalPrmLatDynsCoorrBrk01.TQU8_DEL_M_THR_EXIT_REAR_LM_HS" 0 /end CHARACTERISTIC
/begin CHARACTERISTIC TQU8_DEL_M_THR_EXIT_REAR_LM_LS "" VALUE 0x80020896 CalPrmLatDynsCoorrBrk_UBYTE 0 Gain 0 255 SYMBOL_LINK "CalPrmLatDynsCoorrBrk01.TQU8_DEL_M_THR_EXIT_REAR_LM_LS" 0 /end CHARACTERISTIC
/begin CHARACTERISTIC TQU8_DEL_M_THR_EXIT_REAR_LM_MS "" VALUE 0x80020897 CalPrmLatDynsCoorrBrk_UBYTE 0 Gain 0 255 SYMBOL_LINK "CalPrmLatDynsCoorrBrk01.TQU8_DEL_M_THR_EXIT_REAR_LM_MS" 0 /end CHARACTERISTIC
/begin CHARACTERISTIC TQU8_DEL_M_THR_EXIT_REAR_MM_HS "" VALUE 0x8002089B CalPrmLatDynsCoorrBrk_UBYTE 0 Gain 0 255 SYMBOL_LINK "CalPrmLatDynsCoorrBrk01.TQU8_DEL_M_THR_EXIT_REAR_MM_HS" 0 /end CHARACTERISTIC
/begin CHARACTERISTIC TQU8_DEL_M_THR_EXIT_REAR_MM_LS "" VALUE 0x8002089C CalPrmLatDynsCoorrBrk_UBYTE 0 Gain 0 255 SYMBOL_LINK "CalPrmLatDynsCoorrBrk01.TQU8_DEL_M_THR_EXIT_REAR_MM_LS" 0 /end CHARACTERISTIC
/begin CHARACTERISTIC TQU8_DEL_M_THR_EXIT_REAR_MM_MS "" VALUE 0x8002089D CalPrmLatDynsCoorrBrk_UBYTE 0 Gain 0 255 SYMBOL_LINK "CalPrmLatDynsCoorrBrk01.TQU8_DEL_M_THR_EXIT_REAR_MM_MS" 0 /end CHARACTERISTIC
/begin CHARACTERISTIC TQU8_ROP_AY_VX_DOT_1ST_WEG "" VALUE 0x80020B6B CalPrmLatDynsCoorrBrk_UBYTE 0 Gain 0 255 SYMBOL_LINK "CalPrmLatDynsCoorrBrk01.TQU8_ROP_AY_VX_DOT_1ST_WEG" 0 /end CHARACTERISTIC
/begin CHARACTERISTIC TQU8_ROP_AY_VX_DOT_2ND_WEG "" VALUE 0x80020B6A CalPrmLatDynsCoorrBrk_UBYTE 0 Gain 0 255 SYMBOL_LINK "CalPrmLatDynsCoorrBrk01.TQU8_ROP_AY_VX_DOT_2ND_WEG" 0 /end CHARACTERISTIC
/begin CHARACTERISTIC TQU8_ROP_AY_VX_DOT_WEG "" VALUE 0x80020B6C CalPrmLatDynsCoorrBrk_UBYTE 0 Gain 0 255 SYMBOL_LINK "CalPrmLatDynsCoorrBrk01.TQU8_ROP_AY_VX_DOT_WEG" 0 /end CHARACTERISTIC
/begin CHARACTERISTIC TQU8_TVBB_CTRL_WEG_FOR_SLIP_HMU_1 "" VALUE 0x80020DCC CalPrmLatDynsCoorrBrk_UBYTE 0 Gain 0 255 SYMBOL_LINK "CalPrmLatDynsCoorrBrk01.TQU8_TVBB_CTRL_WEG_FOR_SLIP_HMU_1" 0 /end CHARACTERISTIC
/begin CHARACTERISTIC TQU8_TVBB_CTRL_WEG_FOR_SLIP_HMU_2 "" VALUE 0x80020DCD CalPrmLatDynsCoorrBrk_UBYTE 0 Gain 0 255 SYMBOL_LINK "CalPrmLatDynsCoorrBrk01.TQU8_TVBB_CTRL_WEG_FOR_SLIP_HMU_2" 0 /end CHARACTERISTIC
/begin CHARACTERISTIC TQU8_TVBB_CTRL_WEG_FOR_SLIP_HMU_3 "" VALUE 0x80020DCE CalPrmLatDynsCoorrBrk_UBYTE 0 Gain 0 255 SYMBOL_LINK "CalPrmLatDynsCoorrBrk01.TQU8_TVBB_CTRL_WEG_FOR_SLIP_HMU_3" 0 /end CHARACTERISTIC
/begin CHARACTERISTIC TQU8_TVBB_CTRL_WEG_FOR_SLIP_HMU_4 "" VALUE 0x80020DCF CalPrmLatDynsCoorrBrk_UBYTE 0 Gain 0 255 SYMBOL_LINK "CalPrmLatDynsCoorrBrk01.TQU8_TVBB_CTRL_WEG_FOR_SLIP_HMU_4" 0 /end CHARACTERISTIC
/begin CHARACTERISTIC TQU8_TVBB_CTRL_WEG_FOR_SLIP_HMU_5 "" VALUE 0x80020DD0 CalPrmLatDynsCoorrBrk_UBYTE 0 Gain 0 255 SYMBOL_LINK "CalPrmLatDynsCoorrBrk01.TQU8_TVBB_CTRL_WEG_FOR_SLIP_HMU_5" 0 /end CHARACTERISTIC
/begin CHARACTERISTIC TQYAW_CONTORL_P_GAIN_BETA_H "" VALUE 0x80020A6C CalPrmLatDynsCoorrBrk_SWORD 0 Gain -32768 32767 SYMBOL_LINK "CalPrmLatDynsCoorrBrk01.TQYAW_CONTORL_P_GAIN_BETA_H" 0 /end CHARACTERISTIC
/begin CHARACTERISTIC TQYAW_CONTORL_P_GAIN_BETA_L "" VALUE 0x80020A6E CalPrmLatDynsCoorrBrk_SWORD 0 Gain -32768 32767 SYMBOL_LINK "CalPrmLatDynsCoorrBrk01.TQYAW_CONTORL_P_GAIN_BETA_L" 0 /end CHARACTERISTIC
/begin CHARACTERISTIC TQYAW_CONTORL_P_GAIN_BETA_M "" VALUE 0x80020A70 CalPrmLatDynsCoorrBrk_SWORD 0 Gain -32768 32767 SYMBOL_LINK "CalPrmLatDynsCoorrBrk01.TQYAW_CONTORL_P_GAIN_BETA_M" 0 /end CHARACTERISTIC
/begin CHARACTERISTIC U8_WPE_LFC_Hold_Duty_r_10th "Temp" VALUE 0x8002168B CalPrmBrkTqCtrlrBrk_UBYTE 0 Gain 0 255 SYMBOL_LINK "CalPrmBrkTqCtrlrBrk01.U8_WPE_LFC_Hold_Duty_r_10th" 0 /end CHARACTERISTIC
/begin CHARACTERISTIC U8_WPE_LFC_Hold_Duty_r_11th "Temp" VALUE 0x8002168C CalPrmBrkTqCtrlrBrk_UBYTE 0 Gain 0 255 SYMBOL_LINK "CalPrmBrkTqCtrlrBrk01.U8_WPE_LFC_Hold_Duty_r_11th" 0 /end CHARACTERISTIC
/begin CHARACTERISTIC U8_WPE_LFC_Hold_Duty_r_12th "Temp" VALUE 0x8002168D CalPrmBrkTqCtrlrBrk_UBYTE 0 Gain 0 255 SYMBOL_LINK "CalPrmBrkTqCtrlrBrk01.U8_WPE_LFC_Hold_Duty_r_12th" 0 /end CHARACTERISTIC
/begin CHARACTERISTIC U8_WPE_LFC_Hold_Duty_r_13th "Temp" VALUE 0x8002168E CalPrmBrkTqCtrlrBrk_UBYTE 0 Gain 0 255 SYMBOL_LINK "CalPrmBrkTqCtrlrBrk01.U8_WPE_LFC_Hold_Duty_r_13th" 0 /end CHARACTERISTIC
/begin CHARACTERISTIC U8_WPE_LFC_Hold_Duty_r_14th "Temp" VALUE 0x8002168F CalPrmBrkTqCtrlrBrk_UBYTE 0 Gain 0 255 SYMBOL_LINK "CalPrmBrkTqCtrlrBrk01.U8_WPE_LFC_Hold_Duty_r_14th" 0 /end CHARACTERISTIC
/begin CHARACTERISTIC U8_WPE_LFC_Hold_Duty_r_15th "Temp" VALUE 0x80021690 CalPrmBrkTqCtrlrBrk_UBYTE 0 Gain 0 255 SYMBOL_LINK "CalPrmBrkTqCtrlrBrk01.U8_WPE_LFC_Hold_Duty_r_15th" 0 /end CHARACTERISTIC
/begin CHARACTERISTIC U8_WPE_LFC_Hold_Duty_r_16th "Temp" VALUE 0x80021691 CalPrmBrkTqCtrlrBrk_UBYTE 0 Gain 0 255 SYMBOL_LINK "CalPrmBrkTqCtrlrBrk01.U8_WPE_LFC_Hold_Duty_r_16th" 0 /end CHARACTERISTIC
/begin CHARACTERISTIC U8_WPE_LFC_Hold_Duty_r_1st "Temp" VALUE 0x80021682 CalPrmBrkTqCtrlrBrk_UBYTE 0 Gain 0 255 SYMBOL_LINK "CalPrmBrkTqCtrlrBrk01.U8_WPE_LFC_Hold_Duty_r_1st" 0 /end CHARACTERISTIC
/begin CHARACTERISTIC U8_WPE_LFC_Hold_Duty_r_2nd "Temp" VALUE 0x80021683 CalPrmBrkTqCtrlrBrk_UBYTE 0 Gain 0 255 SYMBOL_LINK "CalPrmBrkTqCtrlrBrk01.U8_WPE_LFC_Hold_Duty_r_2nd" 0 /end CHARACTERISTIC
/begin CHARACTERISTIC U8_WPE_LFC_Hold_Duty_r_3rd "Temp" VALUE 0x80021684 CalPrmBrkTqCtrlrBrk_UBYTE 0 Gain 0 255 SYMBOL_LINK "CalPrmBrkTqCtrlrBrk01.U8_WPE_LFC_Hold_Duty_r_3rd" 0 /end CHARACTERISTIC
/begin CHARACTERISTIC U8_WPE_LFC_Hold_Duty_r_4th "Temp" VALUE 0x80021685 CalPrmBrkTqCtrlrBrk_UBYTE 0 Gain 0 255 SYMBOL_LINK "CalPrmBrkTqCtrlrBrk01.U8_WPE_LFC_Hold_Duty_r_4th" 0 /end CHARACTERISTIC
/begin CHARACTERISTIC U8_WPE_LFC_Hold_Duty_r_5th "Temp" VALUE 0x80021686 CalPrmBrkTqCtrlrBrk_UBYTE 0 Gain 0 255 SYMBOL_LINK "CalPrmBrkTqCtrlrBrk01.U8_WPE_LFC_Hold_Duty_r_5th" 0 /end CHARACTERISTIC
/begin CHARACTERISTIC U8_WPE_LFC_Hold_Duty_r_6th "Temp" VALUE 0x80021687 CalPrmBrkTqCtrlrBrk_UBYTE 0 Gain 0 255 SYMBOL_LINK "CalPrmBrkTqCtrlrBrk01.U8_WPE_LFC_Hold_Duty_r_6th" 0 /end CHARACTERISTIC
/begin CHARACTERISTIC U8_WPE_LFC_Hold_Duty_r_7th "Temp" VALUE 0x80021688 CalPrmBrkTqCtrlrBrk_UBYTE 0 Gain 0 255 SYMBOL_LINK "CalPrmBrkTqCtrlrBrk01.U8_WPE_LFC_Hold_Duty_r_7th" 0 /end CHARACTERISTIC
/begin CHARACTERISTIC U8_WPE_LFC_Hold_Duty_r_8th "Temp" VALUE 0x80021689 CalPrmBrkTqCtrlrBrk_UBYTE 0 Gain 0 255 SYMBOL_LINK "CalPrmBrkTqCtrlrBrk01.U8_WPE_LFC_Hold_Duty_r_8th" 0 /end CHARACTERISTIC
/begin CHARACTERISTIC U8_WPE_LFC_Hold_Duty_r_9th "Temp" VALUE 0x8002168A CalPrmBrkTqCtrlrBrk_UBYTE 0 Gain 0 255 SYMBOL_LINK "CalPrmBrkTqCtrlrBrk01.U8_WPE_LFC_Hold_Duty_r_9th" 0 /end CHARACTERISTIC
/begin CHARACTERISTIC U8_WPE_LFC_Rise_Duty_f_10th "Temp" VALUE 0x800216BB CalPrmBrkTqCtrlrBrk_UBYTE 0 Gain 0 255 SYMBOL_LINK "CalPrmBrkTqCtrlrBrk01.U8_WPE_LFC_Rise_Duty_f_10th" 0 /end CHARACTERISTIC
/begin CHARACTERISTIC U8_WPE_LFC_Rise_Duty_f_11th "Temp" VALUE 0x800216BC CalPrmBrkTqCtrlrBrk_UBYTE 0 Gain 0 255 SYMBOL_LINK "CalPrmBrkTqCtrlrBrk01.U8_WPE_LFC_Rise_Duty_f_11th" 0 /end CHARACTERISTIC
/begin CHARACTERISTIC U8_WPE_LFC_Rise_Duty_f_1st "Temp" VALUE 0x800216B2 CalPrmBrkTqCtrlrBrk_UBYTE 0 Gain 0 255 SYMBOL_LINK "CalPrmBrkTqCtrlrBrk01.U8_WPE_LFC_Rise_Duty_f_1st" 0 /end CHARACTERISTIC
/begin CHARACTERISTIC U8_WPE_LFC_Rise_Duty_f_2nd "Temp" VALUE 0x800216B3 CalPrmBrkTqCtrlrBrk_UBYTE 0 Gain 0 255 SYMBOL_LINK "CalPrmBrkTqCtrlrBrk01.U8_WPE_LFC_Rise_Duty_f_2nd" 0 /end CHARACTERISTIC
/begin CHARACTERISTIC U8_WPE_LFC_Rise_Duty_f_3rd "Temp" VALUE 0x800216B4 CalPrmBrkTqCtrlrBrk_UBYTE 0 Gain 0 255 SYMBOL_LINK "CalPrmBrkTqCtrlrBrk01.U8_WPE_LFC_Rise_Duty_f_3rd" 0 /end CHARACTERISTIC
/begin CHARACTERISTIC U8_WPE_LFC_Rise_Duty_f_4th "Temp" VALUE 0x800216B5 CalPrmBrkTqCtrlrBrk_UBYTE 0 Gain 0 255 SYMBOL_LINK "CalPrmBrkTqCtrlrBrk01.U8_WPE_LFC_Rise_Duty_f_4th" 0 /end CHARACTERISTIC
/begin CHARACTERISTIC U8_WPE_LFC_Rise_Duty_f_5th "Temp" VALUE 0x800216B6 CalPrmBrkTqCtrlrBrk_UBYTE 0 Gain 0 255 SYMBOL_LINK "CalPrmBrkTqCtrlrBrk01.U8_WPE_LFC_Rise_Duty_f_5th" 0 /end CHARACTERISTIC
/begin CHARACTERISTIC U8_WPE_LFC_Rise_Duty_f_6th "Temp" VALUE 0x800216B7 CalPrmBrkTqCtrlrBrk_UBYTE 0 Gain 0 255 SYMBOL_LINK "CalPrmBrkTqCtrlrBrk01.U8_WPE_LFC_Rise_Duty_f_6th" 0 /end CHARACTERISTIC
/begin CHARACTERISTIC U8_WPE_LFC_Rise_Duty_f_7th "Temp" VALUE 0x800216B8 CalPrmBrkTqCtrlrBrk_UBYTE 0 Gain 0 255 SYMBOL_LINK "CalPrmBrkTqCtrlrBrk01.U8_WPE_LFC_Rise_Duty_f_7th" 0 /end CHARACTERISTIC
/begin CHARACTERISTIC U8_WPE_LFC_Rise_Duty_f_8th "Temp" VALUE 0x800216B9 CalPrmBrkTqCtrlrBrk_UBYTE 0 Gain 0 255 SYMBOL_LINK "CalPrmBrkTqCtrlrBrk01.U8_WPE_LFC_Rise_Duty_f_8th" 0 /end CHARACTERISTIC
/begin CHARACTERISTIC U8_WPE_LFC_Rise_Duty_f_9th "Temp" VALUE 0x800216BA CalPrmBrkTqCtrlrBrk_UBYTE 0 Gain 0 255 SYMBOL_LINK "CalPrmBrkTqCtrlrBrk01.U8_WPE_LFC_Rise_Duty_f_9th" 0 /end CHARACTERISTIC
/begin COMPU_METHOD A20 "" LINEAR "%.15" "g" COEFFS_LINEAR 0.25 0 /end COMPU_METHOD
/begin COMPU_METHOD A42 "" LINEAR "%.15" "g" COEFFS_LINEAR 0.01 0 /end COMPU_METHOD
/begin COMPU_METHOD AgSpd31 "" LINEAR "%.15" "DegPerSec" COEFFS_LINEAR 0.01 0 /end COMPU_METHOD
/begin COMPU_METHOD Fac31 "" LINEAR "%.15" "NA" COEFFS_LINEAR 1 0 /end COMPU_METHOD
/begin COMPU_METHOD Gain "" LINEAR "%.15" "NA" COEFFS_LINEAR 1 0 /end COMPU_METHOD
/begin COMPU_METHOD N10 "" LINEAR "%.15" "RPM" COEFFS_LINEAR 1 0 /end COMPU_METHOD
/begin COMPU_METHOD Nr2 "" LINEAR "%.15" "NA" COEFFS_LINEAR 1 0 /end COMPU_METHOD
/begin COMPU_METHOD OnOff1 "" LINEAR "%.15" "NA" COEFFS_LINEAR 1 0 STATUS_STRING_REF OnOffTable /end COMPU_METHOD
/begin COMPU_METHOD P32 "" LINEAR "%.15" "bar" COEFFS_LINEAR 0.01 0 /end COMPU_METHOD
/begin COMPU_METHOD P34 "" LINEAR "%.15" "bar" COEFFS_LINEAR 0.1 0 /end COMPU_METHOD
/begin COMPU_METHOD PGrdt13 "" LINEAR "%.15" "bar/30ms" COEFFS_LINEAR 0.1 0 /end COMPU_METHOD
/begin COMPU_METHOD Perc6 "" LINEAR "%.15" "Percentage" COEFFS_LINEAR 1 0 /end COMPU_METHOD
/begin COMPU_METHOD Perc9 "" LINEAR "%.15" "Percentage" COEFFS_LINEAR 0.1 0 /end COMPU_METHOD
/begin COMPU_METHOD Spd12 "" LINEAR "%.15" "kph" COEFFS_LINEAR 0.125 0 /end COMPU_METHOD
/begin COMPU_METHOD T32 "" LINEAR "%.15" "degC" COEFFS_LINEAR 0.031225 0 /end COMPU_METHOD
/begin COMPU_METHOD Ti21 "" LINEAR "%.15" "sec" COEFFS_LINEAR 0.01 0 /end COMPU_METHOD
/begin COMPU_METHOD Ti41 "" LINEAR "%.15" "sec" COEFFS_LINEAR 0.005 0 /end COMPU_METHOD
/begin COMPU_METHOD TqGrdt10 "" LINEAR "%.15" "Nm/10ms" COEFFS_LINEAR 1 0 /end COMPU_METHOD
/begin COMPU_VTAB OnOff1 "" TAB_VERB 2 0 "off" 1 "on" DEFAULT_VALUE "" /end COMPU_VTAB
/begin COMPU_VTAB OnOffTable "" TAB_VERB 2 0 "Off" 1 "On" DEFAULT_VALUE "" /end COMPU_VTAB
/begin RECORD_LAYOUT CalPrmBrkAssisCoorrBrk_SWORD FNC_VALUES 1 SWORD COLUMN_DIR DIRECT ALIGNMENT_BYTE 1 ALIGNMENT_WORD 1 ALIGNMENT_LONG 1 ALIGNMENT_FLOAT32_IEEE 1 ALIGNMENT_FLOAT64_IEEE 1 ALIGNMENT_INT64 1 /end RECORD_LAYOUT
/begin RECORD_LAYOUT CalPrmBrkAssisCoorrBrk_UBYTE FNC_VALUES 1 UBYTE COLUMN_DIR DIRECT ALIGNMENT_BYTE 1 ALIGNMENT_WORD 1 ALIGNMENT_LONG 1 ALIGNMENT_FLOAT32_IEEE 1 ALIGNMENT_FLOAT64_IEEE 1 ALIGNMENT_INT64 1 /end RECORD_LAYOUT
/begin RECORD_LAYOUT CalPrmBrkAssisCoorrBrk_UWORD FNC_VALUES 1 UWORD COLUMN_DIR DIRECT ALIGNMENT_BYTE 1 ALIGNMENT_WORD 1 ALIGNMENT_LONG 1 ALIGNMENT_FLOAT32_IEEE 1 ALIGNMENT_FLOAT64_IEEE 1 ALIGNMENT_INT64 1 /end RECORD_LAYOUT
/begin RECORD_LAYOUT CalPrmBrkTqCtrlrBrk_SWORD FNC_VALUES 1 SWORD COLUMN_DIR DIRECT ALIGNMENT_BYTE 1 ALIGNMENT_WORD 1 ALIGNMENT_LONG 1 ALIGNMENT_FLOAT32_IEEE 1 ALIGNMENT_FLOAT64_IEEE 1 ALIGNMENT_INT64 1 /end RECORD_LAYOUT
/begin RECORD_LAYOUT CalPrmBrkTqCtrlrBrk_UBYTE FNC_VALUES 1 UBYTE COLUMN_DIR DIRECT ALIGNMENT_BYTE 1 ALIGNMENT_WORD 1 ALIGNMENT_LONG 1 ALIGNMENT_FLOAT32_IEEE 1 ALIGNMENT_FLOAT64_IEEE 1 ALIGNMENT_INT64 1 /end RECORD_LAYOUT
/begin RECORD_LAYOUT CalPrmLatDynsCoorrBrk_SBYTE FNC_VALUES 1 SBYTE COLUMN_DIR DIRECT ALIGNMENT_BYTE 1 ALIGNMENT_WORD 1 ALIGNMENT_LONG 1 ALIGNMENT_FLOAT32_IEEE 1 ALIGNMENT_FLOAT64_IEEE 1 ALIGNMENT_INT64 1 /end RECORD_LAYOUT
/begin RECORD_LAYOUT CalPrmLatDynsCoorrBrk_SWORD FNC_VALUES 1 SWORD COLUMN_DIR DIRECT ALIGNMENT_BYTE 1 ALIGNMENT_WORD 1 ALIGNMENT_LONG 1 ALIGNMENT_FLOAT32_IEEE 1 ALIGNMENT_FLOAT64_IEEE 1 ALIGNMENT_INT64 1 /end RECORD_LAYOUT
/begin RECORD_LAYOUT CalPrmLatDynsCoorrBrk_UBYTE FNC_VALUES 1 UBYTE COLUMN_DIR DIRECT ALIGNMENT_BYTE 1 ALIGNMENT_WORD 1 ALIGNMENT_LONG 1 ALIGNMENT_FLOAT32_IEEE 1 ALIGNMENT_FLOAT64_IEEE 1 ALIGNMENT_INT64 1 /end RECORD_LAYOUT
/begin RECORD_LAYOUT CalPrmSsmEng_SBYTE FNC_VALUES 1 SBYTE COLUMN_DIR DIRECT ALIGNMENT_BYTE 1 ALIGNMENT_WORD 1 ALIGNMENT_LONG 1 ALIGNMENT_FLOAT32_IEEE 1 ALIGNMENT_FLOAT64_IEEE 1 ALIGNMENT_INT64 1 /end RECORD_LAYOUT
/begin RECORD_LAYOUT CalPrmSsmEng_SWORD FNC_VALUES 1 SWORD COLUMN_DIR DIRECT ALIGNMENT_BYTE 1 ALIGNMENT_WORD 1 ALIGNMENT_LONG 1 ALIGNMENT_FLOAT32_IEEE 1 ALIGNMENT_FLOAT64_IEEE 1 ALIGNMENT_INT64 1 /end RECORD_LAYOUT
/begin RECORD_LAYOUT CalPrmSsmEng_UBYTE FNC_VALUES 1 UBYTE COLUMN_DIR DIRECT ALIGNMENT_BYTE 1 ALIGNMENT_WORD 1 ALIGNMENT_LONG 1 ALIGNMENT_FLOAT32_IEEE 1 ALIGNMENT_FLOAT64_IEEE 1 ALIGNMENT_INT64 1 /end RECORD_LAYOUT
/begin RECORD_LAYOUT CalPrmWslcBrk_SBYTE FNC_VALUES 1 SBYTE COLUMN_DIR DIRECT ALIGNMENT_BYTE 1 ALIGNMENT_WORD 1 ALIGNMENT_LONG 1 ALIGNMENT_FLOAT32_IEEE 1 ALIGNMENT_FLOAT64_IEEE 1 ALIGNMENT_INT64 1 /end RECORD_LAYOUT
/begin RECORD_LAYOUT CalPrmWslcBrk_SWORD FNC_VALUES 1 SWORD COLUMN_DIR DIRECT ALIGNMENT_BYTE 1 ALIGNMENT_WORD 1 ALIGNMENT_LONG 1 ALIGNMENT_FLOAT32_IEEE 1 ALIGNMENT_FLOAT64_IEEE 1 ALIGNMENT_INT64 1 /end RECORD_LAYOUT
/begin RECORD_LAYOUT CalPrmWslcBrk_UBYTE FNC_VALUES 1 UBYTE COLUMN_DIR DIRECT ALIGNMENT_BYTE 1 ALIGNMENT_WORD 1 ALIGNMENT_LONG 1 ALIGNMENT_FLOAT32_IEEE 1 ALIGNMENT_FLOAT64_IEEE 1 ALIGNMENT_INT64 1 /end RECORD_LAYOUT
/begin RECORD_LAYOUT CalPrmWspcEng_SWORD FNC_VALUES 1 SWORD COLUMN_DIR DIRECT ALIGNMENT_BYTE 1 ALIGNMENT_WORD 1 ALIGNMENT_LONG 1 ALIGNMENT_FLOAT32_IEEE 1 ALIGNMENT_FLOAT64_IEEE 1 ALIGNMENT_INT64 1 /end RECORD_LAYOUT
/begin RECORD_LAYOUT CalPrmWspcEng_UBYTE FNC_VALUES 1 UBYTE COLUMN_DIR DIRECT ALIGNMENT_BYTE 1 ALIGNMENT_WORD 1 ALIGNMENT_LONG 1 ALIGNMENT_FLOAT32_IEEE 1 ALIGNMENT_FLOAT64_IEEE 1 ALIGNMENT_INT64 1 /end RECORD_LAYOUT
/begin RECORD_LAYOUT SSV__FLOAT64_IEEE_S AXIS_PTS_X 1 FLOAT64_IEEE INDEX_INCR DIRECT /end RECORD_LAYOUT
/begin RECORD_LAYOUT SSV__SBYTE_S AXIS_PTS_X 1 SBYTE INDEX_INCR DIRECT /end RECORD_LAYOUT
/begin RECORD_LAYOUT SSV__SLONG_S AXIS_PTS_X 1 SLONG INDEX_INCR DIRECT /end RECORD_LAYOUT
/begin RECORD_LAYOUT SSV__SWORD_S AXIS_PTS_X 1 SWORD INDEX_INCR DIRECT /end RECORD_LAYOUT
/begin RECORD_LAYOUT SSV__UBYTE_S AXIS_PTS_X 1 UBYTE INDEX_INCR DIRECT /end RECORD_LAYOUT
/begin RECORD_LAYOUT SSV__ULONG_S AXIS_PTS_X 1 ULONG INDEX_INCR DIRECT /end RECORD_LAYOUT
/begin RECORD_LAYOUT SSV__UWORD_S AXIS_PTS_X 1 UWORD INDEX_INCR DIRECT /end RECORD_LAYOUT
/begin RECORD_LAYOUT __A_INT64_S FNC_VALUES 1 A_INT64 COLUMN_DIR DIRECT /end RECORD_LAYOUT
/begin RECORD_LAYOUT __A_INT64_Z FNC_VALUES 1 A_INT64 ROW_DIR DIRECT /end RECORD_LAYOUT
/begin RECORD_LAYOUT __A_UINT64_S FNC_VALUES 1 A_UINT64 COLUMN_DIR DIRECT /end RECORD_LAYOUT
/begin RECORD_LAYOUT __A_UINT64_Z FNC_VALUES 1 A_UINT64 ROW_DIR DIRECT /end RECORD_LAYOUT
/begin RECORD_LAYOUT __FLOAT32_IEEE_S FNC_VALUES 1 FLOAT32_IEEE COLUMN_DIR DIRECT /end RECORD_LAYOUT
/begin RECORD_LAYOUT __FLOAT32_IEEE_Z FNC_VALUES 1 FLOAT32_IEEE ROW_DIR DIRECT /end RECORD_LAYOUT
/begin RECORD_LAYOUT __FLOAT64_IEEE_S FNC_VALUES 1 FLOAT64_IEEE COLUMN_DIR DIRECT /end RECORD_LAYOUT
/begin RECORD_LAYOUT __FLOAT64_IEEE_Z FNC_VALUES 1 FLOAT64_IEEE ROW_DIR DIRECT /end RECORD_LAYOUT
/begin RECORD_LAYOUT __SBYTE_S FNC_VALUES 1 SBYTE COLUMN_DIR DIRECT /end RECORD_LAYOUT
/begin GROUP c_WpeTcHoldDuty ""
 /begin REF_CHARACTERISTIC S16_WPE_TC_Valve_Hold_Duty_V_1 S16_WPE_TC_Valve_Hold_Duty_V_10 S16_WPE_TC_Valve_Hold_Duty_V_11 S16_WPE_TC_Valve_Hold_Duty_V_12 S16_WPE_TC_Valve_Hold_Duty_V_13 S16_WPE_TC_Valve_Hold_Duty_V_14 S16_WPE_TC_Valve_Hold_Duty_V_15 S16_WPE_TC_Valve_Hold_Duty_V_16 S16_WPE_TC_Valve_Hold_Duty_V_2 S16_WPE_TC_Valve_Hold_Duty_V_3 S16_WPE_TC_Valve_Hold_Duty_V_4 S16_WPE_TC_Valve_Hold_Duty_V_5 S16_WPE_TC_Valve_Hold_Duty_V_6 S16_WPE_TC_Valve_Hold_Duty_V_7 S16_WPE_TC_Valve_Hold_Duty_V_8 S16_WPE_TC_Valve_Hold_Duty_V_9 /end REF_CHARACTERISTIC
/end GROUP
/begin GROUP c_Yaw_Stability_Improve_Ctrl ""
 /begin SUB_GROUP a_1st_Stable_Dump_Threshold b_Dump_Rate_Per_YDF c_Rise_Rate_Per_YDF d_Stable_hold_time_by_YDF /end SUB_GROUP
/end GROUP
/begin GROUP ca.EHC_Tq_Max ""
 /begin REF_CHARACTERISTIC TQS16_EHC_CAL_TQ_MAX_HM TQS16_EHC_CAL_TQ_MAX_MM TQS16_EHC_CAL_TQ_MIN_HM TQS16_EHC_CAL_TQ_MIN_MM TQS16_EHC_TORQ_MAX /end REF_CHARACTERISTIC
/end GROUP
/begin GROUP ca.EHC_Tq_Weg ""
 /begin REF_CHARACTERISTIC TQS16_EHC_TORQ_WSTR_WEG_HM_100K TQS16_EHC_TORQ_WSTR_WEG_HM_40K TQS16_EHC_TORQ_WSTR_WEG_HM_60K TQS16_EHC_TORQ_WSTR_WEG_HM_80K TQS16_EHC_TORQ_WSTR_WEG_MM_100K TQS16_EHC_TORQ_WSTR_WEG_MM_40K TQS16_EHC_TORQ_WSTR_WEG_MM_60K TQS16_EHC_TORQ_WSTR_WEG_MM_80K /end REF_CHARACTERISTIC
/end GROUP
/begin GROUP ca.Grad_Base ""
 /begin REF_CHARACTERISTIC TQS16_TORQ_GRDT_F_LIMT_HMU_HSP TQS16_TORQ_GRDT_F_LIMT_HMU_LSP TQS16_TORQ_GRDT_F_LIMT_HMU_MSP TQS16_TORQ_GRDT_F_LIMT_LMU_HSP TQS16_TORQ_GRDT_F_LIMT_LMU_LSP TQS16_TORQ_GRDT_F_LIMT_LMU_MSP TQS16_TORQ_GRDT_F_LIMT_MMU_HSP TQS16_TORQ_GRDT_F_LIMT_MMU_LSP TQS16_TORQ_GRDT_F_LIMT_MMU_MSP /end REF_CHARACTERISTIC
/end GROUP
/begin GROUP ca.Rop_Ay_Vx_Dot ""
 /begin REF_CHARACTERISTIC TQU8_ROP_AY_VX_DOT_1ST_WEG TQU8_ROP_AY_VX_DOT_2ND_WEG TQU8_ROP_AY_VX_DOT_WEG /end REF_CHARACTERISTIC
/end GROUP
/begin GROUP ca.TVBB_Tar_Moment ""
 /begin REF_CHARACTERISTIC TQS16_TVBB_YC_D_GAIN_DEC_HM TQS16_TVBB_YC_D_GAIN_DEC_LM TQS16_TVBB_YC_D_GAIN_DEC_MM TQS16_TVBB_YC_D_GAIN_INC_HM TQS16_TVBB_YC_D_GAIN_INC_LM TQS16_TVBB_YC_D_GAIN_INC_MM TQS16_TVBB_YC_P_GAIN_DEC_HM TQS16_TVBB_YC_P_GAIN_DEC_LM TQS16_TVBB_YC_P_GAIN_DEC_MM TQS16_TVBB_YC_P_GAIN_INC_HM TQS16_TVBB_YC_P_GAIN_INC_LM TQS16_TVBB_YC_P_GAIN_INC_MM /end REF_CHARACTERISTIC
 /begin SUB_GROUP TVBB_Tar_Mmt_Eng_tq /end SUB_GROUP
/end GROUP
/begin GROUP ca_FBC_Fade_Detection ""
 /begin REF_CHARACTERISTIC BAC_S16_BRAKE_DISK_FADE_TEMPERATURE BAC_S16_BRAKE_DISK_MONITOR_TEMPERATURE BAC_S16_BRAKE_High_MCPRESS BAC_S16_BRAKE_LOWMU_ABSPRESS BAC_S16_BRAKE_Low_MCPRESS BAC_S16_BRAKE_Med_MCPRESS BAC_U8_BRAKE_High_Decel BAC_U8_BRAKE_Low_Decel BAC_U8_BRAKE_Med_Decel BAC_U8_FBC_FADING_DCT_COUNT_MAX /end REF_CHARACTERISTIC
/end GROUP
/begin GROUP ca_HSA_Enter_thres ""
 /begin REF_CHARACTERISTIC SSM_S16_HSA_FLAT_THR_FORWARD SSM_S16_HSA_FLAT_THR_REVERSE SSM_S16_HSA_MIN_SLOPE_FORWARD SSM_S16_HSA_MIN_SLOPE_REVERSE SSM_S16_HSA_STOP_ON_HILL_MIN_SPD SSM_S16_HSA_c_MaxLongG SSM_U8_MPlessHSA_ENTER_SPD_OK_TIME /end REF_CHARACTERISTIC
/end GROUP
/begin GROUP cb.EHC_Tq_Inc "" /begin SUB_GROUP EHC_Tq_Inc_MM /end SUB_GROUP /end GROUP
/begin GROUP cb.Grad_Add_YawAccel ""
 /begin REF_CHARACTERISTIC TQS16_TORQ_GRDT_ADD_CNT_HMU TQS16_TORQ_GRDT_ADD_CNT_LMU TQS16_TORQ_GRDT_ADD_CNT_MMU TQS16_TORQ_GRDT_ADD_X2_F_HMU TQS16_TORQ_GRDT_ADD_X2_F_LMU TQS16_TORQ_GRDT_ADD_X2_F_MMU TQS16_TORQ_GRDT_ADD_X3_F_HMU TQS16_TORQ_GRDT_ADD_X3_F_LMU TQS16_TORQ_GRDT_ADD_X3_F_MMU TQS16_YAW_ACCEL_TH_X1 TQS16_YAW_ACCEL_TH_X2 TQS16_YAW_ACCEL_TH_X3 /end REF_CHARACTERISTIC
/end GROUP
/begin GROUP cb.Rop_Ay_Gain ""
 /begin REF_CHARACTERISTIC TQS16_AYC_1ST_CYCLE_D_IN_WEG TQS16_AYC_1ST_CYCLE_D_OUT_WEG TQS16_AYC_1ST_CYCLE_P_IN_WEG TQS16_AYC_1ST_CYCLE_P_OUT_WEG TQS16_AYC_D_GAIN_INSIDE_DEC TQS16_AYC_D_GAIN_INSIDE_INC TQS16_AYC_D_GAIN_OUTSIDE_DEC TQS16_AYC_D_GAIN_OUTSIDE_INC TQS16_AYC_MQ_WEG_VEL_100K TQS16_AYC_MQ_WEG_VEL_20K TQS16_AYC_MQ_WEG_VEL_40K TQS16_AYC_MQ_WEG_VEL_60K TQS16_AYC_MQ_WEG_VEL_80K TQS16_AYC_P_GAIN_INSIDE_DEC TQS16_AYC_P_GAIN_INSIDE_INC TQS16_AYC_P_GAIN_OUTSIDE_DEC TQS16_AYC_P_GAIN_OUTSIDE_INC TQS16_AY_P_GAIN_FED_FOWR TQS16_AY_REF_DYN_WEG_VEL_100K TQS16_AY_REF_DYN_WEG_VEL_20K TQS16_AY_REF_DYN_WEG_VEL_40K TQS16_AY_REF_DYN_WEG_VEL_60K TQS16_AY_REF_DYN_WEG_VEL_80K TQS16_AY_REF_MAX_OFFSET TQS16_AY_REF_MIN_OFFSET TQS16_AY_REF_WEG_VEL_100K TQS16_AY_REF_WEG_VEL_20K TQS16_AY_REF_WEG_VEL_40K TQS16_AY_REF_WEG_VEL_60K TQS16_AY_REF_WEG_VEL_80K TQS16_ROP_AY_DOT_TH_1st TQS16_ROP_AY_DOT_TH_2nd /end REF_CHARACTERISTIC
/end GROUP
/begin GROUP cb.TVBB_Tar_Mmt_Spd_Weg "" /begin SUB_GROUP TVBB_Mmt_Weg_HM TVBB_Mmt_Weg_LM TVBB_Mmt_Weg_MM /end SUB_GROUP /end GROUP
/begin GROUP cb_FBC_Enter ""
 /begin REF_CHARACTERISTIC BAC_S16_FBC_ENTER_DECEL BAC_S16_FBC_PRESS_ENTER_THR BAC_S16_FBC_PRESS_RATE_ENTER_THR BAC_S16_FBC_SPEED_ENTER_THR /end REF_CHARACTERISTIC
/end GROUP
/begin GROUP cb_HSA_Exit_thres "" /begin SUB_GROUP cba_TimeOut cbb_Accel_Apply /end SUB_GROUP /end GROUP
/begin GROUP cba_TimeOut ""
 /begin REF_CHARACTERISTIC SSM_U8_HSA_HOLDTIME_HIGHMED_HILL SSM_U8_HSA_HOLDTIME_LOWMED_HILL SSM_U8_HSA_MAX_HOLDTIME_1 SSM_U8_HSA_MAX_HOLDTIME_2 SSM_U8_HSA_MAX_HOLDTIME_3 SSM_U8_HSA_MAX_HOLDTIME_4 SSM_U8_HSA_MAX_HOLDTIME_RVS_1 SSM_U8_HSA_MAX_HOLDTIME_RVS_2 SSM_U8_HSA_MAX_HOLDTIME_RVS_3 SSM_U8_HSA_MAX_HOLDTIME_RVS_4 /end REF_CHARACTERISTIC
/end GROUP
/begin GROUP cbb_Accel_Apply "" /begin REF_CHARACTERISTIC SSM_U8_HSA_FAST_EXIT_MTP_TH /end REF_CHARACTERISTIC /end GROUP
/begin GROUP cc.EHC_Tq_Dec ""
 /begin REF_CHARACTERISTIC TQS16_EHC_TORQ_DEC_100K TQS16_EHC_TORQ_DEC_40K TQS16_EHC_TORQ_DEC_60K TQS16_EHC_TORQ_DEC_80K TQS16_EHC_TQ_DEC_RATE_1 TQS16_EHC_TQ_DEC_RATE_2 TQS16_EHC_TQ_DEC_RATE_3 TQS16_EHC_TQ_DEC_YAW_TH_1 TQS16_EHC_TQ_DEC_YAW_TH_2 TQS16_EHC_TQ_DEC_YAW_TH_3 /end REF_CHARACTERISTIC
/end GROUP
/begin GROUP cc.Grad_Add_DelM ""
 /begin REF_CHARACTERISTIC TQS16_DELM_ADD_TH_X1 TQS16_DELM_ADD_TH_X2 TQS16_DELM_ADD_TH_X3 TQS16_TORQ_GRDT_DELM_ADD_X2 TQS16_TORQ_GRDT_DELM_ADD_X3 /end REF_CHARACTERISTIC
/end GROUP
/begin GROUP cc.Rop_Dump ""
 /begin REF_CHARACTERISTIC TQS16_ROP_DUMP_ALAT_1st TQS16_ROP_DUMP_ALAT_2nd TQS16_ROP_DUMP_ALAT_3rd TQS16_ROP_DUMP_DYN_WEG_VEL_100K TQS16_ROP_DUMP_DYN_WEG_VEL_20K TQS16_ROP_DUMP_DYN_WEG_VEL_40K TQS16_ROP_DUMP_DYN_WEG_VEL_60K TQS16_ROP_DUMP_DYN_WEG_VEL_80K TQS16_ROP_DUMP_RATE_1st TQS16_ROP_DUMP_RATE_2nd TQS16_ROP_DUMP_RATE_3rd TQS16_ROP_DUMP_RATE_ADD TQS16_ROP_DUMP_RATE_SLIP_MAX TQS16_ROP_DUMP_RATE_SLIP_MIN TQS16_ROP_DUMP_WEG_VEL_100K TQS16_ROP_DUMP_WEG_VEL_20K TQS16_ROP_DUMP_WEG_VEL_40K TQS16_ROP_DUMP_WEG_VEL_60K TQS16_ROP_DUMP_WEG_VEL_80K /end REF_CHARACTERISTIC
/end GROUP
/begin GROUP cc.Rop_Prefill ""
 /begin REF_CHARACTERISTIC TQS16_ROP_FRT_PRESS_MIN TQS16_ROP_PREFILL_MPRESS_TH TQS16_ROP_PREFILL_MQ_WEG_VEL_100K TQS16_ROP_PREFILL_MQ_WEG_VEL_20K TQS16_ROP_PREFILL_MQ_WEG_VEL_40K TQS16_ROP_PREFILL_MQ_WEG_VEL_60K TQS16_ROP_PREFILL_MQ_WEG_VEL_80K TQS16_ROP_Pre_Frt_Alatm_TH TQS16_ROP_Pre_Frt_Vel_TH /end REF_CHARACTERISTIC
/end GROUP
/begin GROUP cc.TVBB_Tar_Mmt_Slip_Weg ""
 /begin REF_CHARACTERISTIC TQS16_TVBB_CTRL_REF_WHL_SLIP_HMU_1 TQS16_TVBB_CTRL_REF_WHL_SLIP_HMU_2 TQS16_TVBB_CTRL_REF_WHL_SLIP_HMU_3 TQS16_TVBB_CTRL_REF_WHL_SLIP_HMU_4 TQS16_TVBB_CTRL_REF_WHL_SLIP_HMU_5 TQU8_TVBB_CTRL_WEG_FOR_SLIP_HMU_1 TQU8_TVBB_CTRL_WEG_FOR_SLIP_HMU_2 TQU8_TVBB_CTRL_WEG_FOR_SLIP_HMU_3 TQU8_TVBB_CTRL_WEG_FOR_SLIP_HMU_4 TQU8_TVBB_CTRL_WEG_FOR_SLIP_HMU_5 /end REF_CHARACTERISTIC
/end GROUP
/begin GROUP cc_FBC_Exit ""
 /begin REF_CHARACTERISTIC BAC_S16_FBC_PRESS_EXIT_THR1 BAC_S16_FBC_PRESS_EXIT_THR2 BAC_S16_FBC_PRESS_EXIT_THR3 BAC_S16_FBC_SPEED_EXIT_THR BAC_U8_FBC_PRESS_EXIT_THR3_TIMER /end REF_CHARACTERISTIC
/end GROUP
/begin GROUP cc_HSA_Press_Release ""
 /begin REF_CHARACTERISTIC SSM_U8_HSA_HighMedLongG SSM_U8_HSA_LowMedLongG SSM_U8_HSA_RELEASE_TIME_DEFAULT SSM_U8_HSA_RELEASE_TIME_NOT_HILL SSM_U8_HSA_RELEASE_TIME_PB_ACTIVE SSM_U8_HSA_RELEASE_TIME_UNLATCHED /end REF_CHARACTERISTIC
/end GROUP
/begin GROUP cca.EHC_Tq_Weg "" /begin REF_CHARACTERISTIC TQS16_EHC_TORQ_WEG_WSTRD TQS16_EHC_TORQ_WEG_YAWD /end REF_CHARACTERISTIC /end GROUP
/begin GROUP ccb.EHC_Tq_Inc "" /begin SUB_GROUP EHC_Tq_Inc_HM /end SUB_GROUP /end GROUP
/begin GROUP cd.Grad_Max ""
 /begin REF_CHARACTERISTIC TQS16_TORQ_GRDT_F_MAX_HMU TQS16_TORQ_GRDT_F_MAX_LMU TQS16_TORQ_GRDT_F_MAX_MMU /end REF_CHARACTERISTIC
/end GROUP
/begin GROUP cd.Rop_Press ""
 /begin REF_CHARACTERISTIC TQS16_ROP_2ND_ENGAGE_SPEED_V1 TQS16_ROP_2ND_ENGAGE_SPEED_V2 TQS16_ROP_PRESS_RISE_1ST_LMT TQS16_ROP_PRESS_RISE_2ND_LMT TQS16_ROP_PRE_FRT_CTRL_MIN TQS16_ROP_PRE_FRT_ENT_WSTR_TH_V1 TQS16_ROP_PRE_FRT_ENT_WSTR_TH_V2 TQS16_ROP_PROACTIVE_DEL_SLIP_R TQS16_ROP_PULSE_UP_INI_DUTY_REAR TQS16_ROP_REAR_RISE_PRESS_BAR TQS8_DR_2ND_F_ENT_PRESS_OF_OUT_F TQS8_DR_2ND_F_LMT_DEL_SLIP TQS8_DR_2ND_R_ENT_PRESS_OF_OUT_F TQS8_DR_2ND_R_EXT_PRESS_OF_OUT_F /end REF_CHARACTERISTIC
/end GROUP
/begin GROUP cd.TVBB_Fade_Out "" /begin REF_CHARACTERISTIC TQS16_TVBB_FADE_DEC_GRDT TQS16_TVBB_FADE_TORQ_TH /end REF_CHARACTERISTIC /end GROUP
/begin GROUP cd.TVBB_Tar_Tq_Cal ""
 /begin REF_CHARACTERISTIC TQS16_TVBB_CTRL_MOMENT_HIGH TQS16_TVBB_CTRL_MOMENT_LOW TQS16_TVBB_CTRL_MOMENT_MEDHIGH TQS16_TVBB_CTRL_MOMENT_MEDLOW TQS16_TVBB_CTRL_TAR_TQ_HIGH TQS16_TVBB_CTRL_TAR_TQ_LOW TQS16_TVBB_CTRL_TAR_TQ_MEDHIGH TQS16_TVBB_CTRL_TAR_TQ_MEDLOW /end REF_CHARACTERISTIC
/end GROUP
/begin GROUP cd_FBC_Exit_Low_Mpress ""
 /begin REF_CHARACTERISTIC BAC_S16_LOW_MPRESS_FBC_ON_TIME_ACCEL BAC_S16_LOW_MPRESS_FBC_ON_TIME_BRAKING BAC_S16_LOW_MPRESS_FBC_ON_TIME_DEFAULT BAC_U8_FBC_EXIT_MTP1 BAC_U8_FBC_EXIT_MTP2 /end REF_CHARACTERISTIC
/end GROUP
/begin GROUP cd_HSA_Logic_Tuning ""
 /begin REF_CHARACTERISTIC SSM_S16_HSA_ENTER_HM_LIMIT_MPRESS SSM_S16_HSA_ENTER_INBIT_MPRESS SSM_S16_HSA_ENTER_LIMIT_SPEED SSM_S16_HSA_ENTER_LM_LIMIT_MPRESS SSM_S16_HSA_ENTER_MAX_LIMIT_MPRESS SSM_S16_HSA_EXIT_SPEED SSM_U8_HSA_Disable /end REF_CHARACTERISTIC
/end GROUP
/begin GROUP ce.Rop_Esc_Off_Mode ""
 /begin REF_CHARACTERISTIC TQS16_RI_THRES_WEG_IN_ESC_OFF TQS16_ROP_IN_ESC_OFF_D_GAIN_WEG TQS16_ROP_IN_ESC_OFF_P_GAIN_WEG TQS16_ROP_IN_ESC_OFF_VEL_ENT_TH /end REF_CHARACTERISTIC
/end GROUP
/begin GROUP ce_FBC_Control ""
 /begin REF_CHARACTERISTIC BAC_S16_FBC_MAX_TARGET_PRESS BAC_U16_FBC_MAX_APPLY_TIME_BEFORE_ABS BAC_U8_FBC_APPLY_TIME BAC_U8_FBC_DUMP_MODE_HOLD_TIME BAC_U8_FBC_DUMP_MODE_MAX_TIME BAC_U8_FBC_EXIT_CONTROL_TIME /end REF_CHARACTERISTIC
/end GROUP
/begin GROUP ce_HSA_Rise_thres ""
 /begin REF_CHARACTERISTIC SSM_S16_HSA_RISE_PRESS SSM_S16_HSA_RISE_TIME SSM_S16_HSA_RISE_WL_SPD_TH SSM_U8_HSA_DCT_OVERLOAD_RISE_NUM SSM_U8_HSA_RISE_ENABLE SSM_U8_HSA_RISE_NUM_OF_WL /end REF_CHARACTERISTIC
/end GROUP
/begin GROUP cf_FBC_Reserved ""
 /begin REF_CHARACTERISTIC BAC_S16_FBC_Temp1 BAC_S16_FBC_Temp2 BAC_S16_FBC_Temp3 BAC_S16_FBC_Temp4 BAC_S16_FBC_Temp5 /end REF_CHARACTERISTIC
/end GROUP
/begin GROUP cf_HSA_Status_Indication ""
 /begin REF_CHARACTERISTIC SSM_U8_HSA_INDICATION_ON_AX_TH SSM_U8_HSA_ONHILL_SET_REF_AX_OK_T /end REF_CHARACTERISTIC
/end GROUP
/begin GROUP cg_HSA_Reserved ""
 /begin REF_CHARACTERISTIC SSM_S16_HSA_TEMP_1 SSM_S16_HSA_TEMP_2 SSM_S16_HSA_T_P_TEMP_1 SSM_S16_HSA_T_P_TEMP_10 SSM_S16_HSA_T_P_TEMP_2 SSM_S16_HSA_T_P_TEMP_3 SSM_S16_HSA_T_P_TEMP_4 SSM_S16_HSA_T_P_TEMP_5 SSM_S16_HSA_T_P_TEMP_6 SSM_S16_HSA_T_P_TEMP_7 SSM_S16_HSA_T_P_TEMP_8 SSM_S16_HSA_T_P_TEMP_9 SSM_U8_HSA_TEMP_3 /end REF_CHARACTERISTIC
/end GROUP
/begin GROUP d.Multi_Wheel ""
 /begin REF_CHARACTERISTIC TQS16_OS2W_CTRL_ENTER_TH TQS16_OS2W_CTRL_EXIT_TH TQS16_OS2W_CTRL_SLIP_WEG TQS16_OS2W_ENTER_TAR_FX_OFFSET TQS16_SATBLE_FRT_TAR_SLIP_WEG TQS16_STABLE_FRT_TAR_SLIP_MAX TQS16_STABLE_OS2W_REAR_TAR_PRESS_MAX TQS16_STABLE_REAR_TAR_SLIP_MAX TQS16_STEER_FRT_TAR_PRESS_MAX TQS16_STEER_REAR_TAR_PRESS_MAX TQS16_TORQ_GRDT_US2W_F_HMU TQS16_TORQ_GRDT_US2W_F_LMU TQS16_TORQ_GRDT_US2W_F_MMU TQS16_US2W_CTRL_ENTER_TH TQS16_US2W_CTRL_EXIT_TH TQS16_US2W_CTRL_SLIP_WEG TQS16_US2W_ENTER_TAR_FX_OFFSET TQTQESC_OS_2W_Inhibit TQTQESC_US_2W_Inhibit /end REF_CHARACTERISTIC
/end GROUP
/begin GROUP d_60_100KPH ""
 /begin REF_CHARACTERISTIC TP_S8_Arad_1stPoint_60_100KPH TP_S8_Arad_2ndPoint_60_100KPH TP_S8_Arad_3rdPoint_60_100KPH TP_S8_Arad_Fact_1_2P_60_100KPH TP_S8_Arad_Fact_2_3P_60_100KPH TP_S8_Arad_Fact_Ab_3P_60_100KPH TP_S8_Arad_Fact_B_1P_60_100KPH /end REF_CHARACTERISTIC
/end GROUP
/begin GROUP d_Big_Rise_Dump_Detect ""
 /begin REF_CHARACTERISTIC TP_U8_BIG_DUMP_BY_LOWMU_FAST_RISE TP_U8_BIG_DUMP_GAUGE_AT_LEVEL1 TP_U8_BIG_DUMP_GAUGE_AT_LEVEL2 TP_U8_BIG_DUMP_GAUGE_AT_LEVEL3 TP_U8_BIG_RISE_DMP_COMP_DUTY TP_U8_BRD_DETECTION_REF TP_U8_BRD_DUMP_CNT_LEVEL1 TP_U8_BRD_DUMP_CNT_LEVEL2 TP_U8_BRD_DUMP_CNT_LEVEL3 /end REF_CHARACTERISTIC
/end GROUP
/begin GROUP d_CBC_Control_Delta_P ""
 /begin REF_CHARACTERISTIC TP_S16_CBC_COMP_MAX_DEL_YAW TP_S16_CBC_COMP_MAX_PRESS TP_S16_CBC_COMP_MIN_DEL_YAW TP_S16_CBC_COMP_MIN_PRESS TP_S16_CBC_DELTA_PRESS_ALAT_H_Spd_H TP_S16_CBC_DELTA_PRESS_ALAT_H_Spd_M TP_S16_CBC_DELTA_PRESS_ALAT_H_Spd_S TP_S16_CBC_DELTA_PRESS_ALAT_M_Spd_H TP_S16_CBC_DELTA_PRESS_ALAT_M_Spd_M TP_S16_CBC_DELTA_PRESS_ALAT_M_Spd_S TP_S16_CBC_DELTA_PRESS_ALAT_S_Spd_H TP_S16_CBC_DELTA_PRESS_ALAT_S_Spd_M TP_S16_CBC_DELTA_PRESS_ALAT_S_Spd_S /end REF_CHARACTERISTIC
/end GROUP
/begin GROUP d_CBC_Enter_Slip_Thres ""
 /begin REF_CHARACTERISTIC TP_S8_CBC_SLIP_THRES_COMP_H TP_S8_CBC_SLIP_THRES_COMP_M TP_S8_CBC_SLIP_THRES_H TP_S8_CBC_SLIP_THRES_L TP_S8_CBC_SLIP_THRES_M /end REF_CHARACTERISTIC
/end GROUP
/begin GROUP d_CBC_abs_Control_Valve ""
 /begin REF_CHARACTERISTIC TP_S16_CBC_DELTA_PRES_MAX_DUMP_ABS TP_S16_CBC_DELTA_PRES_MAX_RISE_ABS TP_S8_CBC_REAPPLY_TIME_ABS_R TP_S8_CBC_REAPPLY_TIME_FADEOUT_ABS_R TP_U8_CBC_DUMPSCAN_TIME TP_U8_CBC_DUMP_DEAD_PRESS_ABS TP_U8_CBC_MAX_HOLD_TIMER TP_U8_CBC_RISE_DEAD_PRESS_ABS /end REF_CHARACTERISTIC
/end GROUP
/begin GROUP d_EBD_Logic_Tuning "" /begin REF_CHARACTERISTIC TP_S16_EBD_KNEE_POINT /end REF_CHARACTERISTIC /end GROUP
/begin GROUP d_Fadeout_turn_RA ""
 /begin REF_CHARACTERISTIC TP_S16TCSCpFadeOutCtrlHghPreTunTh_RA TP_S16TCSCpFadeOutCtrlLowPreTunTh_RA TP_S16TCSCpFadeOutDecTQ4HghPreTurn_RA TP_S16TCSCpFadeOutDecTQ4LowPreTurn_RA /end REF_CHARACTERISTIC
/end GROUP
/begin GROUP d_First_Cycle_LowMed_Ref_Rear ""
 /begin REF_CHARACTERISTIC TP_S16_HDF_REF_MMu_40_60kph_R TP_S16_HDF_REF_MMu_Ab_60kph_R TP_S16_HDF_REF_MMu_B_40kph_R /end REF_CHARACTERISTIC
/end GROUP
/begin GROUP d_Front_slip_Above_5percent ""
 /begin REF_CHARACTERISTIC TP_S8_F_WL_Fact_ASum1G_SlipAb5P TP_S8_F_WL_Fact_ASum3G_SlipAb5P TP_S8_F_WL_Fact_ASumAb3G_SlipAb5P /end REF_CHARACTERISTIC
/end GROUP
/begin GROUP d_GMA_High_Speed_Pars "" /begin REF_CHARACTERISTIC TP_U8_GMA_HOLD_Comp_for_HSPEED /end REF_CHARACTERISTIC /end GROUP
/begin GROUP d_GMA_Pulse_up_Reapply_time "" /begin SUB_GROUP a_High_Speed_Reapply_time b_Med_Speed_Reapply_time /end SUB_GROUP /end GROUP
/begin GROUP d_H2SP_Comp ""
 /begin REF_CHARACTERISTIC TP_S8_Comp_Duty_For_H2SP_Hside_F TP_U8_F_High_side_SL_dump_H_SPEED TP_U8_F_High_side_SL_dump_L_SPEED TP_U8_F_High_side_SL_dump_M_SPEED /end REF_CHARACTERISTIC
/end GROUP
/begin GROUP d_High_Mu_Gain_Rear ""
 /begin REF_CHARACTERISTIC TP_S16_Decel_Gain_HMu_100_150kph_R TP_S16_Decel_Gain_HMu_10_20kph_R TP_S16_Decel_Gain_HMu_20_40kph_R TP_S16_Decel_Gain_HMu_40_60kph_R TP_S16_Decel_Gain_HMu_60_100kph_R TP_S16_Decel_Gain_HMu_Ab_150kph_R TP_S16_Decel_Gain_HMu_B_10kph_R TP_S16_Slip_Gain_HMu_100_150kph_R TP_S16_Slip_Gain_HMu_10_20kph_R TP_S16_Slip_Gain_HMu_20_40kph_R TP_S16_Slip_Gain_HMu_40_60kph_R TP_S16_Slip_Gain_HMu_60_100kph_R TP_S16_Slip_Gain_HMu_Ab_150kph_R TP_S16_Slip_Gain_HMu_B_10kph_R /end REF_CHARACTERISTIC
/end GROUP
/begin GROUP d_ISG ""
 /begin REF_CHARACTERISTIC SSM_S16_AVH_ISG_IDLETOQ_INHIBIT_TIME SSM_S16_ISG_End_RPM_Th SSM_S8_ISG_HSA_ON_AX_TH_GEAR_D SSM_U8_HSA_AutoStart_delay_time SSM_U8_ISG_End_RPM_OK_delay_time SSM_U8_ISG_ON_MAX_SLOP_HOLD_PRESS /end REF_CHARACTERISTIC
/end GROUP
/begin GROUP d_Initial_LowMu_Detect ""
 /begin REF_CHARACTERISTIC TP_S8_LFC_Initial_Dump_Slip_Low TP_S8_LFC_Initial_Peak_Slip_Low TP_S8_LFC_Initial_Slip_Ratio_Low TP_U8_LFC_Initial_Dump_Scan_Low TP_U8_LFC_Initial_Dump_Scan_Med /end REF_CHARACTERISTIC
/end GROUP
/begin GROUP d_L2H_Detect_By_Wheel_Press ""
 /begin REF_CHARACTERISTIC TP_S8_L2H_DCT_WPRESS_MIN_TIME TP_U8_L2H_DCT_WPRESS_DIFF TP_U8_L2H_DCT_WPRESS_THRES1 TP_U8_L2H_DCT_WPRESS_THRES2 /end REF_CHARACTERISTIC
/end GROUP
/begin GROUP d_LFC ""
 /begin SUB_GROUP a_Conventional_Reapply_Time b_Inintial_Duty c_Duty_Pattern d_Initial_LowMu_Detect e_Mu_JumpDown f_L2H_Comp g_InGear_Vib_Detect /end SUB_GROUP
/end GROUP
/begin GROUP d_LFC_ABS_in_ESC "" /begin SUB_GROUP a_DeltaP_Comp_Duty /end SUB_GROUP /end GROUP
/begin GROUP d_LowMed_Mu "" /begin SUB_GROUP a_LowMed_Mu_Front b_LowMed_Mu_Rear /end SUB_GROUP /end GROUP
/begin GROUP d_Low_Med_Mu_UR_Time "" /begin SUB_GROUP a_Front_LM_T b_Rear_LM_T /end SUB_GROUP /end GROUP
/begin GROUP d_Low_Speed_MMu_R "" /begin REF_CHARACTERISTIC TP_U8_B_20KPH_Dumpscantime_MMu_R /end REF_CHARACTERISTIC /end GROUP
/begin GROUP d_MedMu_R_Dumptime "" /begin REF_CHARACTERISTIC TP_U8_1st_Dumpscantime_MMu_R TP_U8_nth_Dumpscantime_MMu_R /end REF_CHARACTERISTIC /begin SUB_GROUP d_Low_Speed_MMu_R /end SUB_GROUP /end GROUP
/begin GROUP d_Medium_Mu_UR_Thres "" /begin SUB_GROUP a_Front_M b_Rear_M /end SUB_GROUP /end GROUP
/begin GROUP d_Pressure_limit ""
 /begin REF_CHARACTERISTIC TP_U8TCSCpTarBrkTqMaxByDrvrTqFac TP_U8TCSCpTarBrkTqMaxBySplitHillFac TP_U8TCSCpTarWhlPreTurnMax[0] TP_U8TCSCpTarWhlPreTurnMax[1] TP_U8TCSCpTarWhlPreTurnMax[2] TP_U8TCSCpTarWhlPreTurnMax[3] TP_U8TCSCpTarWhlPreTurnMax[4] /end REF_CHARACTERISTIC
/end GROUP
/begin GROUP d_Stable_Dump_Rate ""
 /begin SUB_GROUP a_Over_Inside_Front_Ctrl b_Over_Inside_Rear_Ctrl c_Both_Over_Ctrl d_Under_Outside_Front_Ctrl /end SUB_GROUP
/end GROUP
/begin GROUP d_Stable_hold_time_by_YDF ""
 /begin REF_CHARACTERISTIC TP_S16_YDF_STB_HLD_TIME_MAX TP_S16_YDF_STB_HLD_TIME_MAX_F_OINR /end REF_CHARACTERISTIC
/end GROUP
/begin GROUP d_Under_Outside_Front_Ctrl ""
 /begin REF_CHARACTERISTIC TP_U8_STB_DMP_MAX_HIGH_UnderOutF TP_U8_STB_DMP_MAX_LOW_UnderOutF TP_U8_STB_DMP_MAX_MED_UnderOutF TP_U8_STB_DMP_MAX_SP_UnderOutF /end REF_CHARACTERISTIC
/end GROUP
/begin GROUP d_WpeLfcHoldRear ""
 /begin REF_CHARACTERISTIC S16_WPE_LFC_Hold_press_r_10th S16_WPE_LFC_Hold_press_r_11th S16_WPE_LFC_Hold_press_r_12th S16_WPE_LFC_Hold_press_r_13th S16_WPE_LFC_Hold_press_r_14th S16_WPE_LFC_Hold_press_r_15th S16_WPE_LFC_Hold_press_r_16th S16_WPE_LFC_Hold_press_r_1st S16_WPE_LFC_Hold_press_r_2nd S16_WPE_LFC_Hold_press_r_3rd S16_WPE_LFC_Hold_press_r_4th S16_WPE_LFC_Hold_press_r_5th S16_WPE_LFC_Hold_press_r_6th S16_WPE_LFC_Hold_press_r_7th S16_WPE_LFC_Hold_press_r_8th S16_WPE_LFC_Hold_press_r_9th U8_WPE_LFC_Hold_Duty_r_10th U8_WPE_LFC_Hold_Duty_r_11th U8_WPE_LFC_Hold_Duty_r_12th U8_WPE_LFC_Hold_Duty_r_13th U8_WPE_LFC_Hold_Duty_r_14th U8_WPE_LFC_Hold_Duty_r_15th U8_WPE_LFC_Hold_Duty_r_16th U8_WPE_LFC_Hold_Duty_r_1st U8_WPE_LFC_Hold_Duty_r_2nd U8_WPE_LFC_Hold_Duty_r_3rd U8_WPE_LFC_Hold_Duty_r_4th U8_WPE_LFC_Hold_Duty_r_5th U8_WPE_LFC_Hold_Duty_r_6th U8_WPE_LFC_Hold_Duty_r_7th U8_WPE_LFC_Hold_Duty_r_8th U8_WPE_LFC_Hold_Duty_r_9th /end REF_CHARACTERISTIC
/end GROUP
/begin GROUP d_WpeTcHoldPres ""
 /begin REF_CHARACTERISTIC S16_WPE_TC_Valve_Hold_Press_V_1 S16_WPE_TC_Valve_Hold_Press_V_10 S16_WPE_TC_Valve_Hold_Press_V_11 S16_WPE_TC_Valve_Hold_Press_V_12 S16_WPE_TC_Valve_Hold_Press_V_13 S16_WPE_TC_Valve_Hold_Press_V_14 S16_WPE_TC_Valve_Hold_Press_V_15 S16_WPE_TC_Valve_Hold_Press_V_16 S16_WPE_TC_Valve_Hold_Press_V_2 S16_WPE_TC_Valve_Hold_Press_V_3 S16_WPE_TC_Valve_Hold_Press_V_4 S16_WPE_TC_Valve_Hold_Press_V_5 S16_WPE_TC_Valve_Hold_Press_V_6 S16_WPE_TC_Valve_Hold_Press_V_7 S16_WPE_TC_Valve_Hold_Press_V_8 S16_WPE_TC_Valve_Hold_Press_V_9 S16_WPE_WPE_Max_TCMF_Hold_Press /end REF_CHARACTERISTIC
/end GROUP
/begin GROUP d_dP_Control_Logic ""
 /begin SUB_GROUP a_Pulse_down_Logic b_Unstable_Rise_Logic c_Dump_Scantime_Logic /end SUB_GROUP
/end GROUP
/begin GROUP d_modify_Threshold ""
 /begin REF_CHARACTERISTIC TP_S16TCSCpADDTh4ESC TP_S16TCSCpADDTh4RTA TP_S16TCSCpADDTh4RoughRoad /end REF_CHARACTERISTIC
/end GROUP
/begin GROUP e.Tar_Tq_Cal ""
 /begin REF_CHARACTERISTIC TQMass_height TQRadius_Wheel TQS16_BRK_TORQ_D_GAIN TQS16_BRK_TORQ_P_GAIN TQS16_BRK_TORQ_P_GAIN_SLIP_X1_HMU TQS16_BRK_TORQ_P_GAIN_SLIP_X1_LMU TQS16_BRK_TORQ_P_GAIN_SLIP_X1_MMU TQS16_BRK_TORQ_P_GAIN_SLIP_X2_HMU TQS16_BRK_TORQ_P_GAIN_SLIP_X2_LMU TQS16_BRK_TORQ_P_GAIN_SLIP_X2_MMU TQS16_BRK_TORQ_P_GAIN_SLIP_X3_HMU TQS16_BRK_TORQ_P_GAIN_SLIP_X3_LMU TQS16_BRK_TORQ_P_GAIN_SLIP_X3_MMU TQS16_BRK_TORQ_P_HV_HMU TQS16_BRK_TORQ_P_HV_LMU TQS16_BRK_TORQ_P_HV_MMU TQS16_BRK_TORQ_P_LV_HMU TQS16_BRK_TORQ_P_LV_LMU TQS16_BRK_TORQ_P_LV_MMU TQS16_BRK_TORQ_P_MV_HMU TQS16_BRK_TORQ_P_MV_LMU TQS16_BRK_TORQ_P_MV_MMU TQS16_OS_FRT_TAR_PRESS_MIN_HMU TQS16_OS_FRT_TAR_PRESS_MIN_LMU TQS16_OS_FRT_TAR_PRESS_MIN_MMU TQS16_SHAFT_TORQ_WEG TQS16_SLIP_TAR_X1_HMU TQS16_SLIP_TAR_X1_LMU TQS16_SLIP_TAR_X1_MMU TQS16_SLIP_TAR_X2_HMU TQS16_SLIP_TAR_X2_LMU TQS16_SLIP_TAR_X2_MMU TQS16_SLIP_TAR_X3_HMU TQS16_SLIP_TAR_X3_LMU TQS16_SLIP_TAR_X3_MMU TQS16_SPLIT_FRT_TAR_SLIP_MAX TQS16_SPLIT_REAR_TAR_SLIP_MAX TQS16_STEER_FRT_TAR_SLIP_MAX TQS16_STEER_REAR_TAR_SLIP_MAX /end REF_CHARACTERISTIC
 /begin SUB_GROUP ea.OS_Control eb.US_Control ec.DelM_Thres ed.Esc_Abs_Cor ee.MuSlipCurve ef.Bank_road eg.DelYaw_Thres eh.YC_Ay_Vx_Dot /end SUB_GROUP
/end GROUP
/begin GROUP e_100_150KPH ""
 /begin REF_CHARACTERISTIC TP_S8_Arad_1stPoint_100_150KPH TP_S8_Arad_2ndPoint_100_150KPH TP_S8_Arad_3rdPoint_100_150KPH TP_S8_Arad_Fact_1_2P_100_150KPH TP_S8_Arad_Fact_2_3P_100_150KPH TP_S8_Arad_Fact_Ab_3P_100_150KPH TP_S8_Arad_Fact_B_1P_100_150KPH /end REF_CHARACTERISTIC
/end GROUP
/begin GROUP e_ABS_in_Active_braking "" /begin SUB_GROUP a_LFC_AB b_dP_Control_AB /end SUB_GROUP /end GROUP
/begin GROUP e_CBC_Control_Valve ""
 /begin REF_CHARACTERISTIC TP_S16_CBC_DELTA_PRES_MAX_DUMP TP_S16_CBC_DELTA_PRES_MAX_RISE TP_S8_CBC_REAPPLY_TIME_FADEOUT_R TP_S8_CBC_REAPPLY_TIME_R TP_U8_CBC_DUMP_DEAD_PRESS TP_U8_CBC_DUMP_DEAD_PRESS_FRONT TP_U8_CBC_RISE_DEAD_PRESS TP_U8_CBC_RISE_DEAD_PRESS_FRONT /end REF_CHARACTERISTIC
/end GROUP
/begin GROUP e_CBC_abs_Fade_Out ""
 /begin REF_CHARACTERISTIC TP_S16_CBC_FADE_OUT_HOLD_SCAN_ABS TP_S16_CBC_FADE_OUT_TIME_ABS /end REF_CHARACTERISTIC
/end GROUP
/begin GROUP e_Engine_stall ""
 /begin REF_CHARACTERISTIC TP_U8TCSCpBrkTorqDecPcntOfEngStl TP_U8TCSCpBrkTorqDecRateOfEngStl TP_U8TCSCpBrkTorqRecPcntOfEngStl TP_U8TCSCpTBrkTorqDec4SymInStall /end REF_CHARACTERISTIC
/end GROUP
/begin GROUP e_Front_YDF_at_GMA_pulse_up ""
 /begin REF_CHARACTERISTIC TP_S16_FRNT_GMA_STB_DMP_THR_YDF_B_L TP_S16_FRNT_GMA_STB_DMP_THR_YDF_H TP_S16_FRNT_GMA_STB_DMP_THR_YDF_L TP_S16_FRNT_GMA_STB_DMP_THR_YDF_M /end REF_CHARACTERISTIC
/end GROUP
/begin GROUP e_GMA_Clear ""
 /begin REF_CHARACTERISTIC TP_S8_Clear_GMA_Max_Accel1 TP_S8_Clear_GMA_Max_Accel2 TP_U8_DUMP_CNT_FOR_CLEAR_GMA_L1 /end REF_CHARACTERISTIC
/end GROUP
/begin GROUP e_GMA_Logic ""
 /begin SUB_GROUP a_GMA_detection b_GMA_Permit_Speed c_GMA_PulseUp_HoldTim_Max d_GMA_High_Speed_Pars /end SUB_GROUP
/end GROUP
/begin GROUP e_LowMedMu_F_Dumptime ""
 /begin REF_CHARACTERISTIC TP_U8_1st_Dumpscantime_LMMu_F TP_U8_2nd3rd_Dumpscantime_LMMu_F TP_U8_nth_Dumpscantime_LMMu_F /end REF_CHARACTERISTIC
 /begin SUB_GROUP a_Low_Speed_LMMu_F /end SUB_GROUP
/end GROUP
/begin GROUP e_Low_Med_Mu_UR_Thres "" /begin SUB_GROUP a_Front_LM b_Rear_LM /end SUB_GROUP /end GROUP
/begin GROUP e_Low_Mu "" /begin SUB_GROUP a_Low_Mu_Front b_Low_Mu_Rear /end SUB_GROUP /end GROUP
/begin GROUP e_Medium_Mu_Gain_Front ""
 /begin REF_CHARACTERISTIC TP_S16_Decel_Gain_MMu_100_150kph_F TP_S16_Decel_Gain_MMu_10_20kph_F TP_S16_Decel_Gain_MMu_20_40kph_F TP_S16_Decel_Gain_MMu_40_60kph_F TP_S16_Decel_Gain_MMu_60_100kph_F TP_S16_Decel_Gain_MMu_Ab_150kph_F TP_S16_Decel_Gain_MMu_B_10kph_F TP_S16_Slip_Gain_MMu_100_150kph_F TP_S16_Slip_Gain_MMu_10_20kph_F TP_S16_Slip_Gain_MMu_20_40kph_F TP_S16_Slip_Gain_MMu_40_60kph_F TP_S16_Slip_Gain_MMu_60_100kph_F TP_S16_Slip_Gain_MMu_Ab_150kph_F TP_S16_Slip_Gain_MMu_B_10kph_F /end REF_CHARACTERISTIC
/end GROUP
/begin GROUP e_Mu_Change "" /begin REF_CHARACTERISTIC TP_U8_Chess_Dump_Rise_Ref TP_U8_Low_Mu_Dump_Rise_Factor /end REF_CHARACTERISTIC /begin SUB_GROUP a_H2SP_Detect_1 b_H2SP_Detect_2 c_L2SP_Detect d_H2SP_Comp /end SUB_GROUP /end GROUP
/begin GROUP e_Mu_JumpDown ""
 /begin REF_CHARACTERISTIC TP_S8_LFC_Dump_Slip_Jump_Mu TP_S8_LFC_Peak_Slip_Jump_Mu TP_S8_LFC_Slip_Ratio_Jump_Mu TP_U8_LFC_2ND_CYC_COMP_LOW TP_U8_LFC_Dump_Scan_Jump_Mu TP_U8_LFC_Dump_Scan_Rough_Road TP_U8_LFC_Jump_Down_Comp_F TP_U8_LFC_Jump_Down_Comp_R /end REF_CHARACTERISTIC
/end GROUP
/begin GROUP e_Under_Low_Med_Mu_UR_Time "" /begin SUB_GROUP a_Front_UL_T b_Rear_UL_T /end SUB_GROUP /end GROUP
/begin GROUP e_WpeLfcRiseFront ""
 /begin REF_CHARACTERISTIC S16_WPE_LFC_Rise_Gain_f_10th S16_WPE_LFC_Rise_Gain_f_11th S16_WPE_LFC_Rise_Gain_f_1st S16_WPE_LFC_Rise_Gain_f_2nd S16_WPE_LFC_Rise_Gain_f_3rd S16_WPE_LFC_Rise_Gain_f_4th S16_WPE_LFC_Rise_Gain_f_5th S16_WPE_LFC_Rise_Gain_f_6th S16_WPE_LFC_Rise_Gain_f_7th S16_WPE_LFC_Rise_Gain_f_8th S16_WPE_LFC_Rise_Gain_f_9th U8_WPE_LFC_Rise_Duty_f_10th U8_WPE_LFC_Rise_Duty_f_11th U8_WPE_LFC_Rise_Duty_f_1st U8_WPE_LFC_Rise_Duty_f_2nd U8_WPE_LFC_Rise_Duty_f_3rd U8_WPE_LFC_Rise_Duty_f_4th U8_WPE_LFC_Rise_Duty_f_5th U8_WPE_LFC_Rise_Duty_f_6th U8_WPE_LFC_Rise_Duty_f_7th U8_WPE_LFC_Rise_Duty_f_8th U8_WPE_LFC_Rise_Duty_f_9th /end REF_CHARACTERISTIC
/end GROUP
/begin GROUP e_WpeTcRelsCompFront ""
 /begin REF_CHARACTERISTIC S16_WPE_TC_Rels_Comp_Gain_f_1 S16_WPE_TC_Rels_Comp_Gain_f_2 S16_WPE_TC_Rels_Comp_Gain_f_3 S16_WPE_TC_Rels_Comp_Gain_f_4 S16_WPE_TC_Rels_Comp_Gain_f_5 S16_WPE_TC_Rels_Comp_Gain_f_6 S16_WPE_TC_Rels_Comp_Press_f_1 S16_WPE_TC_Rels_Comp_Press_f_2 S16_WPE_TC_Rels_Comp_Press_f_3 S16_WPE_TC_Rels_Comp_Press_f_4 S16_WPE_TC_Rels_Comp_Press_f_5 S16_WPE_TC_Rels_Comp_Press_f_6 /end REF_CHARACTERISTIC
/end GROUP
/begin GROUP e_dP_Control "" /begin SUB_GROUP a_Pulse_down b_Unstable_Rise c_Dump_Scantime /end SUB_GROUP /end GROUP
/begin GROUP ea.OS_Control ""
 /begin REF_CHARACTERISTIC TQS16_YC_AR_LIMIT_HIG_SPD_H_MU TQS16_YC_AR_LIMIT_HIG_SPD_L_MU TQS16_YC_AR_LIMIT_HIG_SPD_M_MU TQS16_YC_AR_LIMIT_LOW_SPD_H_MU TQS16_YC_AR_LIMIT_LOW_SPD_L_MU TQS16_YC_AR_LIMIT_LOW_SPD_M_MU TQS16_YC_AR_LIMIT_MED_SPD_H_MU TQS16_YC_AR_LIMIT_MED_SPD_L_MU TQS16_YC_AR_LIMIT_MED_SPD_M_MU TQS16_YC_AR_M_DEL_YAW_TH_H TQS16_YC_AR_M_DEL_YAW_TH_L TQS16_YC_AR_M_DEL_YAW_TH_M TQS16_YC_AR_M_DEP_DYAW_WEG_H TQS16_YC_AR_M_DEP_DYAW_WEG_L TQS16_YC_AR_M_DEP_DYAW_WEG_M TQS16_YC_AR_P_GAIN_HIG_MU TQS16_YC_AR_P_GAIN_LOW_MU TQS16_YC_AR_P_GAIN_MED_MU TQS16_YC_AR_THRES_HIG_SPD_H_MU TQS16_YC_AR_THRES_HIG_SPD_L_MU TQS16_YC_AR_THRES_HIG_SPD_M_MU TQS16_YC_AR_THRES_LOW_SPD_H_MU TQS16_YC_AR_THRES_LOW_SPD_L_MU TQS16_YC_AR_THRES_LOW_SPD_M_MU TQS16_YC_AR_THRES_MED_SPD_H_MU TQS16_YC_AR_THRES_MED_SPD_L_MU TQS16_YC_AR_THRES_MED_SPD_M_MU TQS16_YC_SPEED_DEP_HIG_VH_GAIN TQS16_YC_SPEED_DEP_LOW_VH_GAIN TQS16_YC_SPEED_DEP_MED_VH_GAIN TQS16_YC_SPEED_DEP_VER_HIG_VH_GAIN TQS16_YC_SPEED_DEP_VLOW_VH_GAIN TQYAW_CONTORL_P_GAIN_BETA_H TQYAW_CONTORL_P_GAIN_BETA_L TQYAW_CONTORL_P_GAIN_BETA_M /end REF_CHARACTERISTIC
 /begin SUB_GROUP OS_Gain /end SUB_GROUP
/end GROUP
/begin GROUP eb.US_Control ""
 /begin REF_CHARACTERISTIC TQS16_UNDER_ENT_DEL_YAW_HMU_HSP TQS16_UNDER_ENT_DEL_YAW_HMU_LSP TQS16_UNDER_ENT_DEL_YAW_HMU_MSP TQS16_UNDER_ENT_DEL_YAW_LMU_HSP TQS16_UNDER_ENT_DEL_YAW_LMU_LSP TQS16_UNDER_ENT_DEL_YAW_LMU_MSP TQS16_UNDER_ENT_DEL_YAW_MMU_HSP TQS16_UNDER_ENT_DEL_YAW_MMU_LSP TQS16_UNDER_ENT_DEL_YAW_MMU_MSP TQS16_UNDER_EXT_DEL_YAW_HMU_HSP TQS16_UNDER_EXT_DEL_YAW_HMU_LSP TQS16_UNDER_EXT_DEL_YAW_HMU_MSP TQS16_UNDER_EXT_DEL_YAW_LMU_HSP TQS16_UNDER_EXT_DEL_YAW_LMU_LSP TQS16_UNDER_EXT_DEL_YAW_LMU_MSP TQS16_UNDER_EXT_DEL_YAW_MMU_HSP TQS16_UNDER_EXT_DEL_YAW_MMU_LSP TQS16_UNDER_EXT_DEL_YAW_MMU_MSP /end REF_CHARACTERISTIC
 /begin SUB_GROUP US_Gain /end SUB_GROUP
/end GROUP
/begin GROUP ec.DelM_Thres ""
 /begin REF_CHARACTERISTIC TQU8_DEL_M_THR_ENTER_FRONT_HM_HS TQU8_DEL_M_THR_ENTER_FRONT_HM_LS TQU8_DEL_M_THR_ENTER_FRONT_HM_MS TQU8_DEL_M_THR_ENTER_FRONT_LM_HS TQU8_DEL_M_THR_ENTER_FRONT_LM_LS TQU8_DEL_M_THR_ENTER_FRONT_LM_MS TQU8_DEL_M_THR_ENTER_FRONT_MM_HS TQU8_DEL_M_THR_ENTER_FRONT_MM_LS TQU8_DEL_M_THR_ENTER_FRONT_MM_MS TQU8_DEL_M_THR_ENTER_REAR_HM_HS TQU8_DEL_M_THR_ENTER_REAR_HM_LS TQU8_DEL_M_THR_ENTER_REAR_HM_MS TQU8_DEL_M_THR_ENTER_REAR_LM_HS TQU8_DEL_M_THR_ENTER_REAR_LM_LS TQU8_DEL_M_THR_ENTER_REAR_LM_MS TQU8_DEL_M_THR_ENTER_REAR_MM_HS TQU8_DEL_M_THR_ENTER_REAR_MM_LS TQU8_DEL_M_THR_ENTER_REAR_MM_MS TQU8_DEL_M_THR_EXIT_FRONT_HM_HS TQU8_DEL_M_THR_EXIT_FRONT_HM_LS TQU8_DEL_M_THR_EXIT_FRONT_HM_MS TQU8_DEL_M_THR_EXIT_FRONT_LM_HS TQU8_DEL_M_THR_EXIT_FRONT_LM_LS TQU8_DEL_M_THR_EXIT_FRONT_LM_MS TQU8_DEL_M_THR_EXIT_FRONT_MM_HS TQU8_DEL_M_THR_EXIT_FRONT_MM_LS TQU8_DEL_M_THR_EXIT_FRONT_MM_MS TQU8_DEL_M_THR_EXIT_REAR_HM_HS TQU8_DEL_M_THR_EXIT_REAR_HM_LS TQU8_DEL_M_THR_EXIT_REAR_HM_MS TQU8_DEL_M_THR_EXIT_REAR_LM_HS TQU8_DEL_M_THR_EXIT_REAR_LM_LS TQU8_DEL_M_THR_EXIT_REAR_LM_MS TQU8_DEL_M_THR_EXIT_REAR_MM_HS TQU8_DEL_M_THR_EXIT_REAR_MM_LS TQU8_DEL_M_THR_EXIT_REAR_MM_MS /end REF_CHARACTERISTIC
/end GROUP
/end MODULE
/end PROJECT
