ASAP2_VERSION 1 60
/begin PROJECT Master ""
/begin MODULE CPP ""
/begin MOD_COMMON "" BYTE_ORDER MSB_LAST ALIGNMENT_BYTE 1 ALIGNMENT_WORD 1 ALIGNMENT_LONG 1 ALIGNMENT_FLOAT32_IEEE 1 ALIGNMENT_FLOAT64_IEEE 1 ALIGNMENT_INT64 1 /end MOD_COMMON
/begin CHARACTERISTIC S16_ACC_BRAKE_FADE_OUT_RATE "ACC Brake torque fade out rate" VALUE 0x80021028 CalPrmVehLgtCoorrBrk_SWORD 0 Tq2 -32768 32767 SYMBOL_LINK "CalPrmVehLgtCoorrBrk01.S16_ACC_BRAKE_FADE_OUT_RATE" 0 /end CHARACTERISTIC
/begin CHARACTERISTIC S16_ACC_EPB_DEMAND_MAX_CNT "Maximum standstill control time. If  standstill control time excess this time, EPB automatically activate" VALUE 0x8002102E CalPrmVehLgtCoorrBrk_SWORD 0 Ti11 -32768 32767 SYMBOL_LINK "CalPrmVehLgtCoorrBrk01.S16_ACC_EPB_DEMAND_MAX_CNT" 0 /end CHARACTERISTIC
/begin CHARACTERISTIC S16_ACC_PRESS_MAX "ACC maximum target pressure" VALUE 0x8002102A CalPrmVehLgtCoorrBrk_SWORD 0 P34 -3276.8 3276.7 SYMBOL_LINK "CalPrmVehLgtCoorrBrk01.S16_ACC_PRESS_MAX" 0 /end CHARACTERISTIC
/begin CHARACTERISTIC S16_ACC_TARGETG_LIMIT_MAX "Target acceleration/deceleration maximum limit of ACC" VALUE 0x8002101C CalPrmVehLgtCoorrBrk_SWORD 0 A41 -32.768 32.767 SYMBOL_LINK "CalPrmVehLgtCoorrBrk01.S16_ACC_TARGETG_LIMIT_MAX" 0 /end CHARACTERISTIC
/begin CHARACTERISTIC S16_ACC_TARGETG_LIMIT_MIN "Target acceleration/deceleration minimum limit of ACC" VALUE 0x8002101E CalPrmVehLgtCoorrBrk_SWORD 0 A41 -32.768 32.767 SYMBOL_LINK "CalPrmVehLgtCoorrBrk01.S16_ACC_TARGETG_LIMIT_MIN" 0 /end CHARACTERISTIC
/begin CHARACTERISTIC S16_ACC_TARGETG_MAX_STOP "ACC maximum target deceleration at standstill (StopReq)" VALUE 0x80021020 CalPrmVehLgtCoorrBrk_SWORD 0 A41 -32.768 32.767 SYMBOL_LINK "CalPrmVehLgtCoorrBrk01.S16_ACC_TARGETG_MAX_STOP" 0 /end CHARACTERISTIC
/begin CHARACTERISTIC S16_ACC_TARGETG_MIN_HILLUP_STOP "ACC minimum target deceleration at standstill (StopReq) in down hill road" VALUE 0x80021022 CalPrmVehLgtCoorrBrk_SWORD 0 A41 -32.768 32.767 SYMBOL_LINK "CalPrmVehLgtCoorrBrk01.S16_ACC_TARGETG_MIN_HILLUP_STOP" 0 /end CHARACTERISTIC
/begin CHARACTERISTIC S16_ACC_TARGETG_MIN_HILL_STOP "ACC minimum target deceleration at standstill (StopReq) in up hill road" VALUE 0x80021024 CalPrmVehLgtCoorrBrk_SWORD 0 A41 -32.768 32.767 SYMBOL_LINK "CalPrmVehLgtCoorrBrk01.S16_ACC_TARGETG_MIN_HILL_STOP" 0 /end CHARACTERISTIC
/begin CHARACTERISTIC S16_ACC_TARGETG_MIN_STOP "ACC minimum target deceleration at standstill (StopReq) in flat road" VALUE 0x80021026 CalPrmVehLgtCoorrBrk_SWORD 0 A41 -32.768 32.767 SYMBOL_LINK "CalPrmVehLgtCoorrBrk01.S16_ACC_TARGETG_MIN_STOP" 0 /end CHARACTERISTIC
/begin CHARACTERISTIC S16_AEB_BRAKE_FADE_OUT_RATE "AEB Brake torque fade out rate" VALUE 0x80021052 CalPrmVehLgtCoorrBrk_SWORD 0 Tq2 -32768 32767 SYMBOL_LINK "CalPrmVehLgtCoorrBrk01.S16_AEB_BRAKE_FADE_OUT_RATE" 0 /end CHARACTERISTIC
/begin CHARACTERISTIC S16_AEB_ME_PED_DGAIN_HIGH "AEB feedback torque D gain at Full-brake request (high level deceleration)" VALUE 0x8003A922 CalPrmVehLgtCoorrEng_SWORD 0 Fac31 -32768 32767 SYMBOL_LINK "CalPrmVehLgtCoorrEng01.S16_AEB_ME_PED_DGAIN_HIGH" 0 /end CHARACTERISTIC
/begin CHARACTERISTIC S16_AEB_ME_PED_DGAIN_LOW "AEB feedback torque D gain at pre-brake request (low level deceleration)" VALUE 0x8003A91C CalPrmVehLgtCoorrEng_SWORD 0 Fac31 -32768 32767 SYMBOL_LINK "CalPrmVehLgtCoorrEng01.S16_AEB_ME_PED_DGAIN_LOW" 0 /end CHARACTERISTIC
/begin CHARACTERISTIC S16_AEB_ME_PED_IGAIN_HIGH "AEB feedback torque I gain at Full-brake request (high level deceleration)" VALUE 0x8003A920 CalPrmVehLgtCoorrEng_SWORD 0 Fac31 -32768 32767 SYMBOL_LINK "CalPrmVehLgtCoorrEng01.S16_AEB_ME_PED_IGAIN_HIGH" 0 /end CHARACTERISTIC
/begin CHARACTERISTIC S16_AEB_ME_PED_IGAIN_LOW "AEB feedback torque I gain at pre-brake request (low level deceleration)" VALUE 0x8003A91A CalPrmVehLgtCoorrEng_SWORD 0 Fac31 -32768 32767 SYMBOL_LINK "CalPrmVehLgtCoorrEng01.S16_AEB_ME_PED_IGAIN_LOW" 0 /end CHARACTERISTIC
/begin CHARACTERISTIC S16_AEB_ME_PED_PGAIN_HIGH "AEB feedback torque P gain at Full-brake request (high level deceleration)" VALUE 0x8003A91E CalPrmVehLgtCoorrEng_SWORD 0 Fac31 -32768 32767 SYMBOL_LINK "CalPrmVehLgtCoorrEng01.S16_AEB_ME_PED_PGAIN_HIGH" 0 /end CHARACTERISTIC
/begin CHARACTERISTIC S16_AEB_ME_PED_PGAIN_LOW "AEB feedback torque P gain at pre-brake request (low level deceleration)" VALUE 0x8003A918 CalPrmVehLgtCoorrEng_SWORD 0 Fac31 -32768 32767 SYMBOL_LINK "CalPrmVehLgtCoorrEng01.S16_AEB_ME_PED_PGAIN_LOW" 0 /end CHARACTERISTIC
/begin CHARACTERISTIC S16_AEB_PE_PED_DGAIN_HIGH "AEB feedback torque D gain at Full-brake request (high level deceleration)" VALUE 0x8003A916 CalPrmVehLgtCoorrEng_SWORD 0 Fac31 -32768 32767 SYMBOL_LINK "CalPrmVehLgtCoorrEng01.S16_AEB_PE_PED_DGAIN_HIGH" 0 /end CHARACTERISTIC
/begin CHARACTERISTIC S16_AEB_PE_PED_DGAIN_LOW "AEB feedback torque D gain at pre-brake request (low level deceleration)" VALUE 0x8003A910 CalPrmVehLgtCoorrEng_SWORD 0 Fac31 -32768 32767 SYMBOL_LINK "CalPrmVehLgtCoorrEng01.S16_AEB_PE_PED_DGAIN_LOW" 0 /end CHARACTERISTIC
/begin CHARACTERISTIC S16_AEB_PE_PED_IGAIN_HIGH "AEB feedback torque I gain at Full-brake request (high level deceleration)" VALUE 0x8003A914 CalPrmVehLgtCoorrEng_SWORD 0 Fac31 -32768 32767 SYMBOL_LINK "CalPrmVehLgtCoorrEng01.S16_AEB_PE_PED_IGAIN_HIGH" 0 /end CHARACTERISTIC
/begin CHARACTERISTIC S16_AEB_PE_PED_IGAIN_LOW "AEB feedback torque I gain at pre-brake request (low level deceleration)" VALUE 0x8003A90E CalPrmVehLgtCoorrEng_SWORD 0 Fac31 -32768 32767 SYMBOL_LINK "CalPrmVehLgtCoorrEng01.S16_AEB_PE_PED_IGAIN_LOW" 0 /end CHARACTERISTIC
/begin CHARACTERISTIC S16_AEB_PE_PED_PGAIN_HIGH "AEB feedback torque P gain at Full-brake request (high level deceleration)" VALUE 0x8003A912 CalPrmVehLgtCoorrEng_SWORD 0 Fac31 -32768 32767 SYMBOL_LINK "CalPrmVehLgtCoorrEng01.S16_AEB_PE_PED_PGAIN_HIGH" 0 /end CHARACTERISTIC
/begin CHARACTERISTIC S16_AEB_PE_PED_PGAIN_LOW "AEB feedback torque P gain at pre-brake request (low level deceleration)" VALUE 0x8003A90C CalPrmVehLgtCoorrEng_SWORD 0 Fac31 -32768 32767 SYMBOL_LINK "CalPrmVehLgtCoorrEng01.S16_AEB_PE_PED_PGAIN_LOW" 0 /end CHARACTERISTIC
/begin CHARACTERISTIC S16_AEB_PRESS_MAX "AEB maximum target pressure" VALUE 0x80021050 CalPrmVehLgtCoorrBrk_SWORD 0 P34 -3276.8 3276.7 SYMBOL_LINK "CalPrmVehLgtCoorrBrk01.S16_AEB_PRESS_MAX" 0 /end CHARACTERISTIC
/begin CHARACTERISTIC S16_AEB_TARGETG_MAX_STOP "Target acceleration/deceleration minimum limit of AEB" VALUE 0x8002104C CalPrmVehLgtCoorrBrk_SWORD 0 A41 -32.768 32.767 SYMBOL_LINK "CalPrmVehLgtCoorrBrk01.S16_AEB_TARGETG_MAX_STOP" 0 /end CHARACTERISTIC
/begin CHARACTERISTIC S16_AEB_TARGETG_MIN_STOP "Target acceleration/deceleration maximum limit of AEB" VALUE 0x8002104A CalPrmVehLgtCoorrBrk_SWORD 0 A41 -32.768 32.767 SYMBOL_LINK "CalPrmVehLgtCoorrBrk01.S16_AEB_TARGETG_MIN_STOP" 0 /end CHARACTERISTIC
/begin CHARACTERISTIC S16_DPB_ME_MED_DGAIN "DPB feedback torque D gain" VALUE 0x8003A94E CalPrmVehLgtCoorrEng_SWORD 0 Fac31 -32768 32767 SYMBOL_LINK "CalPrmVehLgtCoorrEng01.S16_DPB_ME_MED_DGAIN" 0 /end CHARACTERISTIC
/begin CHARACTERISTIC S16_DPB_ME_MED_IGAIN "DPB feedback torque I gain" VALUE 0x8003A94C CalPrmVehLgtCoorrEng_SWORD 0 Fac31 -32768 32767 SYMBOL_LINK "CalPrmVehLgtCoorrEng01.S16_DPB_ME_MED_IGAIN" 0 /end CHARACTERISTIC
/begin CHARACTERISTIC S16_DPB_ME_MED_PGAIN "DPB feedback torque P gain" VALUE 0x8003A94A CalPrmVehLgtCoorrEng_SWORD 0 Fac31 -32768 32767 SYMBOL_LINK "CalPrmVehLgtCoorrEng01.S16_DPB_ME_MED_PGAIN" 0 /end CHARACTERISTIC
/begin CHARACTERISTIC S16_DPB_ME_PED_DGAIN "DPB feedback torque D gain" VALUE 0x8003A948 CalPrmVehLgtCoorrEng_SWORD 0 Fac31 -32768 32767 SYMBOL_LINK "CalPrmVehLgtCoorrEng01.S16_DPB_ME_PED_DGAIN" 0 /end CHARACTERISTIC
/begin CHARACTERISTIC S16_DPB_ME_PED_IGAIN "DPB feedback torque I gain" VALUE 0x8003A946 CalPrmVehLgtCoorrEng_SWORD 0 Fac31 -32768 32767 SYMBOL_LINK "CalPrmVehLgtCoorrEng01.S16_DPB_ME_PED_IGAIN" 0 /end CHARACTERISTIC
/begin CHARACTERISTIC S16_DPB_ME_PED_PGAIN "DPB feedback torque P gain" VALUE 0x8003A944 CalPrmVehLgtCoorrEng_SWORD 0 Fac31 -32768 32767 SYMBOL_LINK "CalPrmVehLgtCoorrEng01.S16_DPB_ME_PED_PGAIN" 0 /end CHARACTERISTIC
/begin CHARACTERISTIC S16_DPB_PE_MED_DGAIN "DPB feedback torque D gain" VALUE 0x8003A942 CalPrmVehLgtCoorrEng_SWORD 0 Fac31 -32768 32767 SYMBOL_LINK "CalPrmVehLgtCoorrEng01.S16_DPB_PE_MED_DGAIN" 0 /end CHARACTERISTIC
/begin CHARACTERISTIC S16_DPB_PE_MED_IGAIN "DPB feedback torque I gain" VALUE 0x8003A940 CalPrmVehLgtCoorrEng_SWORD 0 Fac31 -32768 32767 SYMBOL_LINK "CalPrmVehLgtCoorrEng01.S16_DPB_PE_MED_IGAIN" 0 /end CHARACTERISTIC
/begin CHARACTERISTIC S16_DPB_PE_MED_PGAIN "DPB feedback torque P gain" VALUE 0x8003A93E CalPrmVehLgtCoorrEng_SWORD 0 Fac31 -32768 32767 SYMBOL_LINK "CalPrmVehLgtCoorrEng01.S16_DPB_PE_MED_PGAIN" 0 /end CHARACTERISTIC
/begin CHARACTERISTIC S16_DPB_PE_PED_DGAIN "DPB feedback torque D gain" VALUE 0x8003A93C CalPrmVehLgtCoorrEng_SWORD 0 Fac31 -32768 32767 SYMBOL_LINK "CalPrmVehLgtCoorrEng01.S16_DPB_PE_PED_DGAIN" 0 /end CHARACTERISTIC
/begin CHARACTERISTIC S16_DPB_PE_PED_IGAIN "DPB feedback torque I gain" VALUE 0x8003A93A CalPrmVehLgtCoorrEng_SWORD 0 Fac31 -32768 32767 SYMBOL_LINK "CalPrmVehLgtCoorrEng01.S16_DPB_PE_PED_IGAIN" 0 /end CHARACTERISTIC
/begin CHARACTERISTIC S16_DPB_PE_PED_PGAIN "DPB feedback torque P gain" VALUE 0x8003A938 CalPrmVehLgtCoorrEng_SWORD 0 Fac31 -32768 32767 SYMBOL_LINK "CalPrmVehLgtCoorrEng01.S16_DPB_PE_PED_PGAIN" 0 /end CHARACTERISTIC
/begin CHARACTERISTIC S16_WPE_Motor_Eff_Gain_1st "Temp" VALUE 0x80021542 CalPrmBrkTqCtrlrBrk_SWORD 0 Perc6 -32768 32767 SYMBOL_LINK "CalPrmBrkTqCtrlrBrk01.S16_WPE_Motor_Eff_Gain_1st" 0 /end CHARACTERISTIC
/begin CHARACTERISTIC S16_WPE_Motor_Eff_Gain_2nd "Temp" VALUE 0x80021544 CalPrmBrkTqCtrlrBrk_SWORD 0 Perc6 -32768 32767 SYMBOL_LINK "CalPrmBrkTqCtrlrBrk01.S16_WPE_Motor_Eff_Gain_2nd" 0 /end CHARACTERISTIC
/begin CHARACTERISTIC S16_WPE_Motor_Eff_Gain_3rd "Temp" VALUE 0x80021546 CalPrmBrkTqCtrlrBrk_SWORD 0 Perc6 -32768 32767 SYMBOL_LINK "CalPrmBrkTqCtrlrBrk01.S16_WPE_Motor_Eff_Gain_3rd" 0 /end CHARACTERISTIC
/begin CHARACTERISTIC S16_WPE_Motor_Eff_Gain_4th "Temp" VALUE 0x80021548 CalPrmBrkTqCtrlrBrk_SWORD 0 Perc6 -32768 32767 SYMBOL_LINK "CalPrmBrkTqCtrlrBrk01.S16_WPE_Motor_Eff_Gain_4th" 0 /end CHARACTERISTIC
/begin CHARACTERISTIC S16_WPE_Motor_Eff_Gain_5th "Temp" VALUE 0x8002154A CalPrmBrkTqCtrlrBrk_SWORD 0 Perc6 -32768 32767 SYMBOL_LINK "CalPrmBrkTqCtrlrBrk01.S16_WPE_Motor_Eff_Gain_5th" 0 /end CHARACTERISTIC
/begin CHARACTERISTIC S16_WPE_Motor_Eff_Gain_6th "Temp" VALUE 0x8002154C CalPrmBrkTqCtrlrBrk_SWORD 0 Perc6 -32768 32767 SYMBOL_LINK "CalPrmBrkTqCtrlrBrk01.S16_WPE_Motor_Eff_Gain_6th" 0 /end CHARACTERISTIC
/begin CHARACTERISTIC S16_WPE_Motor_Eff_MPress_1st "Temp" VALUE 0x80021536 CalPrmBrkTqCtrlrBrk_SWORD 0 P34 -3276.8 3276.7 SYMBOL_LINK "CalPrmBrkTqCtrlrBrk01.S16_WPE_Motor_Eff_MPress_1st" 0 /end CHARACTERISTIC
/begin CHARACTERISTIC S16_WPE_Motor_Eff_MPress_2nd "Temp" VALUE 0x80021538 CalPrmBrkTqCtrlrBrk_SWORD 0 P34 -3276.8 3276.7 SYMBOL_LINK "CalPrmBrkTqCtrlrBrk01.S16_WPE_Motor_Eff_MPress_2nd" 0 /end CHARACTERISTIC
/begin CHARACTERISTIC S16_WPE_Motor_Eff_MPress_3rd "Temp" VALUE 0x8002153A CalPrmBrkTqCtrlrBrk_SWORD 0 P34 -3276.8 3276.7 SYMBOL_LINK "CalPrmBrkTqCtrlrBrk01.S16_WPE_Motor_Eff_MPress_3rd" 0 /end CHARACTERISTIC
/begin CHARACTERISTIC S16_WPE_Motor_Eff_MPress_4th "Temp" VALUE 0x8002153C CalPrmBrkTqCtrlrBrk_SWORD 0 P34 -3276.8 3276.7 SYMBOL_LINK "CalPrmBrkTqCtrlrBrk01.S16_WPE_Motor_Eff_MPress_4th" 0 /end CHARACTERISTIC
/begin CHARACTERISTIC S16_WPE_Motor_Eff_MPress_5th "Temp" VALUE 0x8002153E CalPrmBrkTqCtrlrBrk_SWORD 0 P34 -3276.8 3276.7 SYMBOL_LINK "CalPrmBrkTqCtrlrBrk01.S16_WPE_Motor_Eff_MPress_5th" 0 /end CHARACTERISTIC
/begin CHARACTERISTIC S16_WPE_Motor_Eff_MPress_6th "Temp" VALUE 0x80021540 CalPrmBrkTqCtrlrBrk_SWORD 0 P34 -3276.8 3276.7 SYMBOL_LINK "CalPrmBrkTqCtrlrBrk01.S16_WPE_Motor_Eff_MPress_6th" 0 /end CHARACTERISTIC
/begin CHARACTERISTIC S16_WPE_WPE_MotorEff_MPRESS_ON_BAR "Temp" VALUE 0x80021534 CalPrmBrkTqCtrlrBrk_SWORD 0 P32 -327.68 327.67 SYMBOL_LINK "CalPrmBrkTqCtrlrBrk01.S16_WPE_WPE_MotorEff_MPRESS_ON_BAR" 0 /end CHARACTERISTIC
/begin CHARACTERISTIC S8_ACC_CONT_B_D_GAIN "ACC feedback torque D gain for brake control (gear ratio > D1)" VALUE 0x8003A8E9 CalPrmVehLgtCoorrEng_SBYTE 0 Fac31 -128 127 SYMBOL_LINK "CalPrmVehLgtCoorrEng01.S8_ACC_CONT_B_D_GAIN" 0 /end CHARACTERISTIC
/begin CHARACTERISTIC S8_ACC_CONT_B_G1_D_GAIN "ACC feedback torque D gain for brake control (gear ratio = D1) - for smooth stop pattern at low speed" VALUE 0x8003A8E5 CalPrmVehLgtCoorrEng_SBYTE 0 Fac31 -128 127 SYMBOL_LINK "CalPrmVehLgtCoorrEng01.S8_ACC_CONT_B_G1_D_GAIN" 0 /end CHARACTERISTIC
/begin CHARACTERISTIC S8_ACC_CONT_B_G1_I_GAIN "ACC feedback torque I gain for brake control (gear ratio = D1) - for smooth stop pattern at low speed" VALUE 0x8003A8E6 CalPrmVehLgtCoorrEng_SBYTE 0 Fac31 -128 127 SYMBOL_LINK "CalPrmVehLgtCoorrEng01.S8_ACC_CONT_B_G1_I_GAIN" 0 /end CHARACTERISTIC
/begin CHARACTERISTIC S8_ACC_CONT_B_G1_P_GAIN "ACC feedback torque plus P gain for brake control (gear ratio = D1) (targetG > veh.accel) - for smooth stop pattern at low speed" VALUE 0x8003A8E7 CalPrmVehLgtCoorrEng_SBYTE 0 Fac31 -128 127 SYMBOL_LINK "CalPrmVehLgtCoorrEng01.S8_ACC_CONT_B_G1_P_GAIN" 0 /end CHARACTERISTIC
/begin CHARACTERISTIC S8_ACC_CONT_B_G1_P_GAIN_MINUS_G_ERR "ACC feedback torque minus P gain for brake control (gear ratio = D1) (targetG < veh.accel) - for smooth stop pattern at low speed" VALUE 0x8003A8E8 CalPrmVehLgtCoorrEng_SBYTE 0 Fac31 -128 127 SYMBOL_LINK "CalPrmVehLgtCoorrEng01.S8_ACC_CONT_B_G1_P_GAIN_MINUS_G_ERR" 0 /end CHARACTERISTIC
/begin CHARACTERISTIC S8_ACC_CONT_B_HILLDOWN_STOP_D_GAIN "ACC feedback torque D gain for brake stop control at down hill" VALUE 0x8003A8F3 CalPrmVehLgtCoorrEng_SBYTE 0 Tq2 -128 127 SYMBOL_LINK "CalPrmVehLgtCoorrEng01.S8_ACC_CONT_B_HILLDOWN_STOP_D_GAIN" 0 /end CHARACTERISTIC
/begin CHARACTERISTIC S8_ACC_CONT_B_HILLDOWN_STOP_I_GAIN "ACC feedback torque I gain for brake stop control at down hill" VALUE 0x8003A8F4 CalPrmVehLgtCoorrEng_SBYTE 0 Tq2 -128 127 SYMBOL_LINK "CalPrmVehLgtCoorrEng01.S8_ACC_CONT_B_HILLDOWN_STOP_I_GAIN" 0 /end CHARACTERISTIC
/begin CHARACTERISTIC S8_ACC_CONT_B_HILLDOWN_STOP_P_GAIN "ACC feedback torque P gain for brake stop control at down hill" VALUE 0x8003A8F5 CalPrmVehLgtCoorrEng_SBYTE 0 Tq2 -128 127 SYMBOL_LINK "CalPrmVehLgtCoorrEng01.S8_ACC_CONT_B_HILLDOWN_STOP_P_GAIN" 0 /end CHARACTERISTIC
/begin CHARACTERISTIC S8_ACC_CONT_B_HILLUP_STOP_D_GAIN "ACC feedback torque D gain for brake stop control at up hill" VALUE 0x8003A8F0 CalPrmVehLgtCoorrEng_SBYTE 0 Fac31 -128 127 SYMBOL_LINK "CalPrmVehLgtCoorrEng01.S8_ACC_CONT_B_HILLUP_STOP_D_GAIN" 0 /end CHARACTERISTIC
/begin CHARACTERISTIC S8_ACC_CONT_B_HILLUP_STOP_I_GAIN "ACC feedback torque I gain for brake stop control at up hill" VALUE 0x8003A8F1 CalPrmVehLgtCoorrEng_SBYTE 0 Fac31 -128 127 SYMBOL_LINK "CalPrmVehLgtCoorrEng01.S8_ACC_CONT_B_HILLUP_STOP_I_GAIN" 0 /end CHARACTERISTIC
/begin CHARACTERISTIC S8_ACC_CONT_B_HILLUP_STOP_P_GAIN "ACC feedback torque P gain for brake stop control at up hill" VALUE 0x8003A8F2 CalPrmVehLgtCoorrEng_SBYTE 0 Fac31 -128 127 SYMBOL_LINK "CalPrmVehLgtCoorrEng01.S8_ACC_CONT_B_HILLUP_STOP_P_GAIN" 0 /end CHARACTERISTIC
/begin CHARACTERISTIC S8_ACC_CONT_B_I_GAIN "ACC feedback torque I gain for brake control (gear ratio > D1)" VALUE 0x8003A8EA CalPrmVehLgtCoorrEng_SBYTE 0 Fac31 -128 127 SYMBOL_LINK "CalPrmVehLgtCoorrEng01.S8_ACC_CONT_B_I_GAIN" 0 /end CHARACTERISTIC
/begin CHARACTERISTIC S8_ACC_CONT_B_P_GAIN "ACC feedback torque plus P gain for brake control (gear ratio > D1) (targetG > veh.accel)" VALUE 0x8003A8EB CalPrmVehLgtCoorrEng_SBYTE 0 Fac31 -128 127 SYMBOL_LINK "CalPrmVehLgtCoorrEng01.S8_ACC_CONT_B_P_GAIN" 0 /end CHARACTERISTIC
/begin CHARACTERISTIC S8_ACC_CONT_B_P_GAIN_MINUS_G_ERR "ACC feedback torque minus P gain for brake control (gear ratio > D1) (targetG < veh.accel)" VALUE 0x8003A8EC CalPrmVehLgtCoorrEng_SBYTE 0 Fac31 -128 127 SYMBOL_LINK "CalPrmVehLgtCoorrEng01.S8_ACC_CONT_B_P_GAIN_MINUS_G_ERR" 0 /end CHARACTERISTIC
/begin CHARACTERISTIC S8_ACC_CONT_B_STOP_D_GAIN "ACC feedback torque D gain for brake stop control" VALUE 0x8003A8ED CalPrmVehLgtCoorrEng_SBYTE 0 Fac31 -128 127 SYMBOL_LINK "CalPrmVehLgtCoorrEng01.S8_ACC_CONT_B_STOP_D_GAIN" 0 /end CHARACTERISTIC
/begin CHARACTERISTIC S8_ACC_CONT_B_STOP_I_GAIN "ACC feedback torque I gain for brake stop control" VALUE 0x8003A8EE CalPrmVehLgtCoorrEng_SBYTE 0 Fac31 -128 127 SYMBOL_LINK "CalPrmVehLgtCoorrEng01.S8_ACC_CONT_B_STOP_I_GAIN" 0 /end CHARACTERISTIC
/begin CHARACTERISTIC S8_ACC_CONT_B_STOP_P_GAIN "ACC feedback torque plus P gain for brake stop control" VALUE 0x8003A8EF CalPrmVehLgtCoorrEng_SBYTE 0 Fac31 -128 127 SYMBOL_LINK "CalPrmVehLgtCoorrEng01.S8_ACC_CONT_B_STOP_P_GAIN" 0 /end CHARACTERISTIC
/begin CHARACTERISTIC S8_ACC_CONT_E_D_GAIN "ACC feedback torque D gain for engine control (gear ratio > D3)" VALUE 0x8003A8DD CalPrmVehLgtCoorrEng_SBYTE 0 Fac31 -128 127 SYMBOL_LINK "CalPrmVehLgtCoorrEng01.S8_ACC_CONT_E_D_GAIN" 0 /end CHARACTERISTIC
/begin CHARACTERISTIC S8_ACC_CONT_E_G1_D_GAIN "ACC feedback torque D gain for engine control (gear ratio = D1)" VALUE 0x8003A8D5 CalPrmVehLgtCoorrEng_SBYTE 0 Fac31 -128 127 SYMBOL_LINK "CalPrmVehLgtCoorrEng01.S8_ACC_CONT_E_G1_D_GAIN" 0 /end CHARACTERISTIC
/begin CHARACTERISTIC S8_ACC_CONT_E_G1_I_GAIN "ACC feedback torque I gain for engine control (gear ratio = D1)" VALUE 0x8003A8D6 CalPrmVehLgtCoorrEng_SBYTE 0 Fac31 -128 127 SYMBOL_LINK "CalPrmVehLgtCoorrEng01.S8_ACC_CONT_E_G1_I_GAIN" 0 /end CHARACTERISTIC
/begin CHARACTERISTIC S8_ACC_CONT_E_G1_P_GAIN "ACC feedback torque plus P gain for engine control (gear ratio = D1) (targetG > veh.accel)" VALUE 0x8003A8D7 CalPrmVehLgtCoorrEng_SBYTE 0 Fac31 -128 127 SYMBOL_LINK "CalPrmVehLgtCoorrEng01.S8_ACC_CONT_E_G1_P_GAIN" 0 /end CHARACTERISTIC
/begin CHARACTERISTIC S8_ACC_CONT_E_G1_P_GAIN_MINUS_G_ERR "ACC feedback torque minus P gain for engine control (gear ratio = D1) (targetG < veh.accel)" VALUE 0x8003A8D8 CalPrmVehLgtCoorrEng_SBYTE 0 Fac31 -128 127 SYMBOL_LINK "CalPrmVehLgtCoorrEng01.S8_ACC_CONT_E_G1_P_GAIN_MINUS_G_ERR" 0 /end CHARACTERISTIC
/begin CHARACTERISTIC S8_ACC_CONT_E_G23_D_GAIN "ACC feedback torque D gain for engine control (gear ratio = D2,D3)" VALUE 0x8003A8D9 CalPrmVehLgtCoorrEng_SBYTE 0 Fac31 -128 127 SYMBOL_LINK "CalPrmVehLgtCoorrEng01.S8_ACC_CONT_E_G23_D_GAIN" 0 /end CHARACTERISTIC
/begin CHARACTERISTIC S8_ACC_CONT_E_G23_I_GAIN "ACC feedback torque I gain for engine control (gear ratio = D2,D3)" VALUE 0x8003A8DA CalPrmVehLgtCoorrEng_SBYTE 0 Fac31 -128 127 SYMBOL_LINK "CalPrmVehLgtCoorrEng01.S8_ACC_CONT_E_G23_I_GAIN" 0 /end CHARACTERISTIC
/begin CHARACTERISTIC S8_ACC_CONT_E_G23_P_GAIN "ACC feedback torque plus P gain for engine control (gear ratio = D2,D3) (targetG > veh.accel)" VALUE 0x8003A8DB CalPrmVehLgtCoorrEng_SBYTE 0 Fac31 -128 127 SYMBOL_LINK "CalPrmVehLgtCoorrEng01.S8_ACC_CONT_E_G23_P_GAIN" 0 /end CHARACTERISTIC
/begin CHARACTERISTIC S8_ACC_CONT_E_G23_P_GAIN_MINUS_G_ERR "ACC feedback torque minus P gain for engine control (gear ratio = D2,D3) (targetG < veh.accel)" VALUE 0x8003A8DC CalPrmVehLgtCoorrEng_SBYTE 0 Fac31 -128 127 SYMBOL_LINK "CalPrmVehLgtCoorrEng01.S8_ACC_CONT_E_G23_P_GAIN_MINUS_G_ERR" 0 /end CHARACTERISTIC
/begin CHARACTERISTIC S8_ACC_CONT_E_I_GAIN "ACC feedback torque I gain for engine control (gear ratio > D3)" VALUE 0x8003A8DE CalPrmVehLgtCoorrEng_SBYTE 0 Fac31 -128 127 SYMBOL_LINK "CalPrmVehLgtCoorrEng01.S8_ACC_CONT_E_I_GAIN" 0 /end CHARACTERISTIC
/begin CHARACTERISTIC S8_ACC_CONT_E_P_GAIN "ACC feedback torque plus P gain for engine control (gear ratio > D3) (targetG > veh.accel)" VALUE 0x8003A8DF CalPrmVehLgtCoorrEng_SBYTE 0 Fac31 -128 127 SYMBOL_LINK "CalPrmVehLgtCoorrEng01.S8_ACC_CONT_E_P_GAIN" 0 /end CHARACTERISTIC
/begin CHARACTERISTIC S8_ACC_CONT_E_P_GAIN_MINUS_G_ERR "ACC feedback torque minus P gain for engine control (gear ratio > D3) (targetG < veh.accel)" VALUE 0x8003A8E0 CalPrmVehLgtCoorrEng_SBYTE 0 Fac31 -128 127 SYMBOL_LINK "CalPrmVehLgtCoorrEng01.S8_ACC_CONT_E_P_GAIN_MINUS_G_ERR" 0 /end CHARACTERISTIC
/begin CHARACTERISTIC SSM_K_Current_Sensor_Offset "" VALUE 0x8003A7C9 CalPrmSsmBrk_UBYTE 0 OnOff1 0 255 SYMBOL_LINK "CalPrmSsmEng01.SSM_K_Current_Sensor_Offset" 0 /end CHARACTERISTIC
/begin CHARACTERISTIC SSM_K_Current_Sensor_Offset_EEPROM "" VALUE 0x8003A7CA CalPrmSsmBrk_UBYTE 0 OnOff1 0 255 SYMBOL_LINK "CalPrmSsmEng01.SSM_K_Current_Sensor_Offset_EEPROM" 0 /end CHARACTERISTIC
/begin CHARACTERISTIC SSM_K_EPB_Auto_Apply_HillStop_Feature_En "" VALUE 0x8003A83B CalPrmSsmBrk_UBYTE 0 OnOff1 0 255 SYMBOL_LINK "CalPrmSsmEng01.SSM_K_EPB_Auto_Apply_HillStop_Feature_En" 0 /end CHARACTERISTIC
/begin CHARACTERISTIC SSM_K_EPB_Auto_Apply_SW_Fail_Feature_En "" VALUE 0x8003A83A CalPrmSsmBrk_UBYTE 0 OnOff1 0 255 SYMBOL_LINK "CalPrmSsmEng01.SSM_K_EPB_Auto_Apply_SW_Fail_Feature_En" 0 /end CHARACTERISTIC
/begin CHARACTERISTIC SSM_K_EPB_Automatic_Apply_DoorBelt_Feature_En "" VALUE 0x8003A832 CalPrmSsmBrk_UBYTE 0 OnOff1 0 255 SYMBOL_LINK "CalPrmSsmEng01.SSM_K_EPB_Automatic_Apply_DoorBelt_Feature_En" 0 /end CHARACTERISTIC
/begin CHARACTERISTIC SSM_K_EPB_Automatic_Switch_Feature_En "" VALUE 0x8003A842 CalPrmSsmBrk_UBYTE 0 OnOff1 0 255 SYMBOL_LINK "CalPrmSsmEng01.SSM_K_EPB_Automatic_Switch_Feature_En" 0 /end CHARACTERISTIC
/begin CHARACTERISTIC SSM_K_EPB_HillStop_Detecting_Time_Th "" VALUE 0x8003A83C CalPrmSsmBrk_UWORD 0 Ti21 0 655.35 SYMBOL_LINK "CalPrmSsmEng01.SSM_K_EPB_HillStop_Detecting_Time_Th" 0 /end CHARACTERISTIC
/begin CHARACTERISTIC SSM_K_EPB_HillStop_Gear_Act "" VALUE 0x8003A83E CalPrmSsmBrk_UBYTE 0 OnOff1 0 255 SYMBOL_LINK "CalPrmSsmEng01.SSM_K_EPB_HillStop_Gear_Act" 0 /end CHARACTERISTIC
/begin CHARACTERISTIC SSM_K_EPB_HillStop_Gradient_Th "" VALUE 0x8003A840 CalPrmSsmBrk_SWORD 0 A48 -3.2768 3.2767 SYMBOL_LINK "CalPrmSsmEng01.SSM_K_EPB_HillStop_Gradient_Th" 0 /end CHARACTERISTIC
/begin CHARACTERISTIC SSM_K_EPB_Master_Pressure_Signal_Th "" VALUE 0x8003A7EA CalPrmSsmBrk_SWORD 0 P34 -3276.8 3276.7 SYMBOL_LINK "CalPrmSsmEng01.SSM_K_EPB_Master_Pressure_Signal_Th" 0 /end CHARACTERISTIC
/begin CHARACTERISTIC SSM_K_EPB_Output_Selection_Mode "" VALUE 0x8003A7C8 CalPrmSsmBrk_UBYTE 0 OnOff1 0 255 SYMBOL_LINK "CalPrmSsmEng01.SSM_K_EPB_Output_Selection_Mode" 0 /end CHARACTERISTIC
/begin CHARACTERISTIC TP_S16TCSCpAddMtrV4SPHillHghMuStab "" VALUE 0x8003A17A CalPrmWspcEng_SWORD 0 U13 -3276.8 3276.7 SYMBOL_LINK "CalPrmWspcEng01.TP_S16TCSCpAddMtrV4SPHillHghMuStab" 0 /end CHARACTERISTIC
/begin CHARACTERISTIC TP_S16TCSCpAddMtrV4SPHillHghMuUnSt "" VALUE 0x8003A17C CalPrmWspcEng_SWORD 0 U13 -3276.8 3276.7 SYMBOL_LINK "CalPrmWspcEng01.TP_S16TCSCpAddMtrV4SPHillHghMuUnSt" 0 /end CHARACTERISTIC
/begin CHARACTERISTIC TP_S16TCSCpFBMtrV_ASC "" VALUE 0x8003A1F2 CalPrmWspcEng_SWORD 0 U13 -3276.8 3276.7 SYMBOL_LINK "CalPrmWspcEng01.TP_S16TCSCpFBMtrV_ASC" 0 /end CHARACTERISTIC
/begin CHARACTERISTIC TP_S16TCSCpFBMtrV_Turn "" VALUE 0x8003A1F4 CalPrmWspcEng_SWORD 0 U13 -3276.8 3276.7 SYMBOL_LINK "CalPrmWspcEng01.TP_S16TCSCpFBMtrV_Turn" 0 /end CHARACTERISTIC
/begin CHARACTERISTIC TP_S16TCSCpFFMtrV_ASC "" VALUE 0x8003A1F6 CalPrmWspcEng_SWORD 0 U13 -3276.8 3276.7 SYMBOL_LINK "CalPrmWspcEng01.TP_S16TCSCpFFMtrV_ASC" 0 /end CHARACTERISTIC
/begin CHARACTERISTIC TP_S16TCSCpFFMtrV_Turn "" VALUE 0x8003A1F8 CalPrmWspcEng_SWORD 0 U13 -3276.8 3276.7 SYMBOL_LINK "CalPrmWspcEng01.TP_S16TCSCpFFMtrV_Turn" 0 /end CHARACTERISTIC
/begin CHARACTERISTIC TP_S16TCSCpIniRMdeMtrV_ASC "" VALUE 0x8003A1FA CalPrmWspcEng_SWORD 0 U13 -3276.8 3276.7 SYMBOL_LINK "CalPrmWspcEng01.TP_S16TCSCpIniRMdeMtrV_ASC" 0 /end CHARACTERISTIC
/begin CHARACTERISTIC TP_S16TCSCpIniRMdeMtrV_SC "" VALUE 0x8003A1FC CalPrmWspcEng_SWORD 0 U13 -3276.8 3276.7 SYMBOL_LINK "CalPrmWspcEng01.TP_S16TCSCpIniRMdeMtrV_SC" 0 /end CHARACTERISTIC
/begin CHARACTERISTIC TP_S16TCSCpIniRMdeMtrV_Turn "" VALUE 0x8003A1FE CalPrmWspcEng_SWORD 0 U13 -3276.8 3276.7 SYMBOL_LINK "CalPrmWspcEng01.TP_S16TCSCpIniRMdeMtrV_Turn" 0 /end CHARACTERISTIC
/begin CHARACTERISTIC TP_S16TCSCpNormMtrV_SC "" VALUE 0x8003A206 CalPrmWspcEng_SWORD 0 U13 -3276.8 3276.7 SYMBOL_LINK "CalPrmWspcEng01.TP_S16TCSCpNormMtrV_SC" 0 /end CHARACTERISTIC
/begin CHARACTERISTIC TP_S16_AT_In_Gear_Lower_Limit "" VALUE 0x8003A156 CalPrmWslcEng_SWORD 0 Gain -32768 32767 SYMBOL_LINK "CalPrmWslcEng01.TP_S16_AT_In_Gear_Lower_Limit" 0 /end CHARACTERISTIC
/begin CHARACTERISTIC TP_S16_AT_In_Gear_Upper_Limit "" VALUE 0x8003A158 CalPrmWslcEng_SWORD 0 Gain -32768 32767 SYMBOL_LINK "CalPrmWslcEng01.TP_S16_AT_In_Gear_Upper_Limit" 0 /end CHARACTERISTIC
/begin CHARACTERISTIC TP_S16_EDC_DEL_ENG_RPM_FOR_PARK "" VALUE 0x8003A14E CalPrmWslcEng_SWORD 0 Gain -32768 32767 SYMBOL_LINK "CalPrmWslcEng01.TP_S16_EDC_DEL_ENG_RPM_FOR_PARK" 0 /end CHARACTERISTIC
/begin CHARACTERISTIC TP_S16_EDC_PARK_ENTRY_RPM_DIFF "" VALUE 0x8003A150 CalPrmWslcEng_SWORD 0 Gain -32768 32767 SYMBOL_LINK "CalPrmWslcEng01.TP_S16_EDC_PARK_ENTRY_RPM_DIFF" 0 /end CHARACTERISTIC
/begin CHARACTERISTIC TP_S16_EDC_PARK_ENTRY_TC_RPM "" VALUE 0x8003A152 CalPrmWslcEng_SWORD 0 Gain -32768 32767 SYMBOL_LINK "CalPrmWslcEng01.TP_S16_EDC_PARK_ENTRY_TC_RPM" 0 /end CHARACTERISTIC
/begin CHARACTERISTIC TP_S16_MT_In_Gear_Out_Vel_Threshold "" VALUE 0x8003A15A CalPrmWslcEng_SWORD 0 Gain -32768 32767 SYMBOL_LINK "CalPrmWslcEng01.TP_S16_MT_In_Gear_Out_Vel_Threshold" 0 /end CHARACTERISTIC
/begin CHARACTERISTIC TP_S16_MT_In_Gear_Vel_Threshold_1to3 "" VALUE 0x8003A15C CalPrmWslcEng_SWORD 0 Gain -32768 32767 SYMBOL_LINK "CalPrmWslcEng01.TP_S16_MT_In_Gear_Vel_Threshold_1to3" 0 /end CHARACTERISTIC
/begin CHARACTERISTIC TP_S16_MT_In_Gear_Vel_Threshold_4to6 "" VALUE 0x8003A15E CalPrmWslcEng_SWORD 0 Gain -32768 32767 SYMBOL_LINK "CalPrmWslcEng01.TP_S16_MT_In_Gear_Vel_Threshold_4to6" 0 /end CHARACTERISTIC
/begin CHARACTERISTIC TP_S16_TOD_MAX_TORQ "Max. Torque value to be used for TOD" VALUE 0x8003A6A8 CalPrmAwdCtrlrEng_SWORD 0 Gain -32768 32767 SYMBOL_LINK "CalPrmAwdCtrlrEng01.TP_S16_TOD_MAX_TORQ" 0 /end CHARACTERISTIC
/begin CHARACTERISTIC TP_S16_TOD_MIN_TORQ "Min. Torque value to be used for TOD" VALUE 0x8003A6AA CalPrmAwdCtrlrEng_SWORD 0 Gain -32768 32767 SYMBOL_LINK "CalPrmAwdCtrlrEng01.TP_S16_TOD_MIN_TORQ" 0 /end CHARACTERISTIC
/begin CHARACTERISTIC TP_S8_EDC_ENTRY_THR0_ABS_S1 "" VALUE 0x8003A097 CalPrmWslcEng_SBYTE 0 Spd12 -16 15.875 SYMBOL_LINK "CalPrmWslcEng01.TP_S8_EDC_ENTRY_THR0_ABS_S1" 0 /end CHARACTERISTIC
/begin CHARACTERISTIC TP_S8_EDC_ENTRY_THR0_ABS_S2 "" VALUE 0x8003A098 CalPrmWslcEng_SBYTE 0 Spd12 -16 15.875 SYMBOL_LINK "CalPrmWslcEng01.TP_S8_EDC_ENTRY_THR0_ABS_S2" 0 /end CHARACTERISTIC
/begin CHARACTERISTIC TP_S8_EDC_ENTRY_THR0_ABS_S3 "" VALUE 0x8003A099 CalPrmWslcEng_SBYTE 0 Spd12 -16 15.875 SYMBOL_LINK "CalPrmWslcEng01.TP_S8_EDC_ENTRY_THR0_ABS_S3" 0 /end CHARACTERISTIC
/begin CHARACTERISTIC TP_S8_EDC_ENTRY_THR0_ABS_S4 "" VALUE 0x8003A09A CalPrmWslcEng_SBYTE 0 Spd12 -16 15.875 SYMBOL_LINK "CalPrmWslcEng01.TP_S8_EDC_ENTRY_THR0_ABS_S4" 0 /end CHARACTERISTIC
/begin CHARACTERISTIC TP_S8_EDC_ENTRY_THR0_S1 "" VALUE 0x8003A08A CalPrmWslcEng_SBYTE 0 Spd12 -16 15.875 SYMBOL_LINK "CalPrmWslcEng01.TP_S8_EDC_ENTRY_THR0_S1" 0 /end CHARACTERISTIC
/begin CHARACTERISTIC TP_S8_EDC_ENTRY_THR0_S2 "" VALUE 0x8003A08B CalPrmWslcEng_SBYTE 0 Spd12 -16 15.875 SYMBOL_LINK "CalPrmWslcEng01.TP_S8_EDC_ENTRY_THR0_S2" 0 /end CHARACTERISTIC
/begin CHARACTERISTIC TP_S8_EDC_ENTRY_THR0_S3 "" VALUE 0x8003A08C CalPrmWslcEng_SBYTE 0 Spd12 -16 15.875 SYMBOL_LINK "CalPrmWslcEng01.TP_S8_EDC_ENTRY_THR0_S3" 0 /end CHARACTERISTIC
/begin CHARACTERISTIC TP_S8_EDC_ENTRY_THR0_S4 "" VALUE 0x8003A08D CalPrmWslcEng_SBYTE 0 Spd12 -16 15.875 SYMBOL_LINK "CalPrmWslcEng01.TP_S8_EDC_ENTRY_THR0_S4" 0 /end CHARACTERISTIC
/begin CHARACTERISTIC TP_S8_EDC_ENTRY_THR1_ABS_S1 "" VALUE 0x8003A09B CalPrmWslcEng_SBYTE 0 Spd12 -16 15.875 SYMBOL_LINK "CalPrmWslcEng01.TP_S8_EDC_ENTRY_THR1_ABS_S1" 0 /end CHARACTERISTIC
/begin CHARACTERISTIC TP_S8_EDC_ENTRY_THR1_ABS_S2 "" VALUE 0x8003A09C CalPrmWslcEng_SBYTE 0 Spd12 -16 15.875 SYMBOL_LINK "CalPrmWslcEng01.TP_S8_EDC_ENTRY_THR1_ABS_S2" 0 /end CHARACTERISTIC
/begin CHARACTERISTIC TP_S8_EDC_ENTRY_THR1_ABS_S3 "" VALUE 0x8003A09D CalPrmWslcEng_SBYTE 0 Spd12 -16 15.875 SYMBOL_LINK "CalPrmWslcEng01.TP_S8_EDC_ENTRY_THR1_ABS_S3" 0 /end CHARACTERISTIC
/begin CHARACTERISTIC TP_S8_EDC_ENTRY_THR1_ABS_S4 "" VALUE 0x8003A09E CalPrmWslcEng_SBYTE 0 Spd12 -16 15.875 SYMBOL_LINK "CalPrmWslcEng01.TP_S8_EDC_ENTRY_THR1_ABS_S4" 0 /end CHARACTERISTIC
/begin CHARACTERISTIC TP_S8_EDC_ENTRY_THR1_S1 "" VALUE 0x8003A08E CalPrmWslcEng_SBYTE 0 Spd12 -16 15.875 SYMBOL_LINK "CalPrmWslcEng01.TP_S8_EDC_ENTRY_THR1_S1" 0 /end CHARACTERISTIC
/begin CHARACTERISTIC TP_S8_EDC_ENTRY_THR1_S2 "" VALUE 0x8003A08F CalPrmWslcEng_SBYTE 0 Spd12 -16 15.875 SYMBOL_LINK "CalPrmWslcEng01.TP_S8_EDC_ENTRY_THR1_S2" 0 /end CHARACTERISTIC
/begin CHARACTERISTIC TP_S8_EDC_ENTRY_THR1_S3 "" VALUE 0x8003A090 CalPrmWslcEng_SBYTE 0 Spd12 -16 15.875 SYMBOL_LINK "CalPrmWslcEng01.TP_S8_EDC_ENTRY_THR1_S3" 0 /end CHARACTERISTIC
/begin CHARACTERISTIC TP_S8_EDC_ENTRY_THR1_S4 "" VALUE 0x8003A091 CalPrmWslcEng_SBYTE 0 Spd12 -16 15.875 SYMBOL_LINK "CalPrmWslcEng01.TP_S8_EDC_ENTRY_THR1_S4" 0 /end CHARACTERISTIC
/begin CHARACTERISTIC TP_S8_EDC_ENTRY_THR2_ABS_S1 "" VALUE 0x8003A09F CalPrmWslcEng_SBYTE 0 Spd12 -16 15.875 SYMBOL_LINK "CalPrmWslcEng01.TP_S8_EDC_ENTRY_THR2_ABS_S1" 0 /end CHARACTERISTIC
/begin CHARACTERISTIC TP_S8_EDC_ENTRY_THR2_ABS_S2 "" VALUE 0x8003A0A0 CalPrmWslcEng_SBYTE 0 Spd12 -16 15.875 SYMBOL_LINK "CalPrmWslcEng01.TP_S8_EDC_ENTRY_THR2_ABS_S2" 0 /end CHARACTERISTIC
/begin CHARACTERISTIC TP_S8_EDC_ENTRY_THR2_ABS_S3 "" VALUE 0x8003A0A1 CalPrmWslcEng_SBYTE 0 Spd12 -16 15.875 SYMBOL_LINK "CalPrmWslcEng01.TP_S8_EDC_ENTRY_THR2_ABS_S3" 0 /end CHARACTERISTIC
/begin CHARACTERISTIC TP_S8_EDC_ENTRY_THR2_ABS_S4 "" VALUE 0x8003A0A2 CalPrmWslcEng_SBYTE 0 Spd12 -16 15.875 SYMBOL_LINK "CalPrmWslcEng01.TP_S8_EDC_ENTRY_THR2_ABS_S4" 0 /end CHARACTERISTIC
/begin CHARACTERISTIC TP_S8_EDC_ENTRY_THR2_S1 "" VALUE 0x8003A092 CalPrmWslcEng_SBYTE 0 Spd12 -16 15.875 SYMBOL_LINK "CalPrmWslcEng01.TP_S8_EDC_ENTRY_THR2_S1" 0 /end CHARACTERISTIC
/begin CHARACTERISTIC TP_S8_EDC_ENTRY_THR2_S2 "" VALUE 0x8003A093 CalPrmWslcEng_SBYTE 0 Spd12 -16 15.875 SYMBOL_LINK "CalPrmWslcEng01.TP_S8_EDC_ENTRY_THR2_S2" 0 /end CHARACTERISTIC
/begin CHARACTERISTIC TP_S8_EDC_ENTRY_THR2_S3 "" VALUE 0x8003A094 CalPrmWslcEng_SBYTE 0 Spd12 -16 15.875 SYMBOL_LINK "CalPrmWslcEng01.TP_S8_EDC_ENTRY_THR2_S3" 0 /end CHARACTERISTIC
/begin CHARACTERISTIC TP_S8_EDC_ENTRY_THR2_S4 "" VALUE 0x8003A095 CalPrmWslcEng_SBYTE 0 Spd12 -16 15.875 SYMBOL_LINK "CalPrmWslcEng01.TP_S8_EDC_ENTRY_THR2_S4" 0 /end CHARACTERISTIC
/begin CHARACTERISTIC TP_S8_EDC_PARKING_SUSPECT_LIMIT "" VALUE 0x8003A154 CalPrmWslcEng_SBYTE 0 Spd12 -16 15.875 SYMBOL_LINK "CalPrmWslcEng01.TP_S8_EDC_PARKING_SUSPECT_LIMIT" 0 /end CHARACTERISTIC
/begin CHARACTERISTIC TP_S8_EDC_TARGET_DELTA_V_ABS_S1 "" VALUE 0x8003A0BB CalPrmWslcEng_SBYTE 0 Spd12 -16 15.875 SYMBOL_LINK "CalPrmWslcEng01.TP_S8_EDC_TARGET_DELTA_V_ABS_S1" 0 /end CHARACTERISTIC
/begin CHARACTERISTIC TP_S8_EDC_TARGET_DELTA_V_ABS_S2 "" VALUE 0x8003A0BC CalPrmWslcEng_SBYTE 0 Spd12 -16 15.875 SYMBOL_LINK "CalPrmWslcEng01.TP_S8_EDC_TARGET_DELTA_V_ABS_S2" 0 /end CHARACTERISTIC
/begin CHARACTERISTIC TP_S8_EDC_TARGET_DELTA_V_ABS_S3 "" VALUE 0x8003A0BD CalPrmWslcEng_SBYTE 0 Spd12 -16 15.875 SYMBOL_LINK "CalPrmWslcEng01.TP_S8_EDC_TARGET_DELTA_V_ABS_S3" 0 /end CHARACTERISTIC
/begin CHARACTERISTIC TP_S8_EDC_TARGET_DELTA_V_ABS_S4 "" VALUE 0x8003A0BE CalPrmWslcEng_SBYTE 0 Spd12 -16 15.875 SYMBOL_LINK "CalPrmWslcEng01.TP_S8_EDC_TARGET_DELTA_V_ABS_S4" 0 /end CHARACTERISTIC
/begin CHARACTERISTIC TP_S8_EDC_TARGET_DELTA_V_S1 "" VALUE 0x8003A0B7 CalPrmWslcEng_SBYTE 0 Spd12 -16 15.875 SYMBOL_LINK "CalPrmWslcEng01.TP_S8_EDC_TARGET_DELTA_V_S1" 0 /end CHARACTERISTIC
/begin CHARACTERISTIC TP_S8_EDC_TARGET_DELTA_V_S2 "" VALUE 0x8003A0B8 CalPrmWslcEng_SBYTE 0 Spd12 -16 15.875 SYMBOL_LINK "CalPrmWslcEng01.TP_S8_EDC_TARGET_DELTA_V_S2" 0 /end CHARACTERISTIC
/begin CHARACTERISTIC TP_S8_EDC_TARGET_DELTA_V_S3 "" VALUE 0x8003A0B9 CalPrmWslcEng_SBYTE 0 Spd12 -16 15.875 SYMBOL_LINK "CalPrmWslcEng01.TP_S8_EDC_TARGET_DELTA_V_S3" 0 /end CHARACTERISTIC
/begin CHARACTERISTIC TP_S8_EDC_TARGET_DELTA_V_S4 "" VALUE 0x8003A0BA CalPrmWslcEng_SBYTE 0 Spd12 -16 15.875 SYMBOL_LINK "CalPrmWslcEng01.TP_S8_EDC_TARGET_DELTA_V_S4" 0 /end CHARACTERISTIC
/begin CHARACTERISTIC TP_S8_MT_In_Gear_Accel_Threshold "" VALUE 0x8003A160 CalPrmWslcEng_SBYTE 0 Gain -128 127 SYMBOL_LINK "CalPrmWslcEng01.TP_S8_MT_In_Gear_Accel_Threshold" 0 /end CHARACTERISTIC
/begin CHARACTERISTIC TP_S8_MT_In_Gear_Out_Accel_Threshold "" VALUE 0x8003A161 CalPrmWslcEng_SBYTE 0 Gain -128 127 SYMBOL_LINK "CalPrmWslcEng01.TP_S8_MT_In_Gear_Out_Accel_Threshold" 0 /end CHARACTERISTIC
/begin CHARACTERISTIC TP_U16_EDC_SPEED1 "" VALUE 0x8003A082 CalPrmWslcEng_UWORD 0 Spd12 0 8191.875 SYMBOL_LINK "CalPrmWslcEng01.TP_U16_EDC_SPEED1" 0 /end CHARACTERISTIC
/begin CHARACTERISTIC TP_U16_EDC_SPEED2 "" VALUE 0x8003A084 CalPrmWslcEng_UWORD 0 Spd12 0 8191.875 SYMBOL_LINK "CalPrmWslcEng01.TP_U16_EDC_SPEED2" 0 /end CHARACTERISTIC
/begin CHARACTERISTIC TP_U16_EDC_SPEED3 "" VALUE 0x8003A086 CalPrmWslcEng_UWORD 0 Spd12 0 8191.875 SYMBOL_LINK "CalPrmWslcEng01.TP_U16_EDC_SPEED3" 0 /end CHARACTERISTIC
/begin CHARACTERISTIC TP_U16_EDC_SPEED4 "" VALUE 0x8003A088 CalPrmWslcEng_UWORD 0 Spd12 0 8191.875 SYMBOL_LINK "CalPrmWslcEng01.TP_U16_EDC_SPEED4" 0 /end CHARACTERISTIC
/begin CHARACTERISTIC TP_U8TCSCpBrkTqGrdtLimIncFacSpinDiffDec "" VALUE 0x8003A27D CalPrmWspcEng_UBYTE 0 Perc6 0 255 SYMBOL_LINK "CalPrmWspcEng01.TP_U8TCSCpBrkTqGrdtLimIncFacSpinDiffDec" 0 /end CHARACTERISTIC
/begin CHARACTERISTIC TP_U8_EDC_ENT_THR_DEL_YAW "" VALUE 0x8003A096 CalPrmWslcEng_UBYTE 0 AgSpd31 0 2.55 SYMBOL_LINK "CalPrmWslcEng01.TP_U8_EDC_ENT_THR_DEL_YAW" 0 /end CHARACTERISTIC
/begin CHARACTERISTIC TP_U8_EDC_PHASE1_D_GAIN_ABS_S1 "" VALUE 0x8003A0E4 CalPrmWslcEng_UBYTE 0 Gain 0 255 SYMBOL_LINK "CalPrmWslcEng01.TP_U8_EDC_PHASE1_D_GAIN_ABS_S1" 0 /end CHARACTERISTIC
/begin CHARACTERISTIC TP_U8_EDC_PHASE1_D_GAIN_ABS_S2 "" VALUE 0x8003A0E5 CalPrmWslcEng_UBYTE 0 Gain 0 255 SYMBOL_LINK "CalPrmWslcEng01.TP_U8_EDC_PHASE1_D_GAIN_ABS_S2" 0 /end CHARACTERISTIC
/begin CHARACTERISTIC TP_U8_EDC_PHASE1_D_GAIN_ABS_S3 "" VALUE 0x8003A0E6 CalPrmWslcEng_UBYTE 0 Gain 0 255 SYMBOL_LINK "CalPrmWslcEng01.TP_U8_EDC_PHASE1_D_GAIN_ABS_S3" 0 /end CHARACTERISTIC
/begin CHARACTERISTIC TP_U8_EDC_PHASE1_D_GAIN_ABS_S4 "" VALUE 0x8003A0E7 CalPrmWslcEng_UBYTE 0 Gain 0 255 SYMBOL_LINK "CalPrmWslcEng01.TP_U8_EDC_PHASE1_D_GAIN_ABS_S4" 0 /end CHARACTERISTIC
/begin CHARACTERISTIC TP_U8_EDC_PHASE1_D_GAIN_S1 "" VALUE 0x8003A0C4 CalPrmWslcEng_UBYTE 0 Gain 0 255 SYMBOL_LINK "CalPrmWslcEng01.TP_U8_EDC_PHASE1_D_GAIN_S1" 0 /end CHARACTERISTIC
/begin CHARACTERISTIC TP_U8_EDC_PHASE1_D_GAIN_S2 "" VALUE 0x8003A0C5 CalPrmWslcEng_UBYTE 0 Gain 0 255 SYMBOL_LINK "CalPrmWslcEng01.TP_U8_EDC_PHASE1_D_GAIN_S2" 0 /end CHARACTERISTIC
/begin CHARACTERISTIC TP_U8_EDC_PHASE1_D_GAIN_S3 "" VALUE 0x8003A0C6 CalPrmWslcEng_UBYTE 0 Gain 0 255 SYMBOL_LINK "CalPrmWslcEng01.TP_U8_EDC_PHASE1_D_GAIN_S3" 0 /end CHARACTERISTIC
/begin CHARACTERISTIC TP_U8_EDC_PHASE1_D_GAIN_S4 "" VALUE 0x8003A0C7 CalPrmWslcEng_UBYTE 0 Gain 0 255 SYMBOL_LINK "CalPrmWslcEng01.TP_U8_EDC_PHASE1_D_GAIN_S4" 0 /end CHARACTERISTIC
/begin CHARACTERISTIC TP_U8_EDC_PHASE1_P_GAIN_ABS_S1 "" VALUE 0x8003A0E8 CalPrmWslcEng_UBYTE 0 Gain 0 255 SYMBOL_LINK "CalPrmWslcEng01.TP_U8_EDC_PHASE1_P_GAIN_ABS_S1" 0 /end CHARACTERISTIC
/begin CHARACTERISTIC TP_U8_EDC_PHASE1_P_GAIN_ABS_S2 "" VALUE 0x8003A0E9 CalPrmWslcEng_UBYTE 0 Gain 0 255 SYMBOL_LINK "CalPrmWslcEng01.TP_U8_EDC_PHASE1_P_GAIN_ABS_S2" 0 /end CHARACTERISTIC
/begin CHARACTERISTIC TP_U8_EDC_PHASE1_P_GAIN_ABS_S3 "" VALUE 0x8003A0EA CalPrmWslcEng_UBYTE 0 Gain 0 255 SYMBOL_LINK "CalPrmWslcEng01.TP_U8_EDC_PHASE1_P_GAIN_ABS_S3" 0 /end CHARACTERISTIC
/begin CHARACTERISTIC TP_U8_EDC_PHASE1_P_GAIN_ABS_S4 "" VALUE 0x8003A0EB CalPrmWslcEng_UBYTE 0 Gain 0 255 SYMBOL_LINK "CalPrmWslcEng01.TP_U8_EDC_PHASE1_P_GAIN_ABS_S4" 0 /end CHARACTERISTIC
/begin CHARACTERISTIC TP_U8_EDC_PHASE1_P_GAIN_S1 "" VALUE 0x8003A0C8 CalPrmWslcEng_UBYTE 0 Gain 0 255 SYMBOL_LINK "CalPrmWslcEng01.TP_U8_EDC_PHASE1_P_GAIN_S1" 0 /end CHARACTERISTIC
/begin CHARACTERISTIC TP_U8_EDC_PHASE1_P_GAIN_S2 "" VALUE 0x8003A0C9 CalPrmWslcEng_UBYTE 0 Gain 0 255 SYMBOL_LINK "CalPrmWslcEng01.TP_U8_EDC_PHASE1_P_GAIN_S2" 0 /end CHARACTERISTIC
/begin CHARACTERISTIC TP_U8_EDC_PHASE1_P_GAIN_S3 "" VALUE 0x8003A0CA CalPrmWslcEng_UBYTE 0 Gain 0 255 SYMBOL_LINK "CalPrmWslcEng01.TP_U8_EDC_PHASE1_P_GAIN_S3" 0 /end CHARACTERISTIC
/begin CHARACTERISTIC TP_U8_EDC_PHASE1_P_GAIN_S4 "" VALUE 0x8003A0CB CalPrmWslcEng_UBYTE 0 Gain 0 255 SYMBOL_LINK "CalPrmWslcEng01.TP_U8_EDC_PHASE1_P_GAIN_S4" 0 /end CHARACTERISTIC
/begin CHARACTERISTIC TP_U8_EDC_PHASE2_D_GAIN_ABS_S1 "" VALUE 0x8003A0EC CalPrmWslcEng_UBYTE 0 Gain 0 255 SYMBOL_LINK "CalPrmWslcEng01.TP_U8_EDC_PHASE2_D_GAIN_ABS_S1" 0 /end CHARACTERISTIC
/begin CHARACTERISTIC TP_U8_EDC_PHASE2_D_GAIN_ABS_S2 "" VALUE 0x8003A0ED CalPrmWslcEng_UBYTE 0 Gain 0 255 SYMBOL_LINK "CalPrmWslcEng01.TP_U8_EDC_PHASE2_D_GAIN_ABS_S2" 0 /end CHARACTERISTIC
/begin CHARACTERISTIC TP_U8_EDC_PHASE2_D_GAIN_ABS_S3 "" VALUE 0x8003A0EE CalPrmWslcEng_UBYTE 0 Gain 0 255 SYMBOL_LINK "CalPrmWslcEng01.TP_U8_EDC_PHASE2_D_GAIN_ABS_S3" 0 /end CHARACTERISTIC
/begin CHARACTERISTIC TP_U8_EDC_PHASE2_D_GAIN_ABS_S4 "" VALUE 0x8003A0EF CalPrmWslcEng_UBYTE 0 Gain 0 255 SYMBOL_LINK "CalPrmWslcEng01.TP_U8_EDC_PHASE2_D_GAIN_ABS_S4" 0 /end CHARACTERISTIC
/begin CHARACTERISTIC TP_U8_EDC_PHASE2_D_GAIN_S1 "" VALUE 0x8003A0CC CalPrmWslcEng_UBYTE 0 Gain 0 255 SYMBOL_LINK "CalPrmWslcEng01.TP_U8_EDC_PHASE2_D_GAIN_S1" 0 /end CHARACTERISTIC
/begin CHARACTERISTIC TP_U8_EDC_PHASE2_D_GAIN_S2 "" VALUE 0x8003A0CD CalPrmWslcEng_UBYTE 0 Gain 0 255 SYMBOL_LINK "CalPrmWslcEng01.TP_U8_EDC_PHASE2_D_GAIN_S2" 0 /end CHARACTERISTIC
/begin CHARACTERISTIC TP_U8_EDC_PHASE2_D_GAIN_S3 "" VALUE 0x8003A0CE CalPrmWslcEng_UBYTE 0 Gain 0 255 SYMBOL_LINK "CalPrmWslcEng01.TP_U8_EDC_PHASE2_D_GAIN_S3" 0 /end CHARACTERISTIC
/begin CHARACTERISTIC TP_U8_EDC_PHASE2_D_GAIN_S4 "" VALUE 0x8003A0CF CalPrmWslcEng_UBYTE 0 Gain 0 255 SYMBOL_LINK "CalPrmWslcEng01.TP_U8_EDC_PHASE2_D_GAIN_S4" 0 /end CHARACTERISTIC
/begin CHARACTERISTIC TP_U8_EDC_PHASE2_P_GAIN_ABS_S1 "" VALUE 0x8003A0F0 CalPrmWslcEng_UBYTE 0 Gain 0 255 SYMBOL_LINK "CalPrmWslcEng01.TP_U8_EDC_PHASE2_P_GAIN_ABS_S1" 0 /end CHARACTERISTIC
/begin CHARACTERISTIC TP_U8_EDC_PHASE2_P_GAIN_ABS_S2 "" VALUE 0x8003A0F1 CalPrmWslcEng_UBYTE 0 Gain 0 255 SYMBOL_LINK "CalPrmWslcEng01.TP_U8_EDC_PHASE2_P_GAIN_ABS_S2" 0 /end CHARACTERISTIC
/begin CHARACTERISTIC TP_U8_EDC_PHASE2_P_GAIN_ABS_S3 "" VALUE 0x8003A0F2 CalPrmWslcEng_UBYTE 0 Gain 0 255 SYMBOL_LINK "CalPrmWslcEng01.TP_U8_EDC_PHASE2_P_GAIN_ABS_S3" 0 /end CHARACTERISTIC
/begin CHARACTERISTIC TP_U8_EDC_PHASE2_P_GAIN_ABS_S4 "" VALUE 0x8003A0F3 CalPrmWslcEng_UBYTE 0 Gain 0 255 SYMBOL_LINK "CalPrmWslcEng01.TP_U8_EDC_PHASE2_P_GAIN_ABS_S4" 0 /end CHARACTERISTIC
/begin CHARACTERISTIC TP_U8_EDC_PHASE2_P_GAIN_S1 "" VALUE 0x8003A0D0 CalPrmWslcEng_UBYTE 0 Gain 0 255 SYMBOL_LINK "CalPrmWslcEng01.TP_U8_EDC_PHASE2_P_GAIN_S1" 0 /end CHARACTERISTIC
/begin CHARACTERISTIC TP_U8_EDC_PHASE2_P_GAIN_S2 "" VALUE 0x8003A0D1 CalPrmWslcEng_UBYTE 0 Gain 0 255 SYMBOL_LINK "CalPrmWslcEng01.TP_U8_EDC_PHASE2_P_GAIN_S2" 0 /end CHARACTERISTIC
/begin CHARACTERISTIC TP_U8_EDC_PHASE2_P_GAIN_S3 "" VALUE 0x8003A0D2 CalPrmWslcEng_UBYTE 0 Gain 0 255 SYMBOL_LINK "CalPrmWslcEng01.TP_U8_EDC_PHASE2_P_GAIN_S3" 0 /end CHARACTERISTIC
/begin CHARACTERISTIC TP_U8_EDC_PHASE2_P_GAIN_S4 "" VALUE 0x8003A0D3 CalPrmWslcEng_UBYTE 0 Gain 0 255 SYMBOL_LINK "CalPrmWslcEng01.TP_U8_EDC_PHASE2_P_GAIN_S4" 0 /end CHARACTERISTIC
/begin CHARACTERISTIC TP_U8_EDC_PHASE3_D_GAIN_ABS_S1 "" VALUE 0x8003A0F4 CalPrmWslcEng_UBYTE 0 Gain 0 255 SYMBOL_LINK "CalPrmWslcEng01.TP_U8_EDC_PHASE3_D_GAIN_ABS_S1" 0 /end CHARACTERISTIC
/begin CHARACTERISTIC TP_U8_EDC_PHASE3_D_GAIN_ABS_S2 "" VALUE 0x8003A0F5 CalPrmWslcEng_UBYTE 0 Gain 0 255 SYMBOL_LINK "CalPrmWslcEng01.TP_U8_EDC_PHASE3_D_GAIN_ABS_S2" 0 /end CHARACTERISTIC
/begin CHARACTERISTIC TP_U8_EDC_PHASE3_D_GAIN_ABS_S3 "" VALUE 0x8003A0F6 CalPrmWslcEng_UBYTE 0 Gain 0 255 SYMBOL_LINK "CalPrmWslcEng01.TP_U8_EDC_PHASE3_D_GAIN_ABS_S3" 0 /end CHARACTERISTIC
/begin CHARACTERISTIC TP_U8_EDC_PHASE3_D_GAIN_ABS_S4 "" VALUE 0x8003A0F7 CalPrmWslcEng_UBYTE 0 Gain 0 255 SYMBOL_LINK "CalPrmWslcEng01.TP_U8_EDC_PHASE3_D_GAIN_ABS_S4" 0 /end CHARACTERISTIC
/begin CHARACTERISTIC TP_U8_EDC_PHASE3_D_GAIN_S1 "" VALUE 0x8003A0D4 CalPrmWslcEng_UBYTE 0 Gain 0 255 SYMBOL_LINK "CalPrmWslcEng01.TP_U8_EDC_PHASE3_D_GAIN_S1" 0 /end CHARACTERISTIC
/begin CHARACTERISTIC TP_U8_EDC_PHASE3_D_GAIN_S2 "" VALUE 0x8003A0D5 CalPrmWslcEng_UBYTE 0 Gain 0 255 SYMBOL_LINK "CalPrmWslcEng01.TP_U8_EDC_PHASE3_D_GAIN_S2" 0 /end CHARACTERISTIC
/begin CHARACTERISTIC TP_U8_EDC_PHASE3_D_GAIN_S3 "" VALUE 0x8003A0D6 CalPrmWslcEng_UBYTE 0 Gain 0 255 SYMBOL_LINK "CalPrmWslcEng01.TP_U8_EDC_PHASE3_D_GAIN_S3" 0 /end CHARACTERISTIC
/begin CHARACTERISTIC TP_U8_EDC_PHASE3_D_GAIN_S4 "" VALUE 0x8003A0D7 CalPrmWslcEng_UBYTE 0 Gain 0 255 SYMBOL_LINK "CalPrmWslcEng01.TP_U8_EDC_PHASE3_D_GAIN_S4" 0 /end CHARACTERISTIC
/begin CHARACTERISTIC TP_U8_EDC_PHASE3_P_GAIN_ABS_S1 "" VALUE 0x8003A0F8 CalPrmWslcEng_UBYTE 0 Gain 0 255 SYMBOL_LINK "CalPrmWslcEng01.TP_U8_EDC_PHASE3_P_GAIN_ABS_S1" 0 /end CHARACTERISTIC
/begin CHARACTERISTIC TP_U8_EDC_PHASE3_P_GAIN_ABS_S2 "" VALUE 0x8003A0F9 CalPrmWslcEng_UBYTE 0 Gain 0 255 SYMBOL_LINK "CalPrmWslcEng01.TP_U8_EDC_PHASE3_P_GAIN_ABS_S2" 0 /end CHARACTERISTIC
/begin CHARACTERISTIC TP_U8_EDC_PHASE3_P_GAIN_ABS_S3 "" VALUE 0x8003A0FA CalPrmWslcEng_UBYTE 0 Gain 0 255 SYMBOL_LINK "CalPrmWslcEng01.TP_U8_EDC_PHASE3_P_GAIN_ABS_S3" 0 /end CHARACTERISTIC
/begin CHARACTERISTIC TP_U8_EDC_PHASE3_P_GAIN_ABS_S4 "" VALUE 0x8003A0FB CalPrmWslcEng_UBYTE 0 Gain 0 255 SYMBOL_LINK "CalPrmWslcEng01.TP_U8_EDC_PHASE3_P_GAIN_ABS_S4" 0 /end CHARACTERISTIC
/begin CHARACTERISTIC TP_U8_EDC_PHASE3_P_GAIN_S1 "" VALUE 0x8003A0D8 CalPrmWslcEng_UBYTE 0 Gain 0 255 SYMBOL_LINK "CalPrmWslcEng01.TP_U8_EDC_PHASE3_P_GAIN_S1" 0 /end CHARACTERISTIC
/begin CHARACTERISTIC TP_U8_EDC_PHASE3_P_GAIN_S2 "" VALUE 0x8003A0D9 CalPrmWslcEng_UBYTE 0 Gain 0 255 SYMBOL_LINK "CalPrmWslcEng01.TP_U8_EDC_PHASE3_P_GAIN_S2" 0 /end CHARACTERISTIC
/begin CHARACTERISTIC TP_U8_EDC_PHASE3_P_GAIN_S3 "" VALUE 0x8003A0DA CalPrmWslcEng_UBYTE 0 Gain 0 255 SYMBOL_LINK "CalPrmWslcEng01.TP_U8_EDC_PHASE3_P_GAIN_S3" 0 /end CHARACTERISTIC
/begin CHARACTERISTIC TP_U8_EDC_PHASE3_P_GAIN_S4 "" VALUE 0x8003A0DB CalPrmWslcEng_UBYTE 0 Gain 0 255 SYMBOL_LINK "CalPrmWslcEng01.TP_U8_EDC_PHASE3_P_GAIN_S4" 0 /end CHARACTERISTIC
/begin CHARACTERISTIC TP_U8_EDC_PHASE4_D_GAIN_ABS_S1 "" VALUE 0x8003A0FC CalPrmWslcEng_UBYTE 0 Gain 0 255 SYMBOL_LINK "CalPrmWslcEng01.TP_U8_EDC_PHASE4_D_GAIN_ABS_S1" 0 /end CHARACTERISTIC
/begin CHARACTERISTIC TP_U8_EDC_PHASE4_D_GAIN_ABS_S2 "" VALUE 0x8003A0FD CalPrmWslcEng_UBYTE 0 Gain 0 255 SYMBOL_LINK "CalPrmWslcEng01.TP_U8_EDC_PHASE4_D_GAIN_ABS_S2" 0 /end CHARACTERISTIC
/begin CHARACTERISTIC TP_U8_EDC_PHASE4_D_GAIN_ABS_S3 "" VALUE 0x8003A0FE CalPrmWslcEng_UBYTE 0 Gain 0 255 SYMBOL_LINK "CalPrmWslcEng01.TP_U8_EDC_PHASE4_D_GAIN_ABS_S3" 0 /end CHARACTERISTIC
/begin CHARACTERISTIC TP_U8_EDC_PHASE4_D_GAIN_ABS_S4 "" VALUE 0x8003A0FF CalPrmWslcEng_UBYTE 0 Gain 0 255 SYMBOL_LINK "CalPrmWslcEng01.TP_U8_EDC_PHASE4_D_GAIN_ABS_S4" 0 /end CHARACTERISTIC
/begin CHARACTERISTIC TP_U8_EDC_PHASE4_D_GAIN_S1 "" VALUE 0x8003A0DC CalPrmWslcEng_UBYTE 0 Gain 0 255 SYMBOL_LINK "CalPrmWslcEng01.TP_U8_EDC_PHASE4_D_GAIN_S1" 0 /end CHARACTERISTIC
/begin CHARACTERISTIC TP_U8_EDC_PHASE4_D_GAIN_S2 "" VALUE 0x8003A0DD CalPrmWslcEng_UBYTE 0 Gain 0 255 SYMBOL_LINK "CalPrmWslcEng01.TP_U8_EDC_PHASE4_D_GAIN_S2" 0 /end CHARACTERISTIC
/begin CHARACTERISTIC TP_U8_EDC_PHASE4_D_GAIN_S3 "" VALUE 0x8003A0DE CalPrmWslcEng_UBYTE 0 Gain 0 255 SYMBOL_LINK "CalPrmWslcEng01.TP_U8_EDC_PHASE4_D_GAIN_S3" 0 /end CHARACTERISTIC
/begin CHARACTERISTIC TP_U8_EDC_PHASE4_D_GAIN_S4 "" VALUE 0x8003A0DF CalPrmWslcEng_UBYTE 0 Gain 0 255 SYMBOL_LINK "CalPrmWslcEng01.TP_U8_EDC_PHASE4_D_GAIN_S4" 0 /end CHARACTERISTIC
/begin CHARACTERISTIC TP_U8_EDC_PHASE4_P_GAIN_ABS_S1 "" VALUE 0x8003A100 CalPrmWslcEng_UBYTE 0 Gain 0 255 SYMBOL_LINK "CalPrmWslcEng01.TP_U8_EDC_PHASE4_P_GAIN_ABS_S1" 0 /end CHARACTERISTIC
/begin CHARACTERISTIC TP_U8_EDC_PHASE4_P_GAIN_ABS_S2 "" VALUE 0x8003A101 CalPrmWslcEng_UBYTE 0 Gain 0 255 SYMBOL_LINK "CalPrmWslcEng01.TP_U8_EDC_PHASE4_P_GAIN_ABS_S2" 0 /end CHARACTERISTIC
/begin CHARACTERISTIC TP_U8_EDC_PHASE4_P_GAIN_ABS_S3 "" VALUE 0x8003A102 CalPrmWslcEng_UBYTE 0 Gain 0 255 SYMBOL_LINK "CalPrmWslcEng01.TP_U8_EDC_PHASE4_P_GAIN_ABS_S3" 0 /end CHARACTERISTIC
/begin CHARACTERISTIC TP_U8_EDC_PHASE4_P_GAIN_ABS_S4 "" VALUE 0x8003A103 CalPrmWslcEng_UBYTE 0 Gain 0 255 SYMBOL_LINK "CalPrmWslcEng01.TP_U8_EDC_PHASE4_P_GAIN_ABS_S4" 0 /end CHARACTERISTIC
/begin CHARACTERISTIC TP_U8_EDC_PHASE4_P_GAIN_S1 "" VALUE 0x8003A0E0 CalPrmWslcEng_UBYTE 0 Gain 0 255 SYMBOL_LINK "CalPrmWslcEng01.TP_U8_EDC_PHASE4_P_GAIN_S1" 0 /end CHARACTERISTIC
/begin CHARACTERISTIC TP_U8_EDC_PHASE4_P_GAIN_S2 "" VALUE 0x8003A0E1 CalPrmWslcEng_UBYTE 0 Gain 0 255 SYMBOL_LINK "CalPrmWslcEng01.TP_U8_EDC_PHASE4_P_GAIN_S2" 0 /end CHARACTERISTIC
/begin CHARACTERISTIC TP_U8_EDC_PHASE4_P_GAIN_S3 "" VALUE 0x8003A0E2 CalPrmWslcEng_UBYTE 0 Gain 0 255 SYMBOL_LINK "CalPrmWslcEng01.TP_U8_EDC_PHASE4_P_GAIN_S3" 0 /end CHARACTERISTIC
/begin CHARACTERISTIC TP_U8_EDC_PHASE4_P_GAIN_S4 "" VALUE 0x8003A0E3 CalPrmWslcEng_UBYTE 0 Gain 0 255 SYMBOL_LINK "CalPrmWslcEng01.TP_U8_EDC_PHASE4_P_GAIN_S4" 0 /end CHARACTERISTIC
/begin CHARACTERISTIC TP_U8_TOD_MTP_THR "MTP Threshold to determine the full acceleration state" VALUE 0x8003A6D9 CalPrmAwdCtrlrEng_UBYTE 0 Gain 0 255 SYMBOL_LINK "CalPrmAwdCtrlrEng01.TP_U8_TOD_MTP_THR" 0 /end CHARACTERISTIC
/begin CHARACTERISTIC TP_U8_TOD_OVER_THR_G1 "Threshold Gain to detect oversteer" VALUE 0x8003A6DA CalPrmAwdCtrlrEng_UBYTE 0 Gain 0 255 SYMBOL_LINK "CalPrmAwdCtrlrEng01.TP_U8_TOD_OVER_THR_G1" 0 /end CHARACTERISTIC
/begin CHARACTERISTIC TP_U8_TOD_OVER_THR_G2 "Threshold Gain to detect severe oversteer" VALUE 0x8003A6DB CalPrmAwdCtrlrEng_UBYTE 0 Gain 0 255 SYMBOL_LINK "CalPrmAwdCtrlrEng01.TP_U8_TOD_OVER_THR_G2" 0 /end CHARACTERISTIC
/begin CHARACTERISTIC TP_U8_TOD_UNDER_THR_G1 "Threshold Gain to detect understeer" VALUE 0x8003A6DC CalPrmAwdCtrlrEng_UBYTE 0 Gain 0 255 SYMBOL_LINK "CalPrmAwdCtrlrEng01.TP_U8_TOD_UNDER_THR_G1" 0 /end CHARACTERISTIC
/begin CHARACTERISTIC TP_U8_TOD_UNDER_THR_G2 "Threshold Gain to detect severe understeer" VALUE 0x8003A6DD CalPrmAwdCtrlrEng_UBYTE 0 Gain 0 255 SYMBOL_LINK "CalPrmAwdCtrlrEng01.TP_U8_TOD_UNDER_THR_G2" 0 /end CHARACTERISTIC
/begin CHARACTERISTIC TQEHCuint8InhibitionFlag "" VALUE 0x80020CDE CalPrmLatDynsCoorrBrk_UBYTE 0 Gain 0 255 SYMBOL_LINK "CalPrmLatDynsCoorrBrk01.TQEHCuint8InhibitionFlag" 0 /end CHARACTERISTIC
/begin CHARACTERISTIC TQU16_FRNT_WH_PRESS_TO_BRK_TORQ_RATIO "" VALUE 0x800207F2 CalPrmLatDynsCoorrBrk_UWORD 0 Gain 0 65535 SYMBOL_LINK "CalPrmLatDynsCoorrBrk01.TQU16_FRNT_WH_PRESS_TO_BRK_TORQ_RATIO" 0 /end CHARACTERISTIC
/begin CHARACTERISTIC TQU16_REAR_WH_PRESS_TO_BRK_TORQ_RATIO "" VALUE 0x800207F4 CalPrmLatDynsCoorrBrk_UWORD 0 Gain 0 65535 SYMBOL_LINK "CalPrmLatDynsCoorrBrk01.TQU16_REAR_WH_PRESS_TO_BRK_TORQ_RATIO" 0 /end CHARACTERISTIC
/begin CHARACTERISTIC U16DtrmMstCylP "If the master cylinder pressure is bigger than this value, brake controller determine the driver step on the brake" VALUE 0x80021258 CalPrmBrkTqCtrlrBrk_UWORD 0 P32 0 655.35 SYMBOL_LINK "CalPrmBrkTqCtrlrBrk01.U16DtrmMstCylP" 0 /end CHARACTERISTIC
/begin CHARACTERISTIC U16DtrmTcmfMstCylP "If the master cylinder pressure is bigger than this value, brake controller determine suction mode" VALUE 0x8002125E CalPrmBrkTqCtrlrBrk_UWORD 0 P32 0 655.35 SYMBOL_LINK "CalPrmBrkTqCtrlrBrk01.U16DtrmTcmfMstCylP" 0 /end CHARACTERISTIC
/begin CHARACTERISTIC U16DtrmTcmpPErr "If the pressure error (master pressure - target pressure) is smaller than this valure, brake controller determine suction mode" VALUE 0x8002125A CalPrmBrkTqCtrlrBrk_UWORD 0 P32 0 655.35 SYMBOL_LINK "CalPrmBrkTqCtrlrBrk01.U16DtrmTcmpPErr" 0 /end CHARACTERISTIC
/begin CHARACTERISTIC U16EsvVlvActtnTiFctCtrlFinshd "ESV valve activation after brake control total time" VALUE 0x800213D0 CalPrmBrkTqCtrlrBrk_UWORD 0 Ti41 0 327.675 SYMBOL_LINK "CalPrmBrkTqCtrlrBrk01.U16EsvVlvActtnTiFctCtrlFinshd" 0 /end CHARACTERISTIC
/begin CHARACTERISTIC U16EsvVlvActtnVehSpdFctCtrlFinshd "If vehicle speed is smaller than this value, ESV valve activation after brake control not active" VALUE 0x800213CC CalPrmBrkTqCtrlrBrk_UWORD 0 Spd11 0 1023.984375 SYMBOL_LINK "CalPrmBrkTqCtrlrBrk01.U16EsvVlvActtnVehSpdFctCtrlFinshd" 0 /end CHARACTERISTIC
/begin CHARACTERISTIC U16EsvVlvCurPatIniActtnTi "ESV valve pattern control time" VALUE 0x800213D4 CalPrmBrkTqCtrlrBrk_UWORD 0 Ti41 0 327.675 SYMBOL_LINK "CalPrmBrkTqCtrlrBrk01.U16EsvVlvCurPatIniActtnTi" 0 /end CHARACTERISTIC
/begin CHARACTERISTIC U16FricMotUAbs1 "Target motot voltage in ABS normal acitvation at road friction 1point" VALUE 0x800213F0 CalPrmBrkTqCtrlrBrk_UWORD 0 U11 0 65.535 SYMBOL_LINK "CalPrmBrkTqCtrlrBrk01.U16FricMotUAbs1" 0 /end CHARACTERISTIC
/begin CHARACTERISTIC U16FricMotUAbs2 "Target motot voltage in ABS normal acitvation at road friction 2point" VALUE 0x800213F2 CalPrmBrkTqCtrlrBrk_UWORD 0 U11 0 65.535 SYMBOL_LINK "CalPrmBrkTqCtrlrBrk01.U16FricMotUAbs2" 0 /end CHARACTERISTIC
/begin CHARACTERISTIC U16FricMotUAbs3 "Target motot voltage in ABS normal acitvation at road friction 3point" VALUE 0x800213F4 CalPrmBrkTqCtrlrBrk_UWORD 0 U11 0 65.535 SYMBOL_LINK "CalPrmBrkTqCtrlrBrk01.U16FricMotUAbs3" 0 /end CHARACTERISTIC
/begin CHARACTERISTIC U16FricMotUWslcDecelComb1 "Target motot voltage in ABS with decel control at road friction 1point" VALUE 0x800213FE CalPrmBrkTqCtrlrBrk_UWORD 0 U11 0 65.535 SYMBOL_LINK "CalPrmBrkTqCtrlrBrk01.U16FricMotUWslcDecelComb1" 0 /end CHARACTERISTIC
/begin CHARACTERISTIC U16FricMotUWslcDecelComb2 "Target motot voltage in ABS with decel control at road friction 2point" VALUE 0x80021400 CalPrmBrkTqCtrlrBrk_UWORD 0 U11 0 65.535 SYMBOL_LINK "CalPrmBrkTqCtrlrBrk01.U16FricMotUWslcDecelComb2" 0 /end CHARACTERISTIC
/begin CHARACTERISTIC U16FricMotUWslcDecelComb3 "Target motot voltage in ABS with decel control at road friction 3point" VALUE 0x80021402 CalPrmBrkTqCtrlrBrk_UWORD 0 U11 0 65.535 SYMBOL_LINK "CalPrmBrkTqCtrlrBrk01.U16FricMotUWslcDecelComb3" 0 /end CHARACTERISTIC
/begin CHARACTERISTIC U16IniDutyMotU1 "Motor target voltage for determine initial motor duty (1 point of 2 interpolation)" VALUE 0x80021494 CalPrmBrkTqCtrlrBrk_UWORD 0 U11 0 65.535 SYMBOL_LINK "CalPrmBrkTqCtrlrBrk01.U16IniDutyMotU1" 0 /end CHARACTERISTIC
/begin CHARACTERISTIC U16IniDutyMotU2 "Motor target voltage for determine initial motor duty (2 point of 2 interpolation)" VALUE 0x80021496 CalPrmBrkTqCtrlrBrk_UWORD 0 U11 0 65.535 SYMBOL_LINK "CalPrmBrkTqCtrlrBrk01.U16IniDutyMotU2" 0 /end CHARACTERISTIC
/begin CHARACTERISTIC U16IniMotUAbsMstCylP1 "Master cylinder pressure for determine target motor voltage in ABS initial acitvation (1 point of 4 interpolation)" VALUE 0x800213DC CalPrmBrkTqCtrlrBrk_UWORD 0 P32 0 655.35 SYMBOL_LINK "CalPrmBrkTqCtrlrBrk01.U16IniMotUAbsMstCylP1" 0 /end CHARACTERISTIC
/begin CHARACTERISTIC U16IniMotUAbsMstCylP2 "Master cylinder pressure for determine target motor voltage in ABS initial acitvation (2 point of 4 interpolation)" VALUE 0x800213DE CalPrmBrkTqCtrlrBrk_UWORD 0 P32 0 655.35 SYMBOL_LINK "CalPrmBrkTqCtrlrBrk01.U16IniMotUAbsMstCylP2" 0 /end CHARACTERISTIC
/begin CHARACTERISTIC U16IniMotUAbsMstCylP3 "Master cylinder pressure for determine target motor voltage in ABS initial acitvation (3 point of 4 interpolation)" VALUE 0x800213E0 CalPrmBrkTqCtrlrBrk_UWORD 0 P32 0 655.35 SYMBOL_LINK "CalPrmBrkTqCtrlrBrk01.U16IniMotUAbsMstCylP3" 0 /end CHARACTERISTIC
/begin CHARACTERISTIC U16IniMotUAbsMstCylP4 "Master cylinder pressure for determine target motor voltage in ABS initial acitvation (4 point of 4 interpolation)" VALUE 0x800213E2 CalPrmBrkTqCtrlrBrk_UWORD 0 P32 0 655.35 SYMBOL_LINK "CalPrmBrkTqCtrlrBrk01.U16IniMotUAbsMstCylP4" 0 /end CHARACTERISTIC
/begin CHARACTERISTIC U16IniTiMotU1 "Motor target voltage for determine initial motor on time (1 point of 2 interpolation)" VALUE 0x800214A2 CalPrmBrkTqCtrlrBrk_UWORD 0 U11 0 65.535 SYMBOL_LINK "CalPrmBrkTqCtrlrBrk01.U16IniTiMotU1" 0 /end CHARACTERISTIC
/begin CHARACTERISTIC U16IniTiMotU2 "Motor target voltage for determine initial motor on time (2 point of 2 interpolation)" VALUE 0x800214A4 CalPrmBrkTqCtrlrBrk_UWORD 0 U11 0 65.535 SYMBOL_LINK "CalPrmBrkTqCtrlrBrk01.U16IniTiMotU2" 0 /end CHARACTERISTIC
/begin CHARACTERISTIC U16IniTiMotU3 "Motor target voltage for determine initial motor on time (3 point of 2 interpolation)" VALUE 0x800214A6 CalPrmBrkTqCtrlrBrk_UWORD 0 U11 0 65.535 SYMBOL_LINK "CalPrmBrkTqCtrlrBrk01.U16IniTiMotU3" 0 /end CHARACTERISTIC
/begin CHARACTERISTIC U16IniTiMotU4 "Motor target voltage for determine initial motor on time (4 point of 2 interpolation)" VALUE 0x800214A8 CalPrmBrkTqCtrlrBrk_UWORD 0 U11 0 65.535 SYMBOL_LINK "CalPrmBrkTqCtrlrBrk01.U16IniTiMotU4" 0 /end CHARACTERISTIC
/begin CHARACTERISTIC U16LfcRiseNotSuctnNo1VlvCurPGrdt11 "Target brake pressure gradient for determine NO valve current at LFC rise mode without suction (1 point of 5 interpolation at pressure error 1 point)" VALUE 0x8002128A CalPrmBrkTqCtrlrBrk_UWORD 0 PGrdt11 0 6553.5 SYMBOL_LINK "CalPrmBrkTqCtrlrBrk01.U16LfcRiseNotSuctnNo1VlvCurPGrdt11" 0 /end CHARACTERISTIC
/begin CHARACTERISTIC U16LfcRiseNotSuctnNo1VlvCurPGrdt12 "Target brake pressure gradient for determine NO valve current at LFC rise mode without suction (2 point of 5 interpolation at pressure error 1 point)" VALUE 0x8002128C CalPrmBrkTqCtrlrBrk_UWORD 0 PGrdt11 0 6553.5 SYMBOL_LINK "CalPrmBrkTqCtrlrBrk01.U16LfcRiseNotSuctnNo1VlvCurPGrdt12" 0 /end CHARACTERISTIC
/begin CHARACTERISTIC U16LfcRiseNotSuctnNo1VlvCurPGrdt13 "Target brake pressure gradient for determine NO valve current at LFC rise mode without suction (3 point of 5 interpolation at pressure error 1 point)" VALUE 0x8002128E CalPrmBrkTqCtrlrBrk_UWORD 0 PGrdt11 0 6553.5 SYMBOL_LINK "CalPrmBrkTqCtrlrBrk01.U16LfcRiseNotSuctnNo1VlvCurPGrdt13" 0 /end CHARACTERISTIC
/begin CHARACTERISTIC U16LfcRiseNotSuctnNo1VlvCurPGrdt14 "Target brake pressure gradient for determine NO valve current at LFC rise mode without suction (4 point of 5 interpolation at pressure error 1 point)" VALUE 0x80021290 CalPrmBrkTqCtrlrBrk_UWORD 0 PGrdt11 0 6553.5 SYMBOL_LINK "CalPrmBrkTqCtrlrBrk01.U16LfcRiseNotSuctnNo1VlvCurPGrdt14" 0 /end CHARACTERISTIC
/begin CHARACTERISTIC U16LfcRiseNotSuctnNo1VlvCurPGrdt15 "Target brake pressure gradient for determine NO valve current at LFC rise mode without suction (5 point of 5 interpolation at pressure error 1 point)" VALUE 0x80021292 CalPrmBrkTqCtrlrBrk_UWORD 0 PGrdt11 0 6553.5 SYMBOL_LINK "CalPrmBrkTqCtrlrBrk01.U16LfcRiseNotSuctnNo1VlvCurPGrdt15" 0 /end CHARACTERISTIC
/begin CHARACTERISTIC U16LfcRiseNotSuctnNo1VlvCurPGrdt21 "Target brake pressure gradient for determine NO valve current at LFC rise mode without suction (1 point of 7 interpolation at pressure error 2 point)" VALUE 0x8002129E CalPrmBrkTqCtrlrBrk_UWORD 0 PGrdt11 0 6553.5 SYMBOL_LINK "CalPrmBrkTqCtrlrBrk01.U16LfcRiseNotSuctnNo1VlvCurPGrdt21" 0 /end CHARACTERISTIC
/begin CHARACTERISTIC U16LfcRiseNotSuctnNo1VlvCurPGrdt22 "Target brake pressure gradient for determine NO valve current at LFC rise mode without suction (2 point of 7 interpolation at pressure error 2 point)" VALUE 0x800212A0 CalPrmBrkTqCtrlrBrk_UWORD 0 PGrdt11 0 6553.5 SYMBOL_LINK "CalPrmBrkTqCtrlrBrk01.U16LfcRiseNotSuctnNo1VlvCurPGrdt22" 0 /end CHARACTERISTIC
/begin CHARACTERISTIC U16LfcRiseNotSuctnNo1VlvCurPGrdt23 "Target brake pressure gradient for determine NO valve current at LFC rise mode without suction (3 point of 7 interpolation at pressure error 2 point)" VALUE 0x800212A2 CalPrmBrkTqCtrlrBrk_UWORD 0 PGrdt11 0 6553.5 SYMBOL_LINK "CalPrmBrkTqCtrlrBrk01.U16LfcRiseNotSuctnNo1VlvCurPGrdt23" 0 /end CHARACTERISTIC
/begin CHARACTERISTIC U16LfcRiseNotSuctnNo1VlvCurPGrdt24 "Target brake pressure gradient for determine NO valve current at LFC rise mode without suction (4 point of 7 interpolation at pressure error 2 point)" VALUE 0x800212A4 CalPrmBrkTqCtrlrBrk_UWORD 0 PGrdt11 0 6553.5 SYMBOL_LINK "CalPrmBrkTqCtrlrBrk01.U16LfcRiseNotSuctnNo1VlvCurPGrdt24" 0 /end CHARACTERISTIC
/begin CHARACTERISTIC U16LfcRiseNotSuctnNo1VlvCurPGrdt25 "Target brake pressure gradient for determine NO valve current at LFC rise mode without suction (5 point of 7 interpolation at pressure error 2 point)" VALUE 0x800212A6 CalPrmBrkTqCtrlrBrk_UWORD 0 PGrdt11 0 6553.5 SYMBOL_LINK "CalPrmBrkTqCtrlrBrk01.U16LfcRiseNotSuctnNo1VlvCurPGrdt25" 0 /end CHARACTERISTIC
/begin CHARACTERISTIC U16LfcRiseNotSuctnNo1VlvCurPGrdt26 "Target brake pressure gradient for determine NO valve current at LFC rise mode without suction (6 point of 7 interpolation at pressure error 2 point)" VALUE 0x800212A8 CalPrmBrkTqCtrlrBrk_UWORD 0 PGrdt11 0 6553.5 SYMBOL_LINK "CalPrmBrkTqCtrlrBrk01.U16LfcRiseNotSuctnNo1VlvCurPGrdt26" 0 /end CHARACTERISTIC
/begin CHARACTERISTIC U16LfcRiseNotSuctnNo1VlvCurPGrdt27 "Target brake pressure gradient for determine NO valve current at LFC rise mode without suction (7 point of 7 interpolation at pressure error 2 point)" VALUE 0x800212AA CalPrmBrkTqCtrlrBrk_UWORD 0 PGrdt11 0 6553.5 SYMBOL_LINK "CalPrmBrkTqCtrlrBrk01.U16LfcRiseNotSuctnNo1VlvCurPGrdt27" 0 /end CHARACTERISTIC
/begin CHARACTERISTIC U16LfcRiseNotSuctnPErr1 "Pressure error (Master pressure - target pressure) 1point for determine NO valve current at LFC rise mode without suction" VALUE 0x80021284 CalPrmBrkTqCtrlrBrk_UWORD 0 P32 0 655.35 SYMBOL_LINK "CalPrmBrkTqCtrlrBrk01.U16LfcRiseNotSuctnPErr1" 0 /end CHARACTERISTIC
/begin CHARACTERISTIC U16LfcRiseNotSuctnPErr2 "Pressure error (Master pressure - target pressure) 2point for determine NO valve current at LFC rise mode without suction" VALUE 0x80021286 CalPrmBrkTqCtrlrBrk_UWORD 0 P32 0 655.35 SYMBOL_LINK "CalPrmBrkTqCtrlrBrk01.U16LfcRiseNotSuctnPErr2" 0 /end CHARACTERISTIC
/begin CHARACTERISTIC U16LfcRiseNotSuctnPErr3 "Pressure error (Master pressure - target pressure) 3point for determine NO valve current at LFC rise mode without suction" VALUE 0x80021288 CalPrmBrkTqCtrlrBrk_UWORD 0 P32 0 655.35 SYMBOL_LINK "CalPrmBrkTqCtrlrBrk01.U16LfcRiseNotSuctnPErr3" 0 /end CHARACTERISTIC
/begin CHARACTERISTIC U16LfcRiseNotSuctnPGrdtNo1VlvCur11 "NO valve current at target brake pressure gradient 1 point at pressure error 1 point without suction" VALUE 0x80021294 CalPrmBrkTqCtrlrBrk_UWORD 0 Amp2 0 65.535 SYMBOL_LINK "CalPrmBrkTqCtrlrBrk01.U16LfcRiseNotSuctnPGrdtNo1VlvCur11" 0 /end CHARACTERISTIC
/begin CHARACTERISTIC U16LfcRiseNotSuctnPGrdtNo1VlvCur12 "NO valve current at target brake pressure gradient 2 point at pressure error 1 point without suction" VALUE 0x80021296 CalPrmBrkTqCtrlrBrk_UWORD 0 Amp2 0 65.535 SYMBOL_LINK "CalPrmBrkTqCtrlrBrk01.U16LfcRiseNotSuctnPGrdtNo1VlvCur12" 0 /end CHARACTERISTIC
/begin CHARACTERISTIC U16LfcRiseNotSuctnPGrdtNo1VlvCur13 "NO valve current at target brake pressure gradient 3 point at pressure error 1 point without suction" VALUE 0x80021298 CalPrmBrkTqCtrlrBrk_UWORD 0 Amp2 0 65.535 SYMBOL_LINK "CalPrmBrkTqCtrlrBrk01.U16LfcRiseNotSuctnPGrdtNo1VlvCur13" 0 /end CHARACTERISTIC
/begin CHARACTERISTIC U16LfcRiseNotSuctnPGrdtNo1VlvCur14 "NO valve current at target brake pressure gradient 4 point at pressure error 1 point without suction" VALUE 0x8002129A CalPrmBrkTqCtrlrBrk_UWORD 0 Amp2 0 65.535 SYMBOL_LINK "CalPrmBrkTqCtrlrBrk01.U16LfcRiseNotSuctnPGrdtNo1VlvCur14" 0 /end CHARACTERISTIC
/begin CHARACTERISTIC U16LfcRiseNotSuctnPGrdtNo1VlvCur15 "NO valve current at target brake pressure gradient 5 point at pressure error 1 point without suction" VALUE 0x8002129C CalPrmBrkTqCtrlrBrk_UWORD 0 Amp2 0 65.535 SYMBOL_LINK "CalPrmBrkTqCtrlrBrk01.U16LfcRiseNotSuctnPGrdtNo1VlvCur15" 0 /end CHARACTERISTIC
/begin CHARACTERISTIC U16LfcRiseNotSuctnPGrdtNo1VlvCur21 "NO valve current at target brake pressure gradient 1 point at pressure error 2 point without suction" VALUE 0x800212AC CalPrmBrkTqCtrlrBrk_UWORD 0 Amp2 0 65.535 SYMBOL_LINK "CalPrmBrkTqCtrlrBrk01.U16LfcRiseNotSuctnPGrdtNo1VlvCur21" 0 /end CHARACTERISTIC
/begin CHARACTERISTIC U16LfcRiseNotSuctnPGrdtNo1VlvCur22 "NO valve current at target brake pressure gradient 2 point at pressure error 2 point without suction" VALUE 0x800212AE CalPrmBrkTqCtrlrBrk_UWORD 0 Amp2 0 65.535 SYMBOL_LINK "CalPrmBrkTqCtrlrBrk01.U16LfcRiseNotSuctnPGrdtNo1VlvCur22" 0 /end CHARACTERISTIC
/begin CHARACTERISTIC U16LfcRiseNotSuctnPGrdtNo1VlvCur23 "NO valve current at target brake pressure gradient 3 point at pressure error 2 point without suction" VALUE 0x800212B0 CalPrmBrkTqCtrlrBrk_UWORD 0 Amp2 0 65.535 SYMBOL_LINK "CalPrmBrkTqCtrlrBrk01.U16LfcRiseNotSuctnPGrdtNo1VlvCur23" 0 /end CHARACTERISTIC
/begin CHARACTERISTIC U16LfcRiseNotSuctnPGrdtNo1VlvCur24 "NO valve current at target brake pressure gradient 4 point at pressure error 2 point without suction" VALUE 0x800212B2 CalPrmBrkTqCtrlrBrk_UWORD 0 Amp2 0 65.535 SYMBOL_LINK "CalPrmBrkTqCtrlrBrk01.U16LfcRiseNotSuctnPGrdtNo1VlvCur24" 0 /end CHARACTERISTIC
/begin CHARACTERISTIC U16LfcRiseNotSuctnPGrdtNo1VlvCur25 "NO valve current at target brake pressure gradient 5 point at pressure error 2 point without suction" VALUE 0x800212B4 CalPrmBrkTqCtrlrBrk_UWORD 0 Amp2 0 65.535 SYMBOL_LINK "CalPrmBrkTqCtrlrBrk01.U16LfcRiseNotSuctnPGrdtNo1VlvCur25" 0 /end CHARACTERISTIC
/begin CHARACTERISTIC U16LfcRiseNotSuctnPGrdtNo1VlvCur26 "NO valve current at target brake pressure gradient 6 point at pressure error 2 point without suction" VALUE 0x800212B6 CalPrmBrkTqCtrlrBrk_UWORD 0 Amp2 0 65.535 SYMBOL_LINK "CalPrmBrkTqCtrlrBrk01.U16LfcRiseNotSuctnPGrdtNo1VlvCur26" 0 /end CHARACTERISTIC
/begin CHARACTERISTIC U16LfcRiseNotSuctnPGrdtNo1VlvCur27 "NO valve current at target brake pressure gradient 7 point at pressure error 2 point without suction" VALUE 0x800212B8 CalPrmBrkTqCtrlrBrk_UWORD 0 Amp2 0 65.535 SYMBOL_LINK "CalPrmBrkTqCtrlrBrk01.U16LfcRiseNotSuctnPGrdtNo1VlvCur27" 0 /end CHARACTERISTIC
/begin CHARACTERISTIC U16LfcRiseSuctnNo1VlvCurPGrdt1 "Target brake pressure gradient for determine NO valve current at LFC rise mode with suction (1 point of 7 interpolation)" VALUE 0x80021268 CalPrmBrkTqCtrlrBrk_UWORD 0 PGrdt11 0 6553.5 SYMBOL_LINK "CalPrmBrkTqCtrlrBrk01.U16LfcRiseSuctnNo1VlvCurPGrdt1" 0 /end CHARACTERISTIC
/begin CHARACTERISTIC U16LfcRiseSuctnNo1VlvCurPGrdt2 "Target brake pressure gradient for determine NO valve current at LFC rise mode with suction (2 point of 7 interpolation)" VALUE 0x8002126A CalPrmBrkTqCtrlrBrk_UWORD 0 PGrdt11 0 6553.5 SYMBOL_LINK "CalPrmBrkTqCtrlrBrk01.U16LfcRiseSuctnNo1VlvCurPGrdt2" 0 /end CHARACTERISTIC
/begin CHARACTERISTIC U16LfcRiseSuctnNo1VlvCurPGrdt3 "Target brake pressure gradient for determine NO valve current at LFC rise mode with suction (3 point of 7 interpolation)" VALUE 0x8002126C CalPrmBrkTqCtrlrBrk_UWORD 0 PGrdt11 0 6553.5 SYMBOL_LINK "CalPrmBrkTqCtrlrBrk01.U16LfcRiseSuctnNo1VlvCurPGrdt3" 0 /end CHARACTERISTIC
/begin CHARACTERISTIC U16LfcRiseSuctnNo1VlvCurPGrdt4 "Target brake pressure gradient for determine NO valve current at LFC rise mode with suction (4 point of 7 interpolation)" VALUE 0x8002126E CalPrmBrkTqCtrlrBrk_UWORD 0 PGrdt11 0 6553.5 SYMBOL_LINK "CalPrmBrkTqCtrlrBrk01.U16LfcRiseSuctnNo1VlvCurPGrdt4" 0 /end CHARACTERISTIC
/begin CHARACTERISTIC U16LfcRiseSuctnNo1VlvCurPGrdt5 "Target brake pressure gradient for determine NO valve current at LFC rise mode with suction (5 point of 7 interpolation)" VALUE 0x80021270 CalPrmBrkTqCtrlrBrk_UWORD 0 PGrdt11 0 6553.5 SYMBOL_LINK "CalPrmBrkTqCtrlrBrk01.U16LfcRiseSuctnNo1VlvCurPGrdt5" 0 /end CHARACTERISTIC
/begin CHARACTERISTIC U16LfcRiseSuctnNo1VlvCurPGrdt6 "Target brake pressure gradient for determine NO valve current at LFC rise mode with suction (6 point of 7 interpolation)" VALUE 0x80021272 CalPrmBrkTqCtrlrBrk_UWORD 0 PGrdt11 0 6553.5 SYMBOL_LINK "CalPrmBrkTqCtrlrBrk01.U16LfcRiseSuctnNo1VlvCurPGrdt6" 0 /end CHARACTERISTIC
/begin CHARACTERISTIC U16LfcRiseSuctnNo1VlvCurPGrdt7 "Target brake pressure gradient for determine NO valve current at LFC rise mode with suction (7 point of 7 interpolation)" VALUE 0x80021274 CalPrmBrkTqCtrlrBrk_UWORD 0 PGrdt11 0 6553.5 SYMBOL_LINK "CalPrmBrkTqCtrlrBrk01.U16LfcRiseSuctnNo1VlvCurPGrdt7" 0 /end CHARACTERISTIC
/begin CHARACTERISTIC U16LfcRiseSuctnPGrdtNo1VlvCur1 "NO valve current at target brake pressure gradient 1 point with suction" VALUE 0x80021276 CalPrmBrkTqCtrlrBrk_UWORD 0 Amp2 0 65.535 SYMBOL_LINK "CalPrmBrkTqCtrlrBrk01.U16LfcRiseSuctnPGrdtNo1VlvCur1" 0 /end CHARACTERISTIC
/begin CHARACTERISTIC U16LfcRiseSuctnPGrdtNo1VlvCur2 "NO valve current at target brake pressure gradient 2 point with suction" VALUE 0x80021278 CalPrmBrkTqCtrlrBrk_UWORD 0 Amp2 0 65.535 SYMBOL_LINK "CalPrmBrkTqCtrlrBrk01.U16LfcRiseSuctnPGrdtNo1VlvCur2" 0 /end CHARACTERISTIC
/begin CHARACTERISTIC U16LfcRiseSuctnPGrdtNo1VlvCur3 "NO valve current at target brake pressure gradient 3 point with suction" VALUE 0x8002127A CalPrmBrkTqCtrlrBrk_UWORD 0 Amp2 0 65.535 SYMBOL_LINK "CalPrmBrkTqCtrlrBrk01.U16LfcRiseSuctnPGrdtNo1VlvCur3" 0 /end CHARACTERISTIC
/begin CHARACTERISTIC U16LfcRiseSuctnPGrdtNo1VlvCur4 "NO valve current at target brake pressure gradient 4 point with suction" VALUE 0x8002127C CalPrmBrkTqCtrlrBrk_UWORD 0 Amp2 0 65.535 SYMBOL_LINK "CalPrmBrkTqCtrlrBrk01.U16LfcRiseSuctnPGrdtNo1VlvCur4" 0 /end CHARACTERISTIC
/begin CHARACTERISTIC U16LfcRiseSuctnPGrdtNo1VlvCur5 "NO valve current at target brake pressure gradient 5 point with suction" VALUE 0x8002127E CalPrmBrkTqCtrlrBrk_UWORD 0 Amp2 0 65.535 SYMBOL_LINK "CalPrmBrkTqCtrlrBrk01.U16LfcRiseSuctnPGrdtNo1VlvCur5" 0 /end CHARACTERISTIC
/begin CHARACTERISTIC U16LfcRiseSuctnPGrdtNo1VlvCur6 "NO valve current at target brake pressure gradient 6 point with suction" VALUE 0x80021280 CalPrmBrkTqCtrlrBrk_UWORD 0 Amp2 0 65.535 SYMBOL_LINK "CalPrmBrkTqCtrlrBrk01.U16LfcRiseSuctnPGrdtNo1VlvCur6" 0 /end CHARACTERISTIC
/begin CHARACTERISTIC U16LfcRiseSuctnPGrdtNo1VlvCur7 "NO valve current at target brake pressure gradient 7 point with suction" VALUE 0x80021282 CalPrmBrkTqCtrlrBrk_UWORD 0 Amp2 0 65.535 SYMBOL_LINK "CalPrmBrkTqCtrlrBrk01.U16LfcRiseSuctnPGrdtNo1VlvCur7" 0 /end CHARACTERISTIC
/begin CHARACTERISTIC U16MotUAbsVehSpd "If vehicle speed is smaller than this value, target motor voltage is U16VehSpdMotUAbs" VALUE 0x800213F6 CalPrmBrkTqCtrlrBrk_UWORD 0 Spd11 0 1023.984375 SYMBOL_LINK "CalPrmBrkTqCtrlrBrk01.U16MotUAbsVehSpd" 0 /end CHARACTERISTIC
/begin CHARACTERISTIC U16MotUWslcLatCombNotSuctn "Target motot voltage in ABS with lateral dynamics control without suction" VALUE 0x80021406 CalPrmBrkTqCtrlrBrk_UWORD 0 U11 0 65.535 SYMBOL_LINK "CalPrmBrkTqCtrlrBrk01.U16MotUWslcLatCombNotSuctn" 0 /end CHARACTERISTIC
/begin CHARACTERISTIC U16MotUWslcLatCombSuctn "Target motot voltage in ABS with lateral dynamics control with suction" VALUE 0x80021404 CalPrmBrkTqCtrlrBrk_UWORD 0 U11 0 65.535 SYMBOL_LINK "CalPrmBrkTqCtrlrBrk01.U16MotUWslcLatCombSuctn" 0 /end CHARACTERISTIC
/begin CHARACTERISTIC U16MstCylPIniMotUAbs1 "Target motot voltage in ABS initial acitvation at master pressure 1point" VALUE 0x800213E4 CalPrmBrkTqCtrlrBrk_UWORD 0 U11 0 65.535 SYMBOL_LINK "CalPrmBrkTqCtrlrBrk01.U16MstCylPIniMotUAbs1" 0 /end CHARACTERISTIC
/begin CHARACTERISTIC U16MstCylPIniMotUAbs2 "Target motot voltage in ABS initial acitvation at master pressure 2point" VALUE 0x800213E6 CalPrmBrkTqCtrlrBrk_UWORD 0 U11 0 65.535 SYMBOL_LINK "CalPrmBrkTqCtrlrBrk01.U16MstCylPIniMotUAbs2" 0 /end CHARACTERISTIC
/begin CHARACTERISTIC U16MstCylPIniMotUAbs3 "Target motot voltage in ABS initial acitvation at master pressure 3point" VALUE 0x800213E8 CalPrmBrkTqCtrlrBrk_UWORD 0 U11 0 65.535 SYMBOL_LINK "CalPrmBrkTqCtrlrBrk01.U16MstCylPIniMotUAbs3" 0 /end CHARACTERISTIC
/begin CHARACTERISTIC U16MstCylPIniMotUAbs4 "Target motot voltage in ABS initial acitvation at master pressure 4point" VALUE 0x800213EA CalPrmBrkTqCtrlrBrk_UWORD 0 U11 0 65.535 SYMBOL_LINK "CalPrmBrkTqCtrlrBrk01.U16MstCylPIniMotUAbs4" 0 /end CHARACTERISTIC
/begin CHARACTERISTIC U16No1VlvCurMax "NO valve max current (for controller)" VALUE 0x80021262 CalPrmBrkTqCtrlrBrk_UWORD 0 Amp2 0 65.535 SYMBOL_LINK "CalPrmBrkTqCtrlrBrk01.U16No1VlvCurMax" 0 /end CHARACTERISTIC
/begin CHARACTERISTIC U16No1VlvCurMin "NO valve min current" VALUE 0x80021260 CalPrmBrkTqCtrlrBrk_UWORD 0 Amp2 0 65.535 SYMBOL_LINK "CalPrmBrkTqCtrlrBrk01.U16No1VlvCurMin" 0 /end CHARACTERISTIC
/begin CHARACTERISTIC U16No1VlvCurSysMax "NO valve max current (system limit)" VALUE 0x80021264 CalPrmBrkTqCtrlrBrk_UWORD 0 Amp2 0 65.535 SYMBOL_LINK "CalPrmBrkTqCtrlrBrk01.U16No1VlvCurSysMax" 0 /end CHARACTERISTIC
/begin CHARACTERISTIC U16PlsDumpPGrdtP1 "Target brake pressure gradient for determine NC valve open time at pulse-up dump mode (1 point of 3 interpolation)" VALUE 0x800212F2 CalPrmBrkTqCtrlrBrk_UWORD 0 P32 0 655.35 SYMBOL_LINK "CalPrmBrkTqCtrlrBrk01.U16PlsDumpPGrdtP1" 0 /end CHARACTERISTIC
/begin CHARACTERISTIC U16PlsDumpPGrdtP2 "Target brake pressure gradient for determine NC valve open time at pulse-up dump mode (2 point of 3 interpolation)" VALUE 0x800212F4 CalPrmBrkTqCtrlrBrk_UWORD 0 P32 0 655.35 SYMBOL_LINK "CalPrmBrkTqCtrlrBrk01.U16PlsDumpPGrdtP2" 0 /end CHARACTERISTIC
/begin CHARACTERISTIC U16PlsDumpPGrdtP3 "Target brake pressure gradient for determine NC valve open time at pulse-up dump mode (3 point of 3 interpolation)" VALUE 0x800212F6 CalPrmBrkTqCtrlrBrk_UWORD 0 P32 0 655.35 SYMBOL_LINK "CalPrmBrkTqCtrlrBrk01.U16PlsDumpPGrdtP3" 0 /end CHARACTERISTIC
/begin CHARACTERISTIC U16PlsDumpPPGrdt1 "NC valve open time at target brake pressure gradient 1 point pulse-up dump mode" VALUE 0x800212F8 CalPrmBrkTqCtrlrBrk_UWORD 0 PGrdt11 0 6553.5 SYMBOL_LINK "CalPrmBrkTqCtrlrBrk01.U16PlsDumpPPGrdt1" 0 /end CHARACTERISTIC
/begin CHARACTERISTIC U16PlsDumpPPGrdt2 "NC valve open time at target brake pressure gradient 2 point pulse-up dump mode" VALUE 0x800212FA CalPrmBrkTqCtrlrBrk_UWORD 0 PGrdt11 0 6553.5 SYMBOL_LINK "CalPrmBrkTqCtrlrBrk01.U16PlsDumpPPGrdt2" 0 /end CHARACTERISTIC
/begin CHARACTERISTIC U16PlsDumpPPGrdt3 "NC valve open time at target brake pressure gradient 3 point pulse-up dump mode" VALUE 0x800212FC CalPrmBrkTqCtrlrBrk_UWORD 0 PGrdt11 0 6553.5 SYMBOL_LINK "CalPrmBrkTqCtrlrBrk01.U16PlsDumpPPGrdt3" 0 /end CHARACTERISTIC
/begin CHARACTERISTIC U16PlsRisePGrdt1 "Target brake pressure gradient for determine NO valve open time at pulse-up rise mode (1 point of 6 interpolation)" VALUE 0x800212E0 CalPrmBrkTqCtrlrBrk_UWORD 0 PGrdt11 0 6553.5 SYMBOL_LINK "CalPrmBrkTqCtrlrBrk01.U16PlsRisePGrdt1" 0 /end CHARACTERISTIC
/begin CHARACTERISTIC U16PlsRisePGrdt2 "Target brake pressure gradient for determine NO valve open time at pulse-up rise mode (2 point of 6 interpolation)" VALUE 0x800212E2 CalPrmBrkTqCtrlrBrk_UWORD 0 PGrdt11 0 6553.5 SYMBOL_LINK "CalPrmBrkTqCtrlrBrk01.U16PlsRisePGrdt2" 0 /end CHARACTERISTIC
/begin CHARACTERISTIC U16PlsRisePGrdt3 "Target brake pressure gradient for determine NO valve open time at pulse-up rise mode (3 point of 6 interpolation)" VALUE 0x800212E4 CalPrmBrkTqCtrlrBrk_UWORD 0 PGrdt11 0 6553.5 SYMBOL_LINK "CalPrmBrkTqCtrlrBrk01.U16PlsRisePGrdt3" 0 /end CHARACTERISTIC
/begin CHARACTERISTIC U16PlsRisePGrdt4 "Target brake pressure gradient for determine NO valve open time at pulse-up rise mode (4 point of 6 interpolation)" VALUE 0x800212E6 CalPrmBrkTqCtrlrBrk_UWORD 0 PGrdt11 0 6553.5 SYMBOL_LINK "CalPrmBrkTqCtrlrBrk01.U16PlsRisePGrdt4" 0 /end CHARACTERISTIC
/begin CHARACTERISTIC U16PlsRisePGrdt5 "Target brake pressure gradient for determine NO valve open time at pulse-up rise mode (5 point of 6 interpolation)" VALUE 0x800212E8 CalPrmBrkTqCtrlrBrk_UWORD 0 PGrdt11 0 6553.5 SYMBOL_LINK "CalPrmBrkTqCtrlrBrk01.U16PlsRisePGrdt5" 0 /end CHARACTERISTIC
/begin CHARACTERISTIC U16PlsRisePGrdt6 "Target brake pressure gradient for determine NO valve open time at pulse-up rise mode (5 point of 6 interpolation)" VALUE 0x800212EA CalPrmBrkTqCtrlrBrk_UWORD 0 PGrdt11 0 6553.5 SYMBOL_LINK "CalPrmBrkTqCtrlrBrk01.U16PlsRisePGrdt6" 0 /end CHARACTERISTIC
/begin CHARACTERISTIC U16RiseRateTestActtnTi1Whl "1wheel rise actuation time" VALUE 0x800214B0 CalPrmBrkTqCtrlrBrk_UWORD 0 Ti41 0 327.675 SYMBOL_LINK "CalPrmBrkTqCtrlrBrk01.U16RiseRateTestActtnTi1Whl" 0 /end CHARACTERISTIC
/begin CHARACTERISTIC U16RiseRateTestActtnTi4Whl "4wheel rise actuation time" VALUE 0x800214B6 CalPrmBrkTqCtrlrBrk_UWORD 0 Ti41 0 327.675 SYMBOL_LINK "CalPrmBrkTqCtrlrBrk01.U16RiseRateTestActtnTi4Whl" 0 /end CHARACTERISTIC
/begin CHARACTERISTIC U16RiseRateTestMotU1Whl "1wheel rise motor target voltage" VALUE 0x800214B2 CalPrmBrkTqCtrlrBrk_UWORD 0 U11 0 65.535 SYMBOL_LINK "CalPrmBrkTqCtrlrBrk01.U16RiseRateTestMotU1Whl" 0 /end CHARACTERISTIC
/begin CHARACTERISTIC U16RiseRateTestMotU4Whl "4wheel rise motor target voltage" VALUE 0x800214BA CalPrmBrkTqCtrlrBrk_UWORD 0 U11 0 65.535 SYMBOL_LINK "CalPrmBrkTqCtrlrBrk01.U16RiseRateTestMotU4Whl" 0 /end CHARACTERISTIC
/begin CHARACTERISTIC U16RiseRateTestMotUPrefill "Prefill motor target voltage when 4wheel rise test with prefill" VALUE 0x800214B8 CalPrmBrkTqCtrlrBrk_UWORD 0 U11 0 65.535 SYMBOL_LINK "CalPrmBrkTqCtrlrBrk01.U16RiseRateTestMotUPrefill" 0 /end CHARACTERISTIC
/begin CHARACTERISTIC U16TcVlvCurMapGainPrim "TC valve current map gain primary circuit" VALUE 0x800213B8 CalPrmBrkTqCtrlrBrk_UWORD 0 Gain 0 65535 SYMBOL_LINK "CalPrmBrkTqCtrlrBrk01.U16TcVlvCurMapGainPrim" 0 /end CHARACTERISTIC
/begin CHARACTERISTIC U16TcVlvCurMapGainSecd "TC valve current map gain secondary circuit" VALUE 0x800213BA CalPrmBrkTqCtrlrBrk_UWORD 0 Gain 0 65535 SYMBOL_LINK "CalPrmBrkTqCtrlrBrk01.U16TcVlvCurMapGainSecd" 0 /end CHARACTERISTIC
/begin CHARACTERISTIC U16TcVlvCurTestReleafCurHldTi "TC valve current hold time when when TC releaf test" VALUE 0x800214C8 CalPrmBrkTqCtrlrBrk_UWORD 0 Amp2 0 65.535 SYMBOL_LINK "CalPrmBrkTqCtrlrBrk01.U16TcVlvCurTestReleafCurHldTi" 0 /end CHARACTERISTIC
/begin CHARACTERISTIC U16TcVlvCurTestReleafCurMax "TC valve current max when when TC releaf test" VALUE 0x800214C6 CalPrmBrkTqCtrlrBrk_UWORD 0 Amp2 0 65.535 SYMBOL_LINK "CalPrmBrkTqCtrlrBrk01.U16TcVlvCurTestReleafCurMax" 0 /end CHARACTERISTIC
/begin CHARACTERISTIC U16TcVlvCurTestReleafIntlCur "Interval of TC valve current when TC releaf test" VALUE 0x800214C4 CalPrmBrkTqCtrlrBrk_UWORD 0 Amp2 0 65.535 SYMBOL_LINK "CalPrmBrkTqCtrlrBrk01.U16TcVlvCurTestReleafIntlCur" 0 /end CHARACTERISTIC
/begin CHARACTERISTIC U16TcVlvCurTestUpDwnCurHldTi "TC valve current hold time when when TC up-down test" VALUE 0x800214C2 CalPrmBrkTqCtrlrBrk_UWORD 0 Ti41 0 327.675 SYMBOL_LINK "CalPrmBrkTqCtrlrBrk01.U16TcVlvCurTestUpDwnCurHldTi" 0 /end CHARACTERISTIC
/begin CHARACTERISTIC U16TcVlvCurTestUpDwnCurMax "TC valve current max when when TC up-down test" VALUE 0x800214C0 CalPrmBrkTqCtrlrBrk_UWORD 0 Amp2 0 65.535 SYMBOL_LINK "CalPrmBrkTqCtrlrBrk01.U16TcVlvCurTestUpDwnCurMax" 0 /end CHARACTERISTIC
/begin CHARACTERISTIC U16TcVlvCurTestUpDwnIntlCur "Interval of TC valve current when TC up-down test" VALUE 0x800214BE CalPrmBrkTqCtrlrBrk_UWORD 0 Amp2 0 65.535 SYMBOL_LINK "CalPrmBrkTqCtrlrBrk01.U16TcVlvCurTestUpDwnIntlCur" 0 /end CHARACTERISTIC
/begin CHARACTERISTIC U16TcmfCmpHldIncTcVlvCurDyn "TC valve currrent increase margine at compoensation hold in dynamic control" VALUE 0x8002135A CalPrmBrkTqCtrlrBrk_UWORD 0 Amp2 0 65.535 SYMBOL_LINK "CalPrmBrkTqCtrlrBrk01.U16TcmfCmpHldIncTcVlvCurDyn" 0 /end CHARACTERISTIC
/begin CHARACTERISTIC U16TcmfCmpHldIncTcVlvCurSsm "TC valve currrent increase margine in SSM control" VALUE 0x80021358 CalPrmBrkTqCtrlrBrk_UWORD 0 Amp2 0 65.535 SYMBOL_LINK "CalPrmBrkTqCtrlrBrk01.U16TcmfCmpHldIncTcVlvCurSsm" 0 /end CHARACTERISTIC
/begin CHARACTERISTIC U16TcmfDumpDecTcVlvCurPGrdt1 "Target brake pressure gradient for determine TC valve currrent decrease margine at TCMF dump (1 point of 3 interpolation)" VALUE 0x8002135E CalPrmBrkTqCtrlrBrk_UWORD 0 PGrdt11 0 6553.5 SYMBOL_LINK "CalPrmBrkTqCtrlrBrk01.U16TcmfDumpDecTcVlvCurPGrdt1" 0 /end CHARACTERISTIC
/begin CHARACTERISTIC U16TcmfDumpDecTcVlvCurPGrdt2 "Target brake pressure gradient for determine TC valve currrent decrease margine at TCMF dump (2 point of 3 interpolation)" VALUE 0x80021360 CalPrmBrkTqCtrlrBrk_UWORD 0 PGrdt11 0 6553.5 SYMBOL_LINK "CalPrmBrkTqCtrlrBrk01.U16TcmfDumpDecTcVlvCurPGrdt2" 0 /end CHARACTERISTIC
/begin CHARACTERISTIC U16TcmfDumpDecTcVlvCurPGrdt3 "Target brake pressure gradient for determine TC valve currrent decrease margine at TCMF dump (3 point of 3 interpolation)" VALUE 0x80021362 CalPrmBrkTqCtrlrBrk_UWORD 0 PGrdt11 0 6553.5 SYMBOL_LINK "CalPrmBrkTqCtrlrBrk01.U16TcmfDumpDecTcVlvCurPGrdt3" 0 /end CHARACTERISTIC
/begin CHARACTERISTIC U16TcmfFbDecPErrTcVlvCur1 "Decrease TC valve current at pressure error 1 point" VALUE 0x800213C4 CalPrmBrkTqCtrlrBrk_UWORD 0 Amp2 0 65.535 SYMBOL_LINK "CalPrmBrkTqCtrlrBrk01.U16TcmfFbDecPErrTcVlvCur1" 0 /end CHARACTERISTIC
/begin CHARACTERISTIC U16TcmfFbDecPErrTcVlvCur2 "Decrease TC valve current at pressure error 2 point" VALUE 0x800213C6 CalPrmBrkTqCtrlrBrk_UWORD 0 Amp2 0 65.535 SYMBOL_LINK "CalPrmBrkTqCtrlrBrk01.U16TcmfFbDecPErrTcVlvCur2" 0 /end CHARACTERISTIC
/begin CHARACTERISTIC U16TcmfFbIncPErrTcVlvCur1 "Increase TC valve current at pressure error 1 point" VALUE 0x800213C0 CalPrmBrkTqCtrlrBrk_UWORD 0 Amp2 0 65.535 SYMBOL_LINK "CalPrmBrkTqCtrlrBrk01.U16TcmfFbIncPErrTcVlvCur1" 0 /end CHARACTERISTIC
/begin CHARACTERISTIC U16TcmfFbIncPErrTcVlvCur2 "Increase TC valve current at pressure error 2 point" VALUE 0x800213C2 CalPrmBrkTqCtrlrBrk_UWORD 0 Amp2 0 65.535 SYMBOL_LINK "CalPrmBrkTqCtrlrBrk01.U16TcmfFbIncPErrTcVlvCur2" 0 /end CHARACTERISTIC
/begin CHARACTERISTIC U16TcmfFbMotUPErr1 "Pressure error (target pressure - 3P sensor pressure) for determine compensation motor target voltage (1 point of 2 interpolation)" VALUE 0x8002148C CalPrmBrkTqCtrlrBrk_UWORD 0 P32 0 655.35 SYMBOL_LINK "CalPrmBrkTqCtrlrBrk01.U16TcmfFbMotUPErr1" 0 /end CHARACTERISTIC
/begin CHARACTERISTIC U16TcmfFbMotUPErr2 "Pressure error (target pressure - 3P sensor pressure) for determine compensation motor target voltage (2 point of 2 interpolation)" VALUE 0x8002148E CalPrmBrkTqCtrlrBrk_UWORD 0 P32 0 655.35 SYMBOL_LINK "CalPrmBrkTqCtrlrBrk01.U16TcmfFbMotUPErr2" 0 /end CHARACTERISTIC
/begin CHARACTERISTIC U16TcmfFbPErrMotU1 "Compensation motor target voltage at pressure error 1 point" VALUE 0x80021490 CalPrmBrkTqCtrlrBrk_UWORD 0 U11 0 65.535 SYMBOL_LINK "CalPrmBrkTqCtrlrBrk01.U16TcmfFbPErrMotU1" 0 /end CHARACTERISTIC
/begin CHARACTERISTIC U16TcmfFbPErrMotU2 "Compensation motor target voltage at pressure error 2 point" VALUE 0x80021492 CalPrmBrkTqCtrlrBrk_UWORD 0 U11 0 65.535 SYMBOL_LINK "CalPrmBrkTqCtrlrBrk01.U16TcmfFbPErrMotU2" 0 /end CHARACTERISTIC
/begin CHARACTERISTIC U16TcmfFbTcVlvCurPErr1 "Pressure error (target pressure - 3P sensor pressure) for determine compensation TC valve current  (1 point of 2 interpolation)" VALUE 0x800213BC CalPrmBrkTqCtrlrBrk_UWORD 0 P32 0 655.35 SYMBOL_LINK "CalPrmBrkTqCtrlrBrk01.U16TcmfFbTcVlvCurPErr1" 0 /end CHARACTERISTIC
/begin CHARACTERISTIC U16TcmfFbTcVlvCurPErr2 "Pressure error (target pressure - 3P sensor pressure) for determine compensation TC valve current  (2 point of 2 interpolation)" VALUE 0x800213BE CalPrmBrkTqCtrlrBrk_UWORD 0 P32 0 655.35 SYMBOL_LINK "CalPrmBrkTqCtrlrBrk01.U16TcmfFbTcVlvCurPErr2" 0 /end CHARACTERISTIC
/begin CHARACTERISTIC U16TcmfIniRiseInhbTiP1 "The end of same circuit target brake pressure for determine initial rise inhibtion time (1 point of 3 interpolation)" VALUE 0x80021322 CalPrmBrkTqCtrlrBrk_UWORD 0 P32 0 655.35 SYMBOL_LINK "CalPrmBrkTqCtrlrBrk01.U16TcmfIniRiseInhbTiP1" 0 /end CHARACTERISTIC
/begin CHARACTERISTIC U16TcmfIniRiseInhbTiP2 "The end of same circuit target brake pressure for determine initial rise inhibtion time (2 point of 3 interpolation)" VALUE 0x80021324 CalPrmBrkTqCtrlrBrk_UWORD 0 P32 0 655.35 SYMBOL_LINK "CalPrmBrkTqCtrlrBrk01.U16TcmfIniRiseInhbTiP2" 0 /end CHARACTERISTIC
/begin CHARACTERISTIC U16TcmfIniRiseInhbTiP3 "The end of same circuit target brake pressure for determine initial rise inhibtion time (3 point of 3 interpolation)" VALUE 0x80021326 CalPrmBrkTqCtrlrBrk_UWORD 0 P32 0 655.35 SYMBOL_LINK "CalPrmBrkTqCtrlrBrk01.U16TcmfIniRiseInhbTiP3" 0 /end CHARACTERISTIC
/begin CHARACTERISTIC U16TcmfIniRiseMotUPGrdtFrnt01 "Initial rise front target pressure gradient at motor 1V " VALUE 0x80021408 CalPrmBrkTqCtrlrBrk_UWORD 0 PGrdt11 0 6553.5 SYMBOL_LINK "CalPrmBrkTqCtrlrBrk01.U16TcmfIniRiseMotUPGrdtFrnt01" 0 /end CHARACTERISTIC
/begin CHARACTERISTIC U16TcmfIniRiseMotUPGrdtFrnt02 "Initial rise front target pressure gradient at motor 2V" VALUE 0x8002140A CalPrmBrkTqCtrlrBrk_UWORD 0 PGrdt11 0 6553.5 SYMBOL_LINK "CalPrmBrkTqCtrlrBrk01.U16TcmfIniRiseMotUPGrdtFrnt02" 0 /end CHARACTERISTIC
/begin CHARACTERISTIC U16TcmfIniRiseMotUPGrdtFrnt03 "Initial rise front target pressure gradient at motor 3V" VALUE 0x8002140C CalPrmBrkTqCtrlrBrk_UWORD 0 PGrdt11 0 6553.5 SYMBOL_LINK "CalPrmBrkTqCtrlrBrk01.U16TcmfIniRiseMotUPGrdtFrnt03" 0 /end CHARACTERISTIC
/begin CHARACTERISTIC U16TcmfIniRiseMotUPGrdtFrnt04 "Initial rise front target pressure gradient at motor 4V" VALUE 0x8002140E CalPrmBrkTqCtrlrBrk_UWORD 0 PGrdt11 0 6553.5 SYMBOL_LINK "CalPrmBrkTqCtrlrBrk01.U16TcmfIniRiseMotUPGrdtFrnt04" 0 /end CHARACTERISTIC
/begin CHARACTERISTIC U16TcmfIniRiseMotUPGrdtFrnt05 "Initial rise front target pressure gradient at motor 5V" VALUE 0x80021410 CalPrmBrkTqCtrlrBrk_UWORD 0 PGrdt11 0 6553.5 SYMBOL_LINK "CalPrmBrkTqCtrlrBrk01.U16TcmfIniRiseMotUPGrdtFrnt05" 0 /end CHARACTERISTIC
/begin CHARACTERISTIC U16TcmfIniRiseMotUPGrdtFrnt06 "Initial rise front target pressure gradient at motor 6V" VALUE 0x80021412 CalPrmBrkTqCtrlrBrk_UWORD 0 PGrdt11 0 6553.5 SYMBOL_LINK "CalPrmBrkTqCtrlrBrk01.U16TcmfIniRiseMotUPGrdtFrnt06" 0 /end CHARACTERISTIC
/begin CHARACTERISTIC U16TcmfIniRiseMotUPGrdtFrnt07 "Initial rise front target pressure gradient at motor 7V" VALUE 0x80021414 CalPrmBrkTqCtrlrBrk_UWORD 0 PGrdt11 0 6553.5 SYMBOL_LINK "CalPrmBrkTqCtrlrBrk01.U16TcmfIniRiseMotUPGrdtFrnt07" 0 /end CHARACTERISTIC
/begin CHARACTERISTIC U16TcmfIniRiseMotUPGrdtFrnt08 "Initial rise front target pressure gradient at motor 8V" VALUE 0x80021416 CalPrmBrkTqCtrlrBrk_UWORD 0 PGrdt11 0 6553.5 SYMBOL_LINK "CalPrmBrkTqCtrlrBrk01.U16TcmfIniRiseMotUPGrdtFrnt08" 0 /end CHARACTERISTIC
/begin CHARACTERISTIC U16TcmfIniRiseMotUPGrdtFrnt09 "Initial rise front target pressure gradient at motor 9V" VALUE 0x80021418 CalPrmBrkTqCtrlrBrk_UWORD 0 PGrdt11 0 6553.5 SYMBOL_LINK "CalPrmBrkTqCtrlrBrk01.U16TcmfIniRiseMotUPGrdtFrnt09" 0 /end CHARACTERISTIC
/begin CHARACTERISTIC U16TcmfIniRiseMotUPGrdtFrnt10 "Initial rise front target pressure gradient at motor 10V" VALUE 0x8002141A CalPrmBrkTqCtrlrBrk_UWORD 0 PGrdt11 0 6553.5 SYMBOL_LINK "CalPrmBrkTqCtrlrBrk01.U16TcmfIniRiseMotUPGrdtFrnt10" 0 /end CHARACTERISTIC
/begin CHARACTERISTIC U16TcmfIniRiseMotUPGrdtFrnt11 "Initial rise front target pressure gradient at motor 11V" VALUE 0x8002141C CalPrmBrkTqCtrlrBrk_UWORD 0 PGrdt11 0 6553.5 SYMBOL_LINK "CalPrmBrkTqCtrlrBrk01.U16TcmfIniRiseMotUPGrdtFrnt11" 0 /end CHARACTERISTIC
/begin CHARACTERISTIC U16TcmfIniRiseMotUPGrdtFrnt12 "Initial rise front target pressure gradient at motor 12V" VALUE 0x8002141E CalPrmBrkTqCtrlrBrk_UWORD 0 PGrdt11 0 6553.5 SYMBOL_LINK "CalPrmBrkTqCtrlrBrk01.U16TcmfIniRiseMotUPGrdtFrnt12" 0 /end CHARACTERISTIC
/begin CHARACTERISTIC U16TcmfIniRiseMotUPGrdtFrnt13 "Initial rise front target pressure gradient at motor 13V" VALUE 0x80021420 CalPrmBrkTqCtrlrBrk_UWORD 0 PGrdt11 0 6553.5 SYMBOL_LINK "CalPrmBrkTqCtrlrBrk01.U16TcmfIniRiseMotUPGrdtFrnt13" 0 /end CHARACTERISTIC
/begin CHARACTERISTIC U16TcmfIniRiseMotUPGrdtFrnt14 "Initial rise front target pressure gradient at motor 14V" VALUE 0x80021422 CalPrmBrkTqCtrlrBrk_UWORD 0 PGrdt11 0 6553.5 SYMBOL_LINK "CalPrmBrkTqCtrlrBrk01.U16TcmfIniRiseMotUPGrdtFrnt14" 0 /end CHARACTERISTIC
/begin CHARACTERISTIC U16TcmfIniRiseMotUPGrdtRe01 "Initial rise rear target pressure gradient at motor 1V" VALUE 0x80021424 CalPrmBrkTqCtrlrBrk_UWORD 0 PGrdt11 0 6553.5 SYMBOL_LINK "CalPrmBrkTqCtrlrBrk01.U16TcmfIniRiseMotUPGrdtRe01" 0 /end CHARACTERISTIC
/begin CHARACTERISTIC U16TcmfIniRiseMotUPGrdtRe02 "Initial rise rear target pressure gradient at motor 2V" VALUE 0x80021426 CalPrmBrkTqCtrlrBrk_UWORD 0 PGrdt11 0 6553.5 SYMBOL_LINK "CalPrmBrkTqCtrlrBrk01.U16TcmfIniRiseMotUPGrdtRe02" 0 /end CHARACTERISTIC
/begin CHARACTERISTIC U16TcmfIniRiseMotUPGrdtRe03 "Initial rise rear target pressure gradient at motor 3V" VALUE 0x80021428 CalPrmBrkTqCtrlrBrk_UWORD 0 PGrdt11 0 6553.5 SYMBOL_LINK "CalPrmBrkTqCtrlrBrk01.U16TcmfIniRiseMotUPGrdtRe03" 0 /end CHARACTERISTIC
/begin CHARACTERISTIC U16TcmfIniRiseMotUPGrdtRe04 "Initial rise rear target pressure gradient at motor 4V" VALUE 0x8002142A CalPrmBrkTqCtrlrBrk_UWORD 0 PGrdt11 0 6553.5 SYMBOL_LINK "CalPrmBrkTqCtrlrBrk01.U16TcmfIniRiseMotUPGrdtRe04" 0 /end CHARACTERISTIC
/begin CHARACTERISTIC U16TcmfIniRiseMotUPGrdtRe05 "Initial rise rear target pressure gradient at motor 5V" VALUE 0x8002142C CalPrmBrkTqCtrlrBrk_UWORD 0 PGrdt11 0 6553.5 SYMBOL_LINK "CalPrmBrkTqCtrlrBrk01.U16TcmfIniRiseMotUPGrdtRe05" 0 /end CHARACTERISTIC
/begin CHARACTERISTIC U16TcmfIniRiseMotUPGrdtRe06 "Initial rise rear target pressure gradient at motor 6V" VALUE 0x8002142E CalPrmBrkTqCtrlrBrk_UWORD 0 PGrdt11 0 6553.5 SYMBOL_LINK "CalPrmBrkTqCtrlrBrk01.U16TcmfIniRiseMotUPGrdtRe06" 0 /end CHARACTERISTIC
/begin CHARACTERISTIC U16TcmfIniRiseMotUPGrdtRe07 "Initial rise rear target pressure gradient at motor 7V" VALUE 0x80021430 CalPrmBrkTqCtrlrBrk_UWORD 0 PGrdt11 0 6553.5 SYMBOL_LINK "CalPrmBrkTqCtrlrBrk01.U16TcmfIniRiseMotUPGrdtRe07" 0 /end CHARACTERISTIC
/begin CHARACTERISTIC U16TcmfIniRiseMotUPGrdtRe08 "Initial rise rear target pressure gradient at motor 8V" VALUE 0x80021432 CalPrmBrkTqCtrlrBrk_UWORD 0 PGrdt11 0 6553.5 SYMBOL_LINK "CalPrmBrkTqCtrlrBrk01.U16TcmfIniRiseMotUPGrdtRe08" 0 /end CHARACTERISTIC
/begin CHARACTERISTIC U16TcmfIniRiseMotUPGrdtRe09 "Initial rise rear target pressure gradient at motor 9V" VALUE 0x80021434 CalPrmBrkTqCtrlrBrk_UWORD 0 PGrdt11 0 6553.5 SYMBOL_LINK "CalPrmBrkTqCtrlrBrk01.U16TcmfIniRiseMotUPGrdtRe09" 0 /end CHARACTERISTIC
/begin CHARACTERISTIC U16TcmfIniRiseMotUPGrdtRe10 "Initial rise rear target pressure gradient at motor 10V" VALUE 0x80021436 CalPrmBrkTqCtrlrBrk_UWORD 0 PGrdt11 0 6553.5 SYMBOL_LINK "CalPrmBrkTqCtrlrBrk01.U16TcmfIniRiseMotUPGrdtRe10" 0 /end CHARACTERISTIC
/begin CHARACTERISTIC U16TcmfIniRiseMotUPGrdtRe11 "Initial rise rear target pressure gradient at motor 11V" VALUE 0x80021438 CalPrmBrkTqCtrlrBrk_UWORD 0 PGrdt11 0 6553.5 SYMBOL_LINK "CalPrmBrkTqCtrlrBrk01.U16TcmfIniRiseMotUPGrdtRe11" 0 /end CHARACTERISTIC
/begin CHARACTERISTIC U16TcmfIniRiseMotUPGrdtRe12 "Initial rise rear target pressure gradient at motor 12V" VALUE 0x8002143A CalPrmBrkTqCtrlrBrk_UWORD 0 PGrdt11 0 6553.5 SYMBOL_LINK "CalPrmBrkTqCtrlrBrk01.U16TcmfIniRiseMotUPGrdtRe12" 0 /end CHARACTERISTIC
/begin CHARACTERISTIC U16TcmfIniRiseMotUPGrdtRe13 "Initial rise rear target pressure gradient at motor 13V" VALUE 0x8002143C CalPrmBrkTqCtrlrBrk_UWORD 0 PGrdt11 0 6553.5 SYMBOL_LINK "CalPrmBrkTqCtrlrBrk01.U16TcmfIniRiseMotUPGrdtRe13" 0 /end CHARACTERISTIC
/begin CHARACTERISTIC U16TcmfIniRiseMotUPGrdtRe14 "Initial rise rear target pressure gradient at motor 14V" VALUE 0x8002143E CalPrmBrkTqCtrlrBrk_UWORD 0 PGrdt11 0 6553.5 SYMBOL_LINK "CalPrmBrkTqCtrlrBrk01.U16TcmfIniRiseMotUPGrdtRe14" 0 /end CHARACTERISTIC
/begin CHARACTERISTIC U16TcmfPTcVlvCur01 "TC valve current at target brake pressure 1 point" VALUE 0x80021390 CalPrmBrkTqCtrlrBrk_UWORD 0 Amp2 0 65.535 SYMBOL_LINK "CalPrmBrkTqCtrlrBrk01.U16TcmfPTcVlvCur01" 0 /end CHARACTERISTIC
/begin CHARACTERISTIC U16TcmfPTcVlvCur02 "TC valve current at target brake pressure 2 point" VALUE 0x80021392 CalPrmBrkTqCtrlrBrk_UWORD 0 Amp2 0 65.535 SYMBOL_LINK "CalPrmBrkTqCtrlrBrk01.U16TcmfPTcVlvCur02" 0 /end CHARACTERISTIC
/begin CHARACTERISTIC U16TcmfPTcVlvCur03 "TC valve current at target brake pressure 3 point" VALUE 0x80021394 CalPrmBrkTqCtrlrBrk_UWORD 0 Amp2 0 65.535 SYMBOL_LINK "CalPrmBrkTqCtrlrBrk01.U16TcmfPTcVlvCur03" 0 /end CHARACTERISTIC
/begin CHARACTERISTIC U16TcmfPTcVlvCur04 "TC valve current at target brake pressure 4 point" VALUE 0x80021396 CalPrmBrkTqCtrlrBrk_UWORD 0 Amp2 0 65.535 SYMBOL_LINK "CalPrmBrkTqCtrlrBrk01.U16TcmfPTcVlvCur04" 0 /end CHARACTERISTIC
/begin CHARACTERISTIC U16TcmfPTcVlvCur05 "TC valve current at target brake pressure 5 point" VALUE 0x80021398 CalPrmBrkTqCtrlrBrk_UWORD 0 Amp2 0 65.535 SYMBOL_LINK "CalPrmBrkTqCtrlrBrk01.U16TcmfPTcVlvCur05" 0 /end CHARACTERISTIC
/begin CHARACTERISTIC U16TcmfPTcVlvCur06 "TC valve current at target brake pressure 6 point" VALUE 0x8002139A CalPrmBrkTqCtrlrBrk_UWORD 0 Amp2 0 65.535 SYMBOL_LINK "CalPrmBrkTqCtrlrBrk01.U16TcmfPTcVlvCur06" 0 /end CHARACTERISTIC
/begin CHARACTERISTIC U16TcmfPTcVlvCur07 "TC valve current at target brake pressure 7 point" VALUE 0x8002139C CalPrmBrkTqCtrlrBrk_UWORD 0 Amp2 0 65.535 SYMBOL_LINK "CalPrmBrkTqCtrlrBrk01.U16TcmfPTcVlvCur07" 0 /end CHARACTERISTIC
/begin CHARACTERISTIC U16TcmfPTcVlvCur08 "TC valve current at target brake pressure 8 point" VALUE 0x8002139E CalPrmBrkTqCtrlrBrk_UWORD 0 Amp2 0 65.535 SYMBOL_LINK "CalPrmBrkTqCtrlrBrk01.U16TcmfPTcVlvCur08" 0 /end CHARACTERISTIC
/begin CHARACTERISTIC U16TcmfPTcVlvCur09 "TC valve current at target brake pressure 9 point" VALUE 0x800213A0 CalPrmBrkTqCtrlrBrk_UWORD 0 Amp2 0 65.535 SYMBOL_LINK "CalPrmBrkTqCtrlrBrk01.U16TcmfPTcVlvCur09" 0 /end CHARACTERISTIC
/begin CHARACTERISTIC U16TcmfPTcVlvCur10 "TC valve current at target brake pressure 10 point" VALUE 0x800213A2 CalPrmBrkTqCtrlrBrk_UWORD 0 Amp2 0 65.535 SYMBOL_LINK "CalPrmBrkTqCtrlrBrk01.U16TcmfPTcVlvCur10" 0 /end CHARACTERISTIC
/begin CHARACTERISTIC U16TcmfPTcVlvCur11 "TC valve current at target brake pressure 11 point" VALUE 0x800213A4 CalPrmBrkTqCtrlrBrk_UWORD 0 Amp2 0 65.535 SYMBOL_LINK "CalPrmBrkTqCtrlrBrk01.U16TcmfPTcVlvCur11" 0 /end CHARACTERISTIC
/begin CHARACTERISTIC U16TcmfPTcVlvCur12 "TC valve current at target brake pressure 12 point" VALUE 0x800213A6 CalPrmBrkTqCtrlrBrk_UWORD 0 Amp2 0 65.535 SYMBOL_LINK "CalPrmBrkTqCtrlrBrk01.U16TcmfPTcVlvCur12" 0 /end CHARACTERISTIC
/begin CHARACTERISTIC U16TcmfPTcVlvCur13 "TC valve current at target brake pressure 13 point" VALUE 0x800213A8 CalPrmBrkTqCtrlrBrk_UWORD 0 Amp2 0 65.535 SYMBOL_LINK "CalPrmBrkTqCtrlrBrk01.U16TcmfPTcVlvCur13" 0 /end CHARACTERISTIC
/begin CHARACTERISTIC U16TcmfPTcVlvCur14 "TC valve current at target brake pressure 14 point" VALUE 0x800213AA CalPrmBrkTqCtrlrBrk_UWORD 0 Amp2 0 65.535 SYMBOL_LINK "CalPrmBrkTqCtrlrBrk01.U16TcmfPTcVlvCur14" 0 /end CHARACTERISTIC
/begin CHARACTERISTIC U16TcmfPTcVlvCur15 "TC valve current at target brake pressure 15 point" VALUE 0x800213AC CalPrmBrkTqCtrlrBrk_UWORD 0 Amp2 0 65.535 SYMBOL_LINK "CalPrmBrkTqCtrlrBrk01.U16TcmfPTcVlvCur15" 0 /end CHARACTERISTIC
/begin CHARACTERISTIC U16TcmfPTcVlvCur16 "TC valve current at target brake pressure 16 point" VALUE 0x800213AE CalPrmBrkTqCtrlrBrk_UWORD 0 Amp2 0 65.535 SYMBOL_LINK "CalPrmBrkTqCtrlrBrk01.U16TcmfPTcVlvCur16" 0 /end CHARACTERISTIC
/begin CHARACTERISTIC U16TcmfPTcVlvCur17 "TC valve current at target brake pressure 17 point" VALUE 0x800213B0 CalPrmBrkTqCtrlrBrk_UWORD 0 Amp2 0 65.535 SYMBOL_LINK "CalPrmBrkTqCtrlrBrk01.U16TcmfPTcVlvCur17" 0 /end CHARACTERISTIC
/begin CHARACTERISTIC U16TcmfPTcVlvCur18 "TC valve current at target brake pressure 18 point" VALUE 0x800213B2 CalPrmBrkTqCtrlrBrk_UWORD 0 Amp2 0 65.535 SYMBOL_LINK "CalPrmBrkTqCtrlrBrk01.U16TcmfPTcVlvCur18" 0 /end CHARACTERISTIC
/begin CHARACTERISTIC U16TcmfPTcVlvCur19 "TC valve current at target brake pressure 19 point" VALUE 0x800213B4 CalPrmBrkTqCtrlrBrk_UWORD 0 Amp2 0 65.535 SYMBOL_LINK "CalPrmBrkTqCtrlrBrk01.U16TcmfPTcVlvCur19" 0 /end CHARACTERISTIC
/begin CHARACTERISTIC U16TcmfPTcVlvCur20 "TC valve current at target brake pressure 20 point" VALUE 0x800213B6 CalPrmBrkTqCtrlrBrk_UWORD 0 Amp2 0 65.535 SYMBOL_LINK "CalPrmBrkTqCtrlrBrk01.U16TcmfPTcVlvCur20" 0 /end CHARACTERISTIC
/begin CHARACTERISTIC U16TcmfRiseIncTcVlvCurPGrdt1 "Target brake pressure gradient for determine TC valve currrent increase margine at TCMF rise (1 point of 3 interpolation)" VALUE 0x8002134C CalPrmBrkTqCtrlrBrk_UWORD 0 PGrdt11 0 6553.5 SYMBOL_LINK "CalPrmBrkTqCtrlrBrk01.U16TcmfRiseIncTcVlvCurPGrdt1" 0 /end CHARACTERISTIC
/begin CHARACTERISTIC U16TcmfRiseIncTcVlvCurPGrdt2 "Target brake pressure gradient for determine TC valve currrent increase margine at TCMF rise (2 point of 3 interpolation)" VALUE 0x8002134E CalPrmBrkTqCtrlrBrk_UWORD 0 PGrdt11 0 6553.5 SYMBOL_LINK "CalPrmBrkTqCtrlrBrk01.U16TcmfRiseIncTcVlvCurPGrdt2" 0 /end CHARACTERISTIC
/begin CHARACTERISTIC U16TcmfRiseIncTcVlvCurPGrdt3 "Target brake pressure gradient for determine TC valve currrent increase margine at TCMF rise (3 point of 3 interpolation)" VALUE 0x80021350 CalPrmBrkTqCtrlrBrk_UWORD 0 PGrdt11 0 6553.5 SYMBOL_LINK "CalPrmBrkTqCtrlrBrk01.U16TcmfRiseIncTcVlvCurPGrdt3" 0 /end CHARACTERISTIC
/begin CHARACTERISTIC U16TcmfRiseMotUPGrdtFrnt01 "Rise front target pressure gradient at motor 1V" VALUE 0x80021440 CalPrmBrkTqCtrlrBrk_UWORD 0 PGrdt11 0 6553.5 SYMBOL_LINK "CalPrmBrkTqCtrlrBrk01.U16TcmfRiseMotUPGrdtFrnt01" 0 /end CHARACTERISTIC
/begin CHARACTERISTIC U16TcmfRiseMotUPGrdtFrnt02 "Rise front target pressure gradient at motor 2V" VALUE 0x80021442 CalPrmBrkTqCtrlrBrk_UWORD 0 PGrdt11 0 6553.5 SYMBOL_LINK "CalPrmBrkTqCtrlrBrk01.U16TcmfRiseMotUPGrdtFrnt02" 0 /end CHARACTERISTIC
/begin CHARACTERISTIC U16TcmfRiseMotUPGrdtFrnt03 "Rise front target pressure gradient at motor 3V" VALUE 0x80021444 CalPrmBrkTqCtrlrBrk_UWORD 0 PGrdt11 0 6553.5 SYMBOL_LINK "CalPrmBrkTqCtrlrBrk01.U16TcmfRiseMotUPGrdtFrnt03" 0 /end CHARACTERISTIC
/begin CHARACTERISTIC U16TcmfRiseMotUPGrdtFrnt04 "Rise front target pressure gradient at motor 4V" VALUE 0x80021446 CalPrmBrkTqCtrlrBrk_UWORD 0 PGrdt11 0 6553.5 SYMBOL_LINK "CalPrmBrkTqCtrlrBrk01.U16TcmfRiseMotUPGrdtFrnt04" 0 /end CHARACTERISTIC
/begin CHARACTERISTIC U16TcmfRiseMotUPGrdtFrnt05 "Rise front target pressure gradient at motor 5V" VALUE 0x80021448 CalPrmBrkTqCtrlrBrk_UWORD 0 PGrdt11 0 6553.5 SYMBOL_LINK "CalPrmBrkTqCtrlrBrk01.U16TcmfRiseMotUPGrdtFrnt05" 0 /end CHARACTERISTIC
/begin CHARACTERISTIC U16TcmfRiseMotUPGrdtFrnt06 "Rise front target pressure gradient at motor 6V" VALUE 0x8002144A CalPrmBrkTqCtrlrBrk_UWORD 0 PGrdt11 0 6553.5 SYMBOL_LINK "CalPrmBrkTqCtrlrBrk01.U16TcmfRiseMotUPGrdtFrnt06" 0 /end CHARACTERISTIC
/begin CHARACTERISTIC U16TcmfRiseMotUPGrdtFrnt07 "Rise front target pressure gradient at motor 7V" VALUE 0x8002144C CalPrmBrkTqCtrlrBrk_UWORD 0 PGrdt11 0 6553.5 SYMBOL_LINK "CalPrmBrkTqCtrlrBrk01.U16TcmfRiseMotUPGrdtFrnt07" 0 /end CHARACTERISTIC
/begin CHARACTERISTIC U16TcmfRiseMotUPGrdtFrnt08 "Rise front target pressure gradient at motor 8V" VALUE 0x8002144E CalPrmBrkTqCtrlrBrk_UWORD 0 PGrdt11 0 6553.5 SYMBOL_LINK "CalPrmBrkTqCtrlrBrk01.U16TcmfRiseMotUPGrdtFrnt08" 0 /end CHARACTERISTIC
/begin CHARACTERISTIC U16TcmfRiseMotUPGrdtFrnt09 "Rise front target pressure gradient at motor 9V" VALUE 0x80021450 CalPrmBrkTqCtrlrBrk_UWORD 0 PGrdt11 0 6553.5 SYMBOL_LINK "CalPrmBrkTqCtrlrBrk01.U16TcmfRiseMotUPGrdtFrnt09" 0 /end CHARACTERISTIC
/begin CHARACTERISTIC U16TcmfRiseMotUPGrdtFrnt10 "Rise front target pressure gradient at motor 10V" VALUE 0x80021452 CalPrmBrkTqCtrlrBrk_UWORD 0 PGrdt11 0 6553.5 SYMBOL_LINK "CalPrmBrkTqCtrlrBrk01.U16TcmfRiseMotUPGrdtFrnt10" 0 /end CHARACTERISTIC
/begin CHARACTERISTIC U16TcmfRiseMotUPGrdtFrnt11 "Rise front target pressure gradient at motor 11V" VALUE 0x80021454 CalPrmBrkTqCtrlrBrk_UWORD 0 PGrdt11 0 6553.5 SYMBOL_LINK "CalPrmBrkTqCtrlrBrk01.U16TcmfRiseMotUPGrdtFrnt11" 0 /end CHARACTERISTIC
/begin CHARACTERISTIC U16TcmfRiseMotUPGrdtFrnt12 "Rise front target pressure gradient at motor 12V" VALUE 0x80021456 CalPrmBrkTqCtrlrBrk_UWORD 0 PGrdt11 0 6553.5 SYMBOL_LINK "CalPrmBrkTqCtrlrBrk01.U16TcmfRiseMotUPGrdtFrnt12" 0 /end CHARACTERISTIC
/begin CHARACTERISTIC U16TcmfRiseMotUPGrdtFrnt13 "Rise front target pressure gradient at motor 13V" VALUE 0x80021458 CalPrmBrkTqCtrlrBrk_UWORD 0 PGrdt11 0 6553.5 SYMBOL_LINK "CalPrmBrkTqCtrlrBrk01.U16TcmfRiseMotUPGrdtFrnt13" 0 /end CHARACTERISTIC
/begin CHARACTERISTIC U16TcmfRiseMotUPGrdtFrnt14 "Rise front target pressure gradient at motor 14V" VALUE 0x8002145A CalPrmBrkTqCtrlrBrk_UWORD 0 PGrdt11 0 6553.5 SYMBOL_LINK "CalPrmBrkTqCtrlrBrk01.U16TcmfRiseMotUPGrdtFrnt14" 0 /end CHARACTERISTIC
/begin CHARACTERISTIC U16TcmfRiseMotUPGrdtRe01 "Rise rear target pressure gradient at motor 1V" VALUE 0x8002145C CalPrmBrkTqCtrlrBrk_UWORD 0 PGrdt11 0 6553.5 SYMBOL_LINK "CalPrmBrkTqCtrlrBrk01.U16TcmfRiseMotUPGrdtRe01" 0 /end CHARACTERISTIC
/begin CHARACTERISTIC U16TcmfRiseMotUPGrdtRe02 "Rise rear target pressure gradient at motor 2V" VALUE 0x8002145E CalPrmBrkTqCtrlrBrk_UWORD 0 PGrdt11 0 6553.5 SYMBOL_LINK "CalPrmBrkTqCtrlrBrk01.U16TcmfRiseMotUPGrdtRe02" 0 /end CHARACTERISTIC
/begin CHARACTERISTIC U16TcmfRiseMotUPGrdtRe03 "Rise rear target pressure gradient at motor 3V" VALUE 0x80021460 CalPrmBrkTqCtrlrBrk_UWORD 0 PGrdt11 0 6553.5 SYMBOL_LINK "CalPrmBrkTqCtrlrBrk01.U16TcmfRiseMotUPGrdtRe03" 0 /end CHARACTERISTIC
/begin CHARACTERISTIC U16TcmfRiseMotUPGrdtRe04 "Rise rear target pressure gradient at motor 4V" VALUE 0x80021462 CalPrmBrkTqCtrlrBrk_UWORD 0 PGrdt11 0 6553.5 SYMBOL_LINK "CalPrmBrkTqCtrlrBrk01.U16TcmfRiseMotUPGrdtRe04" 0 /end CHARACTERISTIC
/begin CHARACTERISTIC U16TcmfRiseMotUPGrdtRe05 "Rise rear target pressure gradient at motor 5V" VALUE 0x80021464 CalPrmBrkTqCtrlrBrk_UWORD 0 PGrdt11 0 6553.5 SYMBOL_LINK "CalPrmBrkTqCtrlrBrk01.U16TcmfRiseMotUPGrdtRe05" 0 /end CHARACTERISTIC
/begin CHARACTERISTIC U16TcmfRiseMotUPGrdtRe06 "Rise rear target pressure gradient at motor 6V" VALUE 0x80021466 CalPrmBrkTqCtrlrBrk_UWORD 0 PGrdt11 0 6553.5 SYMBOL_LINK "CalPrmBrkTqCtrlrBrk01.U16TcmfRiseMotUPGrdtRe06" 0 /end CHARACTERISTIC
/begin CHARACTERISTIC U16TcmfRiseMotUPGrdtRe07 "Rise rear target pressure gradient at motor 7V" VALUE 0x80021468 CalPrmBrkTqCtrlrBrk_UWORD 0 PGrdt11 0 6553.5 SYMBOL_LINK "CalPrmBrkTqCtrlrBrk01.U16TcmfRiseMotUPGrdtRe07" 0 /end CHARACTERISTIC
/begin CHARACTERISTIC U16TcmfRiseMotUPGrdtRe08 "Rise rear target pressure gradient at motor 8V" VALUE 0x8002146A CalPrmBrkTqCtrlrBrk_UWORD 0 PGrdt11 0 6553.5 SYMBOL_LINK "CalPrmBrkTqCtrlrBrk01.U16TcmfRiseMotUPGrdtRe08" 0 /end CHARACTERISTIC
/begin CHARACTERISTIC U16TcmfRiseMotUPGrdtRe09 "Rise rear target pressure gradient at motor 9V" VALUE 0x8002146C CalPrmBrkTqCtrlrBrk_UWORD 0 PGrdt11 0 6553.5 SYMBOL_LINK "CalPrmBrkTqCtrlrBrk01.U16TcmfRiseMotUPGrdtRe09" 0 /end CHARACTERISTIC
/begin CHARACTERISTIC U16TcmfRiseMotUPGrdtRe10 "Rise rear target pressure gradient at motor 10V" VALUE 0x8002146E CalPrmBrkTqCtrlrBrk_UWORD 0 PGrdt11 0 6553.5 SYMBOL_LINK "CalPrmBrkTqCtrlrBrk01.U16TcmfRiseMotUPGrdtRe10" 0 /end CHARACTERISTIC
/begin CHARACTERISTIC U16TcmfRiseMotUPGrdtRe11 "Rise rear target pressure gradient at motor 11V" VALUE 0x80021470 CalPrmBrkTqCtrlrBrk_UWORD 0 PGrdt11 0 6553.5 SYMBOL_LINK "CalPrmBrkTqCtrlrBrk01.U16TcmfRiseMotUPGrdtRe11" 0 /end CHARACTERISTIC
/begin CHARACTERISTIC U16TcmfRiseMotUPGrdtRe12 "Rise rear target pressure gradient at motor 12V" VALUE 0x80021472 CalPrmBrkTqCtrlrBrk_UWORD 0 PGrdt11 0 6553.5 SYMBOL_LINK "CalPrmBrkTqCtrlrBrk01.U16TcmfRiseMotUPGrdtRe12" 0 /end CHARACTERISTIC
/begin CHARACTERISTIC U16TcmfRiseMotUPGrdtRe13 "Rise rear target pressure gradient at motor 13V" VALUE 0x80021474 CalPrmBrkTqCtrlrBrk_UWORD 0 PGrdt11 0 6553.5 SYMBOL_LINK "CalPrmBrkTqCtrlrBrk01.U16TcmfRiseMotUPGrdtRe13" 0 /end CHARACTERISTIC
/begin CHARACTERISTIC U16TcmfRiseMotUPGrdtRe14 "Rise rear target pressure gradient at motor 14V" VALUE 0x80021476 CalPrmBrkTqCtrlrBrk_UWORD 0 PGrdt11 0 6553.5 SYMBOL_LINK "CalPrmBrkTqCtrlrBrk01.U16TcmfRiseMotUPGrdtRe14" 0 /end CHARACTERISTIC
/begin CHARACTERISTIC U16TcmfRisePatCur "Rise pattern TC valve current" VALUE 0x8002134A CalPrmBrkTqCtrlrBrk_UWORD 0 Amp2 0 65.535 SYMBOL_LINK "CalPrmBrkTqCtrlrBrk01.U16TcmfRisePatCur" 0 /end CHARACTERISTIC
/begin CHARACTERISTIC U16TcmfRisePatPGrdtFrnt1 "Front target brake pressure gradient for determine rise pattern time at TCMF rise mode (1 point of 3 interpolation)" VALUE 0x80021332 CalPrmBrkTqCtrlrBrk_UWORD 0 PGrdt11 0 6553.5 SYMBOL_LINK "CalPrmBrkTqCtrlrBrk01.U16TcmfRisePatPGrdtFrnt1" 0 /end CHARACTERISTIC
/begin CHARACTERISTIC U16TcmfRisePatPGrdtFrnt2 "Front target brake pressure gradient for determine rise pattern time at TCMF rise mode (2 point of 3 interpolation)" VALUE 0x80021334 CalPrmBrkTqCtrlrBrk_UWORD 0 PGrdt11 0 6553.5 SYMBOL_LINK "CalPrmBrkTqCtrlrBrk01.U16TcmfRisePatPGrdtFrnt2" 0 /end CHARACTERISTIC
/begin CHARACTERISTIC U16TcmfRisePatPGrdtFrnt3 "Front target brake pressure gradient for determine rise pattern time at TCMF rise mode (3 point of 3 interpolation)" VALUE 0x80021336 CalPrmBrkTqCtrlrBrk_UWORD 0 PGrdt11 0 6553.5 SYMBOL_LINK "CalPrmBrkTqCtrlrBrk01.U16TcmfRisePatPGrdtFrnt3" 0 /end CHARACTERISTIC
/begin CHARACTERISTIC U16TcmfRisePatPGrdtRe1 "Rear target brake pressure gradient for determine rise pattern time at TCMF rise mode (1 point of 3 interpolation)" VALUE 0x8002133E CalPrmBrkTqCtrlrBrk_UWORD 0 PGrdt11 0 6553.5 SYMBOL_LINK "CalPrmBrkTqCtrlrBrk01.U16TcmfRisePatPGrdtRe1" 0 /end CHARACTERISTIC
/begin CHARACTERISTIC U16TcmfRisePatPGrdtRe2 "Rear target brake pressure gradient for determine rise pattern time at TCMF rise mode (2 point of 3 interpolation)" VALUE 0x80021340 CalPrmBrkTqCtrlrBrk_UWORD 0 PGrdt11 0 6553.5 SYMBOL_LINK "CalPrmBrkTqCtrlrBrk01.U16TcmfRisePatPGrdtRe2" 0 /end CHARACTERISTIC
/begin CHARACTERISTIC U16TcmfRisePatPGrdtRe3 "Rear target brake pressure gradient for determine rise pattern time at TCMF rise mode (3 point of 3 interpolation)" VALUE 0x80021342 CalPrmBrkTqCtrlrBrk_UWORD 0 PGrdt11 0 6553.5 SYMBOL_LINK "CalPrmBrkTqCtrlrBrk01.U16TcmfRisePatPGrdtRe3" 0 /end CHARACTERISTIC
/begin CHARACTERISTIC U16TcmfTcVlvCurP01 "Target brake pressure for determine TC current (1 point of 20 interpolation)" VALUE 0x80021368 CalPrmBrkTqCtrlrBrk_UWORD 0 P32 0 655.35 SYMBOL_LINK "CalPrmBrkTqCtrlrBrk01.U16TcmfTcVlvCurP01" 0 /end CHARACTERISTIC
/begin CHARACTERISTIC U16TcmfTcVlvCurP02 "Target brake pressure for determine TC current (2 point of 20 interpolation)" VALUE 0x8002136A CalPrmBrkTqCtrlrBrk_UWORD 0 P32 0 655.35 SYMBOL_LINK "CalPrmBrkTqCtrlrBrk01.U16TcmfTcVlvCurP02" 0 /end CHARACTERISTIC
/begin CHARACTERISTIC U16TcmfTcVlvCurP03 "Target brake pressure for determine TC current (3 point of 20 interpolation)" VALUE 0x8002136C CalPrmBrkTqCtrlrBrk_UWORD 0 P32 0 655.35 SYMBOL_LINK "CalPrmBrkTqCtrlrBrk01.U16TcmfTcVlvCurP03" 0 /end CHARACTERISTIC
/begin CHARACTERISTIC U16TcmfTcVlvCurP04 "Target brake pressure for determine TC current (4 point of 20 interpolation)" VALUE 0x8002136E CalPrmBrkTqCtrlrBrk_UWORD 0 P32 0 655.35 SYMBOL_LINK "CalPrmBrkTqCtrlrBrk01.U16TcmfTcVlvCurP04" 0 /end CHARACTERISTIC
/begin CHARACTERISTIC U16TcmfTcVlvCurP05 "Target brake pressure for determine TC current (5 point of 20 interpolation)" VALUE 0x80021370 CalPrmBrkTqCtrlrBrk_UWORD 0 P32 0 655.35 SYMBOL_LINK "CalPrmBrkTqCtrlrBrk01.U16TcmfTcVlvCurP05" 0 /end CHARACTERISTIC
/begin CHARACTERISTIC U16TcmfTcVlvCurP06 "Target brake pressure for determine TC current (6 point of 20 interpolation)" VALUE 0x80021372 CalPrmBrkTqCtrlrBrk_UWORD 0 P32 0 655.35 SYMBOL_LINK "CalPrmBrkTqCtrlrBrk01.U16TcmfTcVlvCurP06" 0 /end CHARACTERISTIC
/begin CHARACTERISTIC U16TcmfTcVlvCurP07 "Target brake pressure for determine TC current (7 point of 20 interpolation)" VALUE 0x80021374 CalPrmBrkTqCtrlrBrk_UWORD 0 P32 0 655.35 SYMBOL_LINK "CalPrmBrkTqCtrlrBrk01.U16TcmfTcVlvCurP07" 0 /end CHARACTERISTIC
/begin CHARACTERISTIC U16TcmfTcVlvCurP08 "Target brake pressure for determine TC current (8 point of 20 interpolation)" VALUE 0x80021376 CalPrmBrkTqCtrlrBrk_UWORD 0 P32 0 655.35 SYMBOL_LINK "CalPrmBrkTqCtrlrBrk01.U16TcmfTcVlvCurP08" 0 /end CHARACTERISTIC
/begin CHARACTERISTIC U16TcmfTcVlvCurP09 "Target brake pressure for determine TC current (9 point of 20 interpolation)" VALUE 0x80021378 CalPrmBrkTqCtrlrBrk_UWORD 0 P32 0 655.35 SYMBOL_LINK "CalPrmBrkTqCtrlrBrk01.U16TcmfTcVlvCurP09" 0 /end CHARACTERISTIC
/begin CHARACTERISTIC U16TcmfTcVlvCurP10 "Target brake pressure for determine TC current (10 point of 20 interpolation)" VALUE 0x8002137A CalPrmBrkTqCtrlrBrk_UWORD 0 P32 0 655.35 SYMBOL_LINK "CalPrmBrkTqCtrlrBrk01.U16TcmfTcVlvCurP10" 0 /end CHARACTERISTIC
/begin CHARACTERISTIC U16TcmfTcVlvCurP11 "Target brake pressure for determine TC current (11 point of 20 interpolation)" VALUE 0x8002137C CalPrmBrkTqCtrlrBrk_UWORD 0 P32 0 655.35 SYMBOL_LINK "CalPrmBrkTqCtrlrBrk01.U16TcmfTcVlvCurP11" 0 /end CHARACTERISTIC
/begin CHARACTERISTIC U16TcmfTcVlvCurP12 "Target brake pressure for determine TC current (12 point of 20 interpolation)" VALUE 0x8002137E CalPrmBrkTqCtrlrBrk_UWORD 0 P32 0 655.35 SYMBOL_LINK "CalPrmBrkTqCtrlrBrk01.U16TcmfTcVlvCurP12" 0 /end CHARACTERISTIC
/begin CHARACTERISTIC U16TcmfTcVlvCurP13 "Target brake pressure for determine TC current (13 point of 20 interpolation)" VALUE 0x80021380 CalPrmBrkTqCtrlrBrk_UWORD 0 P32 0 655.35 SYMBOL_LINK "CalPrmBrkTqCtrlrBrk01.U16TcmfTcVlvCurP13" 0 /end CHARACTERISTIC
/begin CHARACTERISTIC U16TcmfTcVlvCurP14 "Target brake pressure for determine TC current (14 point of 20 interpolation)" VALUE 0x80021382 CalPrmBrkTqCtrlrBrk_UWORD 0 P32 0 655.35 SYMBOL_LINK "CalPrmBrkTqCtrlrBrk01.U16TcmfTcVlvCurP14" 0 /end CHARACTERISTIC
/begin CHARACTERISTIC U16TcmfTcVlvCurP15 "Target brake pressure for determine TC current (15 point of 20 interpolation)" VALUE 0x80021384 CalPrmBrkTqCtrlrBrk_UWORD 0 P32 0 655.35 SYMBOL_LINK "CalPrmBrkTqCtrlrBrk01.U16TcmfTcVlvCurP15" 0 /end CHARACTERISTIC
/begin CHARACTERISTIC U16TcmfTcVlvCurP16 "Target brake pressure for determine TC current (16 point of 20 interpolation)" VALUE 0x80021386 CalPrmBrkTqCtrlrBrk_UWORD 0 P32 0 655.35 SYMBOL_LINK "CalPrmBrkTqCtrlrBrk01.U16TcmfTcVlvCurP16" 0 /end CHARACTERISTIC
/begin CHARACTERISTIC U16TcmfTcVlvCurP17 "Target brake pressure for determine TC current (17 point of 20 interpolation)" VALUE 0x80021388 CalPrmBrkTqCtrlrBrk_UWORD 0 P32 0 655.35 SYMBOL_LINK "CalPrmBrkTqCtrlrBrk01.U16TcmfTcVlvCurP17" 0 /end CHARACTERISTIC
/begin CHARACTERISTIC U16TcmfTcVlvCurP18 "Target brake pressure for determine TC current (18 point of 20 interpolation)" VALUE 0x8002138A CalPrmBrkTqCtrlrBrk_UWORD 0 P32 0 655.35 SYMBOL_LINK "CalPrmBrkTqCtrlrBrk01.U16TcmfTcVlvCurP18" 0 /end CHARACTERISTIC
/begin CHARACTERISTIC U16TcmfTcVlvCurP19 "Target brake pressure for determine TC current (19 point of 20 interpolation)" VALUE 0x8002138C CalPrmBrkTqCtrlrBrk_UWORD 0 P32 0 655.35 SYMBOL_LINK "CalPrmBrkTqCtrlrBrk01.U16TcmfTcVlvCurP19" 0 /end CHARACTERISTIC
/begin CHARACTERISTIC U16TcmfTcVlvCurP20 "Target brake pressure for determine TC current (20 point of 20 interpolation)" VALUE 0x8002138E CalPrmBrkTqCtrlrBrk_UWORD 0 P32 0 655.35 SYMBOL_LINK "CalPrmBrkTqCtrlrBrk01.U16TcmfTcVlvCurP20" 0 /end CHARACTERISTIC
/begin CHARACTERISTIC U16VehSpdMotUAbs "Target motor voltage when vehicle speed is smaller than U16MotUAbsVehSpd" VALUE 0x800213F8 CalPrmBrkTqCtrlrBrk_UWORD 0 U11 0 65.535 SYMBOL_LINK "CalPrmBrkTqCtrlrBrk01.U16VehSpdMotUAbs" 0 /end CHARACTERISTIC
/begin CHARACTERISTIC U16WslcNo1VlvDutyMax "NO valve max duty from wheel slip coordinator" VALUE 0x80021266 CalPrmBrkTqCtrlrBrk_UWORD 0 Perc6 0 65535 SYMBOL_LINK "CalPrmBrkTqCtrlrBrk01.U16WslcNo1VlvDutyMax" 0 /end CHARACTERISTIC
/begin CHARACTERISTIC U16_ACC_BRK_INIT_CTRL_TIME "Time for ACC initial control of  brake torque gradient. If brake control engaged, maximum torque gradient output for high pressure build up" VALUE 0x80021036 CalPrmVehLgtCoorrBrk_UWORD 0 Ti31 0 65.535 SYMBOL_LINK "CalPrmVehLgtCoorrBrk01.U16_ACC_BRK_INIT_CTRL_TIME" 0 /end CHARACTERISTIC
/begin CHARACTERISTIC U16_ACC_BRK_TQ_GRDT_MAX "ACC Maximum brake torque gradient" VALUE 0x80021044 CalPrmVehLgtCoorrBrk_UWORD 0 Tq2 0 65535 SYMBOL_LINK "CalPrmVehLgtCoorrBrk01.U16_ACC_BRK_TQ_GRDT_MAX" 0 /end CHARACTERISTIC
/begin CHARACTERISTIC U16_ACC_BRK_TQ_RATE_1 "ACC Brake torque gradient level 1" VALUE 0x80021038 CalPrmVehLgtCoorrBrk_UWORD 0 Tq2 0 65535 SYMBOL_LINK "CalPrmVehLgtCoorrBrk01.U16_ACC_BRK_TQ_RATE_1" 0 /end CHARACTERISTIC
/begin CHARACTERISTIC U16_ACC_BRK_TQ_RATE_2 "ACC Brake torque gradient level 2" VALUE 0x8002103A CalPrmVehLgtCoorrBrk_UWORD 0 Tq2 0 65535 SYMBOL_LINK "CalPrmVehLgtCoorrBrk01.U16_ACC_BRK_TQ_RATE_2" 0 /end CHARACTERISTIC
/begin CHARACTERISTIC U16_ACC_BRK_TQ_RATE_TIME_1 "ACC Brake torque gradient output time level 1" VALUE 0x8002103C CalPrmVehLgtCoorrBrk_UWORD 0 Ti31 0 65.535 SYMBOL_LINK "CalPrmVehLgtCoorrBrk01.U16_ACC_BRK_TQ_RATE_TIME_1" 0 /end CHARACTERISTIC
/begin CHARACTERISTIC U16_ACC_BRK_TQ_RATE_TIME_2 "ACC Brake torque gradient output time level 2" VALUE 0x8002103E CalPrmVehLgtCoorrBrk_UWORD 0 Ti31 0 65.535 SYMBOL_LINK "CalPrmVehLgtCoorrBrk01.U16_ACC_BRK_TQ_RATE_TIME_2" 0 /end CHARACTERISTIC
/begin CHARACTERISTIC U16_ACC_INIT_ADD_BRK_TQ_GRDT_MAX "ACC Maximum additional brake torque gradient for initial control." VALUE 0x80021042 CalPrmVehLgtCoorrBrk_UWORD 0 Tq2 0 65535 SYMBOL_LINK "CalPrmVehLgtCoorrBrk01.U16_ACC_INIT_ADD_BRK_TQ_GRDT_MAX" 0 /end CHARACTERISTIC
/begin CHARACTERISTIC U16_ACC_INIT_ADD_BRK_TQ_GRDT_MIN "ACC Minimum additional brake torque gradient for initial control." VALUE 0x80021040 CalPrmVehLgtCoorrBrk_UWORD 0 Tq2 0 65535 SYMBOL_LINK "CalPrmVehLgtCoorrBrk01.U16_ACC_INIT_ADD_BRK_TQ_GRDT_MIN" 0 /end CHARACTERISTIC
/begin CHARACTERISTIC U16_AEB_BRK_INIT_CTRL_TIME "Time for AEB initial control of  brake torque gradient. If brake control engaged, maximum torque gradient output for high pressure build up" VALUE 0x80021054 CalPrmVehLgtCoorrBrk_UWORD 0 Ti31 0 65.535 SYMBOL_LINK "CalPrmVehLgtCoorrBrk01.U16_AEB_BRK_INIT_CTRL_TIME" 0 /end CHARACTERISTIC
/begin CHARACTERISTIC U16_AEB_BRK_TQ_GRDT_MAX "AEB Maximum brake torque gradient" VALUE 0x8002105A CalPrmVehLgtCoorrBrk_UWORD 0 Tq2 0 65535 SYMBOL_LINK "CalPrmVehLgtCoorrBrk01.U16_AEB_BRK_TQ_GRDT_MAX" 0 /end CHARACTERISTIC
/begin CHARACTERISTIC U16_AEB_INIT_ADD_BRK_TQ_GRDT_MAX "AEB Minimum initial brake torque gradient." VALUE 0x80021056 CalPrmVehLgtCoorrBrk_UWORD 0 Tq2 0 65535 SYMBOL_LINK "CalPrmVehLgtCoorrBrk01.U16_AEB_INIT_ADD_BRK_TQ_GRDT_MAX" 0 /end CHARACTERISTIC
/begin CHARACTERISTIC U16_AEB_INIT_ADD_BRK_TQ_GRDT_MIN "AEB Maximum initial brake torque gradient." VALUE 0x80021058 CalPrmVehLgtCoorrBrk_UWORD 0 Tq2 0 65535 SYMBOL_LINK "CalPrmVehLgtCoorrBrk01.U16_AEB_INIT_ADD_BRK_TQ_GRDT_MIN" 0 /end CHARACTERISTIC
/begin CHARACTERISTIC U8DtrmTcmfModPErr "If the pressure error (master pressure - target pressure) is bigger than this valure, brake controller mode is TCMF compensation mode (without motor)" VALUE 0x8002125C CalPrmBrkTqCtrlrBrk_UBYTE 0 P32 0 2.55 SYMBOL_LINK "CalPrmBrkTqCtrlrBrk01.U8DtrmTcmfModPErr" 0 /end CHARACTERISTIC
/begin CHARACTERISTIC U8EsvVlvActtnIntlTiFctCtrlFinshd "ESV valve activation interval time between primary and secondary circuit after brake control" VALUE 0x800213D2 CalPrmBrkTqCtrlrBrk_UBYTE 0 Ti41 0 1.275 SYMBOL_LINK "CalPrmBrkTqCtrlrBrk01.U8EsvVlvActtnIntlTiFctCtrlFinshd" 0 /end CHARACTERISTIC
/begin CHARACTERISTIC U8EsvVlvActtnStrtTiFctCtrlFinshd "ESV valve activation after brake control start time" VALUE 0x800213CE CalPrmBrkTqCtrlrBrk_UBYTE 0 Ti41 0 1.275 SYMBOL_LINK "CalPrmBrkTqCtrlrBrk01.U8EsvVlvActtnStrtTiFctCtrlFinshd" 0 /end CHARACTERISTIC
/begin CHARACTERISTIC U8EsvVlvActtnTiWslcBac "ESV valve current in ABS with PBA control" VALUE 0x800213D6 CalPrmBrkTqCtrlrBrk_UBYTE 0 Ti41 0 1.275 SYMBOL_LINK "CalPrmBrkTqCtrlrBrk01.U8EsvVlvActtnTiWslcBac" 0 /end CHARACTERISTIC
/begin CHARACTERISTIC U8EsvVlvCurMaxPatActtnTi "ESV valve max current time" VALUE 0x800213D3 CalPrmBrkTqCtrlrBrk_UBYTE 0 Ti41 0 1.275 SYMBOL_LINK "CalPrmBrkTqCtrlrBrk01.U8EsvVlvCurMaxPatActtnTi" 0 /end CHARACTERISTIC
/begin CHARACTERISTIC U8EsvVlvHldCurMin "ESV valve min current (When ESV valve pattern control activated)" VALUE 0x800213C8 CalPrmBrkTqCtrlrBrk_UBYTE 0 Amp1 0 2.55 SYMBOL_LINK "CalPrmBrkTqCtrlrBrk01.U8EsvVlvHldCurMin" 0 /end CHARACTERISTIC
/begin CHARACTERISTIC U8EsvVlvOpenCurMin "ESV valve min current (When ESV valve pattern control at start open)" VALUE 0x800213C9 CalPrmBrkTqCtrlrBrk_UBYTE 0 Amp1 0 2.55 SYMBOL_LINK "CalPrmBrkTqCtrlrBrk01.U8EsvVlvOpenCurMin" 0 /end CHARACTERISTIC
/begin CHARACTERISTIC U8IniMotActtnTiAbs "Initial motor actuation time in ABS control" VALUE 0x800213DA CalPrmBrkTqCtrlrBrk_UBYTE 0 Ti41 0 1.275 SYMBOL_LINK "CalPrmBrkTqCtrlrBrk01.U8IniMotActtnTiAbs" 0 /end CHARACTERISTIC
/begin CHARACTERISTIC U8IniMotUDuty1 "Initial motor duty at motor target voltage 1 point" VALUE 0x80021498 CalPrmBrkTqCtrlrBrk_UBYTE 0 Perc2 0 127.5 SYMBOL_LINK "CalPrmBrkTqCtrlrBrk01.U8IniMotUDuty1" 0 /end CHARACTERISTIC
/begin CHARACTERISTIC U8IniMotUDuty2 "Initial motor duty at motor target voltage 2 point" VALUE 0x80021499 CalPrmBrkTqCtrlrBrk_UBYTE 0 Perc2 0 127.5 SYMBOL_LINK "CalPrmBrkTqCtrlrBrk01.U8IniMotUDuty2" 0 /end CHARACTERISTIC
/begin CHARACTERISTIC U8LfcRiseFbPErrToNo1VlvCurGain "NO valve current feed-back gain using 3P pressure sensor" VALUE 0x800212DE CalPrmBrkTqCtrlrBrk_UBYTE 0 Gain 0 255 SYMBOL_LINK "CalPrmBrkTqCtrlrBrk01.U8LfcRiseFbPErrToNo1VlvCurGain" 0 /end CHARACTERISTIC
/begin CHARACTERISTIC U8MotUAbsFric1 "Road friction for determine target motor voltage in ABS normal acitvation (1 point of 3 interpolation)" VALUE 0x800213EC CalPrmBrkTqCtrlrBrk_UBYTE 0 A42 0 2.55 SYMBOL_LINK "CalPrmBrkTqCtrlrBrk01.U8MotUAbsFric1" 0 /end CHARACTERISTIC
/begin CHARACTERISTIC U8MotUAbsFric2 "Road friction for determine target motor voltage in ABS normal acitvation (2 point of 3 interpolation)" VALUE 0x800213ED CalPrmBrkTqCtrlrBrk_UBYTE 0 A42 0 2.55 SYMBOL_LINK "CalPrmBrkTqCtrlrBrk01.U8MotUAbsFric2" 0 /end CHARACTERISTIC
/begin CHARACTERISTIC U8MotUAbsFric3 "Road friction for determine target motor voltage in ABS normal acitvation (3 point of 3 interpolation)" VALUE 0x800213EE CalPrmBrkTqCtrlrBrk_UBYTE 0 A42 0 2.55 SYMBOL_LINK "CalPrmBrkTqCtrlrBrk01.U8MotUAbsFric3" 0 /end CHARACTERISTIC
/begin CHARACTERISTIC U8MotUIniTi1 "Initial motor on time at motor target voltage 1 point" VALUE 0x800214AA CalPrmBrkTqCtrlrBrk_UBYTE 0 Ti41 0 1.275 SYMBOL_LINK "CalPrmBrkTqCtrlrBrk01.U8MotUIniTi1" 0 /end CHARACTERISTIC
/begin CHARACTERISTIC U8MotUIniTi2 "Initial motor on time at motor target voltage 2 point" VALUE 0x800214AB CalPrmBrkTqCtrlrBrk_UBYTE 0 Ti41 0 1.275 SYMBOL_LINK "CalPrmBrkTqCtrlrBrk01.U8MotUIniTi2" 0 /end CHARACTERISTIC
/begin CHARACTERISTIC U8MotUIniTi3 "Initial motor on time at motor target voltage 3 point" VALUE 0x800214AC CalPrmBrkTqCtrlrBrk_UBYTE 0 Ti41 0 1.275 SYMBOL_LINK "CalPrmBrkTqCtrlrBrk01.U8MotUIniTi3" 0 /end CHARACTERISTIC
/begin CHARACTERISTIC U8MotUIniTi4 "Initial motor on time at motor target voltage 4 point" VALUE 0x800214AD CalPrmBrkTqCtrlrBrk_UBYTE 0 Ti41 0 1.275 SYMBOL_LINK "CalPrmBrkTqCtrlrBrk01.U8MotUIniTi4" 0 /end CHARACTERISTIC
/begin CHARACTERISTIC U8MotUWslcDecelCombFric1 "Road friction for determine target motor voltage in ABS with decel control acitvation (1 point of 3 interpolation)" VALUE 0x800213FA CalPrmBrkTqCtrlrBrk_UBYTE 0 A42 0 2.55 SYMBOL_LINK "CalPrmBrkTqCtrlrBrk01.U8MotUWslcDecelCombFric1" 0 /end CHARACTERISTIC
/begin CHARACTERISTIC U8MotUWslcDecelCombFric2 "Road friction for determine target motor voltage in ABS with decel control acitvation (2 point of 3 interpolation)" VALUE 0x800213FB CalPrmBrkTqCtrlrBrk_UBYTE 0 A42 0 2.55 SYMBOL_LINK "CalPrmBrkTqCtrlrBrk01.U8MotUWslcDecelCombFric2" 0 /end CHARACTERISTIC
/begin CHARACTERISTIC U8MotUWslcDecelCombFric3 "Road friction for determine target motor voltage in ABS with decel control acitvation (3 point of 3 interpolation)" VALUE 0x800213FC CalPrmBrkTqCtrlrBrk_UBYTE 0 A42 0 2.55 SYMBOL_LINK "CalPrmBrkTqCtrlrBrk01.U8MotUWslcDecelCombFric3" 0 /end CHARACTERISTIC
/begin CHARACTERISTIC U8NcVlvCurMax "NC valve max current (for controller)" VALUE 0x800212EE CalPrmBrkTqCtrlrBrk_UBYTE 0 Amp1 0 2.55 SYMBOL_LINK "CalPrmBrkTqCtrlrBrk01.U8NcVlvCurMax" 0 /end CHARACTERISTIC
/begin CHARACTERISTIC U8NcVlvCurMaxPatActtnTi "NC valve max current time" VALUE 0x800212F0 CalPrmBrkTqCtrlrBrk_UBYTE 0 Ti41 0 1.275 SYMBOL_LINK "CalPrmBrkTqCtrlrBrk01.U8NcVlvCurMaxPatActtnTi" 0 /end CHARACTERISTIC
/begin CHARACTERISTIC U8NcVlvCurSysMax "NC valve max current (system limit)" VALUE 0x800212EF CalPrmBrkTqCtrlrBrk_UBYTE 0 Amp1 0 2.55 SYMBOL_LINK "CalPrmBrkTqCtrlrBrk01.U8NcVlvCurSysMax" 0 /end CHARACTERISTIC
/begin CHARACTERISTIC U8NcVlvHldCurMin "NC valve min current (When NC valve activated)" VALUE 0x800212EC CalPrmBrkTqCtrlrBrk_UBYTE 0 Amp1 0 2.55 SYMBOL_LINK "CalPrmBrkTqCtrlrBrk01.U8NcVlvHldCurMin" 0 /end CHARACTERISTIC
/begin CHARACTERISTIC U8NcVlvOpenCurMin "NC valve min current (When NC valve at start open)" VALUE 0x800212ED CalPrmBrkTqCtrlrBrk_UBYTE 0 Amp1 0 2.55 SYMBOL_LINK "CalPrmBrkTqCtrlrBrk01.U8NcVlvOpenCurMin" 0 /end CHARACTERISTIC
/begin CHARACTERISTIC U8RiseRateTestActtnTiPreFill "Prefill actuation time when 4wheel rise test with prefill" VALUE 0x800214B4 CalPrmBrkTqCtrlrBrk_UBYTE 0 Ti41 0 1.275 SYMBOL_LINK "CalPrmBrkTqCtrlrBrk01.U8RiseRateTestActtnTiPreFill" 0 /end CHARACTERISTIC
/begin CHARACTERISTIC U8TcmfCmpDumpDecTcVlvCur "TC valve currrent decrease margine at compoensation dump" VALUE 0x8002135C CalPrmBrkTqCtrlrBrk_UBYTE 0 Amp2 0 0.255 SYMBOL_LINK "CalPrmBrkTqCtrlrBrk01.U8TcmfCmpDumpDecTcVlvCur" 0 /end CHARACTERISTIC
/begin CHARACTERISTIC U8TcmfDumpPGrdtDecTcVlvCur1 "TC valve currrent decrease margine at target brake pressure gradient point 1" VALUE 0x80021364 CalPrmBrkTqCtrlrBrk_UBYTE 0 Amp2 0 0.255 SYMBOL_LINK "CalPrmBrkTqCtrlrBrk01.U8TcmfDumpPGrdtDecTcVlvCur1" 0 /end CHARACTERISTIC
/begin CHARACTERISTIC U8TcmfDumpPGrdtDecTcVlvCur2 "TC valve currrent decrease margine at target brake pressure gradient point 2" VALUE 0x80021365 CalPrmBrkTqCtrlrBrk_UBYTE 0 Amp2 0 0.255 SYMBOL_LINK "CalPrmBrkTqCtrlrBrk01.U8TcmfDumpPGrdtDecTcVlvCur2" 0 /end CHARACTERISTIC
/begin CHARACTERISTIC U8TcmfDumpPGrdtDecTcVlvCur3 "TC valve currrent decrease margine at target brake pressure gradient point 3" VALUE 0x80021366 CalPrmBrkTqCtrlrBrk_UBYTE 0 Amp2 0 0.255 SYMBOL_LINK "CalPrmBrkTqCtrlrBrk01.U8TcmfDumpPGrdtDecTcVlvCur3" 0 /end CHARACTERISTIC
/begin CHARACTERISTIC U8TcmfIniRiseChgPGrdt "If target pressure gradient per 5ms change bigger than this value, it finished the initial rise mode" VALUE 0x80021304 CalPrmBrkTqCtrlrBrk_UBYTE 0 PGrdt11 0 25.5 SYMBOL_LINK "CalPrmBrkTqCtrlrBrk01.U8TcmfIniRiseChgPGrdt" 0 /end CHARACTERISTIC
/begin CHARACTERISTIC U8TcmfIniRiseInhbPTi1 "Initial rise inhibtion time at target brake pressure 1 point" VALUE 0x80021328 CalPrmBrkTqCtrlrBrk_UBYTE 0 Ti41 0 1.275 SYMBOL_LINK "CalPrmBrkTqCtrlrBrk01.U8TcmfIniRiseInhbPTi1" 0 /end CHARACTERISTIC
/begin CHARACTERISTIC U8TcmfIniRiseInhbPTi2 "Initial rise inhibtion time at target brake pressure 2 point" VALUE 0x80021329 CalPrmBrkTqCtrlrBrk_UBYTE 0 Ti41 0 1.275 SYMBOL_LINK "CalPrmBrkTqCtrlrBrk01.U8TcmfIniRiseInhbPTi2" 0 /end CHARACTERISTIC
/begin CHARACTERISTIC U8TcmfIniRiseInhbPTi3 "Initial rise inhibtion time at target brake pressure 3 point" VALUE 0x8002132A CalPrmBrkTqCtrlrBrk_UBYTE 0 Ti41 0 1.275 SYMBOL_LINK "CalPrmBrkTqCtrlrBrk01.U8TcmfIniRiseInhbPTi3" 0 /end CHARACTERISTIC
/begin CHARACTERISTIC U8TcmfIniRisePGrdtTiFrnt01 "TCMF initial rise time at front target pressure gradient 1 point (U16TcmfIniRiseMotUPGrdtFrnt01)" VALUE 0x80021305 CalPrmBrkTqCtrlrBrk_UBYTE 0 Ti41 0 1.275 SYMBOL_LINK "CalPrmBrkTqCtrlrBrk01.U8TcmfIniRisePGrdtTiFrnt01" 0 /end CHARACTERISTIC
/begin CHARACTERISTIC U8TcmfIniRisePGrdtTiFrnt02 "TCMF initial rise time at front target pressure gradient 2 point (U16TcmfIniRiseMotUPGrdtFrnt02)" VALUE 0x80021306 CalPrmBrkTqCtrlrBrk_UBYTE 0 Ti41 0 1.275 SYMBOL_LINK "CalPrmBrkTqCtrlrBrk01.U8TcmfIniRisePGrdtTiFrnt02" 0 /end CHARACTERISTIC
/begin CHARACTERISTIC U8TcmfIniRisePGrdtTiFrnt03 "TCMF initial rise time at front target pressure gradient 3 point (U16TcmfIniRiseMotUPGrdtFrnt03)" VALUE 0x80021307 CalPrmBrkTqCtrlrBrk_UBYTE 0 Ti41 0 1.275 SYMBOL_LINK "CalPrmBrkTqCtrlrBrk01.U8TcmfIniRisePGrdtTiFrnt03" 0 /end CHARACTERISTIC
/begin CHARACTERISTIC U8TcmfIniRisePGrdtTiFrnt04 "TCMF initial rise time at front target pressure gradient 4 point (U16TcmfIniRiseMotUPGrdtFrnt04)" VALUE 0x80021308 CalPrmBrkTqCtrlrBrk_UBYTE 0 Ti41 0 1.275 SYMBOL_LINK "CalPrmBrkTqCtrlrBrk01.U8TcmfIniRisePGrdtTiFrnt04" 0 /end CHARACTERISTIC
/begin CHARACTERISTIC U8TcmfIniRisePGrdtTiFrnt05 "TCMF initial rise time at front target pressure gradient 5 point (U16TcmfIniRiseMotUPGrdtFrnt05)" VALUE 0x80021309 CalPrmBrkTqCtrlrBrk_UBYTE 0 Ti41 0 1.275 SYMBOL_LINK "CalPrmBrkTqCtrlrBrk01.U8TcmfIniRisePGrdtTiFrnt05" 0 /end CHARACTERISTIC
/begin CHARACTERISTIC U8TcmfIniRisePGrdtTiFrnt06 "TCMF initial rise time at front target pressure gradient 6 point (U16TcmfIniRiseMotUPGrdtFrnt06)" VALUE 0x8002130A CalPrmBrkTqCtrlrBrk_UBYTE 0 Ti41 0 1.275 SYMBOL_LINK "CalPrmBrkTqCtrlrBrk01.U8TcmfIniRisePGrdtTiFrnt06" 0 /end CHARACTERISTIC
/begin CHARACTERISTIC U8TcmfIniRisePGrdtTiFrnt07 "TCMF initial rise time at front target pressure gradient 7 point (U16TcmfIniRiseMotUPGrdtFrnt07)" VALUE 0x8002130B CalPrmBrkTqCtrlrBrk_UBYTE 0 Ti41 0 1.275 SYMBOL_LINK "CalPrmBrkTqCtrlrBrk01.U8TcmfIniRisePGrdtTiFrnt07" 0 /end CHARACTERISTIC
/begin CHARACTERISTIC U8TcmfIniRisePGrdtTiFrnt08 "TCMF initial rise time at front target pressure gradient 8 point (U16TcmfIniRiseMotUPGrdtFrnt08)" VALUE 0x8002130C CalPrmBrkTqCtrlrBrk_UBYTE 0 Ti41 0 1.275 SYMBOL_LINK "CalPrmBrkTqCtrlrBrk01.U8TcmfIniRisePGrdtTiFrnt08" 0 /end CHARACTERISTIC
/begin CHARACTERISTIC U8TcmfIniRisePGrdtTiFrnt09 "TCMF initial rise time at front target pressure gradient 9 point (U16TcmfIniRiseMotUPGrdtFrnt09)" VALUE 0x8002130D CalPrmBrkTqCtrlrBrk_UBYTE 0 Ti41 0 1.275 SYMBOL_LINK "CalPrmBrkTqCtrlrBrk01.U8TcmfIniRisePGrdtTiFrnt09" 0 /end CHARACTERISTIC
/begin CHARACTERISTIC U8TcmfIniRisePGrdtTiFrnt10 "TCMF initial rise time at front target pressure gradient 10 point (U16TcmfIniRiseMotUPGrdtFrnt10)" VALUE 0x8002130E CalPrmBrkTqCtrlrBrk_UBYTE 0 Ti41 0 1.275 SYMBOL_LINK "CalPrmBrkTqCtrlrBrk01.U8TcmfIniRisePGrdtTiFrnt10" 0 /end CHARACTERISTIC
/begin CHARACTERISTIC U8TcmfIniRisePGrdtTiFrnt11 "TCMF initial rise time at front target pressure gradient 11 point (U16TcmfIniRiseMotUPGrdtFrnt11)" VALUE 0x8002130F CalPrmBrkTqCtrlrBrk_UBYTE 0 Ti41 0 1.275 SYMBOL_LINK "CalPrmBrkTqCtrlrBrk01.U8TcmfIniRisePGrdtTiFrnt11" 0 /end CHARACTERISTIC
/begin CHARACTERISTIC U8TcmfIniRisePGrdtTiFrnt12 "TCMF initial rise time at front target pressure gradient 12 point (U16TcmfIniRiseMotUPGrdtFrnt12)" VALUE 0x80021310 CalPrmBrkTqCtrlrBrk_UBYTE 0 Ti41 0 1.275 SYMBOL_LINK "CalPrmBrkTqCtrlrBrk01.U8TcmfIniRisePGrdtTiFrnt12" 0 /end CHARACTERISTIC
/begin CHARACTERISTIC U8TcmfIniRisePGrdtTiFrnt13 "TCMF initial rise time at front target pressure gradient 13 point (U16TcmfIniRiseMotUPGrdtFrnt13)" VALUE 0x80021311 CalPrmBrkTqCtrlrBrk_UBYTE 0 Ti41 0 1.275 SYMBOL_LINK "CalPrmBrkTqCtrlrBrk01.U8TcmfIniRisePGrdtTiFrnt13" 0 /end CHARACTERISTIC
/begin CHARACTERISTIC U8TcmfIniRisePGrdtTiFrnt14 "TCMF initial rise time at front target pressure gradient 14 point (U16TcmfIniRiseMotUPGrdtFrnt14)" VALUE 0x80021312 CalPrmBrkTqCtrlrBrk_UBYTE 0 Ti41 0 1.275 SYMBOL_LINK "CalPrmBrkTqCtrlrBrk01.U8TcmfIniRisePGrdtTiFrnt14" 0 /end CHARACTERISTIC
/begin CHARACTERISTIC U8TcmfRiseAftCompPatTiFrnt1 "Front rise pattern time at target brake pressure gradient 1 point (after motor off)" VALUE 0x8002133B CalPrmBrkTqCtrlrBrk_UBYTE 0 Ti41 0 1.275 SYMBOL_LINK "CalPrmBrkTqCtrlrBrk01.U8TcmfRiseAftCompPatTiFrnt1" 0 /end CHARACTERISTIC
/begin CHARACTERISTIC U8TcmfRiseAftCompPatTiFrnt2 "Front rise pattern time at target brake pressure gradient 2 point (after motor off)" VALUE 0x8002133C CalPrmBrkTqCtrlrBrk_UBYTE 0 Ti41 0 1.275 SYMBOL_LINK "CalPrmBrkTqCtrlrBrk01.U8TcmfRiseAftCompPatTiFrnt2" 0 /end CHARACTERISTIC
/begin CHARACTERISTIC U8TcmfRiseAftCompPatTiFrnt3 "Front rise pattern time at target brake pressure gradient 3 point (after motor off)" VALUE 0x8002133D CalPrmBrkTqCtrlrBrk_UBYTE 0 Ti41 0 1.275 SYMBOL_LINK "CalPrmBrkTqCtrlrBrk01.U8TcmfRiseAftCompPatTiFrnt3" 0 /end CHARACTERISTIC
/begin CHARACTERISTIC U8TcmfRiseAftCompPatTiRe1 "Rear rise pattern time at target brake pressure gradient 1 point (after motor off)" VALUE 0x80021347 CalPrmBrkTqCtrlrBrk_UBYTE 0 Ti41 0 1.275 SYMBOL_LINK "CalPrmBrkTqCtrlrBrk01.U8TcmfRiseAftCompPatTiRe1" 0 /end CHARACTERISTIC
/begin CHARACTERISTIC U8TcmfRiseAftCompPatTiRe2 "Rear rise pattern time at target brake pressure gradient 2 point (after motor off)" VALUE 0x80021348 CalPrmBrkTqCtrlrBrk_UBYTE 0 Ti41 0 1.275 SYMBOL_LINK "CalPrmBrkTqCtrlrBrk01.U8TcmfRiseAftCompPatTiRe2" 0 /end CHARACTERISTIC
/begin CHARACTERISTIC U8TcmfRiseAftCompPatTiRe3 "Rear rise pattern time at target brake pressure gradient 3 point (after motor off)" VALUE 0x80021349 CalPrmBrkTqCtrlrBrk_UBYTE 0 Ti41 0 1.275 SYMBOL_LINK "CalPrmBrkTqCtrlrBrk01.U8TcmfRiseAftCompPatTiRe3" 0 /end CHARACTERISTIC
/begin CHARACTERISTIC U8TcmfRisePGrdtIncTcVlvCurFrnt1 "TC valve currrent increase margine at target brake pressure gradient point 1 (front)" VALUE 0x80021352 CalPrmBrkTqCtrlrBrk_UBYTE 0 Amp2 0 0.255 SYMBOL_LINK "CalPrmBrkTqCtrlrBrk01.U8TcmfRisePGrdtIncTcVlvCurFrnt1" 0 /end CHARACTERISTIC
/begin CHARACTERISTIC U8TcmfRisePGrdtIncTcVlvCurFrnt2 "TC valve currrent increase margine at target brake pressure gradient point 2 (front)" VALUE 0x80021353 CalPrmBrkTqCtrlrBrk_UBYTE 0 Amp2 0 0.255 SYMBOL_LINK "CalPrmBrkTqCtrlrBrk01.U8TcmfRisePGrdtIncTcVlvCurFrnt2" 0 /end CHARACTERISTIC
/begin CHARACTERISTIC U8TcmfRisePGrdtIncTcVlvCurFrnt3 "TC valve currrent increase margine at target brake pressure gradient point 3 (front)" VALUE 0x80021354 CalPrmBrkTqCtrlrBrk_UBYTE 0 Amp2 0 0.255 SYMBOL_LINK "CalPrmBrkTqCtrlrBrk01.U8TcmfRisePGrdtIncTcVlvCurFrnt3" 0 /end CHARACTERISTIC
/begin CHARACTERISTIC U8TcmfRisePGrdtIncTcVlvCurRe1 "TC valve currrent increase margine at target brake pressure gradient point 1 (rear)" VALUE 0x80021355 CalPrmBrkTqCtrlrBrk_UBYTE 0 Amp2 0 0.255 SYMBOL_LINK "CalPrmBrkTqCtrlrBrk01.U8TcmfRisePGrdtIncTcVlvCurRe1" 0 /end CHARACTERISTIC
/begin CHARACTERISTIC U8TcmfRisePGrdtIncTcVlvCurRe2 "TC valve currrent increase margine at target brake pressure gradient point 2 (rear)" VALUE 0x80021356 CalPrmBrkTqCtrlrBrk_UBYTE 0 Amp2 0 0.255 SYMBOL_LINK "CalPrmBrkTqCtrlrBrk01.U8TcmfRisePGrdtIncTcVlvCurRe2" 0 /end CHARACTERISTIC
/begin CHARACTERISTIC U8TcmfRisePGrdtIncTcVlvCurRe3 "TC valve currrent increase margine at target brake pressure gradient point 3 (rear)" VALUE 0x80021357 CalPrmBrkTqCtrlrBrk_UBYTE 0 Amp2 0 0.255 SYMBOL_LINK "CalPrmBrkTqCtrlrBrk01.U8TcmfRisePGrdtIncTcVlvCurRe3" 0 /end CHARACTERISTIC
/begin CHARACTERISTIC U8TcmfRisePatTiFrnt1 "Front rise pattern time at target brake pressure gradient 1 point (after motor on)" VALUE 0x80021338 CalPrmBrkTqCtrlrBrk_UBYTE 0 Ti41 0 1.275 SYMBOL_LINK "CalPrmBrkTqCtrlrBrk01.U8TcmfRisePatTiFrnt1" 0 /end CHARACTERISTIC
/begin CHARACTERISTIC U8TcmfRisePatTiFrnt2 "Front rise pattern time at target brake pressure gradient 2 point (after motor on)" VALUE 0x80021339 CalPrmBrkTqCtrlrBrk_UBYTE 0 Ti41 0 1.275 SYMBOL_LINK "CalPrmBrkTqCtrlrBrk01.U8TcmfRisePatTiFrnt2" 0 /end CHARACTERISTIC
/begin CHARACTERISTIC U8TcmfRisePatTiFrnt3 "Front rise pattern time at target brake pressure gradient 3 point (after motor on)" VALUE 0x8002133A CalPrmBrkTqCtrlrBrk_UBYTE 0 Ti41 0 1.275 SYMBOL_LINK "CalPrmBrkTqCtrlrBrk01.U8TcmfRisePatTiFrnt3" 0 /end CHARACTERISTIC
/begin CHARACTERISTIC U8TcmfRisePatTiRe1 "Rear rise pattern time at target brake pressure gradient 1 point (after motor on)" VALUE 0x80021344 CalPrmBrkTqCtrlrBrk_UBYTE 0 Ti41 0 1.275 SYMBOL_LINK "CalPrmBrkTqCtrlrBrk01.U8TcmfRisePatTiRe1" 0 /end CHARACTERISTIC
/begin CHARACTERISTIC U8TcmfRisePatTiRe2 "Rear rise pattern time at target brake pressure gradient 2 point (after motor on)" VALUE 0x80021345 CalPrmBrkTqCtrlrBrk_UBYTE 0 Ti41 0 1.275 SYMBOL_LINK "CalPrmBrkTqCtrlrBrk01.U8TcmfRisePatTiRe2" 0 /end CHARACTERISTIC
/begin CHARACTERISTIC U8TcmfRisePatTiRe3 "Rear rise pattern time at target brake pressure gradient 3 point (after motor on)" VALUE 0x80021346 CalPrmBrkTqCtrlrBrk_UBYTE 0 Ti41 0 1.275 SYMBOL_LINK "CalPrmBrkTqCtrlrBrk01.U8TcmfRisePatTiRe3" 0 /end CHARACTERISTIC
/begin CHARACTERISTIC U8_ACC_ENGTORQSLOPE_G1_MAX "ACC maximum engine torque up rate at gear D1" VALUE 0x8003A8F6 CalPrmVehLgtCoorrEng_UBYTE 0 Tq2 0 255 SYMBOL_LINK "CalPrmVehLgtCoorrEng01.U8_ACC_ENGTORQSLOPE_G1_MAX" 0 /end CHARACTERISTIC
/begin CHARACTERISTIC U8_ACC_ENGTORQSLOPE_G1_MIN "ACC maximum engine torque down rate at gear D1" VALUE 0x8003A8F7 CalPrmVehLgtCoorrEng_UBYTE 0 Tq2 0 255 SYMBOL_LINK "CalPrmVehLgtCoorrEng01.U8_ACC_ENGTORQSLOPE_G1_MIN" 0 /end CHARACTERISTIC
/begin CHARACTERISTIC U8_ACC_ENGTORQSLOPE_MAX "ACC maximum engine torque up rate at upper gear D1" VALUE 0x8003A8F8 CalPrmVehLgtCoorrEng_UBYTE 0 Tq2 0 255 SYMBOL_LINK "CalPrmVehLgtCoorrEng01.U8_ACC_ENGTORQSLOPE_MAX" 0 /end CHARACTERISTIC
/begin CHARACTERISTIC U8_ACC_ENGTORQSLOPE_MIN "ACC maximum engine torque down rate at upper gear D1" VALUE 0x8003A8F9 CalPrmVehLgtCoorrEng_UBYTE 0 Tq2 0 255 SYMBOL_LINK "CalPrmVehLgtCoorrEng01.U8_ACC_ENGTORQSLOPE_MIN" 0 /end CHARACTERISTIC
/begin CHARACTERISTIC U8_ACC_ENGTORQ_OFFSET_HIGHSPD "ACC minimum engine toruqe offset for high speed (ACC minimum engine target torque = engine friction torque + offset)" VALUE 0x8003A8FA CalPrmVehLgtCoorrEng_UBYTE 0 A41 0 0.255 SYMBOL_LINK "CalPrmVehLgtCoorrEng01.U8_ACC_ENGTORQ_OFFSET_HIGHSPD" 0 /end CHARACTERISTIC
/begin CHARACTERISTIC U8_ACC_ENGTORQ_OFFSET_LOWSPD "ACC minimum engine toruqe offset for low speed (ACC minimum engine target torque = engine friction torque + offset)" VALUE 0x8003A8FB CalPrmVehLgtCoorrEng_UBYTE 0 A41 0 0.255 SYMBOL_LINK "CalPrmVehLgtCoorrEng01.U8_ACC_ENGTORQ_OFFSET_LOWSPD" 0 /end CHARACTERISTIC
/begin CHARACTERISTIC U8_ACC_ENG_FADEOUT_SLOPE "ACC engine toruqe fadeout rate" VALUE 0x8003A8FC CalPrmVehLgtCoorrEng_UBYTE 0 Fac31 0 255 SYMBOL_LINK "CalPrmVehLgtCoorrEng01.U8_ACC_ENG_FADEOUT_SLOPE" 0 /end CHARACTERISTIC
/begin CHARACTERISTIC U8_ACC_FF_DEC_FACTOR_NEG_G "ACC feedforward torque gain about deceleration control" VALUE 0x8003A8E4 CalPrmVehLgtCoorrEng_UBYTE 0 Fac31 0 255 SYMBOL_LINK "CalPrmVehLgtCoorrEng01.U8_ACC_FF_DEC_FACTOR_NEG_G" 0 /end CHARACTERISTIC
/begin CHARACTERISTIC U8_ACC_FF_DEC_FACTOR_POS_G "ACC feedforward torque gain about acceleration control" VALUE 0x8003A8D2 CalPrmVehLgtCoorrEng_UBYTE 0 Fac31 0 255 SYMBOL_LINK "CalPrmVehLgtCoorrEng01.U8_ACC_FF_DEC_FACTOR_POS_G" 0 /end CHARACTERISTIC
/begin CHARACTERISTIC U8_ACC_FF_HILL_FACTOR_NEG_G "ACC feedforward torque gain about hill road" VALUE 0x8003A8D3 CalPrmVehLgtCoorrEng_UBYTE 0 Fac31 0 255 SYMBOL_LINK "CalPrmVehLgtCoorrEng01.U8_ACC_FF_HILL_FACTOR_NEG_G" 0 /end CHARACTERISTIC
/begin CHARACTERISTIC U8_ACC_FF_ROLLING_RESIST_FACTOR "ACC feedforward torque gain about tire rolling resistance" VALUE 0x8003A8D4 CalPrmVehLgtCoorrEng_UBYTE 0 Fac31 0 255 SYMBOL_LINK "CalPrmVehLgtCoorrEng01.U8_ACC_FF_ROLLING_RESIST_FACTOR" 0 /end CHARACTERISTIC
/begin CHARACTERISTIC U8_ACC_FF_VREF_FACTOR "ACC feedforward torque gain about vehicle speed" VALUE 0x8003A8D1 CalPrmVehLgtCoorrEng_UBYTE 0 Fac31 0 255 SYMBOL_LINK "CalPrmVehLgtCoorrEng01.U8_ACC_FF_VREF_FACTOR" 0 /end CHARACTERISTIC
/begin CHARACTERISTIC U8_ACC_G_SLOPE_HILLUP_STOP "Target deceleration rate for limiting decreasing rate at stop state on up hill" VALUE 0x80021030 CalPrmVehLgtCoorrBrk_UBYTE 0 A41 0 0.255 SYMBOL_LINK "CalPrmVehLgtCoorrBrk01.U8_ACC_G_SLOPE_HILLUP_STOP" 0 /end CHARACTERISTIC
/begin CHARACTERISTIC U8_ACC_G_SLOPE_HILL_STOP "Target deceleration rate for limiting decreasing rate at stop state on down hill" VALUE 0x80021031 CalPrmVehLgtCoorrBrk_UBYTE 0 A41 0 0.255 SYMBOL_LINK "CalPrmVehLgtCoorrBrk01.U8_ACC_G_SLOPE_HILL_STOP" 0 /end CHARACTERISTIC
/begin CHARACTERISTIC U8_ACC_G_SLOPE_STOP "Target deceleration rate for limiting decreasing rate at stop state on flat road" VALUE 0x80021032 CalPrmVehLgtCoorrBrk_UBYTE 0 A41 0 0.255 SYMBOL_LINK "CalPrmVehLgtCoorrBrk01.U8_ACC_G_SLOPE_STOP" 0 /end CHARACTERISTIC
/begin CHARACTERISTIC U8_ACC_G_SLOPE_STOP_CNT "Hold count for ACC target-G slope limit at standstill on flat road" VALUE 0x80021033 CalPrmVehLgtCoorrBrk_UBYTE 0 Ti31 0 0.255 SYMBOL_LINK "CalPrmVehLgtCoorrBrk01.U8_ACC_G_SLOPE_STOP_CNT" 0 /end CHARACTERISTIC
/begin CHARACTERISTIC U8_ACC_I_GAIN_AMP_BRK_HILL "ACC feedback torque I-gain effective factor at hill brake control" VALUE 0x8003A8E1 CalPrmVehLgtCoorrEng_UBYTE 0 Fac31 0 255 SYMBOL_LINK "CalPrmVehLgtCoorrEng01.U8_ACC_I_GAIN_AMP_BRK_HILL" 0 /end CHARACTERISTIC
/begin CHARACTERISTIC U8_ACC_I_GAIN_AMP_ENG_HILL "ACC feedback torque I-gain effective factor at hill engine control" VALUE 0x8003A8E2 CalPrmVehLgtCoorrEng_UBYTE 0 Fac31 0 255 SYMBOL_LINK "CalPrmVehLgtCoorrEng01.U8_ACC_I_GAIN_AMP_ENG_HILL" 0 /end CHARACTERISTIC
/begin CHARACTERISTIC U8_ACC_PIDHOLD_MAXSPD "Max. speed for holding feedback torque calculation at standstill control" VALUE 0x80021034 CalPrmVehLgtCoorrBrk_UBYTE 0 Spd12 0 31.875 SYMBOL_LINK "CalPrmVehLgtCoorrBrk01.U8_ACC_PIDHOLD_MAXSPD" 0 /end CHARACTERISTIC
/begin CHARACTERISTIC U8_ACC_PID_GAIN_DIV_ENG_HILL "ACC feedback torque PID-Gain effective factor at Engine & hill & accel & vref<8kph" VALUE 0x8003A8E3 CalPrmVehLgtCoorrEng_UBYTE 0 Fac31 0 255 SYMBOL_LINK "CalPrmVehLgtCoorrEng01.U8_ACC_PID_GAIN_DIV_ENG_HILL" 0 /end CHARACTERISTIC
/begin CHARACTERISTIC U8_ACC_PRESS_RESET_THD "Disengaged threshold of ACC deceleration control" VALUE 0x8002102C CalPrmVehLgtCoorrBrk_UBYTE 0 Tq2 0 255 SYMBOL_LINK "CalPrmVehLgtCoorrBrk01.U8_ACC_PRESS_RESET_THD" 0 /end CHARACTERISTIC
/begin CHARACTERISTIC U8_ACC_PRESS_SET_THD "Engaged threshold of ACC deceleration control" VALUE 0x8002102D CalPrmVehLgtCoorrBrk_UBYTE 0 Tq2 0 255 SYMBOL_LINK "CalPrmVehLgtCoorrBrk01.U8_ACC_PRESS_SET_THD" 0 /end CHARACTERISTIC
/begin CHARACTERISTIC U8_ACC_SLOPE_STOP_FACTOR "Gain proportional Slope to calculate Min Wheel Torq" VALUE 0x80021035 CalPrmVehLgtCoorrBrk_UBYTE 0 Fac31 0 255 SYMBOL_LINK "CalPrmVehLgtCoorrBrk01.U8_ACC_SLOPE_STOP_FACTOR" 0 /end CHARACTERISTIC
/begin CHARACTERISTIC U8_ACC_TARGET_ENGTQ_MAX "ACC maximum controlable engine torque." VALUE 0x8003A8D0 CalPrmVehLgtCoorrEng_UBYTE 0 Fac31 0 255 SYMBOL_LINK "CalPrmVehLgtCoorrEng01.U8_ACC_TARGET_ENGTQ_MAX" 0 /end CHARACTERISTIC
/begin CHARACTERISTIC U8_ACC_TARGET_TQ_MIN_STOP "ACC minimum target torque to stop at flat road" VALUE 0x8003A908 CalPrmVehLgtCoorrEng_UBYTE 0 Fac31 0 255 SYMBOL_LINK "CalPrmVehLgtCoorrEng01.U8_ACC_TARGET_TQ_MIN_STOP" 0 /end CHARACTERISTIC
/begin CHARACTERISTIC U8_ACC_TARGET_TQ_MIN_STOP_HILL_DOWN "ACC minimum target torque to stop at down hill" VALUE 0x8003A909 CalPrmVehLgtCoorrEng_UBYTE 0 Fac31 0 255 SYMBOL_LINK "CalPrmVehLgtCoorrEng01.U8_ACC_TARGET_TQ_MIN_STOP_HILL_DOWN" 0 /end CHARACTERISTIC
/begin CHARACTERISTIC U8_ACC_TARGET_TQ_MIN_STOP_HILL_UP "ACC minimum target torque to stop at up hill" VALUE 0x8003A90A CalPrmVehLgtCoorrEng_UBYTE 0 Fac31 0 255 SYMBOL_LINK "CalPrmVehLgtCoorrEng01.U8_ACC_TARGET_TQ_MIN_STOP_HILL_UP" 0 /end CHARACTERISTIC
/begin CHARACTERISTIC U8_AEB_FF_DEC_FACTOR_NEG_G "AEB feedforward torque gain about deceleration control" VALUE 0x8003A929 CalPrmVehLgtCoorrEng_UBYTE 0 A41 0 0.255 SYMBOL_LINK "CalPrmVehLgtCoorrEng01.U8_AEB_FF_DEC_FACTOR_NEG_G" 0 /end CHARACTERISTIC
/begin CHARACTERISTIC U8_AEB_FF_DEC_FACTOR_POS_G "AEB feedforward torque gain about acceleration control" VALUE 0x8003A928 CalPrmVehLgtCoorrEng_UBYTE 0 A41 0 0.255 SYMBOL_LINK "CalPrmVehLgtCoorrEng01.U8_AEB_FF_DEC_FACTOR_POS_G" 0 /end CHARACTERISTIC
/begin CHARACTERISTIC U8_AEB_FF_HILL_FACTOR_NEG_G "AEB feedforward torque gain about hill road" VALUE 0x8003A926 CalPrmVehLgtCoorrEng_UBYTE 0 Fac31 0 255 SYMBOL_LINK "CalPrmVehLgtCoorrEng01.U8_AEB_FF_HILL_FACTOR_NEG_G" 0 /end CHARACTERISTIC
/begin CHARACTERISTIC U8_AEB_FF_LIMIT_NEG_G "AEB feedforward torque limit about deceleration" VALUE 0x8003A92B CalPrmVehLgtCoorrEng_UBYTE 0 Fac31 0 255 SYMBOL_LINK "CalPrmVehLgtCoorrEng01.U8_AEB_FF_LIMIT_NEG_G" 0 /end CHARACTERISTIC
/begin CHARACTERISTIC U8_AEB_FF_LIMIT_POS_G "AEB feedforward torque limit about acceleration" VALUE 0x8003A92A CalPrmVehLgtCoorrEng_UBYTE 0 Spd12 0 31.875 SYMBOL_LINK "CalPrmVehLgtCoorrEng01.U8_AEB_FF_LIMIT_POS_G" 0 /end CHARACTERISTIC
/begin CHARACTERISTIC U8_AEB_FF_ROLLING_RESIST_FACTOR "AEB feedforward torque gain about tire rolling resistance" VALUE 0x8003A927 CalPrmVehLgtCoorrEng_UBYTE 0 A41 0 0.255 SYMBOL_LINK "CalPrmVehLgtCoorrEng01.U8_AEB_FF_ROLLING_RESIST_FACTOR" 0 /end CHARACTERISTIC
/begin CHARACTERISTIC U8_AEB_FF_VREF_FACTOR "AEB feedforward torque gain about vehicle speed" VALUE 0x8003A925 CalPrmVehLgtCoorrEng_UBYTE 0 Fac31 0 255 SYMBOL_LINK "CalPrmVehLgtCoorrEng01.U8_AEB_FF_VREF_FACTOR" 0 /end CHARACTERISTIC
/begin CHARACTERISTIC U8_AEB_G_SLOPE_STOP "AEB Target deceleration rate for limiting decreasing rate at stop state on flat road" VALUE 0x8002104E CalPrmVehLgtCoorrBrk_UBYTE 0 A41 0 0.255 SYMBOL_LINK "CalPrmVehLgtCoorrBrk01.U8_AEB_G_SLOPE_STOP" 0 /end CHARACTERISTIC
/begin CHARACTERISTIC U8_AEB_I_PSEUDO_GAIN_BRAKE "AEB feedback torque pseudo gain of I for brake control" VALUE 0x8003A924 CalPrmVehLgtCoorrEng_UBYTE 0 Fac31 0 255 SYMBOL_LINK "CalPrmVehLgtCoorrEng01.U8_AEB_I_PSEUDO_GAIN_BRAKE" 0 /end CHARACTERISTIC
/begin CHARACTERISTIC U8_DPB_FF_DEC_FACTOR_NEG_G "DPB feedforward torque gain about deceleration control" VALUE 0x8003A934 CalPrmVehLgtCoorrEng_UBYTE 0 Fac31 0 255 SYMBOL_LINK "CalPrmVehLgtCoorrEng01.U8_DPB_FF_DEC_FACTOR_NEG_G" 0 /end CHARACTERISTIC
/begin CHARACTERISTIC U8_DPB_FF_DEC_FACTOR_POS_G "DPB feedforward torque gain about acceleration control" VALUE 0x8003A933 CalPrmVehLgtCoorrEng_UBYTE 0 A41 0 0.255 SYMBOL_LINK "CalPrmVehLgtCoorrEng01.U8_DPB_FF_DEC_FACTOR_POS_G" 0 /end CHARACTERISTIC
/begin CHARACTERISTIC U8_DPB_FF_HILL_FACTOR_NEG_G "DPB feedforward torque gain about hill road" VALUE 0x8003A931 CalPrmVehLgtCoorrEng_UBYTE 0 Fac31 0 255 SYMBOL_LINK "CalPrmVehLgtCoorrEng01.U8_DPB_FF_HILL_FACTOR_NEG_G" 0 /end CHARACTERISTIC
/begin CHARACTERISTIC U8_DPB_FF_LIMIT_NEG_G "DPB feedforward torque limit about deceleration" VALUE 0x8003A936 CalPrmVehLgtCoorrEng_UBYTE 0 Fac31 0 255 SYMBOL_LINK "CalPrmVehLgtCoorrEng01.U8_DPB_FF_LIMIT_NEG_G" 0 /end CHARACTERISTIC
/begin CHARACTERISTIC U8_DPB_FF_LIMIT_POS_G "DPB feedforward torque limit about acceleration" VALUE 0x8003A935 CalPrmVehLgtCoorrEng_UBYTE 0 Fac31 0 255 SYMBOL_LINK "CalPrmVehLgtCoorrEng01.U8_DPB_FF_LIMIT_POS_G" 0 /end CHARACTERISTIC
/begin CHARACTERISTIC U8_DPB_FF_RollingResist_FACTOR "DPB feedforward torque gain about tire rolling resistance" VALUE 0x8003A932 CalPrmVehLgtCoorrEng_UBYTE 0 A41 0 0.255 SYMBOL_LINK "CalPrmVehLgtCoorrEng01.U8_DPB_FF_RollingResist_FACTOR" 0 /end CHARACTERISTIC
/begin CHARACTERISTIC U8_DPB_FF_Vref_FACTOR "DPB feedforward torque gain about vehicle speed" VALUE 0x8003A930 CalPrmVehLgtCoorrEng_UBYTE 0 Fac31 0 255 SYMBOL_LINK "CalPrmVehLgtCoorrEng01.U8_DPB_FF_Vref_FACTOR" 0 /end CHARACTERISTIC
/begin CHARACTERISTIC U8_DPB_I_PSEUDO_GAIN_BRAKE "DPB feedback torque pseudo gain of I for brake control" VALUE 0x8003A950 CalPrmVehLgtCoorrEng_UBYTE 0 Fac31 0 255 SYMBOL_LINK "CalPrmVehLgtCoorrEng01.U8_DPB_I_PSEUDO_GAIN_BRAKE" 0 /end CHARACTERISTIC
/begin CHARACTERISTIC U8_WPE_Motor_Eccentricity "Temp" VALUE 0x8002154F CalPrmBrkTqCtrlrBrk_UBYTE 0 Gain 0 255 SYMBOL_LINK "CalPrmBrkTqCtrlrBrk01.U8_WPE_Motor_Eccentricity" 0 /end CHARACTERISTIC
/begin CHARACTERISTIC U8_WPE_Motor_K_Torque_Current "Temp" VALUE 0x80021550 CalPrmBrkTqCtrlrBrk_UBYTE 0 Gain 0 255 SYMBOL_LINK "CalPrmBrkTqCtrlrBrk01.U8_WPE_Motor_K_Torque_Current" 0 /end CHARACTERISTIC
/begin CHARACTERISTIC U8_WPE_Motor_Resistance "Temp" VALUE 0x80021551 CalPrmBrkTqCtrlrBrk_UBYTE 0 Gain 0 255 SYMBOL_LINK "CalPrmBrkTqCtrlrBrk01.U8_WPE_Motor_Resistance" 0 /end CHARACTERISTIC
/begin CHARACTERISTIC U8_WPE_Motor_Volt_RPM "Temp" VALUE 0x80021552 CalPrmBrkTqCtrlrBrk_UBYTE 0 Gain 0 255 SYMBOL_LINK "CalPrmBrkTqCtrlrBrk01.U8_WPE_Motor_Volt_RPM" 0 /end CHARACTERISTIC
/begin CHARACTERISTIC U8_WPE_Piston_Diameter "Temp" VALUE 0x8002154E CalPrmBrkTqCtrlrBrk_UBYTE 0 Gain 0 255 SYMBOL_LINK "CalPrmBrkTqCtrlrBrk01.U8_WPE_Piston_Diameter" 0 /end CHARACTERISTIC
/begin CHARACTERISTIC U8_WPE_Pump_Efficiency_High_P "Temp" VALUE 0x80021533 CalPrmBrkTqCtrlrBrk_UBYTE 0 Perc6 0 255 SYMBOL_LINK "CalPrmBrkTqCtrlrBrk01.U8_WPE_Pump_Efficiency_High_P" 0 /end CHARACTERISTIC
/begin CHARACTERISTIC U8_WPE_Pump_Efficiency_Low_P "Temp" VALUE 0x80021532 CalPrmBrkTqCtrlrBrk_UBYTE 0 Perc6 0 255 SYMBOL_LINK "CalPrmBrkTqCtrlrBrk01.U8_WPE_Pump_Efficiency_Low_P" 0 /end CHARACTERISTIC
/begin COMPU_METHOD A41 "" LINEAR "%.15" "g" COEFFS_LINEAR 0.001 0 /end COMPU_METHOD
/begin COMPU_METHOD A42 "" LINEAR "%.15" "g" COEFFS_LINEAR 0.01 0 /end COMPU_METHOD
/begin COMPU_METHOD A46 "" LINEAR "%.15" "g" COEFFS_LINEAR 0.03125 0 /end COMPU_METHOD
/begin COMPU_METHOD A48 "" LINEAR "%.15" "g" COEFFS_LINEAR 0.0001 0 /end COMPU_METHOD
/begin COMPU_METHOD ActvSts1 "" LINEAR "%.15" "NA" COEFFS_LINEAR 1 0 STATUS_STRING_REF ActiveTable /end COMPU_METHOD
/begin COMPU_METHOD Ag41 "" LINEAR "%.15" "deg" COEFFS_LINEAR 0.1 0 /end COMPU_METHOD
/begin COMPU_METHOD Ag42 "" LINEAR "%.15" "deg" COEFFS_LINEAR 0.01 0 /end COMPU_METHOD
/begin COMPU_METHOD AgSpd31 "" LINEAR "%.15" "DegPerSec" COEFFS_LINEAR 0.01 0 /end COMPU_METHOD
/begin COMPU_METHOD AgSpd41 "" LINEAR "%.15" "DegPerSec" COEFFS_LINEAR 0.1 0 /end COMPU_METHOD
/begin COMPU_METHOD AgSpd42 "" LINEAR "%.15" "DegPerSec" COEFFS_LINEAR 0.1 0 /end COMPU_METHOD
/begin COMPU_METHOD Amp1 "" LINEAR "%.15" "A" COEFFS_LINEAR 0.01 0 /end COMPU_METHOD
/begin COMPU_METHOD Amp2 "" LINEAR "%.15" "A" COEFFS_LINEAR 0.001 0 /end COMPU_METHOD
/begin COMPU_METHOD Ar11 "" LINEAR "%.15" "m2" COEFFS_LINEAR 0.1 0 /end COMPU_METHOD
/begin COMPU_METHOD Ar21 "" LINEAR "%.15" "cm2" COEFFS_LINEAR 1 0 /end COMPU_METHOD
/begin COMPU_METHOD BltLockSt1 "" LINEAR "%.15" "NA" COEFFS_LINEAR 1 0 STATUS_STRING_REF LockTable /end COMPU_METHOD
/begin COMPU_METHOD BrkCtrlFct1 "" LINEAR "%.15" "NA" COEFFS_LINEAR 1 0 STATUS_STRING_REF CtrlTable /end COMPU_METHOD
/begin COMPU_METHOD BrkDskHeatgCoeff1 "" LINEAR "%.15" "NmPerKgDegc" COEFFS_LINEAR 1 0 /end COMPU_METHOD
/begin COMPU_METHOD BrkOnOff1 "" LINEAR "%.15" "NA" COEFFS_LINEAR 1 0 STATUS_STRING_REF BrkActTable /end COMPU_METHOD
/begin COMPU_METHOD CmdSolnOnOff1 "" LINEAR "%.15" "NA" COEFFS_LINEAR 1 0 STATUS_STRING_REF SolenoidTable /end COMPU_METHOD
/begin COMPU_METHOD CmplnSts1 "" LINEAR "%.15" "NA" COEFFS_LINEAR 1 0 STATUS_STRING_REF CompleTable /end COMPU_METHOD
/begin COMPU_METHOD Dens11 "" LINEAR "%.15" "KgPerm3" COEFFS_LINEAR 0.1 0 /end COMPU_METHOD
/begin COMPU_METHOD DetnSts1 "" LINEAR "%.15" "NA" COEFFS_LINEAR 1 0 STATUS_STRING_REF DetTable /end COMPU_METHOD
/begin COMPU_METHOD DiagSts1 "" LINEAR "%.15" "NA" COEFFS_LINEAR 1 0 STATUS_STRING_REF DiagTable /end COMPU_METHOD
/begin COMPU_METHOD DrvMod1 "" LINEAR "%.15" "NA" COEFFS_LINEAR 1 0 STATUS_STRING_REF DrvMod1 /end COMPU_METHOD
/begin COMPU_METHOD DrvgMod1 "" LINEAR "%.15" "NA" COEFFS_LINEAR 1 0 STATUS_STRING_REF DrvgModTable /end COMPU_METHOD
/begin COMPU_METHOD DrvnAxleTqCtrlFct1 "" LINEAR "%.15" "NA" COEFFS_LINEAR 1 0 STATUS_STRING_REF CtrlTable /end COMPU_METHOD
/begin COMPU_METHOD EpbBtnCtrlSts1 "" LINEAR "%.15" "NA" COEFFS_LINEAR 1 0 STATUS_STRING_REF RelsTable /end COMPU_METHOD
/begin COMPU_METHOD EsvVlvMod "" LINEAR "%.15" "NA" COEFFS_LINEAR 1 0 STATUS_STRING_REF EsvVlvModTable /end COMPU_METHOD
/begin COMPU_METHOD Fac11 "" LINEAR "%.15" "NA" COEFFS_LINEAR 0.001 0 /end COMPU_METHOD
/begin COMPU_METHOD Fac31 "" LINEAR "%.15" "NA" COEFFS_LINEAR 1 0 /end COMPU_METHOD
/begin COMPU_METHOD Fac81 "" LINEAR "%.15" "NA" COEFFS_LINEAR 5 0 /end COMPU_METHOD
/begin COMPU_METHOD Gain "" LINEAR "%.15" "NA" COEFFS_LINEAR 1 0 /end COMPU_METHOD
/begin COMPU_METHOD OnOff1 "" LINEAR "%.15" "NA" COEFFS_LINEAR 1 0 STATUS_STRING_REF OnOffTable /end COMPU_METHOD
/begin COMPU_METHOD P32 "" LINEAR "%.15" "bar" COEFFS_LINEAR 0.01 0 /end COMPU_METHOD
/begin COMPU_METHOD P34 "" LINEAR "%.15" "bar" COEFFS_LINEAR 0.1 0 /end COMPU_METHOD
/begin COMPU_METHOD PGrdt11 "" LINEAR "%.15" "barPersec" COEFFS_LINEAR 0.1 0 /end COMPU_METHOD
/begin COMPU_METHOD Perc2 "" LINEAR "%.15" "Percentage" COEFFS_LINEAR 0.5 0 /end COMPU_METHOD
/begin COMPU_METHOD Perc6 "" LINEAR "%.15" "Percentage" COEFFS_LINEAR 1 0 /end COMPU_METHOD
/begin COMPU_METHOD Spd11 "" LINEAR "%.15" "kph" COEFFS_LINEAR 0.015625 0 /end COMPU_METHOD
/begin COMPU_METHOD Spd12 "" LINEAR "%.15" "kph" COEFFS_LINEAR 0.125 0 /end COMPU_METHOD
/begin COMPU_METHOD Ti11 "" LINEAR "%.15" "sec" COEFFS_LINEAR 1 0 /end COMPU_METHOD
/begin COMPU_METHOD Ti21 "" LINEAR "%.15" "sec" COEFFS_LINEAR 0.01 0 /end COMPU_METHOD
/begin COMPU_METHOD Ti31 "" LINEAR "%.15" "sec" COEFFS_LINEAR 0.001 0 /end COMPU_METHOD
/begin COMPU_METHOD Ti41 "" LINEAR "%.15" "sec" COEFFS_LINEAR 0.005 0 /end COMPU_METHOD
/begin COMPU_METHOD Tq2 "" LINEAR "%.15" "Nm" COEFFS_LINEAR 1 0 /end COMPU_METHOD
/begin COMPU_METHOD U11 "" LINEAR "%.15" "V" COEFFS_LINEAR 0.001 0 /end COMPU_METHOD
/begin COMPU_METHOD U13 "" LINEAR "%.15" "V" COEFFS_LINEAR 0.1 0 /end COMPU_METHOD
/begin COMPU_VTAB ActiveTable "" TAB_VERB 2 0 "NotActive" 1 "Active" DEFAULT_VALUE "" /end COMPU_VTAB
/begin COMPU_VTAB BrkActTable "" TAB_VERB 2 0 "BrakeOff" 1 "BrakeOn" DEFAULT_VALUE "" /end COMPU_VTAB
/begin COMPU_VTAB CompleTable "" TAB_VERB 2 0 "NotCompletion" 1 "Completion" DEFAULT_VALUE "" /end COMPU_VTAB
/begin COMPU_VTAB CtrlTable "" TAB_VERB 40 0 "NoCtrl" 10 "ROP" 11 "ESC" 12 "TVBB" 13 "CRAM" 14 "ABSD" 15 "LDP" 16 "IVSS" 20 "PBA" 21 "FBS" 22 "FCC" 23 "LVBA" 24 "HBOB" 30 "EBD" 31 "ABS" 32 "CBC" 33 "SLS" 34 "PAC" 35 "RBB" 36 "EDC" 40 "BTCS" 41 "ETCS" 42 "ETSC" 50 "AVH" 51 "HSA" 52 "ISG" 53 "EPB" 60 "ACC" 61 "AEB" 62 "TJA" 63 "PIB" 64 "HBP" 70 "HDC" 71 "ADC" 72 "HRC" 73 "TSP" 74 "DPB" 80 "EBP" 81 "CCM" 82 "BDW" DEFAULT_VALUE "" /end COMPU_VTAB
/begin COMPU_VTAB DetTable "" TAB_VERB 2 0 "NotDetected" 1 "Detected" DEFAULT_VALUE "" /end COMPU_VTAB
/begin COMPU_VTAB DiagTable "" TAB_VERB 3 0 "NoDiag" 1 "StandardDiag" 2 "ExtendedDiag" DEFAULT_VALUE "" /end COMPU_VTAB
/begin COMPU_VTAB DrvMod1 "" TAB_VERB 2 0 "2WD" 1 "4WD" DEFAULT_VALUE "" /end COMPU_VTAB
/begin COMPU_VTAB DrvgModTable "" TAB_VERB 6 0 "Normal" 1 "TractionControl" 2 "EscOff" 3 "Comport" 4 "Sport" 5 "SportPlus" DEFAULT_VALUE "" /end COMPU_VTAB
/begin COMPU_VTAB EsvVlvModTable "" TAB_VERB 3 0 "Not control" 1 "Pattern control" 2 "Max current control" DEFAULT_VALUE "" /end COMPU_VTAB
/begin COMPU_VTAB LockTable "" TAB_VERB 2 0 "Unlock" 1 "Lock" DEFAULT_VALUE "" /end COMPU_VTAB
/begin COMPU_VTAB OnOff1 "" TAB_VERB 2 0 "off" 1 "on" DEFAULT_VALUE "" /end COMPU_VTAB
/begin COMPU_VTAB OnOffTable "" TAB_VERB 2 0 "Off" 1 "On" DEFAULT_VALUE "" /end COMPU_VTAB
/begin COMPU_VTAB RelsTable "" TAB_VERB 5 0 "NoReq" 1 "ApplyReq" 2 "RelsReq" 3 "Actvd" 4 "Unknown" DEFAULT_VALUE "" /end COMPU_VTAB
/begin COMPU_VTAB SolenoidTable "" TAB_VERB 2 0 "SolenoidOff" 1 "SolenoidOn" DEFAULT_VALUE "" /end COMPU_VTAB
/begin RECORD_LAYOUT CalPrmAwdCtrlrEng_SWORD FNC_VALUES 1 SWORD COLUMN_DIR DIRECT ALIGNMENT_BYTE 1 ALIGNMENT_WORD 1 ALIGNMENT_LONG 1 ALIGNMENT_FLOAT32_IEEE 1 ALIGNMENT_FLOAT64_IEEE 1 ALIGNMENT_INT64 1 /end RECORD_LAYOUT
/begin RECORD_LAYOUT CalPrmAwdCtrlrEng_UBYTE FNC_VALUES 1 UBYTE COLUMN_DIR DIRECT ALIGNMENT_BYTE 1 ALIGNMENT_WORD 1 ALIGNMENT_LONG 1 ALIGNMENT_FLOAT32_IEEE 1 ALIGNMENT_FLOAT64_IEEE 1 ALIGNMENT_INT64 1 /end RECORD_LAYOUT
/begin RECORD_LAYOUT CalPrmBrkTqCtrlrBrk_SWORD FNC_VALUES 1 SWORD COLUMN_DIR DIRECT ALIGNMENT_BYTE 1 ALIGNMENT_WORD 1 ALIGNMENT_LONG 1 ALIGNMENT_FLOAT32_IEEE 1 ALIGNMENT_FLOAT64_IEEE 1 ALIGNMENT_INT64 1 /end RECORD_LAYOUT
/begin RECORD_LAYOUT CalPrmBrkTqCtrlrBrk_UBYTE FNC_VALUES 1 UBYTE COLUMN_DIR DIRECT ALIGNMENT_BYTE 1 ALIGNMENT_WORD 1 ALIGNMENT_LONG 1 ALIGNMENT_FLOAT32_IEEE 1 ALIGNMENT_FLOAT64_IEEE 1 ALIGNMENT_INT64 1 /end RECORD_LAYOUT
/begin RECORD_LAYOUT CalPrmBrkTqCtrlrBrk_UWORD FNC_VALUES 1 UWORD COLUMN_DIR DIRECT ALIGNMENT_BYTE 1 ALIGNMENT_WORD 1 ALIGNMENT_LONG 1 ALIGNMENT_FLOAT32_IEEE 1 ALIGNMENT_FLOAT64_IEEE 1 ALIGNMENT_INT64 1 /end RECORD_LAYOUT
/begin RECORD_LAYOUT CalPrmLatDynsCoorrBrk_UBYTE FNC_VALUES 1 UBYTE COLUMN_DIR DIRECT ALIGNMENT_BYTE 1 ALIGNMENT_WORD 1 ALIGNMENT_LONG 1 ALIGNMENT_FLOAT32_IEEE 1 ALIGNMENT_FLOAT64_IEEE 1 ALIGNMENT_INT64 1 /end RECORD_LAYOUT
/begin RECORD_LAYOUT CalPrmLatDynsCoorrBrk_UWORD FNC_VALUES 1 UWORD COLUMN_DIR DIRECT ALIGNMENT_BYTE 1 ALIGNMENT_WORD 1 ALIGNMENT_LONG 1 ALIGNMENT_FLOAT32_IEEE 1 ALIGNMENT_FLOAT64_IEEE 1 ALIGNMENT_INT64 1 /end RECORD_LAYOUT
/begin RECORD_LAYOUT CalPrmSsmBrk_SWORD FNC_VALUES 1 SWORD COLUMN_DIR DIRECT ALIGNMENT_BYTE 1 ALIGNMENT_WORD 1 ALIGNMENT_LONG 1 ALIGNMENT_FLOAT32_IEEE 1 ALIGNMENT_FLOAT64_IEEE 1 ALIGNMENT_INT64 1 /end RECORD_LAYOUT
/begin RECORD_LAYOUT CalPrmSsmBrk_UBYTE FNC_VALUES 1 UBYTE COLUMN_DIR DIRECT ALIGNMENT_BYTE 1 ALIGNMENT_WORD 1 ALIGNMENT_LONG 1 ALIGNMENT_FLOAT32_IEEE 1 ALIGNMENT_FLOAT64_IEEE 1 ALIGNMENT_INT64 1 /end RECORD_LAYOUT
/begin RECORD_LAYOUT CalPrmSsmBrk_UWORD FNC_VALUES 1 UWORD COLUMN_DIR DIRECT ALIGNMENT_BYTE 1 ALIGNMENT_WORD 1 ALIGNMENT_LONG 1 ALIGNMENT_FLOAT32_IEEE 1 ALIGNMENT_FLOAT64_IEEE 1 ALIGNMENT_INT64 1 /end RECORD_LAYOUT
/begin RECORD_LAYOUT CalPrmVehLgtCoorrBrk_SWORD FNC_VALUES 1 SWORD COLUMN_DIR DIRECT ALIGNMENT_BYTE 1 ALIGNMENT_WORD 1 ALIGNMENT_LONG 1 ALIGNMENT_FLOAT32_IEEE 1 ALIGNMENT_FLOAT64_IEEE 1 ALIGNMENT_INT64 1 /end RECORD_LAYOUT
/begin RECORD_LAYOUT CalPrmVehLgtCoorrBrk_UBYTE FNC_VALUES 1 UBYTE COLUMN_DIR DIRECT ALIGNMENT_BYTE 1 ALIGNMENT_WORD 1 ALIGNMENT_LONG 1 ALIGNMENT_FLOAT32_IEEE 1 ALIGNMENT_FLOAT64_IEEE 1 ALIGNMENT_INT64 1 /end RECORD_LAYOUT
/begin RECORD_LAYOUT CalPrmVehLgtCoorrBrk_UWORD FNC_VALUES 1 UWORD COLUMN_DIR DIRECT ALIGNMENT_BYTE 1 ALIGNMENT_WORD 1 ALIGNMENT_LONG 1 ALIGNMENT_FLOAT32_IEEE 1 ALIGNMENT_FLOAT64_IEEE 1 ALIGNMENT_INT64 1 /end RECORD_LAYOUT
/begin RECORD_LAYOUT CalPrmVehLgtCoorrEng_SBYTE FNC_VALUES 1 SBYTE COLUMN_DIR DIRECT ALIGNMENT_BYTE 1 ALIGNMENT_WORD 1 ALIGNMENT_LONG 1 ALIGNMENT_FLOAT32_IEEE 1 ALIGNMENT_FLOAT64_IEEE 1 ALIGNMENT_INT64 1 /end RECORD_LAYOUT
/begin RECORD_LAYOUT CalPrmVehLgtCoorrEng_SWORD FNC_VALUES 1 SWORD COLUMN_DIR DIRECT ALIGNMENT_BYTE 1 ALIGNMENT_WORD 1 ALIGNMENT_LONG 1 ALIGNMENT_FLOAT32_IEEE 1 ALIGNMENT_FLOAT64_IEEE 1 ALIGNMENT_INT64 1 /end RECORD_LAYOUT
/begin RECORD_LAYOUT CalPrmVehLgtCoorrEng_UBYTE FNC_VALUES 1 UBYTE COLUMN_DIR DIRECT ALIGNMENT_BYTE 1 ALIGNMENT_WORD 1 ALIGNMENT_LONG 1 ALIGNMENT_FLOAT32_IEEE 1 ALIGNMENT_FLOAT64_IEEE 1 ALIGNMENT_INT64 1 /end RECORD_LAYOUT
/begin RECORD_LAYOUT CalPrmWslcEng_SBYTE FNC_VALUES 1 SBYTE COLUMN_DIR DIRECT ALIGNMENT_BYTE 1 ALIGNMENT_WORD 1 ALIGNMENT_LONG 1 ALIGNMENT_FLOAT32_IEEE 1 ALIGNMENT_FLOAT64_IEEE 1 ALIGNMENT_INT64 1 /end RECORD_LAYOUT
/begin RECORD_LAYOUT CalPrmWslcEng_SWORD FNC_VALUES 1 SWORD COLUMN_DIR DIRECT ALIGNMENT_BYTE 1 ALIGNMENT_WORD 1 ALIGNMENT_LONG 1 ALIGNMENT_FLOAT32_IEEE 1 ALIGNMENT_FLOAT64_IEEE 1 ALIGNMENT_INT64 1 /end RECORD_LAYOUT
/begin RECORD_LAYOUT CalPrmWslcEng_UBYTE FNC_VALUES 1 UBYTE COLUMN_DIR DIRECT ALIGNMENT_BYTE 1 ALIGNMENT_WORD 1 ALIGNMENT_LONG 1 ALIGNMENT_FLOAT32_IEEE 1 ALIGNMENT_FLOAT64_IEEE 1 ALIGNMENT_INT64 1 /end RECORD_LAYOUT
/begin RECORD_LAYOUT CalPrmWslcEng_UWORD FNC_VALUES 1 UWORD COLUMN_DIR DIRECT ALIGNMENT_BYTE 1 ALIGNMENT_WORD 1 ALIGNMENT_LONG 1 ALIGNMENT_FLOAT32_IEEE 1 ALIGNMENT_FLOAT64_IEEE 1 ALIGNMENT_INT64 1 /end RECORD_LAYOUT
/begin RECORD_LAYOUT CalPrmWspcEng_SWORD FNC_VALUES 1 SWORD COLUMN_DIR DIRECT ALIGNMENT_BYTE 1 ALIGNMENT_WORD 1 ALIGNMENT_LONG 1 ALIGNMENT_FLOAT32_IEEE 1 ALIGNMENT_FLOAT64_IEEE 1 ALIGNMENT_INT64 1 /end RECORD_LAYOUT
/begin RECORD_LAYOUT CalPrmWspcEng_UBYTE FNC_VALUES 1 UBYTE COLUMN_DIR DIRECT ALIGNMENT_BYTE 1 ALIGNMENT_WORD 1 ALIGNMENT_LONG 1 ALIGNMENT_FLOAT32_IEEE 1 ALIGNMENT_FLOAT64_IEEE 1 ALIGNMENT_INT64 1 /end RECORD_LAYOUT
/begin GROUP A.AccBrk_CtrlThres ""
 /begin REF_CHARACTERISTIC S16_ACC_PRESS_MAX U8_ACC_PRESS_RESET_THD U8_ACC_PRESS_SET_THD /end REF_CHARACTERISTIC
/end GROUP
/begin GROUP A.AccBrk_DecelSlop ""
 /begin REF_CHARACTERISTIC U8_ACC_G_SLOPE_HILLUP_STOP U8_ACC_G_SLOPE_HILL_STOP U8_ACC_G_SLOPE_STOP U8_ACC_G_SLOPE_STOP_CNT /end REF_CHARACTERISTIC
/end GROUP
/begin GROUP A.AccBrk_FFGain "" /begin REF_CHARACTERISTIC U8_ACC_FF_DEC_FACTOR_NEG_G /end REF_CHARACTERISTIC /end GROUP
/begin GROUP A.AccBrk_FlatRoad ""
 /begin REF_CHARACTERISTIC S8_ACC_CONT_B_D_GAIN S8_ACC_CONT_B_G1_D_GAIN S8_ACC_CONT_B_G1_I_GAIN S8_ACC_CONT_B_G1_P_GAIN S8_ACC_CONT_B_G1_P_GAIN_MINUS_G_ERR S8_ACC_CONT_B_I_GAIN S8_ACC_CONT_B_P_GAIN S8_ACC_CONT_B_P_GAIN_MINUS_G_ERR /end REF_CHARACTERISTIC
/end GROUP
/begin GROUP A.AccBrk_FlatRoad_Stop ""
 /begin REF_CHARACTERISTIC S8_ACC_CONT_B_STOP_D_GAIN S8_ACC_CONT_B_STOP_I_GAIN S8_ACC_CONT_B_STOP_P_GAIN /end REF_CHARACTERISTIC
/end GROUP
/begin GROUP A.AccBrk_InitCtrl ""
 /begin REF_CHARACTERISTIC U16_ACC_BRK_INIT_CTRL_TIME U16_ACC_INIT_ADD_BRK_TQ_GRDT_MAX U16_ACC_INIT_ADD_BRK_TQ_GRDT_MIN /end REF_CHARACTERISTIC
/end GROUP
/begin GROUP A.AccBrk_MinMax "" /begin REF_CHARACTERISTIC S16_ACC_TARGETG_LIMIT_MAX S16_ACC_TARGETG_LIMIT_MIN /end REF_CHARACTERISTIC /end GROUP
/begin GROUP A.AccEng_CtrlGain "" /begin SUB_GROUP A.AccEng_FFGain B.AccEng_FBGain /end SUB_GROUP /end GROUP
/begin GROUP A.AccEng_FFGain ""
 /begin REF_CHARACTERISTIC U8_ACC_FF_DEC_FACTOR_POS_G U8_ACC_FF_HILL_FACTOR_NEG_G U8_ACC_FF_ROLLING_RESIST_FACTOR U8_ACC_FF_VREF_FACTOR /end REF_CHARACTERISTIC
/end GROUP
/begin GROUP A.AccEng_TqSlop ""
 /begin REF_CHARACTERISTIC U8_ACC_ENGTORQSLOPE_G1_MAX U8_ACC_ENGTORQSLOPE_G1_MIN U8_ACC_ENGTORQSLOPE_MAX U8_ACC_ENGTORQSLOPE_MIN /end REF_CHARACTERISTIC
/end GROUP
/begin GROUP A.Acc_TargetAccel "" /begin SUB_GROUP A.AccBrk_MinMax B.AccBrk_StopCtrl /end SUB_GROUP /end GROUP
/begin GROUP A.AebBrk_CtrlGain "" /begin REF_CHARACTERISTIC U8_AEB_I_PSEUDO_GAIN_BRAKE /end REF_CHARACTERISTIC /begin SUB_GROUP A.Aeb_PreBrk B.Aeb_EmerBrk /end SUB_GROUP /end GROUP
/begin GROUP A.AebBrk_CtrlThres "" /begin REF_CHARACTERISTIC S16_AEB_PRESS_MAX /end REF_CHARACTERISTIC /end GROUP
/begin GROUP A.AebBrk_MinMax "" /begin REF_CHARACTERISTIC S16_AEB_TARGETG_MAX_STOP S16_AEB_TARGETG_MIN_STOP /end REF_CHARACTERISTIC /end GROUP
/begin GROUP A.AebFullBrk_FFGain ""
 /begin REF_CHARACTERISTIC U8_AEB_FF_DEC_FACTOR_NEG_G U8_AEB_FF_DEC_FACTOR_POS_G U8_AEB_FF_HILL_FACTOR_NEG_G U8_AEB_FF_LIMIT_NEG_G U8_AEB_FF_LIMIT_POS_G U8_AEB_FF_ROLLING_RESIST_FACTOR U8_AEB_FF_VREF_FACTOR /end REF_CHARACTERISTIC
/end GROUP
/begin GROUP A.Aeb_PreBrk "" /begin SUB_GROUP B.AebPreBrk_FBGain /end SUB_GROUP /end GROUP
/begin GROUP A.Aeb_TargetAccel "" /begin SUB_GROUP A.AebBrk_MinMax B.AebBrk_StopCtrl /end SUB_GROUP /end GROUP
/begin GROUP A.AftMotOn ""
 /begin REF_CHARACTERISTIC U16TcmfRisePatPGrdtFrnt1 U16TcmfRisePatPGrdtFrnt2 U16TcmfRisePatPGrdtFrnt3 U8TcmfRiseAftCompPatTiRe1 U8TcmfRiseAftCompPatTiRe2 U8TcmfRiseAftCompPatTiRe3 U8TcmfRisePatTiFrnt1 U8TcmfRisePatTiFrnt2 U8TcmfRisePatTiFrnt3 U8TcmfRisePatTiRe1 U8TcmfRisePatTiRe2 U8TcmfRisePatTiRe3 /end REF_CHARACTERISTIC
/end GROUP
/begin GROUP A.DpbBrk_CtrlGain "" /begin SUB_GROUP A.Dpb_EmerBrk /end SUB_GROUP /end GROUP
/begin GROUP A.DpbFullBrk_FFGain ""
 /begin REF_CHARACTERISTIC U8_DPB_FF_DEC_FACTOR_NEG_G U8_DPB_FF_DEC_FACTOR_POS_G U8_DPB_FF_HILL_FACTOR_NEG_G U8_DPB_FF_LIMIT_NEG_G U8_DPB_FF_LIMIT_POS_G U8_DPB_FF_RollingResist_FACTOR U8_DPB_FF_Vref_FACTOR /end REF_CHARACTERISTIC
/end GROUP
/begin GROUP A.Dpb_EmerBrk "" /begin SUB_GROUP A.DpbFullBrk_FFGain B.DpbFullBrk_FBGain /end SUB_GROUP /end GROUP
/begin GROUP A.ESC_Control ""
 /begin REF_CHARACTERISTIC TQU16_FRNT_WH_PRESS_TO_BRK_TORQ_RATIO TQU16_REAR_WH_PRESS_TO_BRK_TORQ_RATIO /end REF_CHARACTERISTIC
 /begin SUB_GROUP a.Esc_Road_Mu a.Gain_Speed_V b.Override c.Tq_Gradient d.Multi_Wheel e.Tar_Tq_Cal f.Esc_Fade_Out f.Yaw_Limit g.Esc_Split /end SUB_GROUP
/end GROUP
/begin GROUP A.EsvVlvCurPatCtrl ""
 /begin REF_CHARACTERISTIC U16EsvVlvCurPatIniActtnTi U8EsvVlvCurMaxPatActtnTi U8EsvVlvHldCurMin U8EsvVlvOpenCurMin /end REF_CHARACTERISTIC
/end GROUP
/begin GROUP A.HillEffectFactor ""
 /begin REF_CHARACTERISTIC U8_ACC_I_GAIN_AMP_BRK_HILL U8_ACC_I_GAIN_AMP_ENG_HILL U8_ACC_PID_GAIN_DIV_ENG_HILL /end REF_CHARACTERISTIC
/end GROUP
/begin GROUP A.IniDuty ""
 /begin REF_CHARACTERISTIC U16IniDutyMotU1 U16IniDutyMotU2 U8IniMotUDuty1 U8IniMotUDuty2 /end REF_CHARACTERISTIC
/end GROUP
/begin GROUP A.IniOnTi ""
 /begin REF_CHARACTERISTIC U16IniTiMotU1 U16IniTiMotU2 U16IniTiMotU3 U16IniTiMotU4 U8MotUIniTi1 U8MotUIniTi2 U8MotUIniTi3 U8MotUIniTi4 /end REF_CHARACTERISTIC
/end GROUP
/begin GROUP A.LfcRise "" /begin SUB_GROUP A.Suction B.NotSuction /end SUB_GROUP /end GROUP
/begin GROUP A.NcVlvCurPatCtrl "" /begin REF_CHARACTERISTIC U8NcVlvCurMaxPatActtnTi U8NcVlvHldCurMin U8NcVlvOpenCurMin /end REF_CHARACTERISTIC /end GROUP
/begin GROUP A.NotSuctionPErr ""
 /begin REF_CHARACTERISTIC U16LfcRiseNotSuctnPErr1 U16LfcRiseNotSuctnPErr2 U16LfcRiseNotSuctnPErr3 /end REF_CHARACTERISTIC
/end GROUP
/begin GROUP A.PCtrlCalPrm ""
 /begin REF_CHARACTERISTIC U16DtrmMstCylP U16DtrmTcmfMstCylP U16DtrmTcmpPErr U8DtrmTcmfModPErr /end REF_CHARACTERISTIC
/end GROUP
/begin GROUP A.PFbNo1VlvCur "" /begin REF_CHARACTERISTIC U8LfcRiseFbPErrToNo1VlvCurGain /end REF_CHARACTERISTIC /end GROUP
/begin GROUP A.PwmCtrl "" /begin SUB_GROUP A.IniDuty B.CompDuty /end SUB_GROUP /end GROUP
/begin GROUP A.RiseRateTest1Whl "" /begin REF_CHARACTERISTIC U16RiseRateTestActtnTi1Whl U16RiseRateTestMotU1Whl /end REF_CHARACTERISTIC /end GROUP
/begin GROUP A.Suction ""
 /begin REF_CHARACTERISTIC U16LfcRiseSuctnNo1VlvCurPGrdt1 U16LfcRiseSuctnNo1VlvCurPGrdt2 U16LfcRiseSuctnNo1VlvCurPGrdt3 U16LfcRiseSuctnNo1VlvCurPGrdt4 U16LfcRiseSuctnNo1VlvCurPGrdt5 U16LfcRiseSuctnNo1VlvCurPGrdt6 U16LfcRiseSuctnNo1VlvCurPGrdt7 U16LfcRiseSuctnPGrdtNo1VlvCur1 U16LfcRiseSuctnPGrdtNo1VlvCur2 U16LfcRiseSuctnPGrdtNo1VlvCur3 U16LfcRiseSuctnPGrdtNo1VlvCur4 U16LfcRiseSuctnPGrdtNo1VlvCur5 U16LfcRiseSuctnPGrdtNo1VlvCur6 U16LfcRiseSuctnPGrdtNo1VlvCur7 /end REF_CHARACTERISTIC
/end GROUP
/begin GROUP A.TOD_Threshold ""
 /begin REF_CHARACTERISTIC TP_U8_TOD_MTP_THR TP_U8_TOD_OVER_THR_G1 TP_U8_TOD_OVER_THR_G2 TP_U8_TOD_UNDER_THR_G1 TP_U8_TOD_UNDER_THR_G2 /end REF_CHARACTERISTIC
/end GROUP
/begin GROUP A.TcVlvCurUpDwnTest ""
 /begin REF_CHARACTERISTIC U16TcVlvCurTestUpDwnCurHldTi U16TcVlvCurTestUpDwnCurMax U16TcVlvCurTestUpDwnIntlCur /end REF_CHARACTERISTIC
/end GROUP
/begin GROUP A.TcmfDumpTcVlvCur ""
 /begin REF_CHARACTERISTIC U16TcmfDumpDecTcVlvCurPGrdt1 U16TcmfDumpDecTcVlvCurPGrdt2 U16TcmfDumpDecTcVlvCurPGrdt3 U8TcmfDumpPGrdtDecTcVlvCur1 U8TcmfDumpPGrdtDecTcVlvCur2 U8TcmfDumpPGrdtDecTcVlvCur3 /end REF_CHARACTERISTIC
/end GROUP
/begin GROUP A.TcmfIniRiseInhb ""
 /begin REF_CHARACTERISTIC U16TcmfIniRiseInhbTiP1 U16TcmfIniRiseInhbTiP2 U16TcmfIniRiseInhbTiP3 U8TcmfIniRiseChgPGrdt U8TcmfIniRiseInhbPTi1 U8TcmfIniRiseInhbPTi2 U8TcmfIniRiseInhbPTi3 /end REF_CHARACTERISTIC
/end GROUP
/begin GROUP A.TcmfIniRiseMotU "" /begin SUB_GROUP A.TcmfIniRiseMotUFrnt B.TcmfIniRiseMotURe /end SUB_GROUP /end GROUP
/begin GROUP A.TcmfIniRiseMotUFrnt ""
 /begin REF_CHARACTERISTIC U16TcmfIniRiseMotUPGrdtFrnt01 U16TcmfIniRiseMotUPGrdtFrnt02 U16TcmfIniRiseMotUPGrdtFrnt03 U16TcmfIniRiseMotUPGrdtFrnt04 U16TcmfIniRiseMotUPGrdtFrnt05 U16TcmfIniRiseMotUPGrdtFrnt06 U16TcmfIniRiseMotUPGrdtFrnt07 U16TcmfIniRiseMotUPGrdtFrnt08 U16TcmfIniRiseMotUPGrdtFrnt09 U16TcmfIniRiseMotUPGrdtFrnt10 U16TcmfIniRiseMotUPGrdtFrnt11 U16TcmfIniRiseMotUPGrdtFrnt12 U16TcmfIniRiseMotUPGrdtFrnt13 U16TcmfIniRiseMotUPGrdtFrnt14 /end REF_CHARACTERISTIC
/end GROUP
/begin GROUP A.TcmfMapCur "" /begin REF_CHARACTERISTIC U16TcVlvCurMapGainPrim U16TcVlvCurMapGainSecd /end REF_CHARACTERISTIC /begin SUB_GROUP A.TcmfP B.TcmfPTcVlvCur /end SUB_GROUP /end GROUP
/begin GROUP A.TcmfMotCtrlr "" /begin SUB_GROUP A.TcmfIniRiseMotU B.TcmfRiseMotU C.TcmfHldDumpMotU /end SUB_GROUP /end GROUP
/begin GROUP A.TcmfP ""
 /begin REF_CHARACTERISTIC U16TcmfTcVlvCurP01 U16TcmfTcVlvCurP02 U16TcmfTcVlvCurP03 U16TcmfTcVlvCurP04 U16TcmfTcVlvCurP05 U16TcmfTcVlvCurP06 U16TcmfTcVlvCurP07 U16TcmfTcVlvCurP08 U16TcmfTcVlvCurP09 U16TcmfTcVlvCurP10 U16TcmfTcVlvCurP11 U16TcmfTcVlvCurP12 U16TcmfTcVlvCurP13 U16TcmfTcVlvCurP14 U16TcmfTcVlvCurP15 U16TcmfTcVlvCurP16 U16TcmfTcVlvCurP17 U16TcmfTcVlvCurP18 U16TcmfTcVlvCurP19 U16TcmfTcVlvCurP20 /end REF_CHARACTERISTIC
/end GROUP
/begin GROUP A.TcmfRiseMotUFrnt ""
 /begin REF_CHARACTERISTIC U16TcmfRiseMotUPGrdtFrnt01 U16TcmfRiseMotUPGrdtFrnt02 U16TcmfRiseMotUPGrdtFrnt03 U16TcmfRiseMotUPGrdtFrnt04 U16TcmfRiseMotUPGrdtFrnt05 U16TcmfRiseMotUPGrdtFrnt06 U16TcmfRiseMotUPGrdtFrnt07 U16TcmfRiseMotUPGrdtFrnt08 U16TcmfRiseMotUPGrdtFrnt09 U16TcmfRiseMotUPGrdtFrnt10 U16TcmfRiseMotUPGrdtFrnt11 U16TcmfRiseMotUPGrdtFrnt12 U16TcmfRiseMotUPGrdtFrnt13 U16TcmfRiseMotUPGrdtFrnt14 /end REF_CHARACTERISTIC
/end GROUP
/begin GROUP A.TcmfRisePat "" /begin REF_CHARACTERISTIC U16TcmfRisePatCur /end REF_CHARACTERISTIC /begin SUB_GROUP A.AftMotOn B.AftMotOff /end SUB_GROUP /end GROUP
/begin GROUP A.WslcMotCtrlr "" /begin SUB_GROUP A.AbsMotCtrlr B.WslcDecelComb /end SUB_GROUP /end GROUP
/begin GROUP AA_AutoSwitch "" /begin REF_CHARACTERISTIC SSM_K_EPB_Automatic_Switch_Feature_En /end REF_CHARACTERISTIC /end GROUP
/begin GROUP AA_DoorBelt "" /begin REF_CHARACTERISTIC SSM_K_EPB_Automatic_Apply_DoorBelt_Feature_En /end REF_CHARACTERISTIC /end GROUP
/begin GROUP AA_HilStop ""
 /begin REF_CHARACTERISTIC SSM_K_EPB_Auto_Apply_HillStop_Feature_En SSM_K_EPB_HillStop_Detecting_Time_Th SSM_K_EPB_HillStop_Gear_Act SSM_K_EPB_HillStop_Gradient_Th /end REF_CHARACTERISTIC
/end GROUP
/begin GROUP AA_MT_SWFail "" /begin REF_CHARACTERISTIC SSM_K_EPB_Auto_Apply_SW_Fail_Feature_En /end REF_CHARACTERISTIC /end GROUP
/begin GROUP A_EDC_PARKING_DETECTION ""
 /begin REF_CHARACTERISTIC TP_S16_EDC_DEL_ENG_RPM_FOR_PARK TP_S16_EDC_PARK_ENTRY_RPM_DIFF TP_S16_EDC_PARK_ENTRY_TC_RPM TP_S8_EDC_PARKING_SUSPECT_LIMIT /end REF_CHARACTERISTIC
/end GROUP
/begin GROUP A_EDC_SOLO_Entry ""
 /begin REF_CHARACTERISTIC TP_S8_EDC_ENTRY_THR0_S1 TP_S8_EDC_ENTRY_THR0_S2 TP_S8_EDC_ENTRY_THR0_S3 TP_S8_EDC_ENTRY_THR0_S4 TP_S8_EDC_ENTRY_THR1_S1 TP_S8_EDC_ENTRY_THR1_S2 TP_S8_EDC_ENTRY_THR1_S3 TP_S8_EDC_ENTRY_THR1_S4 TP_S8_EDC_ENTRY_THR2_S1 TP_S8_EDC_ENTRY_THR2_S2 TP_S8_EDC_ENTRY_THR2_S3 TP_S8_EDC_ENTRY_THR2_S4 TP_U8_EDC_ENT_THR_DEL_YAW /end REF_CHARACTERISTIC
/end GROUP
/begin GROUP A_EDC_SOLO_PD_GAIN ""
 /begin REF_CHARACTERISTIC TP_U8_EDC_PHASE1_D_GAIN_S1 TP_U8_EDC_PHASE1_D_GAIN_S2 TP_U8_EDC_PHASE1_D_GAIN_S3 TP_U8_EDC_PHASE1_D_GAIN_S4 TP_U8_EDC_PHASE1_P_GAIN_S1 TP_U8_EDC_PHASE1_P_GAIN_S2 TP_U8_EDC_PHASE1_P_GAIN_S3 TP_U8_EDC_PHASE1_P_GAIN_S4 TP_U8_EDC_PHASE2_D_GAIN_S1 TP_U8_EDC_PHASE2_D_GAIN_S2 TP_U8_EDC_PHASE2_D_GAIN_S3 TP_U8_EDC_PHASE2_D_GAIN_S4 TP_U8_EDC_PHASE2_P_GAIN_S1 TP_U8_EDC_PHASE2_P_GAIN_S2 TP_U8_EDC_PHASE2_P_GAIN_S3 TP_U8_EDC_PHASE2_P_GAIN_S4 TP_U8_EDC_PHASE3_D_GAIN_S1 TP_U8_EDC_PHASE3_D_GAIN_S2 TP_U8_EDC_PHASE3_D_GAIN_S3 TP_U8_EDC_PHASE3_D_GAIN_S4 TP_U8_EDC_PHASE3_P_GAIN_S1 TP_U8_EDC_PHASE3_P_GAIN_S2 TP_U8_EDC_PHASE3_P_GAIN_S3 TP_U8_EDC_PHASE3_P_GAIN_S4 TP_U8_EDC_PHASE4_D_GAIN_S1 TP_U8_EDC_PHASE4_D_GAIN_S2 TP_U8_EDC_PHASE4_D_GAIN_S3 TP_U8_EDC_PHASE4_D_GAIN_S4 TP_U8_EDC_PHASE4_P_GAIN_S1 TP_U8_EDC_PHASE4_P_GAIN_S2 TP_U8_EDC_PHASE4_P_GAIN_S3 TP_U8_EDC_PHASE4_P_GAIN_S4 /end REF_CHARACTERISTIC
/end GROUP
/begin GROUP A_EDC_SOLO_Target ""
 /begin REF_CHARACTERISTIC TP_S8_EDC_TARGET_DELTA_V_S1 TP_S8_EDC_TARGET_DELTA_V_S2 TP_S8_EDC_TARGET_DELTA_V_S3 TP_S8_EDC_TARGET_DELTA_V_S4 /end REF_CHARACTERISTIC
/end GROUP
/begin GROUP A_EDC_SPEED_SETTING ""
 /begin REF_CHARACTERISTIC TP_U16_EDC_SPEED1 TP_U16_EDC_SPEED2 TP_U16_EDC_SPEED3 TP_U16_EDC_SPEED4 /end REF_CHARACTERISTIC
/end GROUP
/begin GROUP A_EPB_Sys_Info "" /begin REF_CHARACTERISTIC SSM_K_EPB_Output_Selection_Mode /end REF_CHARACTERISTIC /end GROUP
/begin GROUP A_HW_Setting "" /begin REF_CHARACTERISTIC TP_U8TCSCpBrkTqGrdtLimIncFacSpinDiffDec /end REF_CHARACTERISTIC /begin SUB_GROUP a_SclFctTrq2PresFrt b_BrkPGrdtLim /end SUB_GROUP /end GROUP
/begin GROUP A_WpeHwPrm ""
 /begin REF_CHARACTERISTIC S16_WPE_Motor_Eff_Gain_1st S16_WPE_Motor_Eff_Gain_2nd S16_WPE_Motor_Eff_Gain_3rd S16_WPE_Motor_Eff_Gain_4th S16_WPE_Motor_Eff_Gain_5th S16_WPE_Motor_Eff_Gain_6th S16_WPE_Motor_Eff_MPress_1st S16_WPE_Motor_Eff_MPress_2nd S16_WPE_Motor_Eff_MPress_3rd S16_WPE_Motor_Eff_MPress_4th S16_WPE_Motor_Eff_MPress_5th S16_WPE_Motor_Eff_MPress_6th S16_WPE_WPE_MotorEff_MPRESS_ON_BAR U8_WPE_Motor_Eccentricity U8_WPE_Motor_K_Torque_Current U8_WPE_Motor_Resistance U8_WPE_Motor_Volt_RPM U8_WPE_Piston_Diameter U8_WPE_Pump_Efficiency_High_P U8_WPE_Pump_Efficiency_Low_P /end REF_CHARACTERISTIC
/end GROUP
/begin GROUP AbsCalPrm "" /begin SUB_GROUP a_Application_Tuning b_Logic_Tuning /end SUB_GROUP /end GROUP
/begin GROUP AccBrkCalPrm ""
 /begin SUB_GROUP A.Acc_TargetAccel B.Acc_BrkCtrlThres C.Acc_StopCtrl D.Acc_BrkTqGrdt E.Acc_Temporary /end SUB_GROUP
/end GROUP
/begin GROUP AccEngCalPrm ""
 /begin SUB_GROUP A.AccEng_CtrlGain B.AccBrk_CtrlGain C.AccEng_TqCtrl D.Acc_PseudoGain /end SUB_GROUP
/end GROUP
/begin GROUP AebBrkCalPrm ""
 /begin SUB_GROUP A.Aeb_TargetAccel B.Aeb_BrkCtrlThres C.Aeb_BrkTqGrdt D.Aeb_Temporary /end SUB_GROUP
/end GROUP
/begin GROUP AebEngCalPrm "" /begin SUB_GROUP A.AebBrk_CtrlGain /end SUB_GROUP /end GROUP
/begin GROUP AwdCtrlrCalPrm ""
 /begin SUB_GROUP A.TOD_Threshold B.TOD_MinMax C.TOD_TorqueMap D.TOD_LimModeMap /end SUB_GROUP
/end GROUP
/begin GROUP AwdCtrlr_EngCal "" /begin SUB_GROUP AwdCtrlrCalPrm /end SUB_GROUP /end GROUP
/begin GROUP B.AbsIniMotU ""
 /begin REF_CHARACTERISTIC U16IniMotUAbsMstCylP1 U16IniMotUAbsMstCylP2 U16IniMotUAbsMstCylP3 U16IniMotUAbsMstCylP4 U16MstCylPIniMotUAbs1 U16MstCylPIniMotUAbs2 U16MstCylPIniMotUAbs3 U16MstCylPIniMotUAbs4 U8IniMotActtnTiAbs /end REF_CHARACTERISTIC
/end GROUP
/begin GROUP B.AccBrk_CtrlFadeout "" /begin REF_CHARACTERISTIC S16_ACC_BRAKE_FADE_OUT_RATE /end REF_CHARACTERISTIC /end GROUP
/begin GROUP B.AccBrk_CtrlGain "" /begin SUB_GROUP A.AccBrk_FFGain B.AccBrk_FBGain C.AccBrk_FBGain_Stop /end SUB_GROUP /end GROUP
/begin GROUP B.AccBrk_FBGain "" /begin SUB_GROUP A.AccBrk_FlatRoad /end SUB_GROUP /end GROUP
/begin GROUP B.AccBrk_FBHold "" /begin REF_CHARACTERISTIC U8_ACC_PIDHOLD_MAXSPD U8_ACC_SLOPE_STOP_FACTOR /end REF_CHARACTERISTIC /end GROUP
/begin GROUP B.AccBrk_GrdtMap ""
 /begin REF_CHARACTERISTIC U16_ACC_BRK_TQ_GRDT_MAX U16_ACC_BRK_TQ_RATE_1 U16_ACC_BRK_TQ_RATE_2 U16_ACC_BRK_TQ_RATE_TIME_1 U16_ACC_BRK_TQ_RATE_TIME_2 /end REF_CHARACTERISTIC
/end GROUP
/begin GROUP B.AccBrk_StopCtrl ""
 /begin REF_CHARACTERISTIC S16_ACC_TARGETG_MAX_STOP S16_ACC_TARGETG_MIN_HILLUP_STOP S16_ACC_TARGETG_MIN_HILL_STOP S16_ACC_TARGETG_MIN_STOP /end REF_CHARACTERISTIC
/end GROUP
/begin GROUP B.AccBrk_UpHill_Stop ""
 /begin REF_CHARACTERISTIC S8_ACC_CONT_B_HILLUP_STOP_D_GAIN S8_ACC_CONT_B_HILLUP_STOP_I_GAIN S8_ACC_CONT_B_HILLUP_STOP_P_GAIN /end REF_CHARACTERISTIC
/end GROUP
/begin GROUP B.AccEng_FBGain ""
 /begin REF_CHARACTERISTIC S8_ACC_CONT_E_D_GAIN S8_ACC_CONT_E_G1_D_GAIN S8_ACC_CONT_E_G1_I_GAIN S8_ACC_CONT_E_G1_P_GAIN S8_ACC_CONT_E_G1_P_GAIN_MINUS_G_ERR S8_ACC_CONT_E_G23_D_GAIN S8_ACC_CONT_E_G23_I_GAIN S8_ACC_CONT_E_G23_P_GAIN S8_ACC_CONT_E_G23_P_GAIN_MINUS_G_ERR S8_ACC_CONT_E_I_GAIN S8_ACC_CONT_E_P_GAIN S8_ACC_CONT_E_P_GAIN_MINUS_G_ERR /end REF_CHARACTERISTIC
 /begin SUB_GROUP A.HillEffectFactor /end SUB_GROUP
/end GROUP
/begin GROUP B.AccEng_TqOffset "" /begin REF_CHARACTERISTIC U8_ACC_ENGTORQ_OFFSET_HIGHSPD U8_ACC_ENGTORQ_OFFSET_LOWSPD /end REF_CHARACTERISTIC /end GROUP
/begin GROUP B.Acc_BrkCtrlThres "" /begin SUB_GROUP A.AccBrk_CtrlThres B.AccBrk_CtrlFadeout /end SUB_GROUP /end GROUP
/begin GROUP B.AebBrk_CtrlFadeout "" /begin REF_CHARACTERISTIC S16_AEB_BRAKE_FADE_OUT_RATE /end REF_CHARACTERISTIC /end GROUP
/begin GROUP B.AebBrk_StopCtrl "" /begin REF_CHARACTERISTIC U8_AEB_G_SLOPE_STOP /end REF_CHARACTERISTIC /end GROUP
/begin GROUP B.AebFullBrk_FBGain ""
 /begin REF_CHARACTERISTIC S16_AEB_ME_PED_DGAIN_HIGH S16_AEB_ME_PED_IGAIN_HIGH S16_AEB_ME_PED_PGAIN_HIGH S16_AEB_PE_PED_DGAIN_HIGH S16_AEB_PE_PED_IGAIN_HIGH S16_AEB_PE_PED_PGAIN_HIGH /end REF_CHARACTERISTIC
/end GROUP
/begin GROUP B.AebPreBrk_FBGain ""
 /begin REF_CHARACTERISTIC S16_AEB_ME_PED_DGAIN_LOW S16_AEB_ME_PED_IGAIN_LOW S16_AEB_ME_PED_PGAIN_LOW S16_AEB_PE_PED_DGAIN_LOW S16_AEB_PE_PED_IGAIN_LOW S16_AEB_PE_PED_PGAIN_LOW /end REF_CHARACTERISTIC
/end GROUP
/begin GROUP B.Aeb_BrkCtrlThres "" /begin SUB_GROUP A.AebBrk_CtrlThres B.AebBrk_CtrlFadeout /end SUB_GROUP /end GROUP
/begin GROUP B.Aeb_EmerBrk "" /begin SUB_GROUP A.AebFullBrk_FFGain B.AebFullBrk_FBGain /end SUB_GROUP /end GROUP
/begin GROUP B.AftMotOff ""
 /begin REF_CHARACTERISTIC U16TcmfRisePatPGrdtRe1 U16TcmfRisePatPGrdtRe2 U16TcmfRisePatPGrdtRe3 U8TcmfRiseAftCompPatTiFrnt1 U8TcmfRiseAftCompPatTiFrnt2 U8TcmfRiseAftCompPatTiFrnt3 /end REF_CHARACTERISTIC
/end GROUP
/begin GROUP B.CompDuty "" /begin SUB_GROUP C.TarMotUChgMotOff /end SUB_GROUP /end GROUP
/begin GROUP B.DpbFullBrk_FBGain ""
 /begin REF_CHARACTERISTIC S16_DPB_ME_MED_DGAIN S16_DPB_ME_MED_IGAIN S16_DPB_ME_MED_PGAIN S16_DPB_ME_PED_DGAIN S16_DPB_ME_PED_IGAIN S16_DPB_ME_PED_PGAIN S16_DPB_PE_MED_DGAIN S16_DPB_PE_MED_IGAIN S16_DPB_PE_MED_PGAIN S16_DPB_PE_PED_DGAIN S16_DPB_PE_PED_IGAIN S16_DPB_PE_PED_PGAIN U8_DPB_I_PSEUDO_GAIN_BRAKE /end REF_CHARACTERISTIC
/end GROUP
/begin GROUP B.EHC_Control "" /begin REF_CHARACTERISTIC TQEHCuint8InhibitionFlag /end REF_CHARACTERISTIC /begin SUB_GROUP b.EHC_Enter_Exit c.EHC_Tar_Torque /end SUB_GROUP /end GROUP
/begin GROUP B.EsvVlvActtnCtrlFinshd ""
 /begin REF_CHARACTERISTIC U16EsvVlvActtnTiFctCtrlFinshd U16EsvVlvActtnVehSpdFctCtrlFinshd U8EsvVlvActtnIntlTiFctCtrlFinshd U8EsvVlvActtnStrtTiFctCtrlFinshd /end REF_CHARACTERISTIC
/end GROUP
/begin GROUP B.No1VlvCtrlCalPrm ""
 /begin REF_CHARACTERISTIC U16No1VlvCurMax U16No1VlvCurMin U16No1VlvCurSysMax U16WslcNo1VlvDutyMax /end REF_CHARACTERISTIC
 /begin SUB_GROUP A.LfcRise B.PlsRise /end SUB_GROUP
/end GROUP
/begin GROUP B.NotSuction ""
 /begin SUB_GROUP A.NotSuctionPErr B.PErrNo1VlvMap1 C.PErrNo1VlvMap2 D.PErrNo1VlvMap3 /end SUB_GROUP
/end GROUP
/begin GROUP B.NotWlscMotCtrlr "" /begin SUB_GROUP A.TcmfMotCtrlr B.WslcLatComb /end SUB_GROUP /end GROUP
/begin GROUP B.OnOffCtrl "" /begin SUB_GROUP A.IniOnTi /end SUB_GROUP /end GROUP
/begin GROUP B.PErrNo1VlvMap1 ""
 /begin REF_CHARACTERISTIC U16LfcRiseNotSuctnNo1VlvCurPGrdt11 U16LfcRiseNotSuctnNo1VlvCurPGrdt12 U16LfcRiseNotSuctnNo1VlvCurPGrdt13 U16LfcRiseNotSuctnNo1VlvCurPGrdt14 U16LfcRiseNotSuctnNo1VlvCurPGrdt15 U16LfcRiseNotSuctnPGrdtNo1VlvCur11 U16LfcRiseNotSuctnPGrdtNo1VlvCur12 U16LfcRiseNotSuctnPGrdtNo1VlvCur13 U16LfcRiseNotSuctnPGrdtNo1VlvCur14 U16LfcRiseNotSuctnPGrdtNo1VlvCur15 /end REF_CHARACTERISTIC
/end GROUP
/begin GROUP B.PFbTcVlvCur ""
 /begin REF_CHARACTERISTIC U16TcmfFbDecPErrTcVlvCur1 U16TcmfFbDecPErrTcVlvCur2 U16TcmfFbIncPErrTcVlvCur1 U16TcmfFbIncPErrTcVlvCur2 U16TcmfFbTcVlvCurPErr1 U16TcmfFbTcVlvCurPErr2 /end REF_CHARACTERISTIC
/end GROUP
/begin GROUP B.PlsDump ""
 /begin REF_CHARACTERISTIC U16PlsDumpPGrdtP1 U16PlsDumpPGrdtP2 U16PlsDumpPGrdtP3 U16PlsDumpPPGrdt1 U16PlsDumpPPGrdt2 U16PlsDumpPPGrdt3 /end REF_CHARACTERISTIC
/end GROUP
/begin GROUP B.PlsRise ""
 /begin REF_CHARACTERISTIC U16PlsRisePGrdt1 U16PlsRisePGrdt2 U16PlsRisePGrdt3 U16PlsRisePGrdt4 U16PlsRisePGrdt5 U16PlsRisePGrdt6 /end REF_CHARACTERISTIC
/end GROUP
/begin GROUP B.RiseRateTest4Whl ""
 /begin REF_CHARACTERISTIC U16RiseRateTestActtnTi4Whl U16RiseRateTestMotU4Whl U16RiseRateTestMotUPrefill U8RiseRateTestActtnTiPreFill /end REF_CHARACTERISTIC
/end GROUP
/begin GROUP B.TOD_MinMax "" /begin REF_CHARACTERISTIC TP_S16_TOD_MAX_TORQ TP_S16_TOD_MIN_TORQ /end REF_CHARACTERISTIC /end GROUP
/begin GROUP B.TcVlvCurReleafTest ""
 /begin REF_CHARACTERISTIC U16TcVlvCurTestReleafCurHldTi U16TcVlvCurTestReleafCurMax U16TcVlvCurTestReleafIntlCur /end REF_CHARACTERISTIC
/end GROUP
/begin GROUP B.TcmfCmpDumpTcVlvCur "" /begin REF_CHARACTERISTIC U8TcmfCmpDumpDecTcVlvCur /end REF_CHARACTERISTIC /end GROUP
/begin GROUP B.TcmfCmpHldTcVlvCur "" /begin REF_CHARACTERISTIC U16TcmfCmpHldIncTcVlvCurDyn U16TcmfCmpHldIncTcVlvCurSsm /end REF_CHARACTERISTIC /end GROUP
/begin GROUP B.TcmfIniRise "" /begin SUB_GROUP A.TcmfIniRiseInhb B.TcmfIniRiseTiFrnt C.TcmfIniRiseTiRe /end SUB_GROUP /end GROUP
/begin GROUP B.TcmfIniRiseMotURe ""
 /begin REF_CHARACTERISTIC U16TcmfIniRiseMotUPGrdtRe01 U16TcmfIniRiseMotUPGrdtRe02 U16TcmfIniRiseMotUPGrdtRe03 U16TcmfIniRiseMotUPGrdtRe04 U16TcmfIniRiseMotUPGrdtRe05 U16TcmfIniRiseMotUPGrdtRe06 U16TcmfIniRiseMotUPGrdtRe07 U16TcmfIniRiseMotUPGrdtRe08 U16TcmfIniRiseMotUPGrdtRe09 U16TcmfIniRiseMotUPGrdtRe10 U16TcmfIniRiseMotUPGrdtRe11 U16TcmfIniRiseMotUPGrdtRe12 U16TcmfIniRiseMotUPGrdtRe13 U16TcmfIniRiseMotUPGrdtRe14 /end REF_CHARACTERISTIC
/end GROUP
/begin GROUP B.TcmfIniRiseTiFrnt ""
 /begin REF_CHARACTERISTIC U8TcmfIniRisePGrdtTiFrnt01 U8TcmfIniRisePGrdtTiFrnt02 U8TcmfIniRisePGrdtTiFrnt03 U8TcmfIniRisePGrdtTiFrnt04 U8TcmfIniRisePGrdtTiFrnt05 U8TcmfIniRisePGrdtTiFrnt06 U8TcmfIniRisePGrdtTiFrnt07 U8TcmfIniRisePGrdtTiFrnt08 U8TcmfIniRisePGrdtTiFrnt09 U8TcmfIniRisePGrdtTiFrnt10 U8TcmfIniRisePGrdtTiFrnt11 U8TcmfIniRisePGrdtTiFrnt12 U8TcmfIniRisePGrdtTiFrnt13 U8TcmfIniRisePGrdtTiFrnt14 /end REF_CHARACTERISTIC
/end GROUP
/begin GROUP B.TcmfPTcVlvCur ""
 /begin REF_CHARACTERISTIC U16TcmfPTcVlvCur01 U16TcmfPTcVlvCur02 U16TcmfPTcVlvCur03 U16TcmfPTcVlvCur04 U16TcmfPTcVlvCur05 U16TcmfPTcVlvCur06 U16TcmfPTcVlvCur07 U16TcmfPTcVlvCur08 U16TcmfPTcVlvCur09 U16TcmfPTcVlvCur10 U16TcmfPTcVlvCur11 U16TcmfPTcVlvCur12 U16TcmfPTcVlvCur13 U16TcmfPTcVlvCur14 U16TcmfPTcVlvCur15 U16TcmfPTcVlvCur16 U16TcmfPTcVlvCur17 U16TcmfPTcVlvCur18 U16TcmfPTcVlvCur19 U16TcmfPTcVlvCur20 /end REF_CHARACTERISTIC
/end GROUP
/begin GROUP B.TcmfRiseMotU "" /begin SUB_GROUP A.TcmfRiseMotUFrnt B.TcmfRiseMotURe /end SUB_GROUP /end GROUP
/begin GROUP B.TcmfRiseMotURe ""
 /begin REF_CHARACTERISTIC U16TcmfRiseMotUPGrdtRe01 U16TcmfRiseMotUPGrdtRe02 U16TcmfRiseMotUPGrdtRe03 U16TcmfRiseMotUPGrdtRe04 U16TcmfRiseMotUPGrdtRe05 U16TcmfRiseMotUPGrdtRe06 U16TcmfRiseMotUPGrdtRe07 U16TcmfRiseMotUPGrdtRe08 U16TcmfRiseMotUPGrdtRe09 U16TcmfRiseMotUPGrdtRe10 U16TcmfRiseMotUPGrdtRe11 U16TcmfRiseMotUPGrdtRe12 U16TcmfRiseMotUPGrdtRe13 U16TcmfRiseMotUPGrdtRe14 /end REF_CHARACTERISTIC
/end GROUP
/begin GROUP B.TcmfRiseTcVlvCur ""
 /begin REF_CHARACTERISTIC U16TcmfRiseIncTcVlvCurPGrdt1 U16TcmfRiseIncTcVlvCurPGrdt2 U16TcmfRiseIncTcVlvCurPGrdt3 U8TcmfRisePGrdtIncTcVlvCurFrnt1 U8TcmfRisePGrdtIncTcVlvCurFrnt2 U8TcmfRisePGrdtIncTcVlvCurFrnt3 U8TcmfRisePGrdtIncTcVlvCurRe1 U8TcmfRisePGrdtIncTcVlvCurRe2 U8TcmfRisePGrdtIncTcVlvCurRe3 /end REF_CHARACTERISTIC
/end GROUP
/begin GROUP B.WslcDecelComb ""
 /begin REF_CHARACTERISTIC U16FricMotUWslcDecelComb1 U16FricMotUWslcDecelComb2 U16FricMotUWslcDecelComb3 U8MotUWslcDecelCombFric1 U8MotUWslcDecelCombFric2 U8MotUWslcDecelCombFric3 /end REF_CHARACTERISTIC
/end GROUP
/begin GROUP B.WslcLatComb "" /begin REF_CHARACTERISTIC U16MotUWslcLatCombNotSuctn U16MotUWslcLatCombSuctn /end REF_CHARACTERISTIC /end GROUP
/begin GROUP B_EDC_ABS_Entry ""
 /begin REF_CHARACTERISTIC TP_S8_EDC_ENTRY_THR0_ABS_S1 TP_S8_EDC_ENTRY_THR0_ABS_S2 TP_S8_EDC_ENTRY_THR0_ABS_S3 TP_S8_EDC_ENTRY_THR0_ABS_S4 TP_S8_EDC_ENTRY_THR1_ABS_S1 TP_S8_EDC_ENTRY_THR1_ABS_S2 TP_S8_EDC_ENTRY_THR1_ABS_S3 TP_S8_EDC_ENTRY_THR1_ABS_S4 TP_S8_EDC_ENTRY_THR2_ABS_S1 TP_S8_EDC_ENTRY_THR2_ABS_S2 TP_S8_EDC_ENTRY_THR2_ABS_S3 TP_S8_EDC_ENTRY_THR2_ABS_S4 /end REF_CHARACTERISTIC
/end GROUP
/begin GROUP B_EDC_ABS_PD_GAIN ""
 /begin REF_CHARACTERISTIC TP_U8_EDC_PHASE1_D_GAIN_ABS_S1 TP_U8_EDC_PHASE1_D_GAIN_ABS_S2 TP_U8_EDC_PHASE1_D_GAIN_ABS_S3 TP_U8_EDC_PHASE1_D_GAIN_ABS_S4 TP_U8_EDC_PHASE1_P_GAIN_ABS_S1 TP_U8_EDC_PHASE1_P_GAIN_ABS_S2 TP_U8_EDC_PHASE1_P_GAIN_ABS_S3 TP_U8_EDC_PHASE1_P_GAIN_ABS_S4 TP_U8_EDC_PHASE2_D_GAIN_ABS_S1 TP_U8_EDC_PHASE2_D_GAIN_ABS_S2 TP_U8_EDC_PHASE2_D_GAIN_ABS_S3 TP_U8_EDC_PHASE2_D_GAIN_ABS_S4 TP_U8_EDC_PHASE2_P_GAIN_ABS_S1 TP_U8_EDC_PHASE2_P_GAIN_ABS_S2 TP_U8_EDC_PHASE2_P_GAIN_ABS_S3 TP_U8_EDC_PHASE2_P_GAIN_ABS_S4 TP_U8_EDC_PHASE3_D_GAIN_ABS_S1 TP_U8_EDC_PHASE3_D_GAIN_ABS_S2 TP_U8_EDC_PHASE3_D_GAIN_ABS_S3 TP_U8_EDC_PHASE3_D_GAIN_ABS_S4 TP_U8_EDC_PHASE3_P_GAIN_ABS_S1 TP_U8_EDC_PHASE3_P_GAIN_ABS_S2 TP_U8_EDC_PHASE3_P_GAIN_ABS_S3 TP_U8_EDC_PHASE3_P_GAIN_ABS_S4 TP_U8_EDC_PHASE4_D_GAIN_ABS_S1 TP_U8_EDC_PHASE4_D_GAIN_ABS_S2 TP_U8_EDC_PHASE4_D_GAIN_ABS_S3 TP_U8_EDC_PHASE4_D_GAIN_ABS_S4 TP_U8_EDC_PHASE4_P_GAIN_ABS_S1 TP_U8_EDC_PHASE4_P_GAIN_ABS_S2 TP_U8_EDC_PHASE4_P_GAIN_ABS_S3 TP_U8_EDC_PHASE4_P_GAIN_ABS_S4 /end REF_CHARACTERISTIC
/end GROUP
/begin GROUP B_EDC_ABS_Target ""
 /begin REF_CHARACTERISTIC TP_S8_EDC_TARGET_DELTA_V_ABS_S1 TP_S8_EDC_TARGET_DELTA_V_ABS_S2 TP_S8_EDC_TARGET_DELTA_V_ABS_S3 TP_S8_EDC_TARGET_DELTA_V_ABS_S4 /end REF_CHARACTERISTIC
/end GROUP
/begin GROUP B_EDC_ENTRY_THRESHOLD ""
 /begin SUB_GROUP A_EDC_SOLO_Entry B_EDC_ABS_Entry C_EDC_ESC_Entry D_EDC_Entry_Modify /end SUB_GROUP
/end GROUP
/begin GROUP B_EDC_GEAR_DETECTION ""
 /begin REF_CHARACTERISTIC TP_S16_AT_In_Gear_Lower_Limit TP_S16_AT_In_Gear_Upper_Limit TP_S16_MT_In_Gear_Out_Vel_Threshold TP_S16_MT_In_Gear_Vel_Threshold_1to3 TP_S16_MT_In_Gear_Vel_Threshold_4to6 TP_S8_MT_In_Gear_Accel_Threshold TP_S8_MT_In_Gear_Out_Accel_Threshold /end REF_CHARACTERISTIC
/end GROUP
/begin GROUP B_EPB_Dect "" /begin SUB_GROUP Ba_EPB_Veh Bb_EPB_Driver Bc_EPB_Sen /end SUB_GROUP /end GROUP
/begin GROUP B_Motor_Control ""
 /begin REF_CHARACTERISTIC TP_S16TCSCpAddMtrV4SPHillHghMuStab TP_S16TCSCpAddMtrV4SPHillHghMuUnSt TP_S16TCSCpFBMtrV_ASC TP_S16TCSCpFBMtrV_Turn TP_S16TCSCpFFMtrV_ASC TP_S16TCSCpFFMtrV_Turn TP_S16TCSCpIniRMdeMtrV_ASC TP_S16TCSCpIniRMdeMtrV_SC TP_S16TCSCpIniRMdeMtrV_Turn TP_S16TCSCpNormMtrV_SC /end REF_CHARACTERISTIC
/end GROUP
/begin GROUP B_WpeBrkVolumePresPrm "" /begin SUB_GROUP a_WpeBrkVolumeFront b_WpeBrkVolumeRear c_WpeBrkVolumPres /end SUB_GROUP /end GROUP
/begin GROUP Ba_EPB_Veh "" /begin SUB_GROUP Engine_Run Road_Grade Veh_Stat /end SUB_GROUP /end GROUP
/begin GROUP Bb_EPB_Driver "" /begin SUB_GROUP Brake_Pedal Clutch_Pedal Engine_RPM Engine_Torq Gas_Pedal /end SUB_GROUP /end GROUP
/begin GROUP Bc_EPB_Sen ""
 /begin REF_CHARACTERISTIC SSM_K_Current_Sensor_Offset SSM_K_Current_Sensor_Offset_EEPROM /end REF_CHARACTERISTIC
/end GROUP
/begin GROUP Brake_Pedal "" /begin REF_CHARACTERISTIC SSM_K_EPB_Master_Pressure_Signal_Th /end REF_CHARACTERISTIC /end GROUP
/begin GROUP BrkAssisCoorrBrkCalPrm "" /begin SUB_GROUP a_BrkAssisCoorrDetn b_PBA c_FBC /end SUB_GROUP /end GROUP
/begin GROUP BrkAssisCoorr_BrkCal "" /begin SUB_GROUP BrkAssisCoorrBrkCalPrm /end SUB_GROUP /end GROUP
/begin GROUP BrkTqCtrlCalPrm ""
 /begin SUB_GROUP A.PCtrlCalPrm B.No1VlvCtrlCalPrm C.NcVlvCtrlCalPrm D.TcVlvCtrlCalPrm E.EsvVlvCtrlCalPrm F.MotCtrlCalPrm G.FbCtrlCalPrm H.HwTestCalPrm /end SUB_GROUP
/end GROUP
/begin GROUP BrkTqCtrlr_BrkCal "" /begin SUB_GROUP BrkTqCtrlCalPrm WhlPEstimdCalPrm /end SUB_GROUP /end GROUP
/begin GROUP BtcsCalPrm ""
 /begin SUB_GROUP A_HW_Setting B_Motor_Control C_Initial_Control D_Turnning_Index E_BTCS_Enter_Condition F_BTCS_Target_Spin G_BTCS_Torque_Control H_BTCS_Special_case I_TCS_LogicAppl J_BTCS_SpeedCondition K_BTCS_Reserved /end SUB_GROUP
/end GROUP
/begin GROUP C.AbsCtrlMotU ""
 /begin REF_CHARACTERISTIC U16FricMotUAbs1 U16FricMotUAbs2 U16FricMotUAbs3 U16MotUAbsVehSpd U16VehSpdMotUAbs U8MotUAbsFric1 U8MotUAbsFric2 U8MotUAbsFric3 /end REF_CHARACTERISTIC
/end GROUP
/begin GROUP C.AccBrk_DownHill_Stop ""
 /begin REF_CHARACTERISTIC S8_ACC_CONT_B_HILLDOWN_STOP_D_GAIN S8_ACC_CONT_B_HILLDOWN_STOP_I_GAIN S8_ACC_CONT_B_HILLDOWN_STOP_P_GAIN /end REF_CHARACTERISTIC
/end GROUP
/begin GROUP C.AccBrk_FBGain_Stop ""
 /begin REF_CHARACTERISTIC U8_ACC_TARGET_TQ_MIN_STOP U8_ACC_TARGET_TQ_MIN_STOP_HILL_DOWN U8_ACC_TARGET_TQ_MIN_STOP_HILL_UP /end REF_CHARACTERISTIC
 /begin SUB_GROUP A.AccBrk_FlatRoad_Stop B.AccBrk_UpHill_Stop C.AccBrk_DownHill_Stop /end SUB_GROUP
/end GROUP
/begin GROUP C.AccEng_TqCtrl "" /begin REF_CHARACTERISTIC U8_ACC_ENG_FADEOUT_SLOPE U8_ACC_TARGET_ENGTQ_MAX /end REF_CHARACTERISTIC /begin SUB_GROUP A.AccEng_TqSlop B.AccEng_TqOffset /end SUB_GROUP /end GROUP
/begin GROUP C.Acc_StopCtrl "" /begin REF_CHARACTERISTIC S16_ACC_EPB_DEMAND_MAX_CNT /end REF_CHARACTERISTIC /begin SUB_GROUP A.AccBrk_DecelSlop B.AccBrk_FBHold /end SUB_GROUP /end GROUP
/begin GROUP C.Aeb_BrkTqGrdt ""
 /begin REF_CHARACTERISTIC U16_AEB_BRK_INIT_CTRL_TIME U16_AEB_BRK_TQ_GRDT_MAX U16_AEB_INIT_ADD_BRK_TQ_GRDT_MAX U16_AEB_INIT_ADD_BRK_TQ_GRDT_MIN /end REF_CHARACTERISTIC
/end GROUP
/begin GROUP C.EsvVlvActtnWslcBac "" /begin REF_CHARACTERISTIC U8EsvVlvActtnTiWslcBac /end REF_CHARACTERISTIC /end GROUP
/begin GROUP C.MotActr "" /begin SUB_GROUP A.PwmCtrl B.OnOffCtrl /end SUB_GROUP /end GROUP
/begin GROUP C.NcVlvCtrlCalPrm "" /begin REF_CHARACTERISTIC U8NcVlvCurMax U8NcVlvCurSysMax /end REF_CHARACTERISTIC /begin SUB_GROUP A.NcVlvCurPatCtrl B.PlsDump /end SUB_GROUP /end GROUP
/begin GROUP C.PErrNo1VlvMap2 ""
 /begin REF_CHARACTERISTIC U16LfcRiseNotSuctnNo1VlvCurPGrdt21 U16LfcRiseNotSuctnNo1VlvCurPGrdt22 U16LfcRiseNotSuctnNo1VlvCurPGrdt23 U16LfcRiseNotSuctnNo1VlvCurPGrdt24 U16LfcRiseNotSuctnNo1VlvCurPGrdt25 U16LfcRiseNotSuctnNo1VlvCurPGrdt26 U16LfcRiseNotSuctnNo1VlvCurPGrdt27 U16LfcRiseNotSuctnPGrdtNo1VlvCur21 U16LfcRiseNotSuctnPGrdtNo1VlvCur22 U16LfcRiseNotSuctnPGrdtNo1VlvCur23 U16LfcRiseNotSuctnPGrdtNo1VlvCur24 U16LfcRiseNotSuctnPGrdtNo1VlvCur25 U16LfcRiseNotSuctnPGrdtNo1VlvCur26 U16LfcRiseNotSuctnPGrdtNo1VlvCur27 /end REF_CHARACTERISTIC
/end GROUP
/begin GROUP C.PFbMotU ""
 /begin REF_CHARACTERISTIC U16TcmfFbMotUPErr1 U16TcmfFbMotUPErr2 U16TcmfFbPErrMotU1 U16TcmfFbPErrMotU2 /end REF_CHARACTERISTIC
/end GROUP
/end MODULE
/end PROJECT
