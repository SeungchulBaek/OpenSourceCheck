ASAP2_VERSION 1 60
/begin PROJECT Master ""
/begin MODULE CPP ""
/begin MOD_COMMON "" BYTE_ORDER MSB_LAST ALIGNMENT_BYTE 1 ALIGNMENT_WORD 1 ALIGNMENT_LONG 1 ALIGNMENT_FLOAT32_IEEE 1 ALIGNMENT_FLOAT64_IEEE 1 ALIGNMENT_INT64 1 /end MOD_COMMON
/begin CHARACTERISTIC S16_WPE_LFC_Rise_Gain_r_10th "Temp" VALUE 0x800216F2 CalPrmBrkTqCtrlrBrk_SWORD 0 Perc6 -32768 32767 SYMBOL_LINK "CalPrmBrkTqCtrlrBrk01.S16_WPE_LFC_Rise_Gain_r_10th" 0 /end CHARACTERISTIC
/begin CHARACTERISTIC S16_WPE_LFC_Rise_Gain_r_11th "Temp" VALUE 0x800216F4 CalPrmBrkTqCtrlrBrk_SWORD 0 Perc6 -32768 32767 SYMBOL_LINK "CalPrmBrkTqCtrlrBrk01.S16_WPE_LFC_Rise_Gain_r_11th" 0 /end CHARACTERISTIC
/begin CHARACTERISTIC S16_WPE_LFC_Rise_Gain_r_1st "Temp" VALUE 0x800216E0 CalPrmBrkTqCtrlrBrk_SWORD 0 Perc6 -32768 32767 SYMBOL_LINK "CalPrmBrkTqCtrlrBrk01.S16_WPE_LFC_Rise_Gain_r_1st" 0 /end CHARACTERISTIC
/begin CHARACTERISTIC S16_WPE_LFC_Rise_Gain_r_2nd "Temp" VALUE 0x800216E2 CalPrmBrkTqCtrlrBrk_SWORD 0 Perc6 -32768 32767 SYMBOL_LINK "CalPrmBrkTqCtrlrBrk01.S16_WPE_LFC_Rise_Gain_r_2nd" 0 /end CHARACTERISTIC
/begin CHARACTERISTIC S16_WPE_LFC_Rise_Gain_r_3rd "Temp" VALUE 0x800216E4 CalPrmBrkTqCtrlrBrk_SWORD 0 Perc6 -32768 32767 SYMBOL_LINK "CalPrmBrkTqCtrlrBrk01.S16_WPE_LFC_Rise_Gain_r_3rd" 0 /end CHARACTERISTIC
/begin CHARACTERISTIC S16_WPE_LFC_Rise_Gain_r_4th "Temp" VALUE 0x800216E6 CalPrmBrkTqCtrlrBrk_SWORD 0 Perc6 -32768 32767 SYMBOL_LINK "CalPrmBrkTqCtrlrBrk01.S16_WPE_LFC_Rise_Gain_r_4th" 0 /end CHARACTERISTIC
/begin CHARACTERISTIC S16_WPE_LFC_Rise_Gain_r_5th "Temp" VALUE 0x800216E8 CalPrmBrkTqCtrlrBrk_SWORD 0 Perc6 -32768 32767 SYMBOL_LINK "CalPrmBrkTqCtrlrBrk01.S16_WPE_LFC_Rise_Gain_r_5th" 0 /end CHARACTERISTIC
/begin CHARACTERISTIC S16_WPE_LFC_Rise_Gain_r_6th "Temp" VALUE 0x800216EA CalPrmBrkTqCtrlrBrk_SWORD 0 Perc6 -32768 32767 SYMBOL_LINK "CalPrmBrkTqCtrlrBrk01.S16_WPE_LFC_Rise_Gain_r_6th" 0 /end CHARACTERISTIC
/begin CHARACTERISTIC S16_WPE_LFC_Rise_Gain_r_7th "Temp" VALUE 0x800216EC CalPrmBrkTqCtrlrBrk_SWORD 0 Perc6 -32768 32767 SYMBOL_LINK "CalPrmBrkTqCtrlrBrk01.S16_WPE_LFC_Rise_Gain_r_7th" 0 /end CHARACTERISTIC
/begin CHARACTERISTIC S16_WPE_LFC_Rise_Gain_r_8th "Temp" VALUE 0x800216EE CalPrmBrkTqCtrlrBrk_SWORD 0 Perc6 -32768 32767 SYMBOL_LINK "CalPrmBrkTqCtrlrBrk01.S16_WPE_LFC_Rise_Gain_r_8th" 0 /end CHARACTERISTIC
/begin CHARACTERISTIC S16_WPE_LFC_Rise_Gain_r_9th "Temp" VALUE 0x800216F0 CalPrmBrkTqCtrlrBrk_SWORD 0 Perc6 -32768 32767 SYMBOL_LINK "CalPrmBrkTqCtrlrBrk01.S16_WPE_LFC_Rise_Gain_r_9th" 0 /end CHARACTERISTIC
/begin CHARACTERISTIC S16_WPE_MP_Rise_Gain_f_1_volume "Temp" VALUE 0x800215C6 CalPrmBrkTqCtrlrBrk_SWORD 0 Perc6 -32768 32767 SYMBOL_LINK "CalPrmBrkTqCtrlrBrk01.S16_WPE_MP_Rise_Gain_f_1_volume" 0 /end CHARACTERISTIC
/begin CHARACTERISTIC S16_WPE_MP_Rise_Gain_f_2_volume "Temp" VALUE 0x800215C8 CalPrmBrkTqCtrlrBrk_SWORD 0 Perc6 -32768 32767 SYMBOL_LINK "CalPrmBrkTqCtrlrBrk01.S16_WPE_MP_Rise_Gain_f_2_volume" 0 /end CHARACTERISTIC
/begin CHARACTERISTIC S16_WPE_MP_Rise_Gain_f_3_volume "Temp" VALUE 0x800215CA CalPrmBrkTqCtrlrBrk_SWORD 0 Perc6 -32768 32767 SYMBOL_LINK "CalPrmBrkTqCtrlrBrk01.S16_WPE_MP_Rise_Gain_f_3_volume" 0 /end CHARACTERISTIC
/begin CHARACTERISTIC S16_WPE_MP_Rise_Gain_f_4_volume "Temp" VALUE 0x800215CC CalPrmBrkTqCtrlrBrk_SWORD 0 Perc6 -32768 32767 SYMBOL_LINK "CalPrmBrkTqCtrlrBrk01.S16_WPE_MP_Rise_Gain_f_4_volume" 0 /end CHARACTERISTIC
/begin CHARACTERISTIC S16_WPE_MP_Rise_Gain_f_5_volume "Temp" VALUE 0x800215CE CalPrmBrkTqCtrlrBrk_SWORD 0 Perc6 -32768 32767 SYMBOL_LINK "CalPrmBrkTqCtrlrBrk01.S16_WPE_MP_Rise_Gain_f_5_volume" 0 /end CHARACTERISTIC
/begin CHARACTERISTIC S16_WPE_MP_Rise_Gain_f_6_volume "Temp" VALUE 0x800215D0 CalPrmBrkTqCtrlrBrk_SWORD 0 Perc6 -32768 32767 SYMBOL_LINK "CalPrmBrkTqCtrlrBrk01.S16_WPE_MP_Rise_Gain_f_6_volume" 0 /end CHARACTERISTIC
/begin CHARACTERISTIC S16_WPE_MP_Rise_Gain_r_1_volume "Temp" VALUE 0x800215DE CalPrmBrkTqCtrlrBrk_SWORD 0 Perc6 -32768 32767 SYMBOL_LINK "CalPrmBrkTqCtrlrBrk01.S16_WPE_MP_Rise_Gain_r_1_volume" 0 /end CHARACTERISTIC
/begin CHARACTERISTIC S16_WPE_MP_Rise_Gain_r_2_volume "Temp" VALUE 0x800215E0 CalPrmBrkTqCtrlrBrk_SWORD 0 Perc6 -32768 32767 SYMBOL_LINK "CalPrmBrkTqCtrlrBrk01.S16_WPE_MP_Rise_Gain_r_2_volume" 0 /end CHARACTERISTIC
/begin CHARACTERISTIC S16_WPE_MP_Rise_Gain_r_3_volume "Temp" VALUE 0x800215E2 CalPrmBrkTqCtrlrBrk_SWORD 0 Perc6 -32768 32767 SYMBOL_LINK "CalPrmBrkTqCtrlrBrk01.S16_WPE_MP_Rise_Gain_r_3_volume" 0 /end CHARACTERISTIC
/begin CHARACTERISTIC S16_WPE_MP_Rise_Gain_r_4_volume "Temp" VALUE 0x800215E4 CalPrmBrkTqCtrlrBrk_SWORD 0 Perc6 -32768 32767 SYMBOL_LINK "CalPrmBrkTqCtrlrBrk01.S16_WPE_MP_Rise_Gain_r_4_volume" 0 /end CHARACTERISTIC
/begin CHARACTERISTIC S16_WPE_MP_Rise_Gain_r_5_volume "Temp" VALUE 0x800215E6 CalPrmBrkTqCtrlrBrk_SWORD 0 Perc6 -32768 32767 SYMBOL_LINK "CalPrmBrkTqCtrlrBrk01.S16_WPE_MP_Rise_Gain_r_5_volume" 0 /end CHARACTERISTIC
/begin CHARACTERISTIC S16_WPE_MP_Rise_Gain_r_6_volume "Temp" VALUE 0x800215E8 CalPrmBrkTqCtrlrBrk_SWORD 0 Perc6 -32768 32767 SYMBOL_LINK "CalPrmBrkTqCtrlrBrk01.S16_WPE_MP_Rise_Gain_r_6_volume" 0 /end CHARACTERISTIC
/begin CHARACTERISTIC S16_WPE_MP_Rise_Press_f_1_volume "Temp" VALUE 0x800215BA CalPrmBrkTqCtrlrBrk_SWORD 0 P34 -3276.8 3276.7 SYMBOL_LINK "CalPrmBrkTqCtrlrBrk01.S16_WPE_MP_Rise_Press_f_1_volume" 0 /end CHARACTERISTIC
/begin CHARACTERISTIC S16_WPE_MP_Rise_Press_f_2_volume "Temp" VALUE 0x800215BC CalPrmBrkTqCtrlrBrk_SWORD 0 P34 -3276.8 3276.7 SYMBOL_LINK "CalPrmBrkTqCtrlrBrk01.S16_WPE_MP_Rise_Press_f_2_volume" 0 /end CHARACTERISTIC
/begin CHARACTERISTIC S16_WPE_MP_Rise_Press_f_3_volume "Temp" VALUE 0x800215BE CalPrmBrkTqCtrlrBrk_SWORD 0 P34 -3276.8 3276.7 SYMBOL_LINK "CalPrmBrkTqCtrlrBrk01.S16_WPE_MP_Rise_Press_f_3_volume" 0 /end CHARACTERISTIC
/begin CHARACTERISTIC S16_WPE_MP_Rise_Press_f_4_volume "Temp" VALUE 0x800215C0 CalPrmBrkTqCtrlrBrk_SWORD 0 P34 -3276.8 3276.7 SYMBOL_LINK "CalPrmBrkTqCtrlrBrk01.S16_WPE_MP_Rise_Press_f_4_volume" 0 /end CHARACTERISTIC
/begin CHARACTERISTIC S16_WPE_MP_Rise_Press_f_5_volume "Temp" VALUE 0x800215C2 CalPrmBrkTqCtrlrBrk_SWORD 0 P34 -3276.8 3276.7 SYMBOL_LINK "CalPrmBrkTqCtrlrBrk01.S16_WPE_MP_Rise_Press_f_5_volume" 0 /end CHARACTERISTIC
/begin CHARACTERISTIC S16_WPE_MP_Rise_Press_f_6_volume "Temp" VALUE 0x800215C4 CalPrmBrkTqCtrlrBrk_SWORD 0 P34 -3276.8 3276.7 SYMBOL_LINK "CalPrmBrkTqCtrlrBrk01.S16_WPE_MP_Rise_Press_f_6_volume" 0 /end CHARACTERISTIC
/begin CHARACTERISTIC S16_WPE_MP_Rise_Press_r_1_volume "Temp" VALUE 0x800215D2 CalPrmBrkTqCtrlrBrk_SWORD 0 P34 -3276.8 3276.7 SYMBOL_LINK "CalPrmBrkTqCtrlrBrk01.S16_WPE_MP_Rise_Press_r_1_volume" 0 /end CHARACTERISTIC
/begin CHARACTERISTIC S16_WPE_MP_Rise_Press_r_2_volume "Temp" VALUE 0x800215D4 CalPrmBrkTqCtrlrBrk_SWORD 0 P34 -3276.8 3276.7 SYMBOL_LINK "CalPrmBrkTqCtrlrBrk01.S16_WPE_MP_Rise_Press_r_2_volume" 0 /end CHARACTERISTIC
/begin CHARACTERISTIC S16_WPE_MP_Rise_Press_r_3_volume "Temp" VALUE 0x800215D6 CalPrmBrkTqCtrlrBrk_SWORD 0 P34 -3276.8 3276.7 SYMBOL_LINK "CalPrmBrkTqCtrlrBrk01.S16_WPE_MP_Rise_Press_r_3_volume" 0 /end CHARACTERISTIC
/begin CHARACTERISTIC S16_WPE_MP_Rise_Press_r_4_volume "Temp" VALUE 0x800215D8 CalPrmBrkTqCtrlrBrk_SWORD 0 P34 -3276.8 3276.7 SYMBOL_LINK "CalPrmBrkTqCtrlrBrk01.S16_WPE_MP_Rise_Press_r_4_volume" 0 /end CHARACTERISTIC
/begin CHARACTERISTIC S16_WPE_MP_Rise_Press_r_5_volume "Temp" VALUE 0x800215DA CalPrmBrkTqCtrlrBrk_SWORD 0 P34 -3276.8 3276.7 SYMBOL_LINK "CalPrmBrkTqCtrlrBrk01.S16_WPE_MP_Rise_Press_r_5_volume" 0 /end CHARACTERISTIC
/begin CHARACTERISTIC S16_WPE_MP_Rise_Press_r_6_volume "Temp" VALUE 0x800215DC CalPrmBrkTqCtrlrBrk_SWORD 0 P34 -3276.8 3276.7 SYMBOL_LINK "CalPrmBrkTqCtrlrBrk01.S16_WPE_MP_Rise_Press_r_6_volume" 0 /end CHARACTERISTIC
/begin CHARACTERISTIC S16_WPE_TC_Rels_Comp_Gain_r_1 "Temp" VALUE 0x80021646 CalPrmBrkTqCtrlrBrk_SWORD 0 Perc6 -32768 32767 SYMBOL_LINK "CalPrmBrkTqCtrlrBrk01.S16_WPE_TC_Rels_Comp_Gain_r_1" 0 /end CHARACTERISTIC
/begin CHARACTERISTIC S16_WPE_TC_Rels_Comp_Gain_r_2 "Temp" VALUE 0x80021648 CalPrmBrkTqCtrlrBrk_SWORD 0 Perc6 -32768 32767 SYMBOL_LINK "CalPrmBrkTqCtrlrBrk01.S16_WPE_TC_Rels_Comp_Gain_r_2" 0 /end CHARACTERISTIC
/begin CHARACTERISTIC S16_WPE_TC_Rels_Comp_Gain_r_3 "Temp" VALUE 0x8002164A CalPrmBrkTqCtrlrBrk_SWORD 0 Perc6 -32768 32767 SYMBOL_LINK "CalPrmBrkTqCtrlrBrk01.S16_WPE_TC_Rels_Comp_Gain_r_3" 0 /end CHARACTERISTIC
/begin CHARACTERISTIC S16_WPE_TC_Rels_Comp_Gain_r_4 "Temp" VALUE 0x8002164C CalPrmBrkTqCtrlrBrk_SWORD 0 Perc6 -32768 32767 SYMBOL_LINK "CalPrmBrkTqCtrlrBrk01.S16_WPE_TC_Rels_Comp_Gain_r_4" 0 /end CHARACTERISTIC
/begin CHARACTERISTIC S16_WPE_TC_Rels_Comp_Gain_r_5 "Temp" VALUE 0x8002164E CalPrmBrkTqCtrlrBrk_SWORD 0 Perc6 -32768 32767 SYMBOL_LINK "CalPrmBrkTqCtrlrBrk01.S16_WPE_TC_Rels_Comp_Gain_r_5" 0 /end CHARACTERISTIC
/begin CHARACTERISTIC S16_WPE_TC_Rels_Comp_Gain_r_6 "Temp" VALUE 0x80021650 CalPrmBrkTqCtrlrBrk_SWORD 0 Perc6 -32768 32767 SYMBOL_LINK "CalPrmBrkTqCtrlrBrk01.S16_WPE_TC_Rels_Comp_Gain_r_6" 0 /end CHARACTERISTIC
/begin CHARACTERISTIC S16_WPE_TC_Rels_Comp_Press_r_1 "Temp" VALUE 0x8002163A CalPrmBrkTqCtrlrBrk_SWORD 0 P34 -3276.8 3276.7 SYMBOL_LINK "CalPrmBrkTqCtrlrBrk01.S16_WPE_TC_Rels_Comp_Press_r_1" 0 /end CHARACTERISTIC
/begin CHARACTERISTIC S16_WPE_TC_Rels_Comp_Press_r_2 "Temp" VALUE 0x8002163C CalPrmBrkTqCtrlrBrk_SWORD 0 P34 -3276.8 3276.7 SYMBOL_LINK "CalPrmBrkTqCtrlrBrk01.S16_WPE_TC_Rels_Comp_Press_r_2" 0 /end CHARACTERISTIC
/begin CHARACTERISTIC S16_WPE_TC_Rels_Comp_Press_r_3 "Temp" VALUE 0x8002163E CalPrmBrkTqCtrlrBrk_SWORD 0 P34 -3276.8 3276.7 SYMBOL_LINK "CalPrmBrkTqCtrlrBrk01.S16_WPE_TC_Rels_Comp_Press_r_3" 0 /end CHARACTERISTIC
/begin CHARACTERISTIC S16_WPE_TC_Rels_Comp_Press_r_4 "Temp" VALUE 0x80021640 CalPrmBrkTqCtrlrBrk_SWORD 0 P34 -3276.8 3276.7 SYMBOL_LINK "CalPrmBrkTqCtrlrBrk01.S16_WPE_TC_Rels_Comp_Press_r_4" 0 /end CHARACTERISTIC
/begin CHARACTERISTIC S16_WPE_TC_Rels_Comp_Press_r_5 "Temp" VALUE 0x80021642 CalPrmBrkTqCtrlrBrk_SWORD 0 P34 -3276.8 3276.7 SYMBOL_LINK "CalPrmBrkTqCtrlrBrk01.S16_WPE_TC_Rels_Comp_Press_r_5" 0 /end CHARACTERISTIC
/begin CHARACTERISTIC S16_WPE_TC_Rels_Comp_Press_r_6 "Temp" VALUE 0x80021644 CalPrmBrkTqCtrlrBrk_SWORD 0 P34 -3276.8 3276.7 SYMBOL_LINK "CalPrmBrkTqCtrlrBrk01.S16_WPE_TC_Rels_Comp_Press_r_6" 0 /end CHARACTERISTIC
/begin CHARACTERISTIC TP_Press_Dec_gain_Front_10_70bar "Decel gain of dump scan time, First cycle, 10-70bar, Front wheels" VALUE 0x8002066E CalPrmWslcBrk_UBYTE 0 Gain 0 255 SYMBOL_LINK "CalPrmWslcBrk01.TP_Press_Dec_gain_Front_10_70bar" 0 /end CHARACTERISTIC
/begin CHARACTERISTIC TP_Press_Dec_gain_Front_5_10bar "Decel gain of dump scan time, First cycle, 5-10bar, Front wheels" VALUE 0x8002066D CalPrmWslcBrk_UBYTE 0 Gain 0 255 SYMBOL_LINK "CalPrmWslcBrk01.TP_Press_Dec_gain_Front_5_10bar" 0 /end CHARACTERISTIC
/begin CHARACTERISTIC TP_Press_Dec_gain_Front_Above_70bar "Decel gain of dump scan time, First cycle, above 70bar, Front wheels" VALUE 0x8002066F CalPrmWslcBrk_UBYTE 0 Gain 0 255 SYMBOL_LINK "CalPrmWslcBrk01.TP_Press_Dec_gain_Front_Above_70bar" 0 /end CHARACTERISTIC
/begin CHARACTERISTIC TP_Press_Dec_gain_Front_below_5bar "Decel gain of dump scan time, First cycle, below 5bar, Front wheels" VALUE 0x8002066C CalPrmWslcBrk_UBYTE 0 Gain 0 255 SYMBOL_LINK "CalPrmWslcBrk01.TP_Press_Dec_gain_Front_below_5bar" 0 /end CHARACTERISTIC
/begin CHARACTERISTIC TP_Press_Dec_gain_Rear_10_70bar "Decel gain of dump scan time, First cycle, 10-70bar, Rear wheels" VALUE 0x80020672 CalPrmWslcBrk_UBYTE 0 Gain 0 255 SYMBOL_LINK "CalPrmWslcBrk01.TP_Press_Dec_gain_Rear_10_70bar" 0 /end CHARACTERISTIC
/begin CHARACTERISTIC TP_Press_Dec_gain_Rear_5_10bar "Decel gain of dump scan time, First cycle, 5-10bar, Rear wheels" VALUE 0x80020671 CalPrmWslcBrk_UBYTE 0 Gain 0 255 SYMBOL_LINK "CalPrmWslcBrk01.TP_Press_Dec_gain_Rear_5_10bar" 0 /end CHARACTERISTIC
/begin CHARACTERISTIC TP_Press_Dec_gain_Rear_Above_70bar "Decel gain of dump scan time, First cycle, above 70bar, Rear wheels" VALUE 0x80020673 CalPrmWslcBrk_UBYTE 0 Gain 0 255 SYMBOL_LINK "CalPrmWslcBrk01.TP_Press_Dec_gain_Rear_Above_70bar" 0 /end CHARACTERISTIC
/begin CHARACTERISTIC TP_Press_Dec_gain_Rear_below_5bar "Decel gain of dump scan time, First cycle, below 5bar, Rear wheels" VALUE 0x80020670 CalPrmWslcBrk_UBYTE 0 Gain 0 255 SYMBOL_LINK "CalPrmWslcBrk01.TP_Press_Dec_gain_Rear_below_5bar" 0 /end CHARACTERISTIC
/begin CHARACTERISTIC TP_S16TCSCpBrkTorq1stDecTrqOfHWIS "" VALUE 0x8003A1B0 CalPrmWspcEng_SWORD 0 Tq2 -32768 32767 SYMBOL_LINK "CalPrmWspcEng01.TP_S16TCSCpBrkTorq1stDecTrqOfHWIS" 0 /end CHARACTERISTIC
/begin CHARACTERISTIC TP_S16TCSCpBrkTorqDecRateOfOvBrk "" VALUE 0x8003A1B2 CalPrmWspcEng_SWORD 0 Gain -32768 32767 SYMBOL_LINK "CalPrmWspcEng01.TP_S16TCSCpBrkTorqDecRateOfOvBrk" 0 /end CHARACTERISTIC
/begin CHARACTERISTIC TP_S16TCSCpBrkTq1stDecTrqOfHWISHill "" VALUE 0x8003A1B4 CalPrmWspcEng_SWORD 0 Tq2 -32768 32767 SYMBOL_LINK "CalPrmWspcEng01.TP_S16TCSCpBrkTq1stDecTrqOfHWISHill" 0 /end CHARACTERISTIC
/begin CHARACTERISTIC TP_S16TCSCpBrkTrqMaxIncStartTime "" VALUE 0x8003A1B6 CalPrmWspcEng_SWORD 0 Ti21 -327.68 327.67 SYMBOL_LINK "CalPrmWspcEng01.TP_S16TCSCpBrkTrqMaxIncStartTime" 0 /end CHARACTERISTIC
/begin CHARACTERISTIC TP_S16TCSCpWLSpdCrosTh4QuickFadOut "" VALUE 0x8003A232 CalPrmWspcEng_SWORD 0 Spd12 -4096 4095.875 SYMBOL_LINK "CalPrmWspcEng01.TP_S16TCSCpWLSpdCrosTh4QuickFadOut" 0 /end CHARACTERISTIC
/begin CHARACTERISTIC TP_S16TCSCpWorkTh4BrkTrqMaxLim "" VALUE 0x8003A234 CalPrmWspcEng_SWORD 0 Gain -32768 32767 SYMBOL_LINK "CalPrmWspcEng01.TP_S16TCSCpWorkTh4BrkTrqMaxLim" 0 /end CHARACTERISTIC
/begin CHARACTERISTIC TP_S16TCSCpWorkTh4FFAdapt "" VALUE 0x8003A236 CalPrmWspcEng_SWORD 0 Gain -32768 32767 SYMBOL_LINK "CalPrmWspcEng01.TP_S16TCSCpWorkTh4FFAdapt" 0 /end CHARACTERISTIC
/begin CHARACTERISTIC TP_S16TCSCpWorkTh4FFAdaptReset "" VALUE 0x8003A238 CalPrmWspcEng_SWORD 0 Gain -32768 32767 SYMBOL_LINK "CalPrmWspcEng01.TP_S16TCSCpWorkTh4FFAdaptReset" 0 /end CHARACTERISTIC
/begin CHARACTERISTIC TP_S16TCSCpWorkTh4HuntDctReset "" VALUE 0x8003A23A CalPrmWspcEng_SWORD 0 Gain -32768 32767 SYMBOL_LINK "CalPrmWspcEng01.TP_S16TCSCpWorkTh4HuntDctReset" 0 /end CHARACTERISTIC
/begin CHARACTERISTIC TP_S16TCSCpWorkTh4L2SplitSuspect "" VALUE 0x8003A23C CalPrmWspcEng_SWORD 0 Gain -32768 32767 SYMBOL_LINK "CalPrmWspcEng01.TP_S16TCSCpWorkTh4L2SplitSuspect" 0 /end CHARACTERISTIC
/begin CHARACTERISTIC TP_S16_CBC_ABS_REAR_ENTER_DV_SPD_H "Delta V of rear wheel for CBC slip control of ABS solo at high speed, default value = 12kph" VALUE 0x8002072C CalPrmWslcBrk_SWORD 0 Spd12 -4096 4095.875 SYMBOL_LINK "CalPrmWslcBrk01.TP_S16_CBC_ABS_REAR_ENTER_DV_SPD_H" 0 /end CHARACTERISTIC
/begin CHARACTERISTIC TP_S16_CBC_ABS_REAR_ENTER_DV_SPD_M "Delta V of rear wheel for CBC slip control of ABS solo at middle speed, default value = 10kph" VALUE 0x8002072E CalPrmWslcBrk_SWORD 0 Spd12 -4096 4095.875 SYMBOL_LINK "CalPrmWslcBrk01.TP_S16_CBC_ABS_REAR_ENTER_DV_SPD_M" 0 /end CHARACTERISTIC
/begin CHARACTERISTIC TP_S16_CBC_ABS_REAR_ENTER_DV_SPD_S "Delta V of rear wheel for CBC slip control of ABS solo at low speed, default value = 8kph" VALUE 0x80020730 CalPrmWslcBrk_SWORD 0 Spd12 -4096 4095.875 SYMBOL_LINK "CalPrmWslcBrk01.TP_S16_CBC_ABS_REAR_ENTER_DV_SPD_S" 0 /end CHARACTERISTIC
/begin CHARACTERISTIC TP_S16_CBC_ABS_REAR_EXIT_DV "Delta V of rear wheel for CBC slip control exit of ABS solo, default value = 5kph" VALUE 0x80020732 CalPrmWslcBrk_SWORD 0 Spd12 -4096 4095.875 SYMBOL_LINK "CalPrmWslcBrk01.TP_S16_CBC_ABS_REAR_EXIT_DV" 0 /end CHARACTERISTIC
/begin CHARACTERISTIC TP_S16_CBC_ABS_REAR_SLIP_DEL_P_SPD_H "Additional rear delta pressure for slip control of ABS solo at high speed, default value = 20bar" VALUE 0x80020734 CalPrmWslcBrk_SWORD 0 P34 -3276.8 3276.7 SYMBOL_LINK "CalPrmWslcBrk01.TP_S16_CBC_ABS_REAR_SLIP_DEL_P_SPD_H" 0 /end CHARACTERISTIC
/begin CHARACTERISTIC TP_S16_CBC_ABS_REAR_SLIP_DEL_P_SPD_M "Additional rear delta pressure for slip control of ABS solo at middle speed, default value = 15bar" VALUE 0x80020736 CalPrmWslcBrk_SWORD 0 P34 -3276.8 3276.7 SYMBOL_LINK "CalPrmWslcBrk01.TP_S16_CBC_ABS_REAR_SLIP_DEL_P_SPD_M" 0 /end CHARACTERISTIC
/begin CHARACTERISTIC TP_S16_CBC_ABS_REAR_SLIP_DEL_P_SPD_S "Additional rear delta pressure for slip control of ABS solo at low speed, default value = 10bar" VALUE 0x80020738 CalPrmWslcBrk_SWORD 0 P34 -3276.8 3276.7 SYMBOL_LINK "CalPrmWslcBrk01.TP_S16_CBC_ABS_REAR_SLIP_DEL_P_SPD_S" 0 /end CHARACTERISTIC
/begin CHARACTERISTIC TP_S16_CBC_AY_EST_REF_SPD_H "High speed range for using CBC_AY_EST_GAIN_SPD_H parameters" VALUE 0x80020714 CalPrmWslcBrk_SWORD 0 Spd12 -4096 4095.875 SYMBOL_LINK "CalPrmWslcBrk01.TP_S16_CBC_AY_EST_REF_SPD_H" 0 /end CHARACTERISTIC
/begin CHARACTERISTIC TP_S16_CBC_AY_EST_REF_SPD_M "Middle speed range for using CBC_AY_EST_GAIN_SPD_M parameters" VALUE 0x80020716 CalPrmWslcBrk_SWORD 0 Spd12 -4096 4095.875 SYMBOL_LINK "CalPrmWslcBrk01.TP_S16_CBC_AY_EST_REF_SPD_M" 0 /end CHARACTERISTIC
/begin CHARACTERISTIC TP_S16_CBC_AY_EST_REF_SPD_S "Low speed range for using CBC_AY_EST_GAIN_SPD_S parameters" VALUE 0x80020718 CalPrmWslcBrk_SWORD 0 Spd12 -4096 4095.875 SYMBOL_LINK "CalPrmWslcBrk01.TP_S16_CBC_AY_EST_REF_SPD_S" 0 /end CHARACTERISTIC
/begin CHARACTERISTIC TP_S16_CBC_BRAKING_AX_THRES_BLS "Min. deceleration for estimation of Mpress with valid BLS, default 0.1g" VALUE 0x8002070A CalPrmWslcBrk_SWORD 0 A41 -32.768 32.767 SYMBOL_LINK "CalPrmWslcBrk01.TP_S16_CBC_BRAKING_AX_THRES_BLS" 0 /end CHARACTERISTIC
/begin CHARACTERISTIC TP_S16_CBC_BRAKING_AX_THRES_NO_BLS "Min. deceleration for estimation of Mpress without BLS, default 0.15g" VALUE 0x8002070C CalPrmWslcBrk_SWORD 0 A41 -32.768 32.767 SYMBOL_LINK "CalPrmWslcBrk01.TP_S16_CBC_BRAKING_AX_THRES_NO_BLS" 0 /end CHARACTERISTIC
/begin CHARACTERISTIC TP_S16_CBC_FADE_OUT_HOLD_SCAN "Hold scan for pulse up rise at fade out mode " VALUE 0x80020790 CalPrmWslcBrk_SWORD 0 Gain -32768 32767 SYMBOL_LINK "CalPrmWslcBrk01.TP_S16_CBC_FADE_OUT_HOLD_SCAN" 0 /end CHARACTERISTIC
/begin CHARACTERISTIC TP_S16_CBC_FADE_OUT_TIME "Time length for fade out mode after CBC reset" VALUE 0x80020792 CalPrmWslcBrk_SWORD 0 Ti21 -327.68 327.67 SYMBOL_LINK "CalPrmWslcBrk01.TP_S16_CBC_FADE_OUT_TIME" 0 /end CHARACTERISTIC
/begin CHARACTERISTIC TP_S16_CBC_FRONT_DEL_PRESS_H_SPD_H "Front delta pressure at large del V level and high speed" VALUE 0x800207A6 CalPrmWslcBrk_SWORD 0 P34 -3276.8 3276.7 SYMBOL_LINK "CalPrmWslcBrk01.TP_S16_CBC_FRONT_DEL_PRESS_H_SPD_H" 0 /end CHARACTERISTIC
/begin CHARACTERISTIC TP_S16_CBC_FRONT_DEL_PRESS_H_SPD_M "Front delta pressure at large del V level and middle speed" VALUE 0x800207A8 CalPrmWslcBrk_SWORD 0 P34 -3276.8 3276.7 SYMBOL_LINK "CalPrmWslcBrk01.TP_S16_CBC_FRONT_DEL_PRESS_H_SPD_M" 0 /end CHARACTERISTIC
/begin CHARACTERISTIC TP_S16_CBC_FRONT_DEL_PRESS_H_SPD_S "Front delta pressure at large del V level and low speed" VALUE 0x800207AA CalPrmWslcBrk_SWORD 0 P34 -3276.8 3276.7 SYMBOL_LINK "CalPrmWslcBrk01.TP_S16_CBC_FRONT_DEL_PRESS_H_SPD_S" 0 /end CHARACTERISTIC
/begin CHARACTERISTIC TP_S16_CBC_FRONT_DEL_PRESS_S_SPD_H "Front delta pressure at small del V level and high speed" VALUE 0x800207AC CalPrmWslcBrk_SWORD 0 P34 -3276.8 3276.7 SYMBOL_LINK "CalPrmWslcBrk01.TP_S16_CBC_FRONT_DEL_PRESS_S_SPD_H" 0 /end CHARACTERISTIC
/begin CHARACTERISTIC TP_S16_CBC_FRONT_DEL_PRESS_S_SPD_M "Front delta pressure at small del V level and middle speed" VALUE 0x800207AE CalPrmWslcBrk_SWORD 0 P34 -3276.8 3276.7 SYMBOL_LINK "CalPrmWslcBrk01.TP_S16_CBC_FRONT_DEL_PRESS_S_SPD_M" 0 /end CHARACTERISTIC
/begin CHARACTERISTIC TP_S16_CBC_FRONT_DEL_PRESS_S_SPD_S "Front delta pressure at small del V level and low speed" VALUE 0x800207B0 CalPrmWslcBrk_SWORD 0 P34 -3276.8 3276.7 SYMBOL_LINK "CalPrmWslcBrk01.TP_S16_CBC_FRONT_DEL_PRESS_S_SPD_S" 0 /end CHARACTERISTIC
/begin CHARACTERISTIC TP_S16_CBC_FRONT_ENTER_DV_SPD_H "Min. delta V of front wheel for CBC enter condition of a front wheel at high speed, default 15km/h" VALUE 0x80020794 CalPrmWslcBrk_SWORD 0 Spd12 -4096 4095.875 SYMBOL_LINK "CalPrmWslcBrk01.TP_S16_CBC_FRONT_ENTER_DV_SPD_H" 0 /end CHARACTERISTIC
/begin CHARACTERISTIC TP_S16_CBC_FRONT_ENTER_DV_SPD_M "Min. delta V of front wheel for CBC enter condition of a front wheel at middle speed, default 12km/h" VALUE 0x80020796 CalPrmWslcBrk_SWORD 0 Spd12 -4096 4095.875 SYMBOL_LINK "CalPrmWslcBrk01.TP_S16_CBC_FRONT_ENTER_DV_SPD_M" 0 /end CHARACTERISTIC
/begin CHARACTERISTIC TP_S16_CBC_FRONT_ENTER_DV_SPD_S "Min. delta V of front wheel for CBC enter condition of a front wheel at low speed, default 10km/h" VALUE 0x80020798 CalPrmWslcBrk_SWORD 0 Spd12 -4096 4095.875 SYMBOL_LINK "CalPrmWslcBrk01.TP_S16_CBC_FRONT_ENTER_DV_SPD_S" 0 /end CHARACTERISTIC
/begin CHARACTERISTIC TP_S16_CBC_FRONT_EXIT_DV_SPD_H "Max. delta V of front wheel for CBC exit condition of a front wheel at high speed" VALUE 0x8002079A CalPrmWslcBrk_SWORD 0 Spd12 -4096 4095.875 SYMBOL_LINK "CalPrmWslcBrk01.TP_S16_CBC_FRONT_EXIT_DV_SPD_H" 0 /end CHARACTERISTIC
/begin CHARACTERISTIC TP_S16_CBC_FRONT_EXIT_DV_SPD_M "Max. delta V of front wheel for CBC exit condition of a front wheel at middle speed" VALUE 0x8002079C CalPrmWslcBrk_SWORD 0 Spd12 -4096 4095.875 SYMBOL_LINK "CalPrmWslcBrk01.TP_S16_CBC_FRONT_EXIT_DV_SPD_M" 0 /end CHARACTERISTIC
/begin CHARACTERISTIC TP_S16_CBC_FRONT_EXIT_DV_SPD_S "Max. delta V of front wheel for CBC exit condition of a front wheel at low speed" VALUE 0x8002079E CalPrmWslcBrk_SWORD 0 Spd12 -4096 4095.875 SYMBOL_LINK "CalPrmWslcBrk01.TP_S16_CBC_FRONT_EXIT_DV_SPD_S" 0 /end CHARACTERISTIC
/begin CHARACTERISTIC TP_S16_CBC_FRONT_MEDIUM_DV_SPD_H "Delta V of front wheel for slip control of a front wheel at high speed" VALUE 0x800207A0 CalPrmWslcBrk_SWORD 0 Spd12 -4096 4095.875 SYMBOL_LINK "CalPrmWslcBrk01.TP_S16_CBC_FRONT_MEDIUM_DV_SPD_H" 0 /end CHARACTERISTIC
/begin CHARACTERISTIC TP_S16_CBC_FRONT_MEDIUM_DV_SPD_M "Delta V of front wheel for slip control of a front wheel at middle speed" VALUE 0x800207A2 CalPrmWslcBrk_SWORD 0 Spd12 -4096 4095.875 SYMBOL_LINK "CalPrmWslcBrk01.TP_S16_CBC_FRONT_MEDIUM_DV_SPD_M" 0 /end CHARACTERISTIC
/begin CHARACTERISTIC TP_S16_CBC_FRONT_MEDIUM_DV_SPD_S "Delta V of front wheel for slip control of a front wheel at low speed" VALUE 0x800207A4 CalPrmWslcBrk_SWORD 0 Spd12 -4096 4095.875 SYMBOL_LINK "CalPrmWslcBrk01.TP_S16_CBC_FRONT_MEDIUM_DV_SPD_S" 0 /end CHARACTERISTIC
/begin CHARACTERISTIC TP_S16_CBC_REAR_ENTER_DV_SPD_H "Delta V of rear wheel for CBC slip control at high speed, default value = 12kph" VALUE 0x800207B2 CalPrmWslcBrk_SWORD 0 Spd12 -4096 4095.875 SYMBOL_LINK "CalPrmWslcBrk01.TP_S16_CBC_REAR_ENTER_DV_SPD_H" 0 /end CHARACTERISTIC
/begin CHARACTERISTIC TP_S16_CBC_REAR_ENTER_DV_SPD_M "Delta V of rear wheel for CBC slip control at middle speed, default value = 10kph" VALUE 0x800207B4 CalPrmWslcBrk_SWORD 0 Spd12 -4096 4095.875 SYMBOL_LINK "CalPrmWslcBrk01.TP_S16_CBC_REAR_ENTER_DV_SPD_M" 0 /end CHARACTERISTIC
/begin CHARACTERISTIC TP_S16_CBC_REAR_ENTER_DV_SPD_S "Delta V of rear wheel for CBC slip control at low speed, default value = 8kph" VALUE 0x800207B6 CalPrmWslcBrk_SWORD 0 Spd12 -4096 4095.875 SYMBOL_LINK "CalPrmWslcBrk01.TP_S16_CBC_REAR_ENTER_DV_SPD_S" 0 /end CHARACTERISTIC
/begin CHARACTERISTIC TP_S16_CBC_REAR_EXIT_DV "Delta V of rear wheel for CBC slip control exit, default value = 5kph" VALUE 0x800207B8 CalPrmWslcBrk_SWORD 0 Spd12 -4096 4095.875 SYMBOL_LINK "CalPrmWslcBrk01.TP_S16_CBC_REAR_EXIT_DV" 0 /end CHARACTERISTIC
/begin CHARACTERISTIC TP_S16_CBC_REAR_SLIP_DEL_P_SPD_H "Additional rear delta pressure for slip control at high speed, default value = 20bar" VALUE 0x800207BA CalPrmWslcBrk_SWORD 0 P34 -3276.8 3276.7 SYMBOL_LINK "CalPrmWslcBrk01.TP_S16_CBC_REAR_SLIP_DEL_P_SPD_H" 0 /end CHARACTERISTIC
/begin CHARACTERISTIC TP_S16_CBC_REAR_SLIP_DEL_P_SPD_M "Additional rear delta pressure for slip control at middle speed, default value = 15bar" VALUE 0x800207BC CalPrmWslcBrk_SWORD 0 P34 -3276.8 3276.7 SYMBOL_LINK "CalPrmWslcBrk01.TP_S16_CBC_REAR_SLIP_DEL_P_SPD_M" 0 /end CHARACTERISTIC
/begin CHARACTERISTIC TP_S16_CBC_REAR_SLIP_DEL_P_SPD_S "Additional rear delta pressure for slip control at low speed, default value = 10bar" VALUE 0x800207BE CalPrmWslcBrk_SWORD 0 P34 -3276.8 3276.7 SYMBOL_LINK "CalPrmWslcBrk01.TP_S16_CBC_REAR_SLIP_DEL_P_SPD_S" 0 /end CHARACTERISTIC
/begin CHARACTERISTIC TP_S16_Decel_Gain_LMMu_100_150kph_F "Decel Gain, Lowmed Mu Detect, 100-150kph, Decel State, Front wheels" VALUE 0x8002038C CalPrmWslcBrk_SWORD 0 Gain -32768 32767 SYMBOL_LINK "CalPrmWslcBrk01.TP_S16_Decel_Gain_LMMu_100_150kph_F" 0 /end CHARACTERISTIC
/begin CHARACTERISTIC TP_S16_Decel_Gain_LMMu_100_150kph_R "Decel Gain, Lowmed Mu Detect, 100-150kph, Decel State, Rear wheels" VALUE 0x800203A8 CalPrmWslcBrk_SWORD 0 Gain -32768 32767 SYMBOL_LINK "CalPrmWslcBrk01.TP_S16_Decel_Gain_LMMu_100_150kph_R" 0 /end CHARACTERISTIC
/begin CHARACTERISTIC TP_S16_Decel_Gain_LMMu_10_20kph_F "Decel Gain, Lowmed Mu Detect, 10-20kph, Decel State, Front wheels" VALUE 0x8002038E CalPrmWslcBrk_SWORD 0 Gain -32768 32767 SYMBOL_LINK "CalPrmWslcBrk01.TP_S16_Decel_Gain_LMMu_10_20kph_F" 0 /end CHARACTERISTIC
/begin CHARACTERISTIC TP_S16_Decel_Gain_LMMu_10_20kph_R "Decel Gain, Lowmed Mu Detect, 10-20kph, Decel State, Rear wheels" VALUE 0x800203AA CalPrmWslcBrk_SWORD 0 Gain -32768 32767 SYMBOL_LINK "CalPrmWslcBrk01.TP_S16_Decel_Gain_LMMu_10_20kph_R" 0 /end CHARACTERISTIC
/begin CHARACTERISTIC TP_S16_Decel_Gain_LMMu_20_40kph_F "Decel Gain, Lowmed Mu Detect, 20-40kph, Decel State, Front wheels" VALUE 0x80020390 CalPrmWslcBrk_SWORD 0 Gain -32768 32767 SYMBOL_LINK "CalPrmWslcBrk01.TP_S16_Decel_Gain_LMMu_20_40kph_F" 0 /end CHARACTERISTIC
/begin CHARACTERISTIC TP_S16_Decel_Gain_LMMu_20_40kph_R "Decel Gain, Lowmed Mu Detect, 20-40kph, Decel State, Rear wheels" VALUE 0x800203AC CalPrmWslcBrk_SWORD 0 Gain -32768 32767 SYMBOL_LINK "CalPrmWslcBrk01.TP_S16_Decel_Gain_LMMu_20_40kph_R" 0 /end CHARACTERISTIC
/begin CHARACTERISTIC TP_S16_Decel_Gain_LMMu_40_60kph_F "Decel Gain, Lowmed Mu Detect, 40-60kph, Decel State, Front wheels" VALUE 0x80020392 CalPrmWslcBrk_SWORD 0 Gain -32768 32767 SYMBOL_LINK "CalPrmWslcBrk01.TP_S16_Decel_Gain_LMMu_40_60kph_F" 0 /end CHARACTERISTIC
/begin CHARACTERISTIC TP_S16_Decel_Gain_LMMu_40_60kph_R "Decel Gain, Lowmed Mu Detect, 40-60kph, Decel State, Rear wheels" VALUE 0x800203AE CalPrmWslcBrk_SWORD 0 Gain -32768 32767 SYMBOL_LINK "CalPrmWslcBrk01.TP_S16_Decel_Gain_LMMu_40_60kph_R" 0 /end CHARACTERISTIC
/begin CHARACTERISTIC TP_S16_Decel_Gain_LMMu_60_100kph_F "Decel Gain, Lowmed Mu Detect, 60-100kph, Decel State, Front wheels" VALUE 0x80020394 CalPrmWslcBrk_SWORD 0 Gain -32768 32767 SYMBOL_LINK "CalPrmWslcBrk01.TP_S16_Decel_Gain_LMMu_60_100kph_F" 0 /end CHARACTERISTIC
/begin CHARACTERISTIC TP_S16_Decel_Gain_LMMu_60_100kph_R "Decel Gain, Lowmed Mu Detect, 60-100kph, Decel State, Rear wheels" VALUE 0x800203B0 CalPrmWslcBrk_SWORD 0 Gain -32768 32767 SYMBOL_LINK "CalPrmWslcBrk01.TP_S16_Decel_Gain_LMMu_60_100kph_R" 0 /end CHARACTERISTIC
/begin CHARACTERISTIC TP_S16_Decel_Gain_LMMu_Ab_150kph_F "Decel Gain, Lowmed Mu Detect, Above 150kph, Decel State, Front wheels" VALUE 0x80020396 CalPrmWslcBrk_SWORD 0 Gain -32768 32767 SYMBOL_LINK "CalPrmWslcBrk01.TP_S16_Decel_Gain_LMMu_Ab_150kph_F" 0 /end CHARACTERISTIC
/begin CHARACTERISTIC TP_S16_Decel_Gain_LMMu_Ab_150kph_R "Decel Gain, Lowmed Mu Detect, Above 150kph, Decel State, Rear wheels" VALUE 0x800203B2 CalPrmWslcBrk_SWORD 0 Gain -32768 32767 SYMBOL_LINK "CalPrmWslcBrk01.TP_S16_Decel_Gain_LMMu_Ab_150kph_R" 0 /end CHARACTERISTIC
/begin CHARACTERISTIC TP_S16_Decel_Gain_LMMu_B_10kph_F "Decel Gain, Lowmed Mu Detect, Below 10kph, Decel State, Front wheels" VALUE 0x80020398 CalPrmWslcBrk_SWORD 0 Gain -32768 32767 SYMBOL_LINK "CalPrmWslcBrk01.TP_S16_Decel_Gain_LMMu_B_10kph_F" 0 /end CHARACTERISTIC
/begin CHARACTERISTIC TP_S16_Decel_Gain_LMMu_B_10kph_R "Decel Gain, Lowmed Mu Detect, Below 10kph, Decel State, Rear wheels" VALUE 0x800203B4 CalPrmWslcBrk_SWORD 0 Gain -32768 32767 SYMBOL_LINK "CalPrmWslcBrk01.TP_S16_Decel_Gain_LMMu_B_10kph_R" 0 /end CHARACTERISTIC
/begin CHARACTERISTIC TP_S16_Decel_Gain_LMu_100_150kph_F "Decel Gain, Low Mu Detect, 100-150kph, Decel State, Front wheels" VALUE 0x800203C4 CalPrmWslcBrk_SWORD 0 Gain -32768 32767 SYMBOL_LINK "CalPrmWslcBrk01.TP_S16_Decel_Gain_LMu_100_150kph_F" 0 /end CHARACTERISTIC
/begin CHARACTERISTIC TP_S16_Decel_Gain_LMu_100_150kph_R "Decel Gain, Low Mu Detect, 100-150kph, Decel State, Rear wheels" VALUE 0x800203E0 CalPrmWslcBrk_SWORD 0 Gain -32768 32767 SYMBOL_LINK "CalPrmWslcBrk01.TP_S16_Decel_Gain_LMu_100_150kph_R" 0 /end CHARACTERISTIC
/begin CHARACTERISTIC TP_S16_Decel_Gain_LMu_10_20kph_F "Decel Gain, Low Mu Detect, 10-20kph, Decel State, Front wheels" VALUE 0x800203C6 CalPrmWslcBrk_SWORD 0 Gain -32768 32767 SYMBOL_LINK "CalPrmWslcBrk01.TP_S16_Decel_Gain_LMu_10_20kph_F" 0 /end CHARACTERISTIC
/begin CHARACTERISTIC TP_S16_Decel_Gain_LMu_10_20kph_R "Decel Gain, Low Mu Detect, 10-20kph, Decel State, Rear wheels" VALUE 0x800203E2 CalPrmWslcBrk_SWORD 0 Gain -32768 32767 SYMBOL_LINK "CalPrmWslcBrk01.TP_S16_Decel_Gain_LMu_10_20kph_R" 0 /end CHARACTERISTIC
/begin CHARACTERISTIC TP_S16_Decel_Gain_LMu_20_40kph_F "Decel Gain, Low Mu Detect, 20-40kph, Decel State, Front wheels" VALUE 0x800203C8 CalPrmWslcBrk_SWORD 0 Gain -32768 32767 SYMBOL_LINK "CalPrmWslcBrk01.TP_S16_Decel_Gain_LMu_20_40kph_F" 0 /end CHARACTERISTIC
/begin CHARACTERISTIC TP_S16_Decel_Gain_LMu_20_40kph_R "Decel Gain, Low Mu Detect, 20-40kph, Decel State, Rear wheels" VALUE 0x800203E4 CalPrmWslcBrk_SWORD 0 Gain -32768 32767 SYMBOL_LINK "CalPrmWslcBrk01.TP_S16_Decel_Gain_LMu_20_40kph_R" 0 /end CHARACTERISTIC
/begin CHARACTERISTIC TP_S16_Decel_Gain_LMu_40_60kph_F "Decel Gain, Low Mu Detect, 40-60kph, Decel State, Front wheels" VALUE 0x800203CA CalPrmWslcBrk_SWORD 0 Gain -32768 32767 SYMBOL_LINK "CalPrmWslcBrk01.TP_S16_Decel_Gain_LMu_40_60kph_F" 0 /end CHARACTERISTIC
/begin CHARACTERISTIC TP_S16_Decel_Gain_LMu_40_60kph_R "Decel Gain, Low Mu Detect, 40-60kph, Decel State, Rear wheels" VALUE 0x800203E6 CalPrmWslcBrk_SWORD 0 Gain -32768 32767 SYMBOL_LINK "CalPrmWslcBrk01.TP_S16_Decel_Gain_LMu_40_60kph_R" 0 /end CHARACTERISTIC
/begin CHARACTERISTIC TP_S16_Decel_Gain_LMu_60_100kph_F "Decel Gain, Low Mu Detect, 60-100kph, Decel State, Front wheels" VALUE 0x800203CC CalPrmWslcBrk_SWORD 0 Gain -32768 32767 SYMBOL_LINK "CalPrmWslcBrk01.TP_S16_Decel_Gain_LMu_60_100kph_F" 0 /end CHARACTERISTIC
/begin CHARACTERISTIC TP_S16_Decel_Gain_LMu_60_100kph_R "Decel Gain, Low Mu Detect, 60-100kph, Decel State, Rear wheels" VALUE 0x800203E8 CalPrmWslcBrk_SWORD 0 Gain -32768 32767 SYMBOL_LINK "CalPrmWslcBrk01.TP_S16_Decel_Gain_LMu_60_100kph_R" 0 /end CHARACTERISTIC
/begin CHARACTERISTIC TP_S16_Decel_Gain_LMu_Ab_150kph_F "Decel Gain, Low Mu Detect, Above 150kph, Decel State, Front wheels" VALUE 0x800203CE CalPrmWslcBrk_SWORD 0 Gain -32768 32767 SYMBOL_LINK "CalPrmWslcBrk01.TP_S16_Decel_Gain_LMu_Ab_150kph_F" 0 /end CHARACTERISTIC
/begin CHARACTERISTIC TP_S16_Decel_Gain_LMu_Ab_150kph_R "Decel Gain, Low Mu Detect, Above 150kph, Decel State, Rear wheels" VALUE 0x800203EA CalPrmWslcBrk_SWORD 0 Gain -32768 32767 SYMBOL_LINK "CalPrmWslcBrk01.TP_S16_Decel_Gain_LMu_Ab_150kph_R" 0 /end CHARACTERISTIC
/begin CHARACTERISTIC TP_S16_Decel_Gain_LMu_B_10kph_F "Decel Gain, Low Mu Detect, Below 10kph, Decel State, Front wheels" VALUE 0x800203D0 CalPrmWslcBrk_SWORD 0 Gain -32768 32767 SYMBOL_LINK "CalPrmWslcBrk01.TP_S16_Decel_Gain_LMu_B_10kph_F" 0 /end CHARACTERISTIC
/begin CHARACTERISTIC TP_S16_Decel_Gain_LMu_B_10kph_R "Decel Gain, Low Mu Detect, Below 10kph, Decel State, Rear wheels" VALUE 0x800203EC CalPrmWslcBrk_SWORD 0 Gain -32768 32767 SYMBOL_LINK "CalPrmWslcBrk01.TP_S16_Decel_Gain_LMu_B_10kph_R" 0 /end CHARACTERISTIC
/begin CHARACTERISTIC TP_S16_Decel_Gain_MMu_100_150kph_R "Decel Gain, Medium Mu Detect, 100-150kph, Decel State, Rear wheels" VALUE 0x80020370 CalPrmWslcBrk_SWORD 0 Gain -32768 32767 SYMBOL_LINK "CalPrmWslcBrk01.TP_S16_Decel_Gain_MMu_100_150kph_R" 0 /end CHARACTERISTIC
/begin CHARACTERISTIC TP_S16_Decel_Gain_MMu_10_20kph_R "Decel Gain, Medium Mu Detect, 10-20kph, Decel State, Rear Wheels" VALUE 0x80020372 CalPrmWslcBrk_SWORD 0 Gain -32768 32767 SYMBOL_LINK "CalPrmWslcBrk01.TP_S16_Decel_Gain_MMu_10_20kph_R" 0 /end CHARACTERISTIC
/begin CHARACTERISTIC TP_S16_Decel_Gain_MMu_20_40kph_R "Decel Gain, Medium Mu Detect, 20-40kph, Decel State, Rear Wheels" VALUE 0x80020374 CalPrmWslcBrk_SWORD 0 Gain -32768 32767 SYMBOL_LINK "CalPrmWslcBrk01.TP_S16_Decel_Gain_MMu_20_40kph_R" 0 /end CHARACTERISTIC
/begin CHARACTERISTIC TP_S16_Decel_Gain_MMu_40_60kph_R "Decel Gain, Medium Mu Detect, 40-60kph, Decel State, Rear Wheels" VALUE 0x80020376 CalPrmWslcBrk_SWORD 0 Gain -32768 32767 SYMBOL_LINK "CalPrmWslcBrk01.TP_S16_Decel_Gain_MMu_40_60kph_R" 0 /end CHARACTERISTIC
/begin CHARACTERISTIC TP_S16_Decel_Gain_MMu_60_100kph_R "Decel Gain, Medium Mu Detect, 60-100kph, Decel State, Rear Wheels" VALUE 0x80020378 CalPrmWslcBrk_SWORD 0 Gain -32768 32767 SYMBOL_LINK "CalPrmWslcBrk01.TP_S16_Decel_Gain_MMu_60_100kph_R" 0 /end CHARACTERISTIC
/begin CHARACTERISTIC TP_S16_Decel_Gain_MMu_Ab_150kph_R "Decel Gain, Medium Mu Detect, Above 150kph, Decel State, Rear Wheels" VALUE 0x8002037A CalPrmWslcBrk_SWORD 0 Gain -32768 32767 SYMBOL_LINK "CalPrmWslcBrk01.TP_S16_Decel_Gain_MMu_Ab_150kph_R" 0 /end CHARACTERISTIC
/begin CHARACTERISTIC TP_S16_Decel_Gain_MMu_B_10kph_R "Decel Gain, Medium Mu Detect, Below 10kph, Decel State, Rear Wheels" VALUE 0x8002037C CalPrmWslcBrk_SWORD 0 Gain -32768 32767 SYMBOL_LINK "CalPrmWslcBrk01.TP_S16_Decel_Gain_MMu_B_10kph_R" 0 /end CHARACTERISTIC
/begin CHARACTERISTIC TP_S16_Decel_Gain_SpHMu_100_150_F "Decel Gain, Split High Mu Detect, 100-150kph, Decel State, Front wheels" VALUE 0x800203FC CalPrmWslcBrk_SWORD 0 Gain -32768 32767 SYMBOL_LINK "CalPrmWslcBrk01.TP_S16_Decel_Gain_SpHMu_100_150_F" 0 /end CHARACTERISTIC
/begin CHARACTERISTIC TP_S16_Decel_Gain_SpHMu_10_20kph_F "Decel Gain, Split High Mu Detect, 10-20kph, Decel State, Front wheels" VALUE 0x800203FE CalPrmWslcBrk_SWORD 0 Gain -32768 32767 SYMBOL_LINK "CalPrmWslcBrk01.TP_S16_Decel_Gain_SpHMu_10_20kph_F" 0 /end CHARACTERISTIC
/begin CHARACTERISTIC TP_S16_Decel_Gain_SpHMu_20_40kph_F "Decel Gain, Split High Mu Detect, 20-40kph, Decel State, Front wheels" VALUE 0x80020400 CalPrmWslcBrk_SWORD 0 Gain -32768 32767 SYMBOL_LINK "CalPrmWslcBrk01.TP_S16_Decel_Gain_SpHMu_20_40kph_F" 0 /end CHARACTERISTIC
/begin CHARACTERISTIC TP_S16_Decel_Gain_SpHMu_40_60kph_F "Decel Gain, Split High Mu Detect, 40-60kph, Decel State, Front wheels" VALUE 0x80020402 CalPrmWslcBrk_SWORD 0 Gain -32768 32767 SYMBOL_LINK "CalPrmWslcBrk01.TP_S16_Decel_Gain_SpHMu_40_60kph_F" 0 /end CHARACTERISTIC
/begin CHARACTERISTIC TP_S16_Decel_Gain_SpHMu_60_100kph_F "Decel Gain, Split High Mu Detect, 60-100kph, Decel State, Front wheels" VALUE 0x80020404 CalPrmWslcBrk_SWORD 0 Gain -32768 32767 SYMBOL_LINK "CalPrmWslcBrk01.TP_S16_Decel_Gain_SpHMu_60_100kph_F" 0 /end CHARACTERISTIC
/begin CHARACTERISTIC TP_S16_Decel_Gain_SpHMu_Ab_150kph_F "Decel Gain, Split High Mu Detect, Above 150kph, Decel State, Front wheels" VALUE 0x80020406 CalPrmWslcBrk_SWORD 0 Gain -32768 32767 SYMBOL_LINK "CalPrmWslcBrk01.TP_S16_Decel_Gain_SpHMu_Ab_150kph_F" 0 /end CHARACTERISTIC
/begin CHARACTERISTIC TP_S16_Decel_Gain_SpHMu_B_10kph_F "Decel Gain, Split High Mu Detect, Below 10kph, Decel State, Front wheels" VALUE 0x80020408 CalPrmWslcBrk_SWORD 0 Gain -32768 32767 SYMBOL_LINK "CalPrmWslcBrk01.TP_S16_Decel_Gain_SpHMu_B_10kph_F" 0 /end CHARACTERISTIC
/begin CHARACTERISTIC TP_S16_OUTABS_YMR_ALLOW_SPEED "OutABS YMR allowed Min speed(default : 30kph)" VALUE 0x8002065C CalPrmWslcBrk_SWORD 0 Spd12 -4096 4095.875 SYMBOL_LINK "CalPrmWslcBrk01.TP_S16_OUTABS_YMR_ALLOW_SPEED" 0 /end CHARACTERISTIC
/begin CHARACTERISTIC TP_S16_OUTABS_YMR_DUMP_ALLOW_SPEED "OutABS YMR dump reference Min speed(default : 40kph)" VALUE 0x8002065E CalPrmWslcBrk_SWORD 0 Spd12 -4096 4095.875 SYMBOL_LINK "CalPrmWslcBrk01.TP_S16_OUTABS_YMR_DUMP_ALLOW_SPEED" 0 /end CHARACTERISTIC
/begin CHARACTERISTIC TP_S16_OUTABS_YMR_DUMP_HIGH_SPEED "OutABS YMR dump reference High speed(default : 100kph)" VALUE 0x80020660 CalPrmWslcBrk_SWORD 0 Spd12 -4096 4095.875 SYMBOL_LINK "CalPrmWslcBrk01.TP_S16_OUTABS_YMR_DUMP_HIGH_SPEED" 0 /end CHARACTERISTIC
/begin CHARACTERISTIC TP_S16_OUTABS_YMR_DUMP_MAX "YMR dump at S16_OUTABS_YMR_DUMP_HIGH_SPEED(default : 1)" VALUE 0x80020662 CalPrmWslcBrk_SWORD 0 Gain -32768 32767 SYMBOL_LINK "CalPrmWslcBrk01.TP_S16_OUTABS_YMR_DUMP_MAX" 0 /end CHARACTERISTIC
/begin CHARACTERISTIC TP_S16_OUTABS_YMR_DUMP_MIN "YMR dump at S16_OUTABS_YMR_DUMP_ALLOW_SPEED(default : 1)" VALUE 0x80020664 CalPrmWslcBrk_SWORD 0 Gain -32768 32767 SYMBOL_LINK "CalPrmWslcBrk01.TP_S16_OUTABS_YMR_DUMP_MIN" 0 /end CHARACTERISTIC
/begin CHARACTERISTIC TP_S16_PEDAL_CHANGE_DCT_TH1 "Wheel pressure difference threshold for Pedal Effort change detect" VALUE 0x8002020C CalPrmWslcBrk_SWORD 0 P34 -3276.8 3276.7 SYMBOL_LINK "CalPrmWslcBrk01.TP_S16_PEDAL_CHANGE_DCT_TH1" 0 /end CHARACTERISTIC
/begin CHARACTERISTIC TP_S16_PEDAL_CHANGE_DCT_TH2 "Wheel pressure difference threshold2 for Pedal Effort change detect" VALUE 0x8002020E CalPrmWslcBrk_SWORD 0 P34 -3276.8 3276.7 SYMBOL_LINK "CalPrmWslcBrk01.TP_S16_PEDAL_CHANGE_DCT_TH2" 0 /end CHARACTERISTIC
/begin CHARACTERISTIC TP_S16_REAR_HOMO_SL_HLD_THR_YDF_B_L "Rear Selec-Low Yaw-Dump factor threshold below low speed in Homo-mu (default : 500). If Yaw-Dump Factor is bigger than this value, Select Low Dump is applied" VALUE 0x8002053A CalPrmWslcBrk_SWORD 0 Gain -32768 32767 SYMBOL_LINK "CalPrmWslcBrk01.TP_S16_REAR_HOMO_SL_HLD_THR_YDF_B_L" 0 /end CHARACTERISTIC
/begin CHARACTERISTIC TP_S16_REAR_HOMO_SL_HLD_THR_YDF_H "Rear Selec-Low Yaw-Dump factor threshold above high speed in Homo-mu (default : 500). If Yaw-Dump Factor is bigger than this value, Select Low Dump is applied" VALUE 0x8002053C CalPrmWslcBrk_SWORD 0 Gain -32768 32767 SYMBOL_LINK "CalPrmWslcBrk01.TP_S16_REAR_HOMO_SL_HLD_THR_YDF_H" 0 /end CHARACTERISTIC
/begin CHARACTERISTIC TP_S16_REAR_HOMO_SL_HLD_THR_YDF_L "Rear Selec-Low Yaw-Dump factor threshold above low speed in Homo-mu (default : 500). If Yaw-Dump Factor is bigger than this value, Select Low Dump is applied" VALUE 0x8002053E CalPrmWslcBrk_SWORD 0 Gain -32768 32767 SYMBOL_LINK "CalPrmWslcBrk01.TP_S16_REAR_HOMO_SL_HLD_THR_YDF_L" 0 /end CHARACTERISTIC
/begin CHARACTERISTIC TP_S16_REAR_HOMO_SL_HLD_THR_YDF_M "Rear Selec-Low Yaw-Dump factor threshold above med speed in Homo-mu (default : 500). If Yaw-Dump Factor is bigger than this value, Select Low Dump is applied" VALUE 0x80020540 CalPrmWslcBrk_SWORD 0 Gain -32768 32767 SYMBOL_LINK "CalPrmWslcBrk01.TP_S16_REAR_HOMO_SL_HLD_THR_YDF_M" 0 /end CHARACTERISTIC
/begin CHARACTERISTIC TP_S16_REAR_SP_SL_HLD_THRES_YDF_B_L "Rear Selec-Low Slip threshold in Homo-mu (default : 5%). If slip is bigger than this value, Select Low Dump is applied" VALUE 0x80020542 CalPrmWslcBrk_SWORD 0 Gain -32768 32767 SYMBOL_LINK "CalPrmWslcBrk01.TP_S16_REAR_SP_SL_HLD_THRES_YDF_B_L" 0 /end CHARACTERISTIC
/begin CHARACTERISTIC TP_S16_REAR_SP_SL_HLD_THRES_YDF_H "Rear Selec-Low Yaw-Dump factor threshold below speed in Split-mu (default : 250). If Yaw-Dump Factor is bigger than this value, Select Low Dump is applied" VALUE 0x80020544 CalPrmWslcBrk_SWORD 0 Gain -32768 32767 SYMBOL_LINK "CalPrmWslcBrk01.TP_S16_REAR_SP_SL_HLD_THRES_YDF_H" 0 /end CHARACTERISTIC
/begin CHARACTERISTIC TP_S16_REAR_SP_SL_HLD_THRES_YDF_L "Rear Selec-Low Yaw-Dump factor threshold above high speed in Split-mu (default : 250). If Yaw-Dump Factor is bigger than this value, Select Low Dump is applied" VALUE 0x80020546 CalPrmWslcBrk_SWORD 0 Gain -32768 32767 SYMBOL_LINK "CalPrmWslcBrk01.TP_S16_REAR_SP_SL_HLD_THRES_YDF_L" 0 /end CHARACTERISTIC
/begin CHARACTERISTIC TP_S16_REAR_SP_SL_HLD_THRES_YDF_M "Rear Selec-Low Yaw-Dump factor threshold above low speed in Split-mu (default : 250). If Yaw-Dump Factor is bigger than this value, Select Low Dump is applied" VALUE 0x80020548 CalPrmWslcBrk_SWORD 0 Gain -32768 32767 SYMBOL_LINK "CalPrmWslcBrk01.TP_S16_REAR_SP_SL_HLD_THRES_YDF_M" 0 /end CHARACTERISTIC
/begin CHARACTERISTIC TP_S16_SLIGHT_BRAKING_PRESS "MP threshold for detecting slight braking(default: 40bar)" VALUE 0x80020214 CalPrmWslcBrk_SWORD 0 P34 -3276.8 3276.7 SYMBOL_LINK "CalPrmWslcBrk01.TP_S16_SLIGHT_BRAKING_PRESS" 0 /end CHARACTERISTIC
/begin CHARACTERISTIC TP_S16_Slip_Gain_LMMu_100_150kph_F "Slip Gain, Lowmed Mu Detect, 100-150kph, Decel State, Front wheels" VALUE 0x8002039A CalPrmWslcBrk_SWORD 0 Gain -32768 32767 SYMBOL_LINK "CalPrmWslcBrk01.TP_S16_Slip_Gain_LMMu_100_150kph_F" 0 /end CHARACTERISTIC
/begin CHARACTERISTIC TP_S16_Slip_Gain_LMMu_100_150kph_R "Slip Gain, Lowmed Mu Detect, 100-150kph, Decel State, Rear wheels" VALUE 0x800203B6 CalPrmWslcBrk_SWORD 0 Gain -32768 32767 SYMBOL_LINK "CalPrmWslcBrk01.TP_S16_Slip_Gain_LMMu_100_150kph_R" 0 /end CHARACTERISTIC
/begin CHARACTERISTIC TP_S16_Slip_Gain_LMMu_10_20kph_F "Slip Gain, Lowmed Mu Detect, 10-20kph, Decel State, Front wheels" VALUE 0x8002039C CalPrmWslcBrk_SWORD 0 Gain -32768 32767 SYMBOL_LINK "CalPrmWslcBrk01.TP_S16_Slip_Gain_LMMu_10_20kph_F" 0 /end CHARACTERISTIC
/begin CHARACTERISTIC TP_S16_Slip_Gain_LMMu_10_20kph_R "Slip Gain, Lowmed Mu Detect, 10-20kph, Decel State, Rear wheels" VALUE 0x800203B8 CalPrmWslcBrk_SWORD 0 Gain -32768 32767 SYMBOL_LINK "CalPrmWslcBrk01.TP_S16_Slip_Gain_LMMu_10_20kph_R" 0 /end CHARACTERISTIC
/begin CHARACTERISTIC TP_S16_Slip_Gain_LMMu_20_40kph_F "Slip Gain, Lowmed Mu Detect, 20-40kph, Decel State, Front wheels" VALUE 0x8002039E CalPrmWslcBrk_SWORD 0 Gain -32768 32767 SYMBOL_LINK "CalPrmWslcBrk01.TP_S16_Slip_Gain_LMMu_20_40kph_F" 0 /end CHARACTERISTIC
/begin CHARACTERISTIC TP_S16_Slip_Gain_LMMu_20_40kph_R "Slip Gain, Lowmed Mu Detect, 20-40kph, Decel State, Rear wheels" VALUE 0x800203BA CalPrmWslcBrk_SWORD 0 Gain -32768 32767 SYMBOL_LINK "CalPrmWslcBrk01.TP_S16_Slip_Gain_LMMu_20_40kph_R" 0 /end CHARACTERISTIC
/begin CHARACTERISTIC TP_S16_Slip_Gain_LMMu_40_60kph_F "Slip Gain, Lowmed Mu Detect, 40-60kph, Decel State, Front wheels" VALUE 0x800203A0 CalPrmWslcBrk_SWORD 0 Gain -32768 32767 SYMBOL_LINK "CalPrmWslcBrk01.TP_S16_Slip_Gain_LMMu_40_60kph_F" 0 /end CHARACTERISTIC
/begin CHARACTERISTIC TP_S16_Slip_Gain_LMMu_40_60kph_R "Slip Gain, Lowmed Mu Detect, 40-60kph, Decel State, Rear wheels" VALUE 0x800203BC CalPrmWslcBrk_SWORD 0 Gain -32768 32767 SYMBOL_LINK "CalPrmWslcBrk01.TP_S16_Slip_Gain_LMMu_40_60kph_R" 0 /end CHARACTERISTIC
/begin CHARACTERISTIC TP_S16_Slip_Gain_LMMu_60_100kph_F "Slip Gain, Lowmed Mu Detect, 60-100kph, Decel State, Front Wheels" VALUE 0x800203A2 CalPrmWslcBrk_SWORD 0 Gain -32768 32767 SYMBOL_LINK "CalPrmWslcBrk01.TP_S16_Slip_Gain_LMMu_60_100kph_F" 0 /end CHARACTERISTIC
/begin CHARACTERISTIC TP_S16_Slip_Gain_LMMu_60_100kph_R "Slip Gain, Lowmed Mu Detect, 60-100kph, Decel State, Rear Wheels" VALUE 0x800203BE CalPrmWslcBrk_SWORD 0 Gain -32768 32767 SYMBOL_LINK "CalPrmWslcBrk01.TP_S16_Slip_Gain_LMMu_60_100kph_R" 0 /end CHARACTERISTIC
/begin CHARACTERISTIC TP_S16_Slip_Gain_LMMu_Ab_150kph_F "Slip Gain, Lowmed Mu Detect, Above 150kph, Decel State, Front wheels" VALUE 0x800203A4 CalPrmWslcBrk_SWORD 0 Gain -32768 32767 SYMBOL_LINK "CalPrmWslcBrk01.TP_S16_Slip_Gain_LMMu_Ab_150kph_F" 0 /end CHARACTERISTIC
/begin CHARACTERISTIC TP_S16_Slip_Gain_LMMu_Ab_150kph_R "Slip Gain, Lowmed Mu Detect, Above 150kph, Decel State, Rear wheels" VALUE 0x800203C0 CalPrmWslcBrk_SWORD 0 Gain -32768 32767 SYMBOL_LINK "CalPrmWslcBrk01.TP_S16_Slip_Gain_LMMu_Ab_150kph_R" 0 /end CHARACTERISTIC
/begin CHARACTERISTIC TP_S16_Slip_Gain_LMMu_B_10kph_F "Slip Gain, Lowmed Mu Detect, Below 10kph, Decel State, Front wheels" VALUE 0x800203A6 CalPrmWslcBrk_SWORD 0 Gain -32768 32767 SYMBOL_LINK "CalPrmWslcBrk01.TP_S16_Slip_Gain_LMMu_B_10kph_F" 0 /end CHARACTERISTIC
/begin CHARACTERISTIC TP_S16_Slip_Gain_LMMu_B_10kph_R "Slip Gain, Lowmed Mu Detect, Below 10kph, Decel State, Rear wheels" VALUE 0x800203C2 CalPrmWslcBrk_SWORD 0 Gain -32768 32767 SYMBOL_LINK "CalPrmWslcBrk01.TP_S16_Slip_Gain_LMMu_B_10kph_R" 0 /end CHARACTERISTIC
/begin CHARACTERISTIC TP_S16_Slip_Gain_LMu_100_150kph_F "Slip Gain, Low Mu Detect, 100-150kph, Decel State, Front wheels" VALUE 0x800203D2 CalPrmWslcBrk_SWORD 0 Gain -32768 32767 SYMBOL_LINK "CalPrmWslcBrk01.TP_S16_Slip_Gain_LMu_100_150kph_F" 0 /end CHARACTERISTIC
/begin CHARACTERISTIC TP_S16_Slip_Gain_LMu_100_150kph_R "Slip Gain, Low Mu Detect, 100-150kph, Decel State, Rear wheels" VALUE 0x800203EE CalPrmWslcBrk_SWORD 0 Gain -32768 32767 SYMBOL_LINK "CalPrmWslcBrk01.TP_S16_Slip_Gain_LMu_100_150kph_R" 0 /end CHARACTERISTIC
/begin CHARACTERISTIC TP_S16_Slip_Gain_LMu_10_20kph_F "Slip Gain, Low Mu Detect, 10-20kph, Decel State, Front wheels" VALUE 0x800203D4 CalPrmWslcBrk_SWORD 0 Gain -32768 32767 SYMBOL_LINK "CalPrmWslcBrk01.TP_S16_Slip_Gain_LMu_10_20kph_F" 0 /end CHARACTERISTIC
/begin CHARACTERISTIC TP_S16_Slip_Gain_LMu_10_20kph_R "Slip Gain, Low Mu Detect, 10-20kph, Decel State, Rear wheels" VALUE 0x800203F0 CalPrmWslcBrk_SWORD 0 Gain -32768 32767 SYMBOL_LINK "CalPrmWslcBrk01.TP_S16_Slip_Gain_LMu_10_20kph_R" 0 /end CHARACTERISTIC
/begin CHARACTERISTIC TP_S16_Slip_Gain_LMu_20_40kph_F "Slip Gain, Low Mu Detect, 20-40kph, Decel State, Front wheels" VALUE 0x800203D6 CalPrmWslcBrk_SWORD 0 Gain -32768 32767 SYMBOL_LINK "CalPrmWslcBrk01.TP_S16_Slip_Gain_LMu_20_40kph_F" 0 /end CHARACTERISTIC
/begin CHARACTERISTIC TP_S16_Slip_Gain_LMu_20_40kph_R "Slip Gain, Low Mu Detect, 20-40kph, Decel State, Rear wheels" VALUE 0x800203F2 CalPrmWslcBrk_SWORD 0 Gain -32768 32767 SYMBOL_LINK "CalPrmWslcBrk01.TP_S16_Slip_Gain_LMu_20_40kph_R" 0 /end CHARACTERISTIC
/begin CHARACTERISTIC TP_S16_Slip_Gain_LMu_40_60kph_F "Slip Gain, Low Mu Detect, 40-60kph, Decel State, Front wheels" VALUE 0x800203D8 CalPrmWslcBrk_SWORD 0 Gain -32768 32767 SYMBOL_LINK "CalPrmWslcBrk01.TP_S16_Slip_Gain_LMu_40_60kph_F" 0 /end CHARACTERISTIC
/begin CHARACTERISTIC TP_S16_Slip_Gain_LMu_40_60kph_R "Slip Gain, Low Mu Detect, 40-60kph, Decel State, Rear wheels" VALUE 0x800203F4 CalPrmWslcBrk_SWORD 0 Gain -32768 32767 SYMBOL_LINK "CalPrmWslcBrk01.TP_S16_Slip_Gain_LMu_40_60kph_R" 0 /end CHARACTERISTIC
/begin CHARACTERISTIC TP_S16_Slip_Gain_LMu_60_100kph_F "Slip Gain, Low Mu Detect, 60-100kph, Decel State, Front Wheels" VALUE 0x800203DA CalPrmWslcBrk_SWORD 0 Gain -32768 32767 SYMBOL_LINK "CalPrmWslcBrk01.TP_S16_Slip_Gain_LMu_60_100kph_F" 0 /end CHARACTERISTIC
/begin CHARACTERISTIC TP_S16_Slip_Gain_LMu_60_100kph_R "Slip Gain, Low Mu Detect, 60-100kph, Decel State, Rear Wheels" VALUE 0x800203F6 CalPrmWslcBrk_SWORD 0 Gain -32768 32767 SYMBOL_LINK "CalPrmWslcBrk01.TP_S16_Slip_Gain_LMu_60_100kph_R" 0 /end CHARACTERISTIC
/begin CHARACTERISTIC TP_S16_Slip_Gain_LMu_Ab_150kph_F "Slip Gain, Low Mu Detect, Above 150kph, Decel State, Front wheels" VALUE 0x800203DC CalPrmWslcBrk_SWORD 0 Gain -32768 32767 SYMBOL_LINK "CalPrmWslcBrk01.TP_S16_Slip_Gain_LMu_Ab_150kph_F" 0 /end CHARACTERISTIC
/begin CHARACTERISTIC TP_S16_Slip_Gain_LMu_Ab_150kph_R "Slip Gain, Low Mu Detect, Above 150kph, Decel State, Rear wheels" VALUE 0x800203F8 CalPrmWslcBrk_SWORD 0 Gain -32768 32767 SYMBOL_LINK "CalPrmWslcBrk01.TP_S16_Slip_Gain_LMu_Ab_150kph_R" 0 /end CHARACTERISTIC
/begin CHARACTERISTIC TP_S16_Slip_Gain_LMu_B_10kph_F "Slip Gain, Low Mu Detect, Below 10kph, Decel State, Front wheels" VALUE 0x800203DE CalPrmWslcBrk_SWORD 0 Gain -32768 32767 SYMBOL_LINK "CalPrmWslcBrk01.TP_S16_Slip_Gain_LMu_B_10kph_F" 0 /end CHARACTERISTIC
/begin CHARACTERISTIC TP_S16_Slip_Gain_LMu_B_10kph_R "Slip Gain, Low Mu Detect, Below 10kph, Decel State, Rear wheels" VALUE 0x800203FA CalPrmWslcBrk_SWORD 0 Gain -32768 32767 SYMBOL_LINK "CalPrmWslcBrk01.TP_S16_Slip_Gain_LMu_B_10kph_R" 0 /end CHARACTERISTIC
/begin CHARACTERISTIC TP_S16_Slip_Gain_MMu_100_150kph_R "Slip Gain, Medium Mu Detect, 100-150kph, Decel State, Rear Wheels" VALUE 0x8002037E CalPrmWslcBrk_SWORD 0 Gain -32768 32767 SYMBOL_LINK "CalPrmWslcBrk01.TP_S16_Slip_Gain_MMu_100_150kph_R" 0 /end CHARACTERISTIC
/begin CHARACTERISTIC TP_S16_Slip_Gain_MMu_10_20kph_R "Slip Gain, Medium Mu Detect, 10-20kph, Decel State, Rear Wheels" VALUE 0x80020380 CalPrmWslcBrk_SWORD 0 Gain -32768 32767 SYMBOL_LINK "CalPrmWslcBrk01.TP_S16_Slip_Gain_MMu_10_20kph_R" 0 /end CHARACTERISTIC
/begin CHARACTERISTIC TP_S16_Slip_Gain_MMu_20_40kph_R "Slip Gain, Medium Mu Detect, 20-40kph, Decel State,Rear Wheels" VALUE 0x80020382 CalPrmWslcBrk_SWORD 0 Gain -32768 32767 SYMBOL_LINK "CalPrmWslcBrk01.TP_S16_Slip_Gain_MMu_20_40kph_R" 0 /end CHARACTERISTIC
/begin CHARACTERISTIC TP_S16_Slip_Gain_MMu_40_60kph_R "Slip Gain, Medium Mu Detect, 40-60kph, Decel State, Rear Wheels" VALUE 0x80020384 CalPrmWslcBrk_SWORD 0 Gain -32768 32767 SYMBOL_LINK "CalPrmWslcBrk01.TP_S16_Slip_Gain_MMu_40_60kph_R" 0 /end CHARACTERISTIC
/begin CHARACTERISTIC TP_S16_Slip_Gain_MMu_60_100kph_R "Slip Gain, Medium Mu Detect, 60-100kph, Decel State, Front Wheels" VALUE 0x80020386 CalPrmWslcBrk_SWORD 0 Gain -32768 32767 SYMBOL_LINK "CalPrmWslcBrk01.TP_S16_Slip_Gain_MMu_60_100kph_R" 0 /end CHARACTERISTIC
/begin CHARACTERISTIC TP_S16_Slip_Gain_MMu_Ab_150kph_R "Slip Gain, Medium Mu Detect, Above 150kph, Decel State, Rear Wheels" VALUE 0x80020388 CalPrmWslcBrk_SWORD 0 Gain -32768 32767 SYMBOL_LINK "CalPrmWslcBrk01.TP_S16_Slip_Gain_MMu_Ab_150kph_R" 0 /end CHARACTERISTIC
/begin CHARACTERISTIC TP_S16_Slip_Gain_MMu_B_10kph_R "Slip Gain, Medium Mu Detect, Below 10kph, Decel State, Rear Wheels" VALUE 0x8002038A CalPrmWslcBrk_SWORD 0 Gain -32768 32767 SYMBOL_LINK "CalPrmWslcBrk01.TP_S16_Slip_Gain_MMu_B_10kph_R" 0 /end CHARACTERISTIC
/begin CHARACTERISTIC TP_S16_Slip_Gain_SpHMu_100_150_F "Slip Gain, Split High Mu Detect, 100-150kph, Decel State, Front wheels" VALUE 0x8002040A CalPrmWslcBrk_SWORD 0 Gain -32768 32767 SYMBOL_LINK "CalPrmWslcBrk01.TP_S16_Slip_Gain_SpHMu_100_150_F" 0 /end CHARACTERISTIC
/begin CHARACTERISTIC TP_S16_Slip_Gain_SpHMu_10_20kph_F "Slip Gain, Split High Mu Detect, 10-20kph, Decel State, Front wheels" VALUE 0x8002040C CalPrmWslcBrk_SWORD 0 Gain -32768 32767 SYMBOL_LINK "CalPrmWslcBrk01.TP_S16_Slip_Gain_SpHMu_10_20kph_F" 0 /end CHARACTERISTIC
/begin CHARACTERISTIC TP_S16_Slip_Gain_SpHMu_20_40kph_F "Slip Gain, Split High Mu Detect, 20-40kph, Decel State, Front wheels" VALUE 0x8002040E CalPrmWslcBrk_SWORD 0 Gain -32768 32767 SYMBOL_LINK "CalPrmWslcBrk01.TP_S16_Slip_Gain_SpHMu_20_40kph_F" 0 /end CHARACTERISTIC
/begin CHARACTERISTIC TP_S16_Slip_Gain_SpHMu_40_60kph_F "Slip Gain, Split High Mu Detect, 40-60kph, Decel State, Front wheels" VALUE 0x80020410 CalPrmWslcBrk_SWORD 0 Gain -32768 32767 SYMBOL_LINK "CalPrmWslcBrk01.TP_S16_Slip_Gain_SpHMu_40_60kph_F" 0 /end CHARACTERISTIC
/begin CHARACTERISTIC TP_S16_Slip_Gain_SpHMu_60_100kph_F "Slip Gain, Split High Mu Detect, 60-100kph, Decel State, Front Wheels" VALUE 0x80020412 CalPrmWslcBrk_SWORD 0 Gain -32768 32767 SYMBOL_LINK "CalPrmWslcBrk01.TP_S16_Slip_Gain_SpHMu_60_100kph_F" 0 /end CHARACTERISTIC
/begin CHARACTERISTIC TP_S16_Slip_Gain_SpHMu_Ab_150kph_F "Slip Gain, Split High Mu Detect, Above 150kph, Decel State, Front wheels" VALUE 0x80020414 CalPrmWslcBrk_SWORD 0 Gain -32768 32767 SYMBOL_LINK "CalPrmWslcBrk01.TP_S16_Slip_Gain_SpHMu_Ab_150kph_F" 0 /end CHARACTERISTIC
/begin CHARACTERISTIC TP_S16_Slip_Gain_SpHMu_B_10kph_F "Slip Gain, Split High Mu Detect, Below 10kph, Decel State, Front wheels" VALUE 0x80020416 CalPrmWslcBrk_SWORD 0 Gain -32768 32767 SYMBOL_LINK "CalPrmWslcBrk01.TP_S16_Slip_Gain_SpHMu_B_10kph_F" 0 /end CHARACTERISTIC
/begin CHARACTERISTIC TP_S16_VERY_SLIGHT_BRAKING_PRESS "MP threshold for detecting very slight braking(default: 20bar)" VALUE 0x80020212 CalPrmWslcBrk_SWORD 0 P34 -3276.8 3276.7 SYMBOL_LINK "CalPrmWslcBrk01.TP_S16_VERY_SLIGHT_BRAKING_PRESS" 0 /end CHARACTERISTIC
/begin CHARACTERISTIC TP_S16_WPThres_for_IncDumptim_1st "Wheel Skid Pressure in Low-mu. Reference to increase dump time in Low-mu surface" VALUE 0x800204BE CalPrmWslcBrk_SWORD 0 P34 -3276.8 3276.7 SYMBOL_LINK "CalPrmWslcBrk01.TP_S16_WPThres_for_IncDumptim_1st" 0 /end CHARACTERISTIC
/begin CHARACTERISTIC TP_S8TCSCpOverBrkTh "" VALUE 0x8003A240 CalPrmWspcEng_SBYTE 0 Spd12 -16 15.875 SYMBOL_LINK "CalPrmWspcEng01.TP_S8TCSCpOverBrkTh" 0 /end CHARACTERISTIC
/begin CHARACTERISTIC TP_S8_Arad_1stPoint_Ab_150KPH "1st reference point to set the reference EBD cut slip depending on wheel acceleration, above 150KPH" VALUE 0x800206AC CalPrmWslcBrk_SBYTE 0 A20 -32 31.75 SYMBOL_LINK "CalPrmWslcBrk01.TP_S8_Arad_1stPoint_Ab_150KPH" 0 /end CHARACTERISTIC
/begin CHARACTERISTIC TP_S8_Arad_2ndPoint_Ab_150KPH "2nd reference point to set the reference EBD cut slip depending on wheel acceleration, above 150KPH" VALUE 0x800206AD CalPrmWslcBrk_SBYTE 0 A20 -32 31.75 SYMBOL_LINK "CalPrmWslcBrk01.TP_S8_Arad_2ndPoint_Ab_150KPH" 0 /end CHARACTERISTIC
/begin CHARACTERISTIC TP_S8_Arad_3rdPoint_Ab_150KPH "3rd reference point to set the reference EBD cut slip depending on wheel acceleration, above 150KPH" VALUE 0x800206AE CalPrmWslcBrk_SBYTE 0 A20 -32 31.75 SYMBOL_LINK "CalPrmWslcBrk01.TP_S8_Arad_3rdPoint_Ab_150KPH" 0 /end CHARACTERISTIC
/begin CHARACTERISTIC TP_S8_Arad_Fact_1_2P_Ab_150KPH "subtracting value from initial cut slip at wheel acceleration between Arad_1stPoint ~ Arad_2ndPoint, above 150KPH" VALUE 0x800206AF CalPrmWslcBrk_SBYTE 0 Perc6 -128 127 SYMBOL_LINK "CalPrmWslcBrk01.TP_S8_Arad_Fact_1_2P_Ab_150KPH" 0 /end CHARACTERISTIC
/begin CHARACTERISTIC TP_S8_Arad_Fact_2_3P_Ab_150KPH "subtracting value from initial cut slip at wheel acceleration between Arad_2ndPoint ~ Arad_3rdPoint, above 150KPH" VALUE 0x800206B0 CalPrmWslcBrk_SBYTE 0 Perc6 -128 127 SYMBOL_LINK "CalPrmWslcBrk01.TP_S8_Arad_Fact_2_3P_Ab_150KPH" 0 /end CHARACTERISTIC
/begin CHARACTERISTIC TP_S8_Arad_Fact_Ab_3P_Ab_150KPH "subtracting value from initial cut slip at wheel acceleration above Arad_3rdPoint, above 150KPH" VALUE 0x800206B1 CalPrmWslcBrk_SBYTE 0 Perc6 -128 127 SYMBOL_LINK "CalPrmWslcBrk01.TP_S8_Arad_Fact_Ab_3P_Ab_150KPH" 0 /end CHARACTERISTIC
/begin CHARACTERISTIC TP_S8_Arad_Fact_B_1P_Ab_150KPH "subtracting value from initial cut slip at wheel acceleration below Arad_1stPoint, above 150KPH" VALUE 0x800206B2 CalPrmWslcBrk_SBYTE 0 Perc6 -128 127 SYMBOL_LINK "CalPrmWslcBrk01.TP_S8_Arad_Fact_B_1P_Ab_150KPH" 0 /end CHARACTERISTIC
/begin CHARACTERISTIC TP_S8_Dec_Hump_Counting_arad "Peak Wheel deceleration of In gear vibration tendency in Unstable state, hump counter" VALUE 0x800202DB CalPrmWslcBrk_SBYTE 0 A20 -32 31.75 SYMBOL_LINK "CalPrmWslcBrk01.TP_S8_Dec_Hump_Counting_arad" 0 /end CHARACTERISTIC
/begin CHARACTERISTIC TP_S8_DetectAccel_EngTorq_L1 "Engine Torque Level at MTP Position P1 to Detect Driver's Intend to Accelerate" VALUE 0x80020614 CalPrmWslcBrk_SBYTE 0 Perc6 -128 127 SYMBOL_LINK "CalPrmWslcBrk01.TP_S8_DetectAccel_EngTorq_L1" 0 /end CHARACTERISTIC
/begin CHARACTERISTIC TP_S8_DetectAccel_EngTorq_L2 "Engine Torque Level at MTP Position P2 to Detect Driver's Intend to Accelerate" VALUE 0x80020615 CalPrmWslcBrk_SBYTE 0 Perc6 -128 127 SYMBOL_LINK "CalPrmWslcBrk01.TP_S8_DetectAccel_EngTorq_L2" 0 /end CHARACTERISTIC
/begin CHARACTERISTIC TP_S8_DetectAccel_EngTorq_L3 "Engine Torque Level at MTP Position P3 to Detect Driver's Intend to Accelerate" VALUE 0x80020616 CalPrmWslcBrk_SBYTE 0 Perc6 -128 127 SYMBOL_LINK "CalPrmWslcBrk01.TP_S8_DetectAccel_EngTorq_L3" 0 /end CHARACTERISTIC
/begin CHARACTERISTIC TP_S8_DetectAccel_Throttle_P1 "MTP ratio to Detect Driver's Intend to Accelerate" VALUE 0x80020617 CalPrmWslcBrk_SBYTE 0 Perc6 -128 127 SYMBOL_LINK "CalPrmWslcBrk01.TP_S8_DetectAccel_Throttle_P1" 0 /end CHARACTERISTIC
/begin CHARACTERISTIC TP_S8_DetectAccel_Throttle_P2 "MTP ratio to Detect Driver's Intend to Accelerate" VALUE 0x80020618 CalPrmWslcBrk_SBYTE 0 Perc6 -128 127 SYMBOL_LINK "CalPrmWslcBrk01.TP_S8_DetectAccel_Throttle_P2" 0 /end CHARACTERISTIC
/begin CHARACTERISTIC TP_S8_DetectAccel_Throttle_P3 "MTP ratio to Detect Driver's Intend to Accelerate" VALUE 0x80020619 CalPrmWslcBrk_SBYTE 0 Perc6 -128 127 SYMBOL_LINK "CalPrmWslcBrk01.TP_S8_DetectAccel_Throttle_P3" 0 /end CHARACTERISTIC
/begin CHARACTERISTIC TP_S8_FORCED_HOLD_SLIP_BFAFZOK_F "Front Wheel slip to allow stable forced hold before AFZ_OK" VALUE 0x80020606 CalPrmWslcBrk_SBYTE 0 Perc6 -128 127 SYMBOL_LINK "CalPrmWslcBrk01.TP_S8_FORCED_HOLD_SLIP_BFAFZOK_F" 0 /end CHARACTERISTIC
/begin CHARACTERISTIC TP_S8_FORCED_HOLD_SLIP_BFAFZOK_R "Rear Wheel slip to allow stable forced hold before AFZ_OK" VALUE 0x80020607 CalPrmWslcBrk_SBYTE 0 Perc6 -128 127 SYMBOL_LINK "CalPrmWslcBrk01.TP_S8_FORCED_HOLD_SLIP_BFAFZOK_R" 0 /end CHARACTERISTIC
/begin CHARACTERISTIC TP_S8_FORCED_HOLD_SLIP_HIGH_F "Front Wheel slip to allow stable forced hold for High Mu" VALUE 0x80020608 CalPrmWslcBrk_SBYTE 0 Perc6 -128 127 SYMBOL_LINK "CalPrmWslcBrk01.TP_S8_FORCED_HOLD_SLIP_HIGH_F" 0 /end CHARACTERISTIC
/begin CHARACTERISTIC TP_S8_FORCED_HOLD_SLIP_HIGH_R "Rear Wheel slip to allow stable forced hold for High Mu" VALUE 0x80020609 CalPrmWslcBrk_SBYTE 0 Perc6 -128 127 SYMBOL_LINK "CalPrmWslcBrk01.TP_S8_FORCED_HOLD_SLIP_HIGH_R" 0 /end CHARACTERISTIC
/begin CHARACTERISTIC TP_S8_FORCED_HOLD_SLIP_LOW_F "Front Wheel slip to allow stable forced hold for Low Mu" VALUE 0x8002060A CalPrmWslcBrk_SBYTE 0 Perc6 -128 127 SYMBOL_LINK "CalPrmWslcBrk01.TP_S8_FORCED_HOLD_SLIP_LOW_F" 0 /end CHARACTERISTIC
/begin CHARACTERISTIC TP_S8_FORCED_HOLD_SLIP_LOW_R "Rear Wheel slip to allow stable forced hold for Low Mu" VALUE 0x8002060B CalPrmWslcBrk_SBYTE 0 Perc6 -128 127 SYMBOL_LINK "CalPrmWslcBrk01.TP_S8_FORCED_HOLD_SLIP_LOW_R" 0 /end CHARACTERISTIC
/begin CHARACTERISTIC TP_S8_FORCED_HOLD_SLIP_MED_F "Front Wheel slip to allow stable forced hold for Medium Mu" VALUE 0x8002060C CalPrmWslcBrk_SBYTE 0 Perc6 -128 127 SYMBOL_LINK "CalPrmWslcBrk01.TP_S8_FORCED_HOLD_SLIP_MED_F" 0 /end CHARACTERISTIC
/begin CHARACTERISTIC TP_S8_FORCED_HOLD_SLIP_MED_R "Rear Wheel slip to allow stable forced hold for Medium Mu" VALUE 0x8002060D CalPrmWslcBrk_SBYTE 0 Perc6 -128 127 SYMBOL_LINK "CalPrmWslcBrk01.TP_S8_FORCED_HOLD_SLIP_MED_R" 0 /end CHARACTERISTIC
/begin CHARACTERISTIC TP_S8_FORCED_HOLD_SLIP_SP_HIGH_F "Front Wheel slip to allow stable forced hold for Split-High Mu" VALUE 0x8002060E CalPrmWslcBrk_SBYTE 0 Perc6 -128 127 SYMBOL_LINK "CalPrmWslcBrk01.TP_S8_FORCED_HOLD_SLIP_SP_HIGH_F" 0 /end CHARACTERISTIC
/begin CHARACTERISTIC TP_S8_IN_GEAR_Vib_Detect_arad1 "Peak Wheel deceleration of In gear vibration tendency " VALUE 0x800202DC CalPrmWslcBrk_SBYTE 0 A20 -32 31.75 SYMBOL_LINK "CalPrmWslcBrk01.TP_S8_IN_GEAR_Vib_Detect_arad1" 0 /end CHARACTERISTIC
/begin CHARACTERISTIC TP_S8_IN_GEAR_Vib_Detect_arad2 "Peak Wheel deceleration of In gear vibration tendency " VALUE 0x800202DD CalPrmWslcBrk_SBYTE 0 A20 -32 31.75 SYMBOL_LINK "CalPrmWslcBrk01.TP_S8_IN_GEAR_Vib_Detect_arad2" 0 /end CHARACTERISTIC
/begin CHARACTERISTIC TP_S8_L1_LOWSIDE_PEAK_DEC "Low side peak decel Lv1(default : 3g)" VALUE 0x80020666 CalPrmWslcBrk_SBYTE 0 A20 -32 31.75 SYMBOL_LINK "CalPrmWslcBrk01.TP_S8_L1_LOWSIDE_PEAK_DEC" 0 /end CHARACTERISTIC
/begin CHARACTERISTIC TP_S8_L1_SLIP_DIFF_50_80 "Slip diff 50-80kph Lv1(default : 10)" VALUE 0x80020667 CalPrmWslcBrk_SBYTE 0 Perc6 -128 127 SYMBOL_LINK "CalPrmWslcBrk01.TP_S8_L1_SLIP_DIFF_50_80" 0 /end CHARACTERISTIC
/begin CHARACTERISTIC TP_S8_L1_SLIP_DIFF_80_M "Slip diff 80-Max speed Lv1(default : 5)" VALUE 0x80020668 CalPrmWslcBrk_SBYTE 0 Perc6 -128 127 SYMBOL_LINK "CalPrmWslcBrk01.TP_S8_L1_SLIP_DIFF_80_M" 0 /end CHARACTERISTIC
/begin CHARACTERISTIC TP_S8_L2_LOWSIDE_PEAK_DEC "Low side peak decel Lv2(default : 5.5g)" VALUE 0x80020669 CalPrmWslcBrk_SBYTE 0 A20 -32 31.75 SYMBOL_LINK "CalPrmWslcBrk01.TP_S8_L2_LOWSIDE_PEAK_DEC" 0 /end CHARACTERISTIC
/begin CHARACTERISTIC TP_S8_L2_SLIP_DIFF_50_80 "Slip diff 50-80kph Lv2(default : 15)" VALUE 0x8002066A CalPrmWslcBrk_SBYTE 0 Perc6 -128 127 SYMBOL_LINK "CalPrmWslcBrk01.TP_S8_L2_SLIP_DIFF_50_80" 0 /end CHARACTERISTIC
/begin CHARACTERISTIC TP_S8_L2_SLIP_DIFF_80_M "Slip diff 80-Max speed Lv2(default : 10)" VALUE 0x8002066B CalPrmWslcBrk_SBYTE 0 Perc6 -128 127 SYMBOL_LINK "CalPrmWslcBrk01.TP_S8_L2_SLIP_DIFF_80_M" 0 /end CHARACTERISTIC
/begin CHARACTERISTIC TP_S8_MAXIMUM_FORCED_HOLD_SCAN "Max. Num of Stable Forced Hold scans" VALUE 0x8002060F CalPrmWslcBrk_SBYTE 0 Gain -128 127 SYMBOL_LINK "CalPrmWslcBrk01.TP_S8_MAXIMUM_FORCED_HOLD_SCAN" 0 /end CHARACTERISTIC
/begin CHARACTERISTIC TP_S8_REAR_HOMO_SL_HOLD_THRES_SLIP "Rear Selec-Low Yaw-Dump factor threshold above med speed in Split-mu (default : 250). If Yaw-Dump Factor is bigger than this value, Select Low Dump is applied" VALUE 0x8002054A CalPrmWslcBrk_SBYTE 0 Perc6 -128 127 SYMBOL_LINK "CalPrmWslcBrk01.TP_S8_REAR_HOMO_SL_HOLD_THRES_SLIP" 0 /end CHARACTERISTIC
/begin CHARACTERISTIC TP_S8_REAR_SP_SL_HOLD_THRES_SLIP "Rear Selec-Low Slip threshold in Split-mu (default : 3%). If slip is bigger than this value, Select Low Dump is applied" VALUE 0x8002054B CalPrmWslcBrk_SBYTE 0 Perc6 -128 127 SYMBOL_LINK "CalPrmWslcBrk01.TP_S8_REAR_SP_SL_HOLD_THRES_SLIP" 0 /end CHARACTERISTIC
/begin CHARACTERISTIC TP_U8CpAfterHghMuUnstbCntTh "" VALUE 0x8003A26A CalPrmWspcEng_UBYTE 0 Ti21 0 2.55 SYMBOL_LINK "CalPrmWspcEng01.TP_U8CpAfterHghMuUnstbCntTh" 0 /end CHARACTERISTIC
/begin CHARACTERISTIC TP_U8TCSCpBrkTorqDecPcntOfOvBrk "" VALUE 0x8003A276 CalPrmWspcEng_UBYTE 0 Perc6 0 255 SYMBOL_LINK "CalPrmWspcEng01.TP_U8TCSCpBrkTorqDecPcntOfOvBrk" 0 /end CHARACTERISTIC
/begin CHARACTERISTIC TP_U8TCSCpBrkTorqDecRateOfHWIS "" VALUE 0x8003A278 CalPrmWspcEng_UBYTE 0 TqGrdt10 0 255 SYMBOL_LINK "CalPrmWspcEng01.TP_U8TCSCpBrkTorqDecRateOfHWIS" 0 /end CHARACTERISTIC
/begin CHARACTERISTIC TP_U8TCSCpBrkTorqFastDecRateOfHWIS "" VALUE 0x8003A279 CalPrmWspcEng_UBYTE 0 TqGrdt10 0 255 SYMBOL_LINK "CalPrmWspcEng01.TP_U8TCSCpBrkTorqFastDecRateOfHWIS" 0 /end CHARACTERISTIC
/begin CHARACTERISTIC TP_U8TCSCpBrkTorqRecPcntOfHWIS "" VALUE 0x8003A27B CalPrmWspcEng_UBYTE 0 Perc6 0 255 SYMBOL_LINK "CalPrmWspcEng01.TP_U8TCSCpBrkTorqRecPcntOfHWIS" 0 /end CHARACTERISTIC
/begin CHARACTERISTIC TP_U8TCSCpBrkTqDecFacOfFrntAtReSym "" VALUE 0x8003A27C CalPrmWspcEng_UBYTE 0 Perc6 0 255 SYMBOL_LINK "CalPrmWspcEng01.TP_U8TCSCpBrkTqDecFacOfFrntAtReSym" 0 /end CHARACTERISTIC
/begin CHARACTERISTIC TP_U8TCSCpBrkTrqMaxIncRate "" VALUE 0x8003A27E CalPrmWspcEng_UBYTE 0 TqGrdt11 0 255 SYMBOL_LINK "CalPrmWspcEng01.TP_U8TCSCpBrkTrqMaxIncRate" 0 /end CHARACTERISTIC
/begin CHARACTERISTIC TP_U8TCSCpFFReductFactInHunting "" VALUE 0x8003A2FF CalPrmWspcEng_UBYTE 0 Perc6 0 255 SYMBOL_LINK "CalPrmWspcEng01.TP_U8TCSCpFFReductFactInHunting" 0 /end CHARACTERISTIC
/begin CHARACTERISTIC TP_U8TCSCpFadeOutDctScan "" VALUE 0x8003A2FC CalPrmWspcEng_UBYTE 0 Ti21 0 2.55 SYMBOL_LINK "CalPrmWspcEng01.TP_U8TCSCpFadeOutDctScan" 0 /end CHARACTERISTIC
/begin CHARACTERISTIC TP_U8TCSCpFadeOutExitScan "" VALUE 0x8003A2FD CalPrmWspcEng_UBYTE 0 Ti21 0 2.55 SYMBOL_LINK "CalPrmWspcEng01.TP_U8TCSCpFadeOutExitScan" 0 /end CHARACTERISTIC
/begin CHARACTERISTIC TP_U8TCSCpFadeOutSpdDiffThr "" VALUE 0x8003A2FE CalPrmWspcEng_UBYTE 0 Spd12 0 31.875 SYMBOL_LINK "CalPrmWspcEng01.TP_U8TCSCpFadeOutSpdDiffThr" 0 /end CHARACTERISTIC
/begin CHARACTERISTIC TP_U8TCSCpHghMuWhlDelSpinTh "" VALUE 0x8003A302 CalPrmWspcEng_UBYTE 0 Spd12 0 31.875 SYMBOL_LINK "CalPrmWspcEng01.TP_U8TCSCpHghMuWhlDelSpinTh" 0 /end CHARACTERISTIC
/begin CHARACTERISTIC TP_U8TCSCpHghMuWhlHuntSpinTh "" VALUE 0x8003A303 CalPrmWspcEng_UBYTE 0 Spd12 0 31.875 SYMBOL_LINK "CalPrmWspcEng01.TP_U8TCSCpHghMuWhlHuntSpinTh" 0 /end CHARACTERISTIC
/begin CHARACTERISTIC TP_U8TCSCpHghMuWhlSpinTh "" VALUE 0x8003A304 CalPrmWspcEng_UBYTE 0 Spd12 0 31.875 SYMBOL_LINK "CalPrmWspcEng01.TP_U8TCSCpHghMuWhlSpinTh" 0 /end CHARACTERISTIC
/begin CHARACTERISTIC TP_U8TCSCpHghMuWhlSpinThHill "" VALUE 0x8003A305 CalPrmWspcEng_UBYTE 0 Spd12 0 31.875 SYMBOL_LINK "CalPrmWspcEng01.TP_U8TCSCpHghMuWhlSpinThHill" 0 /end CHARACTERISTIC
/begin CHARACTERISTIC TP_U8TCSCpHghMuWhlSpinTm "" VALUE 0x8003A306 CalPrmWspcEng_UBYTE 0 Ti21 0 2.55 SYMBOL_LINK "CalPrmWspcEng01.TP_U8TCSCpHghMuWhlSpinTm" 0 /end CHARACTERISTIC
/begin CHARACTERISTIC TP_U8TCSCpL2SplitSuspectTorq "" VALUE 0x8003A31A CalPrmWspcEng_UBYTE 0 Tq2 0 255 SYMBOL_LINK "CalPrmWspcEng01.TP_U8TCSCpL2SplitSuspectTorq" 0 /end CHARACTERISTIC
/begin CHARACTERISTIC TP_U8TCSCpMtrFstRnTmrAftHghMuWhStb "" VALUE 0x8003A320 CalPrmWspcEng_UBYTE 0 Ti21 0 2.55 SYMBOL_LINK "CalPrmWspcEng01.TP_U8TCSCpMtrFstRnTmrAftHghMuWhStb" 0 /end CHARACTERISTIC
/begin CHARACTERISTIC TP_U8TCSCpReducePgainF4GearShift "" VALUE 0x8003A337 CalPrmWspcEng_UBYTE 0 Gain 0 255 SYMBOL_LINK "CalPrmWspcEng01.TP_U8TCSCpReducePgainF4GearShift" 0 /end CHARACTERISTIC
/begin CHARACTERISTIC TP_U8TCSCpSymSpFadeOutHystSpd "" VALUE 0x8003A346 CalPrmWspcEng_UBYTE 0 Spd12 0 31.875 SYMBOL_LINK "CalPrmWspcEng01.TP_U8TCSCpSymSpFadeOutHystSpd" 0 /end CHARACTERISTIC
/begin CHARACTERISTIC TP_U8TCSFadeOutBrkCtrlMinTorq[0] "" VALUE 0x8003A35C CalPrmWspcEng_UBYTE 0 Gain 0 255 SYMBOL_LINK "CalPrmWspcEng01.TP_U8TCSFadeOutBrkCtrlMinTorq[0]" 0 /end CHARACTERISTIC
/begin CHARACTERISTIC TP_U8TCSFadeOutBrkCtrlMinTorq[1] "" VALUE 0x8003A35D CalPrmWspcEng_UBYTE 0 Gain 0 255 SYMBOL_LINK "CalPrmWspcEng01.TP_U8TCSFadeOutBrkCtrlMinTorq[1]" 0 /end CHARACTERISTIC
/begin CHARACTERISTIC TP_U8TCSHghMuUnstbRecoveryTh "" VALUE 0x8003A35E CalPrmWspcEng_UBYTE 0 Spd12 0 31.875 SYMBOL_LINK "CalPrmWspcEng01.TP_U8TCSHghMuUnstbRecoveryTh" 0 /end CHARACTERISTIC
/begin CHARACTERISTIC TP_U8_1st_Dumpscantime_LMMu_R "Time of 1st dump-scan in Low~Low-medium mu, Rear Wheels" VALUE 0x800204AE CalPrmWslcBrk_UBYTE 0 Gain 0 255 SYMBOL_LINK "CalPrmWslcBrk01.TP_U8_1st_Dumpscantime_LMMu_R" 0 /end CHARACTERISTIC
/begin CHARACTERISTIC TP_U8_1st_Dumpscantime_LMu_F "Time of 1st dump-scan in Low mu, Front Wheels" VALUE 0x800204B3 CalPrmWslcBrk_UBYTE 0 Gain 0 255 SYMBOL_LINK "CalPrmWslcBrk01.TP_U8_1st_Dumpscantime_LMu_F" 0 /end CHARACTERISTIC
/begin CHARACTERISTIC TP_U8_1st_Dumpscantime_LMu_R "Time of 1st dump-scan in Low mu, Rear Wheels" VALUE 0x800204B9 CalPrmWslcBrk_UBYTE 0 Gain 0 255 SYMBOL_LINK "CalPrmWslcBrk01.TP_U8_1st_Dumpscantime_LMu_R" 0 /end CHARACTERISTIC
/begin CHARACTERISTIC TP_U8_2nd3rd_Dumpscantime_LMMu_R "Time of 2nd and 3rd dump-scan in Low~Under-Low-Medium mu, Rear Wheels" VALUE 0x800204AF CalPrmWslcBrk_UBYTE 0 Gain 0 255 SYMBOL_LINK "CalPrmWslcBrk01.TP_U8_2nd3rd_Dumpscantime_LMMu_R" 0 /end CHARACTERISTIC
/begin CHARACTERISTIC TP_U8_2nd3rd_Dumpscantime_LMu_F "Time of 2nd and 3rd dump-scan in Low mu, Front Wheels" VALUE 0x800204B4 CalPrmWslcBrk_UBYTE 0 Gain 0 255 SYMBOL_LINK "CalPrmWslcBrk01.TP_U8_2nd3rd_Dumpscantime_LMu_F" 0 /end CHARACTERISTIC
/begin CHARACTERISTIC TP_U8_2nd3rd_Dumpscantime_LMu_R "Time of 2nd and 3rd dump-scan in Low mu, Rear Wheels" VALUE 0x800204BA CalPrmWslcBrk_UBYTE 0 Gain 0 255 SYMBOL_LINK "CalPrmWslcBrk01.TP_U8_2nd3rd_Dumpscantime_LMu_R" 0 /end CHARACTERISTIC
/begin CHARACTERISTIC TP_U8_4th5th_Dumpscantime_LMMu_R "Time of 4th and 5th dump-scan in Low~Under-Low-Medium mu, Rear Wheels" VALUE 0x800204B0 CalPrmWslcBrk_UBYTE 0 Gain 0 255 SYMBOL_LINK "CalPrmWslcBrk01.TP_U8_4th5th_Dumpscantime_LMMu_R" 0 /end CHARACTERISTIC
/begin CHARACTERISTIC TP_U8_4th5th_Dumpscantime_LMu_F "Time of 4th and 5th dump-scan in Low mu, Front Wheels" VALUE 0x800204B5 CalPrmWslcBrk_UBYTE 0 Gain 0 255 SYMBOL_LINK "CalPrmWslcBrk01.TP_U8_4th5th_Dumpscantime_LMu_F" 0 /end CHARACTERISTIC
/begin CHARACTERISTIC TP_U8_4th5th_Dumpscantime_LMu_R "Time of 4th and 5th dump-scan in Low mu, Rear Wheels" VALUE 0x800204BB CalPrmWslcBrk_UBYTE 0 Gain 0 255 SYMBOL_LINK "CalPrmWslcBrk01.TP_U8_4th5th_Dumpscantime_LMu_R" 0 /end CHARACTERISTIC
/begin CHARACTERISTIC TP_U8_CBC_AX_MPRES_FACTOR "Estimated mpress multiply Ax and this parameter together, default 12" VALUE 0x8002070E CalPrmWslcBrk_UBYTE 0 Gain 0 255 SYMBOL_LINK "CalPrmWslcBrk01.TP_U8_CBC_AX_MPRES_FACTOR" 0 /end CHARACTERISTIC
/begin CHARACTERISTIC TP_U8_CBC_AY_EST_GAIN_SPD_H "Gain multiplied to estimated Ay by wheel speed difference at high speed range" VALUE 0x8002071A CalPrmWslcBrk_UBYTE 0 Perc6 0 255 SYMBOL_LINK "CalPrmWslcBrk01.TP_U8_CBC_AY_EST_GAIN_SPD_H" 0 /end CHARACTERISTIC
/begin CHARACTERISTIC TP_U8_CBC_AY_EST_GAIN_SPD_M "Gain multiplied to estimated Ay by wheel speed difference at middle speed range" VALUE 0x8002071B CalPrmWslcBrk_UBYTE 0 Perc6 0 255 SYMBOL_LINK "CalPrmWslcBrk01.TP_U8_CBC_AY_EST_GAIN_SPD_M" 0 /end CHARACTERISTIC
/begin CHARACTERISTIC TP_U8_CBC_AY_EST_GAIN_SPD_S "Gain multiplied to estimated Ay by wheel speed difference at low speed range" VALUE 0x8002071C CalPrmWslcBrk_UBYTE 0 Perc6 0 255 SYMBOL_LINK "CalPrmWslcBrk01.TP_U8_CBC_AY_EST_GAIN_SPD_S" 0 /end CHARACTERISTIC
/begin CHARACTERISTIC TP_U8_CBC_PRESS_EST_FRONT_DUMP_GAIN "Dump rate gain for estimation of front wheel pressure" VALUE 0x8002070F CalPrmWslcBrk_UBYTE 0 Gain 0 255 SYMBOL_LINK "CalPrmWslcBrk01.TP_U8_CBC_PRESS_EST_FRONT_DUMP_GAIN" 0 /end CHARACTERISTIC
/begin CHARACTERISTIC TP_U8_CBC_PRESS_EST_FRONT_RISE_GAIN "Rise rate gain for estimation of front wheel pressure" VALUE 0x80020710 CalPrmWslcBrk_UBYTE 0 Gain 0 255 SYMBOL_LINK "CalPrmWslcBrk01.TP_U8_CBC_PRESS_EST_FRONT_RISE_GAIN" 0 /end CHARACTERISTIC
/begin CHARACTERISTIC TP_U8_CBC_PRESS_EST_REAR_DUMP_GAIN "Dump rate gain for estimation of rear wheel pressure" VALUE 0x80020711 CalPrmWslcBrk_UBYTE 0 Gain 0 255 SYMBOL_LINK "CalPrmWslcBrk01.TP_U8_CBC_PRESS_EST_REAR_DUMP_GAIN" 0 /end CHARACTERISTIC
/begin CHARACTERISTIC TP_U8_CBC_PRESS_EST_REAR_RISE_GAIN "Rise rate gain for estimation of rear wheel pressure" VALUE 0x80020712 CalPrmWslcBrk_UBYTE 0 Gain 0 255 SYMBOL_LINK "CalPrmWslcBrk01.TP_U8_CBC_PRESS_EST_REAR_RISE_GAIN" 0 /end CHARACTERISTIC
/begin CHARACTERISTIC TP_U8_DUTY_DIFF_FOR_FORCED_HOLD "Min. duty for Stable forced hold entrance by Big rise detection" VALUE 0x80020610 CalPrmWslcBrk_UBYTE 0 Gain 0 255 SYMBOL_LINK "CalPrmWslcBrk01.TP_U8_DUTY_DIFF_FOR_FORCED_HOLD" 0 /end CHARACTERISTIC
/begin CHARACTERISTIC TP_U8_GMA_LFC_INIT_DUTY "GMA LFC Initial Duty" VALUE 0x800202AB CalPrmWslcBrk_UBYTE 0 Gain 0 255 SYMBOL_LINK "CalPrmWslcBrk01.TP_U8_GMA_LFC_INIT_DUTY" 0 /end CHARACTERISTIC
/begin CHARACTERISTIC TP_U8_GMA_LFC_MP_COMP_DUTY "GMA LFC MP compensation duty" VALUE 0x800202AC CalPrmWslcBrk_UBYTE 0 P34 0 25.5 SYMBOL_LINK "CalPrmWslcBrk01.TP_U8_GMA_LFC_MP_COMP_DUTY" 0 /end CHARACTERISTIC
/begin CHARACTERISTIC TP_U8_GMA_LFC_PULSE_UP_TIME "GMA LFC pressure recovery time" VALUE 0x800202AD CalPrmWslcBrk_UBYTE 0 Gain 0 255 SYMBOL_LINK "CalPrmWslcBrk01.TP_U8_GMA_LFC_PULSE_UP_TIME" 0 /end CHARACTERISTIC
/begin CHARACTERISTIC TP_U8_IN_GEAR_Vib_Acc_to_Dec_time "Time, Peak acceleration to Peak deceleration, In gear vibration detection" VALUE 0x800202E1 CalPrmWslcBrk_UBYTE 0 Gain 0 255 SYMBOL_LINK "CalPrmWslcBrk01.TP_U8_IN_GEAR_Vib_Acc_to_Dec_time" 0 /end CHARACTERISTIC
/begin CHARACTERISTIC TP_U8_IN_GEAR_detect_Dec_Hump_cnt "Minimum hump counter for In gear vibration detection" VALUE 0x800202DF CalPrmWslcBrk_UBYTE 0 Gain 0 255 SYMBOL_LINK "CalPrmWslcBrk01.TP_U8_IN_GEAR_detect_Dec_Hump_cnt" 0 /end CHARACTERISTIC
/begin CHARACTERISTIC TP_U8_IN_GEAR_detect_Vib_cnt "Minimum in gear vibration counter for In gear vibration detection" VALUE 0x800202E0 CalPrmWslcBrk_UBYTE 0 Gain 0 255 SYMBOL_LINK "CalPrmWslcBrk01.TP_U8_IN_GEAR_detect_Vib_cnt" 0 /end CHARACTERISTIC
/begin CHARACTERISTIC TP_U8_IN_GEAR_detect_cycle "Minimum LFC cycle counter for In gear vibration detection" VALUE 0x800202DE CalPrmWslcBrk_UBYTE 0 Gain 0 255 SYMBOL_LINK "CalPrmWslcBrk01.TP_U8_IN_GEAR_detect_cycle" 0 /end CHARACTERISTIC
/begin CHARACTERISTIC TP_U8_LFC_L2H_Comp_F "Compensation Duty for Low-to-High mu, Front Wheels" VALUE 0x800202D7 CalPrmWslcBrk_UBYTE 0 Gain 0 255 SYMBOL_LINK "CalPrmWslcBrk01.TP_U8_LFC_L2H_Comp_F" 0 /end CHARACTERISTIC
/begin CHARACTERISTIC TP_U8_LFC_L2H_Comp_R "Compensation Duty for Low-to-High mu, Rear Wheels" VALUE 0x800202D8 CalPrmWslcBrk_UBYTE 0 Gain 0 255 SYMBOL_LINK "CalPrmWslcBrk01.TP_U8_LFC_L2H_Comp_R" 0 /end CHARACTERISTIC
/begin CHARACTERISTIC TP_U8_LFC_L2H_Suspect_Comp_F "Compensation Duty for Low-to-High suspect, Front Wheels" VALUE 0x800202D9 CalPrmWslcBrk_UBYTE 0 Gain 0 255 SYMBOL_LINK "CalPrmWslcBrk01.TP_U8_LFC_L2H_Suspect_Comp_F" 0 /end CHARACTERISTIC
/begin CHARACTERISTIC TP_U8_LFC_L2H_Suspect_Comp_R "Compensation Duty for Low-to-High suspect, Rear Wheels" VALUE 0x800202DA CalPrmWslcBrk_UBYTE 0 Gain 0 255 SYMBOL_LINK "CalPrmWslcBrk01.TP_U8_LFC_L2H_Suspect_Comp_R" 0 /end CHARACTERISTIC
/begin CHARACTERISTIC TP_U8_MAXIMUM_dP_RISESCAN_F "Maximum unstable-rise scans allowed, Front Wheels" VALUE 0x80020491 CalPrmWslcBrk_UBYTE 0 Gain 0 255 SYMBOL_LINK "CalPrmWslcBrk01.TP_U8_MAXIMUM_dP_RISESCAN_F" 0 /end CHARACTERISTIC
/begin CHARACTERISTIC TP_U8_MAXIMUM_dP_RISESCAN_R "Maximum unstable-rise scans allowed, Rear Wheels" VALUE 0x80020492 CalPrmWslcBrk_UBYTE 0 Gain 0 255 SYMBOL_LINK "CalPrmWslcBrk01.TP_U8_MAXIMUM_dP_RISESCAN_R" 0 /end CHARACTERISTIC
/begin CHARACTERISTIC TP_U8_MINIMUM_dP_RISESCAN_F "Minimum rise-scans required for Unstable-rise mode, Front Wheels" VALUE 0x80020493 CalPrmWslcBrk_UBYTE 0 Gain 0 255 SYMBOL_LINK "CalPrmWslcBrk01.TP_U8_MINIMUM_dP_RISESCAN_F" 0 /end CHARACTERISTIC
/begin CHARACTERISTIC TP_U8_MINIMUM_dP_RISESCAN_R "Minimum rise-scans required for Unstable-rise mode, Rear Wheels" VALUE 0x80020494 CalPrmWslcBrk_UBYTE 0 Gain 0 255 SYMBOL_LINK "CalPrmWslcBrk01.TP_U8_MINIMUM_dP_RISESCAN_R" 0 /end CHARACTERISTIC
/begin CHARACTERISTIC TP_U8_MIN_dP_RISE_AT_LOW_MP_F "Minimum rise-scans required for Unstable-rise mode, Slight braking, Front Wheels" VALUE 0x80020497 CalPrmWslcBrk_UBYTE 0 Gain 0 255 SYMBOL_LINK "CalPrmWslcBrk01.TP_U8_MIN_dP_RISE_AT_LOW_MP_F" 0 /end CHARACTERISTIC
/begin CHARACTERISTIC TP_U8_MIN_dP_RISE_AT_LOW_MP_R "Minimum rise-scans required for Unstable-rise mode, Slight braking, Rear Wheels" VALUE 0x80020498 CalPrmWslcBrk_UBYTE 0 Gain 0 255 SYMBOL_LINK "CalPrmWslcBrk01.TP_U8_MIN_dP_RISE_AT_LOW_MP_R" 0 /end CHARACTERISTIC
/begin CHARACTERISTIC TP_U8_MIN_dP_RISE_Bw_15kph_F "Minimum rise-scans required for Unstable-rise at Low Speed (Below 15kph), Front Wheels" VALUE 0x80020495 CalPrmWslcBrk_UBYTE 0 Gain 0 255 SYMBOL_LINK "CalPrmWslcBrk01.TP_U8_MIN_dP_RISE_Bw_15kph_F" 0 /end CHARACTERISTIC
/begin CHARACTERISTIC TP_U8_MIN_dP_RISE_Bw_15kph_R "Minimum rise-scans required for Unstable-rise at Low Speed (Below 15kph), Rear Wheels" VALUE 0x80020496 CalPrmWslcBrk_UBYTE 0 Gain 0 255 SYMBOL_LINK "CalPrmWslcBrk01.TP_U8_MIN_dP_RISE_Bw_15kph_R" 0 /end CHARACTERISTIC
/begin CHARACTERISTIC TP_U8_UnstableTim_for_IncDumptime "For Low-mu surfaces. If unstable time of the last cycle is bigger than this parameter, dump scantime is increased." VALUE 0x800204B7 CalPrmWslcBrk_UBYTE 0 Gain 0 255 SYMBOL_LINK "CalPrmWslcBrk01.TP_U8_UnstableTim_for_IncDumptime" 0 /end CHARACTERISTIC
/begin CHARACTERISTIC TP_U8_nth_Dumpscantime_LMMu_R "Time of nth dump-scan in Low-med mu, Rear Wheels" VALUE 0x800204B1 CalPrmWslcBrk_UBYTE 0 Gain 0 255 SYMBOL_LINK "CalPrmWslcBrk01.TP_U8_nth_Dumpscantime_LMMu_R" 0 /end CHARACTERISTIC
/begin CHARACTERISTIC TP_U8_nth_Dumpscantime_LMu_F "Time of nth dump-scan in Low mu, Front Wheels" VALUE 0x800204B6 CalPrmWslcBrk_UBYTE 0 Gain 0 255 SYMBOL_LINK "CalPrmWslcBrk01.TP_U8_nth_Dumpscantime_LMu_F" 0 /end CHARACTERISTIC
/begin CHARACTERISTIC TP_U8_nth_Dumpscantime_LMu_R "Time of nth dump-scan in Low mu, Rear Wheels" VALUE 0x800204BC CalPrmWslcBrk_UBYTE 0 Gain 0 255 SYMBOL_LINK "CalPrmWslcBrk01.TP_U8_nth_Dumpscantime_LMu_R" 0 /end CHARACTERISTIC
/begin CHARACTERISTIC TQMuSlipCurve_Alpha_HM_MAX "" VALUE 0x8002097C CalPrmLatDynsCoorrBrk_SWORD 0 Gain -32768 32767 SYMBOL_LINK "CalPrmLatDynsCoorrBrk01.TQMuSlipCurve_Alpha_HM_MAX" 0 /end CHARACTERISTIC
/begin CHARACTERISTIC TQMuSlipCurve_Alpha_HM_MIN "" VALUE 0x8002097A CalPrmLatDynsCoorrBrk_SWORD 0 Gain -32768 32767 SYMBOL_LINK "CalPrmLatDynsCoorrBrk01.TQMuSlipCurve_Alpha_HM_MIN" 0 /end CHARACTERISTIC
/begin CHARACTERISTIC TQMuSlipCurve_Alpha_LM_MAX "" VALUE 0x800209AC CalPrmLatDynsCoorrBrk_SWORD 0 Gain -32768 32767 SYMBOL_LINK "CalPrmLatDynsCoorrBrk01.TQMuSlipCurve_Alpha_LM_MAX" 0 /end CHARACTERISTIC
/begin CHARACTERISTIC TQMuSlipCurve_Alpha_LM_MIN "" VALUE 0x800209AA CalPrmLatDynsCoorrBrk_SWORD 0 Gain -32768 32767 SYMBOL_LINK "CalPrmLatDynsCoorrBrk01.TQMuSlipCurve_Alpha_LM_MIN" 0 /end CHARACTERISTIC
/begin CHARACTERISTIC TQMuSlipCurve_Alpha_MM_MAX "" VALUE 0x80020994 CalPrmLatDynsCoorrBrk_SWORD 0 Gain -32768 32767 SYMBOL_LINK "CalPrmLatDynsCoorrBrk01.TQMuSlipCurve_Alpha_MM_MAX" 0 /end CHARACTERISTIC
/begin CHARACTERISTIC TQMuSlipCurve_Alpha_MM_MIN "" VALUE 0x80020992 CalPrmLatDynsCoorrBrk_SWORD 0 Gain -32768 32767 SYMBOL_LINK "CalPrmLatDynsCoorrBrk01.TQMuSlipCurve_Alpha_MM_MIN" 0 /end CHARACTERISTIC
/begin CHARACTERISTIC TQMuSlipCurve_FRICT_H_11 "" VALUE 0x8002097E CalPrmLatDynsCoorrBrk_SWORD 0 Gain -32768 32767 SYMBOL_LINK "CalPrmLatDynsCoorrBrk01.TQMuSlipCurve_FRICT_H_11" 0 /end CHARACTERISTIC
/begin CHARACTERISTIC TQMuSlipCurve_FRICT_H_12 "" VALUE 0x80020980 CalPrmLatDynsCoorrBrk_SWORD 0 Gain -32768 32767 SYMBOL_LINK "CalPrmLatDynsCoorrBrk01.TQMuSlipCurve_FRICT_H_12" 0 /end CHARACTERISTIC
/begin CHARACTERISTIC TQMuSlipCurve_FRICT_H_13 "" VALUE 0x80020982 CalPrmLatDynsCoorrBrk_SWORD 0 Gain -32768 32767 SYMBOL_LINK "CalPrmLatDynsCoorrBrk01.TQMuSlipCurve_FRICT_H_13" 0 /end CHARACTERISTIC
/begin CHARACTERISTIC TQMuSlipCurve_FRICT_H_14 "" VALUE 0x80020984 CalPrmLatDynsCoorrBrk_SWORD 0 Gain -32768 32767 SYMBOL_LINK "CalPrmLatDynsCoorrBrk01.TQMuSlipCurve_FRICT_H_14" 0 /end CHARACTERISTIC
/begin CHARACTERISTIC TQMuSlipCurve_FRICT_H_15 "" VALUE 0x80020986 CalPrmLatDynsCoorrBrk_SWORD 0 Gain -32768 32767 SYMBOL_LINK "CalPrmLatDynsCoorrBrk01.TQMuSlipCurve_FRICT_H_15" 0 /end CHARACTERISTIC
/begin CHARACTERISTIC TQMuSlipCurve_FRICT_H_21 "" VALUE 0x80020988 CalPrmLatDynsCoorrBrk_SWORD 0 Gain -32768 32767 SYMBOL_LINK "CalPrmLatDynsCoorrBrk01.TQMuSlipCurve_FRICT_H_21" 0 /end CHARACTERISTIC
/begin CHARACTERISTIC TQMuSlipCurve_FRICT_H_22 "" VALUE 0x8002098A CalPrmLatDynsCoorrBrk_SWORD 0 Gain -32768 32767 SYMBOL_LINK "CalPrmLatDynsCoorrBrk01.TQMuSlipCurve_FRICT_H_22" 0 /end CHARACTERISTIC
/begin CHARACTERISTIC TQMuSlipCurve_FRICT_H_23 "" VALUE 0x8002098C CalPrmLatDynsCoorrBrk_SWORD 0 Gain -32768 32767 SYMBOL_LINK "CalPrmLatDynsCoorrBrk01.TQMuSlipCurve_FRICT_H_23" 0 /end CHARACTERISTIC
/begin CHARACTERISTIC TQMuSlipCurve_FRICT_H_24 "" VALUE 0x8002098E CalPrmLatDynsCoorrBrk_SWORD 0 Gain -32768 32767 SYMBOL_LINK "CalPrmLatDynsCoorrBrk01.TQMuSlipCurve_FRICT_H_24" 0 /end CHARACTERISTIC
/begin CHARACTERISTIC TQMuSlipCurve_FRICT_H_25 "" VALUE 0x80020990 CalPrmLatDynsCoorrBrk_SWORD 0 Gain -32768 32767 SYMBOL_LINK "CalPrmLatDynsCoorrBrk01.TQMuSlipCurve_FRICT_H_25" 0 /end CHARACTERISTIC
/begin CHARACTERISTIC TQMuSlipCurve_FRICT_L_11 "" VALUE 0x800209AE CalPrmLatDynsCoorrBrk_SWORD 0 Gain -32768 32767 SYMBOL_LINK "CalPrmLatDynsCoorrBrk01.TQMuSlipCurve_FRICT_L_11" 0 /end CHARACTERISTIC
/begin CHARACTERISTIC TQMuSlipCurve_FRICT_L_12 "" VALUE 0x800209B0 CalPrmLatDynsCoorrBrk_SWORD 0 Gain -32768 32767 SYMBOL_LINK "CalPrmLatDynsCoorrBrk01.TQMuSlipCurve_FRICT_L_12" 0 /end CHARACTERISTIC
/begin CHARACTERISTIC TQMuSlipCurve_FRICT_L_13 "" VALUE 0x800209B2 CalPrmLatDynsCoorrBrk_SWORD 0 Gain -32768 32767 SYMBOL_LINK "CalPrmLatDynsCoorrBrk01.TQMuSlipCurve_FRICT_L_13" 0 /end CHARACTERISTIC
/begin CHARACTERISTIC TQMuSlipCurve_FRICT_L_14 "" VALUE 0x800209B4 CalPrmLatDynsCoorrBrk_SWORD 0 Gain -32768 32767 SYMBOL_LINK "CalPrmLatDynsCoorrBrk01.TQMuSlipCurve_FRICT_L_14" 0 /end CHARACTERISTIC
/begin CHARACTERISTIC TQMuSlipCurve_FRICT_L_15 "" VALUE 0x800209B6 CalPrmLatDynsCoorrBrk_SWORD 0 Gain -32768 32767 SYMBOL_LINK "CalPrmLatDynsCoorrBrk01.TQMuSlipCurve_FRICT_L_15" 0 /end CHARACTERISTIC
/begin CHARACTERISTIC TQMuSlipCurve_FRICT_L_21 "" VALUE 0x800209B8 CalPrmLatDynsCoorrBrk_SWORD 0 Gain -32768 32767 SYMBOL_LINK "CalPrmLatDynsCoorrBrk01.TQMuSlipCurve_FRICT_L_21" 0 /end CHARACTERISTIC
/begin CHARACTERISTIC TQMuSlipCurve_FRICT_L_22 "" VALUE 0x800209BA CalPrmLatDynsCoorrBrk_SWORD 0 Gain -32768 32767 SYMBOL_LINK "CalPrmLatDynsCoorrBrk01.TQMuSlipCurve_FRICT_L_22" 0 /end CHARACTERISTIC
/begin CHARACTERISTIC TQMuSlipCurve_FRICT_L_23 "" VALUE 0x800209BC CalPrmLatDynsCoorrBrk_SWORD 0 Gain -32768 32767 SYMBOL_LINK "CalPrmLatDynsCoorrBrk01.TQMuSlipCurve_FRICT_L_23" 0 /end CHARACTERISTIC
/begin CHARACTERISTIC TQMuSlipCurve_FRICT_L_24 "" VALUE 0x800209BE CalPrmLatDynsCoorrBrk_SWORD 0 Gain -32768 32767 SYMBOL_LINK "CalPrmLatDynsCoorrBrk01.TQMuSlipCurve_FRICT_L_24" 0 /end CHARACTERISTIC
/begin CHARACTERISTIC TQMuSlipCurve_FRICT_L_25 "" VALUE 0x800209C0 CalPrmLatDynsCoorrBrk_SWORD 0 Gain -32768 32767 SYMBOL_LINK "CalPrmLatDynsCoorrBrk01.TQMuSlipCurve_FRICT_L_25" 0 /end CHARACTERISTIC
/begin CHARACTERISTIC TQMuSlipCurve_FRICT_M_11 "" VALUE 0x80020996 CalPrmLatDynsCoorrBrk_SWORD 0 Gain -32768 32767 SYMBOL_LINK "CalPrmLatDynsCoorrBrk01.TQMuSlipCurve_FRICT_M_11" 0 /end CHARACTERISTIC
/begin CHARACTERISTIC TQMuSlipCurve_FRICT_M_12 "" VALUE 0x80020998 CalPrmLatDynsCoorrBrk_SWORD 0 Gain -32768 32767 SYMBOL_LINK "CalPrmLatDynsCoorrBrk01.TQMuSlipCurve_FRICT_M_12" 0 /end CHARACTERISTIC
/begin CHARACTERISTIC TQMuSlipCurve_FRICT_M_13 "" VALUE 0x8002099A CalPrmLatDynsCoorrBrk_SWORD 0 Gain -32768 32767 SYMBOL_LINK "CalPrmLatDynsCoorrBrk01.TQMuSlipCurve_FRICT_M_13" 0 /end CHARACTERISTIC
/begin CHARACTERISTIC TQMuSlipCurve_FRICT_M_14 "" VALUE 0x8002099C CalPrmLatDynsCoorrBrk_SWORD 0 Gain -32768 32767 SYMBOL_LINK "CalPrmLatDynsCoorrBrk01.TQMuSlipCurve_FRICT_M_14" 0 /end CHARACTERISTIC
/begin CHARACTERISTIC TQMuSlipCurve_FRICT_M_15 "" VALUE 0x8002099E CalPrmLatDynsCoorrBrk_SWORD 0 Gain -32768 32767 SYMBOL_LINK "CalPrmLatDynsCoorrBrk01.TQMuSlipCurve_FRICT_M_15" 0 /end CHARACTERISTIC
/begin CHARACTERISTIC TQMuSlipCurve_FRICT_M_21 "" VALUE 0x800209A0 CalPrmLatDynsCoorrBrk_SWORD 0 Gain -32768 32767 SYMBOL_LINK "CalPrmLatDynsCoorrBrk01.TQMuSlipCurve_FRICT_M_21" 0 /end CHARACTERISTIC
/begin CHARACTERISTIC TQMuSlipCurve_FRICT_M_22 "" VALUE 0x800209A2 CalPrmLatDynsCoorrBrk_SWORD 0 Gain -32768 32767 SYMBOL_LINK "CalPrmLatDynsCoorrBrk01.TQMuSlipCurve_FRICT_M_22" 0 /end CHARACTERISTIC
/begin CHARACTERISTIC TQMuSlipCurve_FRICT_M_23 "" VALUE 0x800209A4 CalPrmLatDynsCoorrBrk_SWORD 0 Gain -32768 32767 SYMBOL_LINK "CalPrmLatDynsCoorrBrk01.TQMuSlipCurve_FRICT_M_23" 0 /end CHARACTERISTIC
/begin CHARACTERISTIC TQMuSlipCurve_FRICT_M_24 "" VALUE 0x800209A6 CalPrmLatDynsCoorrBrk_SWORD 0 Gain -32768 32767 SYMBOL_LINK "CalPrmLatDynsCoorrBrk01.TQMuSlipCurve_FRICT_M_24" 0 /end CHARACTERISTIC
/begin CHARACTERISTIC TQMuSlipCurve_FRICT_M_25 "" VALUE 0x800209A8 CalPrmLatDynsCoorrBrk_SWORD 0 Gain -32768 32767 SYMBOL_LINK "CalPrmLatDynsCoorrBrk01.TQMuSlipCurve_FRICT_M_25" 0 /end CHARACTERISTIC
/begin CHARACTERISTIC TQMuSlipCurve_Slip_1 "" VALUE 0x80020970 CalPrmLatDynsCoorrBrk_SWORD 0 Gain -32768 32767 SYMBOL_LINK "CalPrmLatDynsCoorrBrk01.TQMuSlipCurve_Slip_1" 0 /end CHARACTERISTIC
/begin CHARACTERISTIC TQMuSlipCurve_Slip_2 "" VALUE 0x80020972 CalPrmLatDynsCoorrBrk_SWORD 0 Gain -32768 32767 SYMBOL_LINK "CalPrmLatDynsCoorrBrk01.TQMuSlipCurve_Slip_2" 0 /end CHARACTERISTIC
/begin CHARACTERISTIC TQMuSlipCurve_Slip_3 "" VALUE 0x80020974 CalPrmLatDynsCoorrBrk_SWORD 0 Gain -32768 32767 SYMBOL_LINK "CalPrmLatDynsCoorrBrk01.TQMuSlipCurve_Slip_3" 0 /end CHARACTERISTIC
/begin CHARACTERISTIC TQMuSlipCurve_Slip_4 "" VALUE 0x80020976 CalPrmLatDynsCoorrBrk_SWORD 0 Gain -32768 32767 SYMBOL_LINK "CalPrmLatDynsCoorrBrk01.TQMuSlipCurve_Slip_4" 0 /end CHARACTERISTIC
/begin CHARACTERISTIC TQMuSlipCurve_Slip_5 "" VALUE 0x80020978 CalPrmLatDynsCoorrBrk_SWORD 0 Gain -32768 32767 SYMBOL_LINK "CalPrmLatDynsCoorrBrk01.TQMuSlipCurve_Slip_5" 0 /end CHARACTERISTIC
/begin CHARACTERISTIC TQS16_BANK_THRES_ADD_ALAT_COND_OF_LOW_SUS "" VALUE 0x800209D6 CalPrmLatDynsCoorrBrk_SWORD 0 Gain -32768 32767 SYMBOL_LINK "CalPrmLatDynsCoorrBrk01.TQS16_BANK_THRES_ADD_ALAT_COND_OF_LOW_SUS" 0 /end CHARACTERISTIC
/begin CHARACTERISTIC TQS16_BANK_THRES_ADD_VREF_COND_OF_LOW_SUS "" VALUE 0x800209D8 CalPrmLatDynsCoorrBrk_SWORD 0 Gain -32768 32767 SYMBOL_LINK "CalPrmLatDynsCoorrBrk01.TQS16_BANK_THRES_ADD_VREF_COND_OF_LOW_SUS" 0 /end CHARACTERISTIC
/begin CHARACTERISTIC TQS16_BRK_LMT_Ax_EST_1ST "" VALUE 0x80020B00 CalPrmLatDynsCoorrBrk_SWORD 0 Gain -32768 32767 SYMBOL_LINK "CalPrmLatDynsCoorrBrk01.TQS16_BRK_LMT_Ax_EST_1ST" 0 /end CHARACTERISTIC
/begin CHARACTERISTIC TQS16_BRK_LMT_Ax_EST_2ND "" VALUE 0x80020B02 CalPrmLatDynsCoorrBrk_SWORD 0 Gain -32768 32767 SYMBOL_LINK "CalPrmLatDynsCoorrBrk01.TQS16_BRK_LMT_Ax_EST_2ND" 0 /end CHARACTERISTIC
/begin CHARACTERISTIC TQS16_BRK_LMT_Ax_EST_3RD "" VALUE 0x80020B04 CalPrmLatDynsCoorrBrk_SWORD 0 Gain -32768 32767 SYMBOL_LINK "CalPrmLatDynsCoorrBrk01.TQS16_BRK_LMT_Ax_EST_3RD" 0 /end CHARACTERISTIC
/begin CHARACTERISTIC TQS16_BRK_LMT_Ax_EST_4TH "" VALUE 0x80020B06 CalPrmLatDynsCoorrBrk_SWORD 0 Gain -32768 32767 SYMBOL_LINK "CalPrmLatDynsCoorrBrk01.TQS16_BRK_LMT_Ax_EST_4TH" 0 /end CHARACTERISTIC
/begin CHARACTERISTIC TQS16_BRK_LMT_Ay_VALUE_1ST "" VALUE 0x80020B08 CalPrmLatDynsCoorrBrk_SWORD 0 Gain -32768 32767 SYMBOL_LINK "CalPrmLatDynsCoorrBrk01.TQS16_BRK_LMT_Ay_VALUE_1ST" 0 /end CHARACTERISTIC
/begin CHARACTERISTIC TQS16_BRK_LMT_Ay_VALUE_2ND "" VALUE 0x80020B0A CalPrmLatDynsCoorrBrk_SWORD 0 Gain -32768 32767 SYMBOL_LINK "CalPrmLatDynsCoorrBrk01.TQS16_BRK_LMT_Ay_VALUE_2ND" 0 /end CHARACTERISTIC
/begin CHARACTERISTIC TQS16_BRK_LMT_Ay_VALUE_3RD "" VALUE 0x80020B0C CalPrmLatDynsCoorrBrk_SWORD 0 Gain -32768 32767 SYMBOL_LINK "CalPrmLatDynsCoorrBrk01.TQS16_BRK_LMT_Ay_VALUE_3RD" 0 /end CHARACTERISTIC
/begin CHARACTERISTIC TQS16_BRK_LMT_Ay_VALUE_4TH "" VALUE 0x80020B0E CalPrmLatDynsCoorrBrk_SWORD 0 Gain -32768 32767 SYMBOL_LINK "CalPrmLatDynsCoorrBrk01.TQS16_BRK_LMT_Ay_VALUE_4TH" 0 /end CHARACTERISTIC
/begin CHARACTERISTIC TQS16_DEL_YAW_THR_SPD_0 "" VALUE 0x800209E0 CalPrmLatDynsCoorrBrk_SWORD 0 Gain -32768 32767 SYMBOL_LINK "CalPrmLatDynsCoorrBrk01.TQS16_DEL_YAW_THR_SPD_0" 0 /end CHARACTERISTIC
/begin CHARACTERISTIC TQS16_DEL_YAW_THR_SPD_HIG "" VALUE 0x800209E6 CalPrmLatDynsCoorrBrk_SWORD 0 Gain -32768 32767 SYMBOL_LINK "CalPrmLatDynsCoorrBrk01.TQS16_DEL_YAW_THR_SPD_HIG" 0 /end CHARACTERISTIC
/begin CHARACTERISTIC TQS16_DEL_YAW_THR_SPD_LOW "" VALUE 0x800209E2 CalPrmLatDynsCoorrBrk_SWORD 0 Gain -32768 32767 SYMBOL_LINK "CalPrmLatDynsCoorrBrk01.TQS16_DEL_YAW_THR_SPD_LOW" 0 /end CHARACTERISTIC
/begin CHARACTERISTIC TQS16_DEL_YAW_THR_SPD_MED "" VALUE 0x800209E4 CalPrmLatDynsCoorrBrk_SWORD 0 Gain -32768 32767 SYMBOL_LINK "CalPrmLatDynsCoorrBrk01.TQS16_DEL_YAW_THR_SPD_MED" 0 /end CHARACTERISTIC
/begin CHARACTERISTIC TQS16_DEL_YAW_THR_WSTR_LARGE_VAL "" VALUE 0x800209EE CalPrmLatDynsCoorrBrk_SWORD 0 Gain -32768 32767 SYMBOL_LINK "CalPrmLatDynsCoorrBrk01.TQS16_DEL_YAW_THR_WSTR_LARGE_VAL" 0 /end CHARACTERISTIC
/begin CHARACTERISTIC TQS16_ESC_SPLIT_ENT_FRT_WHEEL_TH "" VALUE 0x80020B10 CalPrmLatDynsCoorrBrk_SWORD 0 Gain -32768 32767 SYMBOL_LINK "CalPrmLatDynsCoorrBrk01.TQS16_ESC_SPLIT_ENT_FRT_WHEEL_TH" 0 /end CHARACTERISTIC
/begin CHARACTERISTIC TQS16_ESC_SPLIT_ENT_REAR_WHEEL_TH "" VALUE 0x80020B12 CalPrmLatDynsCoorrBrk_SWORD 0 Gain -32768 32767 SYMBOL_LINK "CalPrmLatDynsCoorrBrk01.TQS16_ESC_SPLIT_ENT_REAR_WHEEL_TH" 0 /end CHARACTERISTIC
/begin CHARACTERISTIC TQS16_ESC_SPLIT_EXIT_ALAT_TH "" VALUE 0x80020B14 CalPrmLatDynsCoorrBrk_SWORD 0 Gain -32768 32767 SYMBOL_LINK "CalPrmLatDynsCoorrBrk01.TQS16_ESC_SPLIT_EXIT_ALAT_TH" 0 /end CHARACTERISTIC
/begin CHARACTERISTIC TQS16_ESC_SPLIT_HOMO_DET_DIFF_TH "" VALUE 0x80020B16 CalPrmLatDynsCoorrBrk_SWORD 0 Gain -32768 32767 SYMBOL_LINK "CalPrmLatDynsCoorrBrk01.TQS16_ESC_SPLIT_HOMO_DET_DIFF_TH" 0 /end CHARACTERISTIC
/begin CHARACTERISTIC TQS16_ESC_SPLIT_MU_TRANS_WHEEL_TH "" VALUE 0x80020B18 CalPrmLatDynsCoorrBrk_SWORD 0 Gain -32768 32767 SYMBOL_LINK "CalPrmLatDynsCoorrBrk01.TQS16_ESC_SPLIT_MU_TRANS_WHEEL_TH" 0 /end CHARACTERISTIC
/begin CHARACTERISTIC TQS16_FADE_OUT_THRES_CNT "" VALUE 0x80020828 CalPrmLatDynsCoorrBrk_SWORD 0 Gain -32768 32767 SYMBOL_LINK "CalPrmLatDynsCoorrBrk01.TQS16_FADE_OUT_THRES_CNT" 0 /end CHARACTERISTIC
/begin CHARACTERISTIC TQS16_FADE_OUT_THRES_CNT_REAR "" VALUE 0x80020C62 CalPrmLatDynsCoorrBrk_SWORD 0 Gain -32768 32767 SYMBOL_LINK "CalPrmLatDynsCoorrBrk01.TQS16_FADE_OUT_THRES_CNT_REAR" 0 /end CHARACTERISTIC
/begin CHARACTERISTIC TQS16_FADE_OUT_THRES_TAR_TORQ "" VALUE 0x8002082C CalPrmLatDynsCoorrBrk_SWORD 0 Gain -32768 32767 SYMBOL_LINK "CalPrmLatDynsCoorrBrk01.TQS16_FADE_OUT_THRES_TAR_TORQ" 0 /end CHARACTERISTIC
/begin CHARACTERISTIC TQS16_FADE_OUT_THRES_TAR_TORQ_REAR "" VALUE 0x80020C66 CalPrmLatDynsCoorrBrk_SWORD 0 Gain -32768 32767 SYMBOL_LINK "CalPrmLatDynsCoorrBrk01.TQS16_FADE_OUT_THRES_TAR_TORQ_REAR" 0 /end CHARACTERISTIC
/begin CHARACTERISTIC TQS16_FADE_OUT_THRES_YAW "" VALUE 0x8002082A CalPrmLatDynsCoorrBrk_SWORD 0 Gain -32768 32767 SYMBOL_LINK "CalPrmLatDynsCoorrBrk01.TQS16_FADE_OUT_THRES_YAW" 0 /end CHARACTERISTIC
/begin CHARACTERISTIC TQS16_FADE_OUT_THRES_YAW_REAR "" VALUE 0x80020C64 CalPrmLatDynsCoorrBrk_SWORD 0 Gain -32768 32767 SYMBOL_LINK "CalPrmLatDynsCoorrBrk01.TQS16_FADE_OUT_THRES_YAW_REAR" 0 /end CHARACTERISTIC
/begin CHARACTERISTIC TQS16_FadeOut_DelYaw_H_WEG "" VALUE 0x80020E9C CalPrmLatDynsCoorrBrk_SWORD 0 Gain -32768 32767 SYMBOL_LINK "CalPrmLatDynsCoorrBrk01.TQS16_FadeOut_DelYaw_H_WEG" 0 /end CHARACTERISTIC
/begin CHARACTERISTIC TQS16_FadeOut_DelYaw_L_WEG "" VALUE 0x80020E98 CalPrmLatDynsCoorrBrk_SWORD 0 Gain -32768 32767 SYMBOL_LINK "CalPrmLatDynsCoorrBrk01.TQS16_FadeOut_DelYaw_L_WEG" 0 /end CHARACTERISTIC
/begin CHARACTERISTIC TQS16_FadeOut_DelYaw_M_WEG "" VALUE 0x80020E9A CalPrmLatDynsCoorrBrk_SWORD 0 Gain -32768 32767 SYMBOL_LINK "CalPrmLatDynsCoorrBrk01.TQS16_FadeOut_DelYaw_M_WEG" 0 /end CHARACTERISTIC
/begin CHARACTERISTIC TQS16_FadeOut_DelYaw_Thres_H "" VALUE 0x80020E94 CalPrmLatDynsCoorrBrk_SWORD 0 Gain -32768 32767 SYMBOL_LINK "CalPrmLatDynsCoorrBrk01.TQS16_FadeOut_DelYaw_Thres_H" 0 /end CHARACTERISTIC
/begin CHARACTERISTIC TQS16_FadeOut_DelYaw_Thres_L "" VALUE 0x80020E90 CalPrmLatDynsCoorrBrk_SWORD 0 Gain -32768 32767 SYMBOL_LINK "CalPrmLatDynsCoorrBrk01.TQS16_FadeOut_DelYaw_Thres_L" 0 /end CHARACTERISTIC
/begin CHARACTERISTIC TQS16_FadeOut_DelYaw_Thres_M "" VALUE 0x80020E92 CalPrmLatDynsCoorrBrk_SWORD 0 Gain -32768 32767 SYMBOL_LINK "CalPrmLatDynsCoorrBrk01.TQS16_FadeOut_DelYaw_Thres_M" 0 /end CHARACTERISTIC
/begin CHARACTERISTIC TQS16_FadeOut_DelYaw_Thres_VH "" VALUE 0x80020E96 CalPrmLatDynsCoorrBrk_SWORD 0 Gain -32768 32767 SYMBOL_LINK "CalPrmLatDynsCoorrBrk01.TQS16_FadeOut_DelYaw_Thres_VH" 0 /end CHARACTERISTIC
/begin CHARACTERISTIC TQS16_FadeOut_DelYaw_VH_WEG "" VALUE 0x80020E9E CalPrmLatDynsCoorrBrk_SWORD 0 Gain -32768 32767 SYMBOL_LINK "CalPrmLatDynsCoorrBrk01.TQS16_FadeOut_DelYaw_VH_WEG" 0 /end CHARACTERISTIC
/begin CHARACTERISTIC TQS16_LIMIT_WEIGHT_H "" VALUE 0x80020A86 CalPrmLatDynsCoorrBrk_SWORD 0 Gain -32768 32767 SYMBOL_LINK "CalPrmLatDynsCoorrBrk01.TQS16_LIMIT_WEIGHT_H" 0 /end CHARACTERISTIC
/begin CHARACTERISTIC TQS16_LIMIT_WEIGHT_L "" VALUE 0x80020A9C CalPrmLatDynsCoorrBrk_SWORD 0 Gain -32768 32767 SYMBOL_LINK "CalPrmLatDynsCoorrBrk01.TQS16_LIMIT_WEIGHT_L" 0 /end CHARACTERISTIC
/begin CHARACTERISTIC TQS16_LIMIT_WEIGHT_M "" VALUE 0x80020A88 CalPrmLatDynsCoorrBrk_SWORD 0 Gain -32768 32767 SYMBOL_LINK "CalPrmLatDynsCoorrBrk01.TQS16_LIMIT_WEIGHT_M" 0 /end CHARACTERISTIC
/begin CHARACTERISTIC TQS16_MP_X1 "" VALUE 0x80020E70 CalPrmLatDynsCoorrBrk_SWORD 0 Gain -32768 32767 SYMBOL_LINK "CalPrmLatDynsCoorrBrk01.TQS16_MP_X1" 0 /end CHARACTERISTIC
/begin CHARACTERISTIC TQS16_MP_X2 "" VALUE 0x80020E72 CalPrmLatDynsCoorrBrk_SWORD 0 Gain -32768 32767 SYMBOL_LINK "CalPrmLatDynsCoorrBrk01.TQS16_MP_X2" 0 /end CHARACTERISTIC
/begin CHARACTERISTIC TQS16_MP_X3 "" VALUE 0x80020E74 CalPrmLatDynsCoorrBrk_SWORD 0 Gain -32768 32767 SYMBOL_LINK "CalPrmLatDynsCoorrBrk01.TQS16_MP_X3" 0 /end CHARACTERISTIC
/begin CHARACTERISTIC TQS16_MP_X4 "" VALUE 0x80020E76 CalPrmLatDynsCoorrBrk_SWORD 0 Gain -32768 32767 SYMBOL_LINK "CalPrmLatDynsCoorrBrk01.TQS16_MP_X4" 0 /end CHARACTERISTIC
/begin CHARACTERISTIC TQS16_REAR_FadeOut_TorqDec_HM "" VALUE 0x80020C6C CalPrmLatDynsCoorrBrk_SWORD 0 Gain -32768 32767 SYMBOL_LINK "CalPrmLatDynsCoorrBrk01.TQS16_REAR_FadeOut_TorqDec_HM" 0 /end CHARACTERISTIC
/begin CHARACTERISTIC TQS16_REAR_FadeOut_TorqDec_LM "" VALUE 0x80020C68 CalPrmLatDynsCoorrBrk_SWORD 0 Gain -32768 32767 SYMBOL_LINK "CalPrmLatDynsCoorrBrk01.TQS16_REAR_FadeOut_TorqDec_LM" 0 /end CHARACTERISTIC
/begin CHARACTERISTIC TQS16_REAR_FadeOut_TorqDec_MM "" VALUE 0x80020C6A CalPrmLatDynsCoorrBrk_SWORD 0 Gain -32768 32767 SYMBOL_LINK "CalPrmLatDynsCoorrBrk01.TQS16_REAR_FadeOut_TorqDec_MM" 0 /end CHARACTERISTIC
/begin CHARACTERISTIC TQS16_SPEED_THR_HIG "" VALUE 0x800209DE CalPrmLatDynsCoorrBrk_SWORD 0 Gain -32768 32767 SYMBOL_LINK "CalPrmLatDynsCoorrBrk01.TQS16_SPEED_THR_HIG" 0 /end CHARACTERISTIC
/begin CHARACTERISTIC TQS16_SPEED_THR_LOW "" VALUE 0x800209DA CalPrmLatDynsCoorrBrk_SWORD 0 Gain -32768 32767 SYMBOL_LINK "CalPrmLatDynsCoorrBrk01.TQS16_SPEED_THR_LOW" 0 /end CHARACTERISTIC
/begin CHARACTERISTIC TQS16_SPEED_THR_MED "" VALUE 0x800209DC CalPrmLatDynsCoorrBrk_SWORD 0 Gain -32768 32767 SYMBOL_LINK "CalPrmLatDynsCoorrBrk01.TQS16_SPEED_THR_MED" 0 /end CHARACTERISTIC
/begin CHARACTERISTIC TQS16_TORQ_BASE_ADD_HMU "" VALUE 0x80020CA6 CalPrmLatDynsCoorrBrk_SWORD 0 Gain -32768 32767 SYMBOL_LINK "CalPrmLatDynsCoorrBrk01.TQS16_TORQ_BASE_ADD_HMU" 0 /end CHARACTERISTIC
/begin CHARACTERISTIC TQS16_TORQ_BASE_ADD_HMU_MP_X1 "" VALUE 0x80020E88 CalPrmLatDynsCoorrBrk_SWORD 0 Gain -32768 32767 SYMBOL_LINK "CalPrmLatDynsCoorrBrk01.TQS16_TORQ_BASE_ADD_HMU_MP_X1" 0 /end CHARACTERISTIC
/begin CHARACTERISTIC TQS16_TORQ_BASE_ADD_HMU_MP_X2 "" VALUE 0x80020E8A CalPrmLatDynsCoorrBrk_SWORD 0 Gain -32768 32767 SYMBOL_LINK "CalPrmLatDynsCoorrBrk01.TQS16_TORQ_BASE_ADD_HMU_MP_X2" 0 /end CHARACTERISTIC
/begin CHARACTERISTIC TQS16_TORQ_BASE_ADD_HMU_MP_X3 "" VALUE 0x80020E8C CalPrmLatDynsCoorrBrk_SWORD 0 Gain -32768 32767 SYMBOL_LINK "CalPrmLatDynsCoorrBrk01.TQS16_TORQ_BASE_ADD_HMU_MP_X3" 0 /end CHARACTERISTIC
/begin CHARACTERISTIC TQS16_TORQ_BASE_ADD_HMU_MP_X4 "" VALUE 0x80020E8E CalPrmLatDynsCoorrBrk_SWORD 0 Gain -32768 32767 SYMBOL_LINK "CalPrmLatDynsCoorrBrk01.TQS16_TORQ_BASE_ADD_HMU_MP_X4" 0 /end CHARACTERISTIC
/begin CHARACTERISTIC TQS16_TORQ_BASE_ADD_LMU "" VALUE 0x80020CA2 CalPrmLatDynsCoorrBrk_SWORD 0 Gain -32768 32767 SYMBOL_LINK "CalPrmLatDynsCoorrBrk01.TQS16_TORQ_BASE_ADD_LMU" 0 /end CHARACTERISTIC
/begin CHARACTERISTIC TQS16_TORQ_BASE_ADD_LMU_MP_X1 "" VALUE 0x80020E78 CalPrmLatDynsCoorrBrk_SWORD 0 Gain -32768 32767 SYMBOL_LINK "CalPrmLatDynsCoorrBrk01.TQS16_TORQ_BASE_ADD_LMU_MP_X1" 0 /end CHARACTERISTIC
/begin CHARACTERISTIC TQS16_TORQ_BASE_ADD_LMU_MP_X2 "" VALUE 0x80020E7A CalPrmLatDynsCoorrBrk_SWORD 0 Gain -32768 32767 SYMBOL_LINK "CalPrmLatDynsCoorrBrk01.TQS16_TORQ_BASE_ADD_LMU_MP_X2" 0 /end CHARACTERISTIC
/begin CHARACTERISTIC TQS16_TORQ_BASE_ADD_LMU_MP_X3 "" VALUE 0x80020E7C CalPrmLatDynsCoorrBrk_SWORD 0 Gain -32768 32767 SYMBOL_LINK "CalPrmLatDynsCoorrBrk01.TQS16_TORQ_BASE_ADD_LMU_MP_X3" 0 /end CHARACTERISTIC
/begin CHARACTERISTIC TQS16_TORQ_BASE_ADD_LMU_MP_X4 "" VALUE 0x80020E7E CalPrmLatDynsCoorrBrk_SWORD 0 Gain -32768 32767 SYMBOL_LINK "CalPrmLatDynsCoorrBrk01.TQS16_TORQ_BASE_ADD_LMU_MP_X4" 0 /end CHARACTERISTIC
/begin CHARACTERISTIC TQS16_TORQ_BASE_ADD_MMU "" VALUE 0x80020CA4 CalPrmLatDynsCoorrBrk_SWORD 0 Gain -32768 32767 SYMBOL_LINK "CalPrmLatDynsCoorrBrk01.TQS16_TORQ_BASE_ADD_MMU" 0 /end CHARACTERISTIC
/begin CHARACTERISTIC TQS16_TORQ_BASE_ADD_MMU_MP_X1 "" VALUE 0x80020E80 CalPrmLatDynsCoorrBrk_SWORD 0 Gain -32768 32767 SYMBOL_LINK "CalPrmLatDynsCoorrBrk01.TQS16_TORQ_BASE_ADD_MMU_MP_X1" 0 /end CHARACTERISTIC
/begin CHARACTERISTIC TQS16_TORQ_BASE_ADD_MMU_MP_X2 "" VALUE 0x80020E82 CalPrmLatDynsCoorrBrk_SWORD 0 Gain -32768 32767 SYMBOL_LINK "CalPrmLatDynsCoorrBrk01.TQS16_TORQ_BASE_ADD_MMU_MP_X2" 0 /end CHARACTERISTIC
/begin CHARACTERISTIC TQS16_TORQ_BASE_ADD_MMU_MP_X3 "" VALUE 0x80020E84 CalPrmLatDynsCoorrBrk_SWORD 0 Gain -32768 32767 SYMBOL_LINK "CalPrmLatDynsCoorrBrk01.TQS16_TORQ_BASE_ADD_MMU_MP_X3" 0 /end CHARACTERISTIC
/begin CHARACTERISTIC TQS16_TORQ_BASE_ADD_MMU_MP_X4 "" VALUE 0x80020E86 CalPrmLatDynsCoorrBrk_SWORD 0 Gain -32768 32767 SYMBOL_LINK "CalPrmLatDynsCoorrBrk01.TQS16_TORQ_BASE_ADD_MMU_MP_X4" 0 /end CHARACTERISTIC
/begin CHARACTERISTIC TQS16_WSTR_THR_LARGE "" VALUE 0x800209EC CalPrmLatDynsCoorrBrk_SWORD 0 Gain -32768 32767 SYMBOL_LINK "CalPrmLatDynsCoorrBrk01.TQS16_WSTR_THR_LARGE" 0 /end CHARACTERISTIC
/begin CHARACTERISTIC TQS16_WSTR_THR_MEDIU "" VALUE 0x800209EA CalPrmLatDynsCoorrBrk_SWORD 0 Gain -32768 32767 SYMBOL_LINK "CalPrmLatDynsCoorrBrk01.TQS16_WSTR_THR_MEDIU" 0 /end CHARACTERISTIC
/begin CHARACTERISTIC TQS16_WSTR_THR_SMALL "" VALUE 0x800209E8 CalPrmLatDynsCoorrBrk_SWORD 0 Gain -32768 32767 SYMBOL_LINK "CalPrmLatDynsCoorrBrk01.TQS16_WSTR_THR_SMALL" 0 /end CHARACTERISTIC
/begin CHARACTERISTIC TQS16_X1_Lower_Sus_Bank_Angle "" VALUE 0x800209C6 CalPrmLatDynsCoorrBrk_SWORD 0 Gain -32768 32767 SYMBOL_LINK "CalPrmLatDynsCoorrBrk01.TQS16_X1_Lower_Sus_Bank_Angle" 0 /end CHARACTERISTIC
/begin CHARACTERISTIC TQS16_X2_Suspect_Bank_Angle "" VALUE 0x800209C8 CalPrmLatDynsCoorrBrk_SWORD 0 Gain -32768 32767 SYMBOL_LINK "CalPrmLatDynsCoorrBrk01.TQS16_X2_Suspect_Bank_Angle" 0 /end CHARACTERISTIC
/begin CHARACTERISTIC TQS16_X3_Detect_Bank_Angle "" VALUE 0x800209CA CalPrmLatDynsCoorrBrk_SWORD 0 Gain -32768 32767 SYMBOL_LINK "CalPrmLatDynsCoorrBrk01.TQS16_X3_Detect_Bank_Angle" 0 /end CHARACTERISTIC
/begin CHARACTERISTIC TQS16_X4_Max_Bank_Angle "" VALUE 0x800209CC CalPrmLatDynsCoorrBrk_SWORD 0 Gain -32768 32767 SYMBOL_LINK "CalPrmLatDynsCoorrBrk01.TQS16_X4_Max_Bank_Angle" 0 /end CHARACTERISTIC
/begin CHARACTERISTIC TQS16_Y1_Bank_Lower_Sus_Add_Thres2 "" VALUE 0x800209CE CalPrmLatDynsCoorrBrk_SWORD 0 Gain -32768 32767 SYMBOL_LINK "CalPrmLatDynsCoorrBrk01.TQS16_Y1_Bank_Lower_Sus_Add_Thres2" 0 /end CHARACTERISTIC
/begin CHARACTERISTIC TQS16_Y1_FadeOut_TorqDec_HM "" VALUE 0x80020842 CalPrmLatDynsCoorrBrk_SWORD 0 Gain -32768 32767 SYMBOL_LINK "CalPrmLatDynsCoorrBrk01.TQS16_Y1_FadeOut_TorqDec_HM" 0 /end CHARACTERISTIC
/begin CHARACTERISTIC TQS16_Y1_FadeOut_TorqDec_LM "" VALUE 0x80020832 CalPrmLatDynsCoorrBrk_SWORD 0 Gain -32768 32767 SYMBOL_LINK "CalPrmLatDynsCoorrBrk01.TQS16_Y1_FadeOut_TorqDec_LM" 0 /end CHARACTERISTIC
/begin CHARACTERISTIC TQS16_Y1_FadeOut_TorqDec_MM "" VALUE 0x8002083A CalPrmLatDynsCoorrBrk_SWORD 0 Gain -32768 32767 SYMBOL_LINK "CalPrmLatDynsCoorrBrk01.TQS16_Y1_FadeOut_TorqDec_MM" 0 /end CHARACTERISTIC
/begin CHARACTERISTIC TQS16_Y2_Bank_Suspect_Add_Thres2 "" VALUE 0x800209D0 CalPrmLatDynsCoorrBrk_SWORD 0 Gain -32768 32767 SYMBOL_LINK "CalPrmLatDynsCoorrBrk01.TQS16_Y2_Bank_Suspect_Add_Thres2" 0 /end CHARACTERISTIC
/begin CHARACTERISTIC TQS16_Y2_FadeOut_TorqDec_HM "" VALUE 0x80020844 CalPrmLatDynsCoorrBrk_SWORD 0 Gain -32768 32767 SYMBOL_LINK "CalPrmLatDynsCoorrBrk01.TQS16_Y2_FadeOut_TorqDec_HM" 0 /end CHARACTERISTIC
/begin CHARACTERISTIC TQS16_Y2_FadeOut_TorqDec_LM "" VALUE 0x80020834 CalPrmLatDynsCoorrBrk_SWORD 0 Gain -32768 32767 SYMBOL_LINK "CalPrmLatDynsCoorrBrk01.TQS16_Y2_FadeOut_TorqDec_LM" 0 /end CHARACTERISTIC
/begin CHARACTERISTIC TQS16_Y2_FadeOut_TorqDec_MM "" VALUE 0x8002083C CalPrmLatDynsCoorrBrk_SWORD 0 Gain -32768 32767 SYMBOL_LINK "CalPrmLatDynsCoorrBrk01.TQS16_Y2_FadeOut_TorqDec_MM" 0 /end CHARACTERISTIC
/begin CHARACTERISTIC TQS16_Y3_Bank_Detect_L_Add_Thres2 "" VALUE 0x800209D2 CalPrmLatDynsCoorrBrk_SWORD 0 Gain -32768 32767 SYMBOL_LINK "CalPrmLatDynsCoorrBrk01.TQS16_Y3_Bank_Detect_L_Add_Thres2" 0 /end CHARACTERISTIC
/begin CHARACTERISTIC TQS16_Y3_FadeOut_TorqDec_HM "" VALUE 0x80020846 CalPrmLatDynsCoorrBrk_SWORD 0 Gain -32768 32767 SYMBOL_LINK "CalPrmLatDynsCoorrBrk01.TQS16_Y3_FadeOut_TorqDec_HM" 0 /end CHARACTERISTIC
/begin CHARACTERISTIC TQS16_Y3_FadeOut_TorqDec_LM "" VALUE 0x80020836 CalPrmLatDynsCoorrBrk_SWORD 0 Gain -32768 32767 SYMBOL_LINK "CalPrmLatDynsCoorrBrk01.TQS16_Y3_FadeOut_TorqDec_LM" 0 /end CHARACTERISTIC
/begin CHARACTERISTIC TQS16_Y3_FadeOut_TorqDec_MM "" VALUE 0x8002083E CalPrmLatDynsCoorrBrk_SWORD 0 Gain -32768 32767 SYMBOL_LINK "CalPrmLatDynsCoorrBrk01.TQS16_Y3_FadeOut_TorqDec_MM" 0 /end CHARACTERISTIC
/begin CHARACTERISTIC TQS16_Y4_Bank_Detect_U_Add_Thres2 "" VALUE 0x800209D4 CalPrmLatDynsCoorrBrk_SWORD 0 Gain -32768 32767 SYMBOL_LINK "CalPrmLatDynsCoorrBrk01.TQS16_Y4_Bank_Detect_U_Add_Thres2" 0 /end CHARACTERISTIC
/begin CHARACTERISTIC TQS16_Y4_FadeOut_TorqDec_HM "" VALUE 0x80020848 CalPrmLatDynsCoorrBrk_SWORD 0 Gain -32768 32767 SYMBOL_LINK "CalPrmLatDynsCoorrBrk01.TQS16_Y4_FadeOut_TorqDec_HM" 0 /end CHARACTERISTIC
/begin CHARACTERISTIC TQS16_Y4_FadeOut_TorqDec_LM "" VALUE 0x80020838 CalPrmLatDynsCoorrBrk_SWORD 0 Gain -32768 32767 SYMBOL_LINK "CalPrmLatDynsCoorrBrk01.TQS16_Y4_FadeOut_TorqDec_LM" 0 /end CHARACTERISTIC
/begin CHARACTERISTIC TQS16_Y4_FadeOut_TorqDec_MM "" VALUE 0x80020840 CalPrmLatDynsCoorrBrk_SWORD 0 Gain -32768 32767 SYMBOL_LINK "CalPrmLatDynsCoorrBrk01.TQS16_Y4_FadeOut_TorqDec_MM" 0 /end CHARACTERISTIC
/begin CHARACTERISTIC TQS16_YAW_LIMIT_BETAD_H_SP_CON "" VALUE 0x80020AEE CalPrmLatDynsCoorrBrk_SWORD 0 Gain -32768 32767 SYMBOL_LINK "CalPrmLatDynsCoorrBrk01.TQS16_YAW_LIMIT_BETAD_H_SP_CON" 0 /end CHARACTERISTIC
/begin CHARACTERISTIC TQS16_YAW_LIMIT_BETAD_L_SP_CON "" VALUE 0x80020AF0 CalPrmLatDynsCoorrBrk_SWORD 0 Gain -32768 32767 SYMBOL_LINK "CalPrmLatDynsCoorrBrk01.TQS16_YAW_LIMIT_BETAD_L_SP_CON" 0 /end CHARACTERISTIC
/begin CHARACTERISTIC TQS16_YAW_LIMIT_BETAD_M_SP_CON "" VALUE 0x80020AF2 CalPrmLatDynsCoorrBrk_SWORD 0 Gain -32768 32767 SYMBOL_LINK "CalPrmLatDynsCoorrBrk01.TQS16_YAW_LIMIT_BETAD_M_SP_CON" 0 /end CHARACTERISTIC
/begin CHARACTERISTIC TQS16_YAW_LIMIT_DELTA_HIGH_FAST "" VALUE 0x80020AC2 CalPrmLatDynsCoorrBrk_SWORD 0 Gain -32768 32767 SYMBOL_LINK "CalPrmLatDynsCoorrBrk01.TQS16_YAW_LIMIT_DELTA_HIGH_FAST" 0 /end CHARACTERISTIC
/begin CHARACTERISTIC TQS16_YAW_LIMIT_DELTA_HIGH_FAST_ABS "" VALUE 0x80020ACE CalPrmLatDynsCoorrBrk_SWORD 0 Gain -32768 32767 SYMBOL_LINK "CalPrmLatDynsCoorrBrk01.TQS16_YAW_LIMIT_DELTA_HIGH_FAST_ABS" 0 /end CHARACTERISTIC
/begin CHARACTERISTIC TQS16_YAW_LIMIT_DELTA_HIGH_SLOW "" VALUE 0x80020AC4 CalPrmLatDynsCoorrBrk_SWORD 0 Gain -32768 32767 SYMBOL_LINK "CalPrmLatDynsCoorrBrk01.TQS16_YAW_LIMIT_DELTA_HIGH_SLOW" 0 /end CHARACTERISTIC
/begin CHARACTERISTIC TQS16_YAW_LIMIT_DELTA_HIGH_SLOW_ABS "" VALUE 0x80020AD0 CalPrmLatDynsCoorrBrk_SWORD 0 Gain -32768 32767 SYMBOL_LINK "CalPrmLatDynsCoorrBrk01.TQS16_YAW_LIMIT_DELTA_HIGH_SLOW_ABS" 0 /end CHARACTERISTIC
/begin CHARACTERISTIC TQS16_YAW_LIMIT_DELTA_HIGH_VSLOW "" VALUE 0x80020AC6 CalPrmLatDynsCoorrBrk_SWORD 0 Gain -32768 32767 SYMBOL_LINK "CalPrmLatDynsCoorrBrk01.TQS16_YAW_LIMIT_DELTA_HIGH_VSLOW" 0 /end CHARACTERISTIC
/begin CHARACTERISTIC TQS16_YAW_LIMIT_DELTA_HIGH_VSLOW_ABS "" VALUE 0x80020AD2 CalPrmLatDynsCoorrBrk_SWORD 0 Gain -32768 32767 SYMBOL_LINK "CalPrmLatDynsCoorrBrk01.TQS16_YAW_LIMIT_DELTA_HIGH_VSLOW_ABS" 0 /end CHARACTERISTIC
/begin CHARACTERISTIC TQS16_YAW_LIMIT_DELTA_HMU_AY_L "" VALUE 0x80020AF4 CalPrmLatDynsCoorrBrk_SWORD 0 Gain -32768 32767 SYMBOL_LINK "CalPrmLatDynsCoorrBrk01.TQS16_YAW_LIMIT_DELTA_HMU_AY_L" 0 /end CHARACTERISTIC
/begin CHARACTERISTIC TQS16_YAW_LIMIT_DELTA_HMU_AY_M "" VALUE 0x80020AF6 CalPrmLatDynsCoorrBrk_SWORD 0 Gain -32768 32767 SYMBOL_LINK "CalPrmLatDynsCoorrBrk01.TQS16_YAW_LIMIT_DELTA_HMU_AY_M" 0 /end CHARACTERISTIC
/begin CHARACTERISTIC TQS16_YAW_LIMIT_DELTA_LOW_FAST "" VALUE 0x80020AC8 CalPrmLatDynsCoorrBrk_SWORD 0 Gain -32768 32767 SYMBOL_LINK "CalPrmLatDynsCoorrBrk01.TQS16_YAW_LIMIT_DELTA_LOW_FAST" 0 /end CHARACTERISTIC
/begin CHARACTERISTIC TQS16_YAW_LIMIT_DELTA_LOW_FAST_ABS "" VALUE 0x80020AD4 CalPrmLatDynsCoorrBrk_SWORD 0 Gain -32768 32767 SYMBOL_LINK "CalPrmLatDynsCoorrBrk01.TQS16_YAW_LIMIT_DELTA_LOW_FAST_ABS" 0 /end CHARACTERISTIC
/begin CHARACTERISTIC TQS16_YAW_LIMIT_DELTA_LOW_SLOW "" VALUE 0x80020ACA CalPrmLatDynsCoorrBrk_SWORD 0 Gain -32768 32767 SYMBOL_LINK "CalPrmLatDynsCoorrBrk01.TQS16_YAW_LIMIT_DELTA_LOW_SLOW" 0 /end CHARACTERISTIC
/begin CHARACTERISTIC TQS16_YAW_LIMIT_DELTA_LOW_SLOW_ABS "" VALUE 0x80020AD6 CalPrmLatDynsCoorrBrk_SWORD 0 Gain -32768 32767 SYMBOL_LINK "CalPrmLatDynsCoorrBrk01.TQS16_YAW_LIMIT_DELTA_LOW_SLOW_ABS" 0 /end CHARACTERISTIC
/begin CHARACTERISTIC TQS16_YAW_LIMIT_DELTA_LOW_VSLOW "" VALUE 0x80020ACC CalPrmLatDynsCoorrBrk_SWORD 0 Gain -32768 32767 SYMBOL_LINK "CalPrmLatDynsCoorrBrk01.TQS16_YAW_LIMIT_DELTA_LOW_VSLOW" 0 /end CHARACTERISTIC
/begin CHARACTERISTIC TQS16_YAW_LIMIT_DELTA_LOW_VSLOW_ABS "" VALUE 0x80020AD8 CalPrmLatDynsCoorrBrk_SWORD 0 Gain -32768 32767 SYMBOL_LINK "CalPrmLatDynsCoorrBrk01.TQS16_YAW_LIMIT_DELTA_LOW_VSLOW_ABS" 0 /end CHARACTERISTIC
/begin CHARACTERISTIC TQS16_YAW_LIMIT_DELTA_MMU_AY_L "" VALUE 0x80020AF8 CalPrmLatDynsCoorrBrk_SWORD 0 Gain -32768 32767 SYMBOL_LINK "CalPrmLatDynsCoorrBrk01.TQS16_YAW_LIMIT_DELTA_MMU_AY_L" 0 /end CHARACTERISTIC
/begin CHARACTERISTIC TQS16_YAW_LIMIT_DELTA_MMU_AY_M "" VALUE 0x80020AFA CalPrmLatDynsCoorrBrk_SWORD 0 Gain -32768 32767 SYMBOL_LINK "CalPrmLatDynsCoorrBrk01.TQS16_YAW_LIMIT_DELTA_MMU_AY_M" 0 /end CHARACTERISTIC
/begin CHARACTERISTIC TQS16_YAW_LIMIT_ENTER_FA_ST_H_SP "" VALUE 0x80020AB8 CalPrmLatDynsCoorrBrk_SWORD 0 Gain -32768 32767 SYMBOL_LINK "CalPrmLatDynsCoorrBrk01.TQS16_YAW_LIMIT_ENTER_FA_ST_H_SP" 0 /end CHARACTERISTIC
/begin CHARACTERISTIC TQS16_YAW_LIMIT_ENTER_FA_ST_L_SP "" VALUE 0x80020ABA CalPrmLatDynsCoorrBrk_SWORD 0 Gain -32768 32767 SYMBOL_LINK "CalPrmLatDynsCoorrBrk01.TQS16_YAW_LIMIT_ENTER_FA_ST_L_SP" 0 /end CHARACTERISTIC
/begin CHARACTERISTIC TQS16_YAW_LIMIT_ENTER_FA_ST_M_SP "" VALUE 0x80020ABC CalPrmLatDynsCoorrBrk_SWORD 0 Gain -32768 32767 SYMBOL_LINK "CalPrmLatDynsCoorrBrk01.TQS16_YAW_LIMIT_ENTER_FA_ST_M_SP" 0 /end CHARACTERISTIC
/begin CHARACTERISTIC TQS16_YAW_LIMIT_FA_ST_H_SP_ENT_AD "" VALUE 0x80020ABE CalPrmLatDynsCoorrBrk_SWORD 0 Gain -32768 32767 SYMBOL_LINK "CalPrmLatDynsCoorrBrk01.TQS16_YAW_LIMIT_FA_ST_H_SP_ENT_AD" 0 /end CHARACTERISTIC
/begin CHARACTERISTIC TQS16_YAW_LIMIT_FA_ST_M_SP_ENT_AD "" VALUE 0x80020AC0 CalPrmLatDynsCoorrBrk_SWORD 0 Gain -32768 32767 SYMBOL_LINK "CalPrmLatDynsCoorrBrk01.TQS16_YAW_LIMIT_FA_ST_M_SP_ENT_AD" 0 /end CHARACTERISTIC
/begin CHARACTERISTIC TQS16_YAW_LIMIT_GAIN_H "" VALUE 0x80020A74 CalPrmLatDynsCoorrBrk_SWORD 0 Gain -32768 32767 SYMBOL_LINK "CalPrmLatDynsCoorrBrk01.TQS16_YAW_LIMIT_GAIN_H" 0 /end CHARACTERISTIC
/begin CHARACTERISTIC TQS16_YAW_LIMIT_GAIN_HMU_ABS "" VALUE 0x80020A08 CalPrmLatDynsCoorrBrk_SWORD 0 Gain -32768 32767 SYMBOL_LINK "CalPrmLatDynsCoorrBrk01.TQS16_YAW_LIMIT_GAIN_HMU_ABS" 0 /end CHARACTERISTIC
/begin CHARACTERISTIC TQS16_YAW_LIMIT_GAIN_HMU_HSPD "" VALUE 0x80020A06 CalPrmLatDynsCoorrBrk_SWORD 0 Gain -32768 32767 SYMBOL_LINK "CalPrmLatDynsCoorrBrk01.TQS16_YAW_LIMIT_GAIN_HMU_HSPD" 0 /end CHARACTERISTIC
/begin CHARACTERISTIC TQS16_YAW_LIMIT_GAIN_HMU_LSPD "" VALUE 0x80020A02 CalPrmLatDynsCoorrBrk_SWORD 0 Gain -32768 32767 SYMBOL_LINK "CalPrmLatDynsCoorrBrk01.TQS16_YAW_LIMIT_GAIN_HMU_LSPD" 0 /end CHARACTERISTIC
/begin CHARACTERISTIC TQS16_YAW_LIMIT_GAIN_HMU_MSPD "" VALUE 0x80020A04 CalPrmLatDynsCoorrBrk_SWORD 0 Gain -32768 32767 SYMBOL_LINK "CalPrmLatDynsCoorrBrk01.TQS16_YAW_LIMIT_GAIN_HMU_MSPD" 0 /end CHARACTERISTIC
/begin CHARACTERISTIC TQS16_YAW_LIMIT_GAIN_H_ABS "" VALUE 0x80020A76 CalPrmLatDynsCoorrBrk_SWORD 0 Gain -32768 32767 SYMBOL_LINK "CalPrmLatDynsCoorrBrk01.TQS16_YAW_LIMIT_GAIN_H_ABS" 0 /end CHARACTERISTIC
/begin CHARACTERISTIC TQS16_YAW_LIMIT_GAIN_H_SL "" VALUE 0x80020A72 CalPrmLatDynsCoorrBrk_SWORD 0 Gain -32768 32767 SYMBOL_LINK "CalPrmLatDynsCoorrBrk01.TQS16_YAW_LIMIT_GAIN_H_SL" 0 /end CHARACTERISTIC
/begin CHARACTERISTIC TQS16_YAW_LIMIT_GAIN_H_V1 "" VALUE 0x80020A78 CalPrmLatDynsCoorrBrk_SWORD 0 Gain -32768 32767 SYMBOL_LINK "CalPrmLatDynsCoorrBrk01.TQS16_YAW_LIMIT_GAIN_H_V1" 0 /end CHARACTERISTIC
/begin CHARACTERISTIC TQS16_YAW_LIMIT_GAIN_H_V2 "" VALUE 0x80020A7A CalPrmLatDynsCoorrBrk_SWORD 0 Gain -32768 32767 SYMBOL_LINK "CalPrmLatDynsCoorrBrk01.TQS16_YAW_LIMIT_GAIN_H_V2" 0 /end CHARACTERISTIC
/begin CHARACTERISTIC TQS16_YAW_LIMIT_GAIN_L "" VALUE 0x80020A9E CalPrmLatDynsCoorrBrk_SWORD 0 Gain -32768 32767 SYMBOL_LINK "CalPrmLatDynsCoorrBrk01.TQS16_YAW_LIMIT_GAIN_L" 0 /end CHARACTERISTIC
/begin CHARACTERISTIC TQS16_YAW_LIMIT_GAIN_LIMIT_H "" VALUE 0x80020A7C CalPrmLatDynsCoorrBrk_SWORD 0 Gain -32768 32767 SYMBOL_LINK "CalPrmLatDynsCoorrBrk01.TQS16_YAW_LIMIT_GAIN_LIMIT_H" 0 /end CHARACTERISTIC
/begin CHARACTERISTIC TQS16_YAW_LIMIT_GAIN_LIMIT_H_V1 "" VALUE 0x80020A7E CalPrmLatDynsCoorrBrk_SWORD 0 Gain -32768 32767 SYMBOL_LINK "CalPrmLatDynsCoorrBrk01.TQS16_YAW_LIMIT_GAIN_LIMIT_H_V1" 0 /end CHARACTERISTIC
/begin CHARACTERISTIC TQS16_YAW_LIMIT_GAIN_LIMIT_H_V2 "" VALUE 0x80020A80 CalPrmLatDynsCoorrBrk_SWORD 0 Gain -32768 32767 SYMBOL_LINK "CalPrmLatDynsCoorrBrk01.TQS16_YAW_LIMIT_GAIN_LIMIT_H_V2" 0 /end CHARACTERISTIC
/begin CHARACTERISTIC TQS16_YAW_LIMIT_GAIN_LIMIT_L "" VALUE 0x80020AA0 CalPrmLatDynsCoorrBrk_SWORD 0 Gain -32768 32767 SYMBOL_LINK "CalPrmLatDynsCoorrBrk01.TQS16_YAW_LIMIT_GAIN_LIMIT_L" 0 /end CHARACTERISTIC
/begin CHARACTERISTIC TQS16_YAW_LIMIT_GAIN_LIMIT_L_V1 "" VALUE 0x80020AA2 CalPrmLatDynsCoorrBrk_SWORD 0 Gain -32768 32767 SYMBOL_LINK "CalPrmLatDynsCoorrBrk01.TQS16_YAW_LIMIT_GAIN_LIMIT_L_V1" 0 /end CHARACTERISTIC
/begin CHARACTERISTIC TQS16_YAW_LIMIT_GAIN_LIMIT_L_V2 "" VALUE 0x80020AA4 CalPrmLatDynsCoorrBrk_SWORD 0 Gain -32768 32767 SYMBOL_LINK "CalPrmLatDynsCoorrBrk01.TQS16_YAW_LIMIT_GAIN_LIMIT_L_V2" 0 /end CHARACTERISTIC
/begin CHARACTERISTIC TQS16_YAW_LIMIT_GAIN_LIMIT_M "" VALUE 0x80020A8A CalPrmLatDynsCoorrBrk_SWORD 0 Gain -32768 32767 SYMBOL_LINK "CalPrmLatDynsCoorrBrk01.TQS16_YAW_LIMIT_GAIN_LIMIT_M" 0 /end CHARACTERISTIC
/begin CHARACTERISTIC TQS16_YAW_LIMIT_GAIN_LIMIT_M_V1 "" VALUE 0x80020A8C CalPrmLatDynsCoorrBrk_SWORD 0 Gain -32768 32767 SYMBOL_LINK "CalPrmLatDynsCoorrBrk01.TQS16_YAW_LIMIT_GAIN_LIMIT_M_V1" 0 /end CHARACTERISTIC
/begin CHARACTERISTIC TQS16_YAW_LIMIT_GAIN_LIMIT_M_V2 "" VALUE 0x80020A8E CalPrmLatDynsCoorrBrk_SWORD 0 Gain -32768 32767 SYMBOL_LINK "CalPrmLatDynsCoorrBrk01.TQS16_YAW_LIMIT_GAIN_LIMIT_M_V2" 0 /end CHARACTERISTIC
/begin CHARACTERISTIC TQS16_YAW_LIMIT_GAIN_LMU_ABS "" VALUE 0x800209F8 CalPrmLatDynsCoorrBrk_SWORD 0 Gain -32768 32767 SYMBOL_LINK "CalPrmLatDynsCoorrBrk01.TQS16_YAW_LIMIT_GAIN_LMU_ABS" 0 /end CHARACTERISTIC
/begin CHARACTERISTIC TQS16_YAW_LIMIT_GAIN_LMU_HSPD "" VALUE 0x800209F6 CalPrmLatDynsCoorrBrk_SWORD 0 Gain -32768 32767 SYMBOL_LINK "CalPrmLatDynsCoorrBrk01.TQS16_YAW_LIMIT_GAIN_LMU_HSPD" 0 /end CHARACTERISTIC
/begin CHARACTERISTIC TQS16_YAW_LIMIT_GAIN_LMU_LSPD "" VALUE 0x800209F2 CalPrmLatDynsCoorrBrk_SWORD 0 Gain -32768 32767 SYMBOL_LINK "CalPrmLatDynsCoorrBrk01.TQS16_YAW_LIMIT_GAIN_LMU_LSPD" 0 /end CHARACTERISTIC
/begin CHARACTERISTIC TQS16_YAW_LIMIT_GAIN_LMU_MSPD "" VALUE 0x800209F4 CalPrmLatDynsCoorrBrk_SWORD 0 Gain -32768 32767 SYMBOL_LINK "CalPrmLatDynsCoorrBrk01.TQS16_YAW_LIMIT_GAIN_LMU_MSPD" 0 /end CHARACTERISTIC
/begin CHARACTERISTIC TQS16_YAW_LIMIT_GAIN_L_ABS "" VALUE 0x80020AA6 CalPrmLatDynsCoorrBrk_SWORD 0 Gain -32768 32767 SYMBOL_LINK "CalPrmLatDynsCoorrBrk01.TQS16_YAW_LIMIT_GAIN_L_ABS" 0 /end CHARACTERISTIC
/begin CHARACTERISTIC TQS16_YAW_LIMIT_GAIN_L_V1 "" VALUE 0x80020AA8 CalPrmLatDynsCoorrBrk_SWORD 0 Gain -32768 32767 SYMBOL_LINK "CalPrmLatDynsCoorrBrk01.TQS16_YAW_LIMIT_GAIN_L_V1" 0 /end CHARACTERISTIC
/begin CHARACTERISTIC TQS16_YAW_LIMIT_GAIN_L_V2 "" VALUE 0x80020AAA CalPrmLatDynsCoorrBrk_SWORD 0 Gain -32768 32767 SYMBOL_LINK "CalPrmLatDynsCoorrBrk01.TQS16_YAW_LIMIT_GAIN_L_V2" 0 /end CHARACTERISTIC
/begin CHARACTERISTIC TQS16_YAW_LIMIT_GAIN_M "" VALUE 0x80020A90 CalPrmLatDynsCoorrBrk_SWORD 0 Gain -32768 32767 SYMBOL_LINK "CalPrmLatDynsCoorrBrk01.TQS16_YAW_LIMIT_GAIN_M" 0 /end CHARACTERISTIC
/begin CHARACTERISTIC TQS16_YAW_LIMIT_GAIN_MMU_ABS "" VALUE 0x80020A00 CalPrmLatDynsCoorrBrk_SWORD 0 Gain -32768 32767 SYMBOL_LINK "CalPrmLatDynsCoorrBrk01.TQS16_YAW_LIMIT_GAIN_MMU_ABS" 0 /end CHARACTERISTIC
/begin CHARACTERISTIC TQS16_YAW_LIMIT_GAIN_MMU_HSPD "" VALUE 0x800209FE CalPrmLatDynsCoorrBrk_SWORD 0 Gain -32768 32767 SYMBOL_LINK "CalPrmLatDynsCoorrBrk01.TQS16_YAW_LIMIT_GAIN_MMU_HSPD" 0 /end CHARACTERISTIC
/begin CHARACTERISTIC TQS16_YAW_LIMIT_GAIN_MMU_LSPD "" VALUE 0x800209FA CalPrmLatDynsCoorrBrk_SWORD 0 Gain -32768 32767 SYMBOL_LINK "CalPrmLatDynsCoorrBrk01.TQS16_YAW_LIMIT_GAIN_MMU_LSPD" 0 /end CHARACTERISTIC
/begin CHARACTERISTIC TQS16_YAW_LIMIT_GAIN_MMU_MSPD "" VALUE 0x800209FC CalPrmLatDynsCoorrBrk_SWORD 0 Gain -32768 32767 SYMBOL_LINK "CalPrmLatDynsCoorrBrk01.TQS16_YAW_LIMIT_GAIN_MMU_MSPD" 0 /end CHARACTERISTIC
/begin CHARACTERISTIC TQS16_YAW_LIMIT_GAIN_M_ABS "" VALUE 0x80020A92 CalPrmLatDynsCoorrBrk_SWORD 0 Gain -32768 32767 SYMBOL_LINK "CalPrmLatDynsCoorrBrk01.TQS16_YAW_LIMIT_GAIN_M_ABS" 0 /end CHARACTERISTIC
/begin CHARACTERISTIC TQS16_YAW_LIMIT_GAIN_M_V1 "" VALUE 0x80020A94 CalPrmLatDynsCoorrBrk_SWORD 0 Gain -32768 32767 SYMBOL_LINK "CalPrmLatDynsCoorrBrk01.TQS16_YAW_LIMIT_GAIN_M_V1" 0 /end CHARACTERISTIC
/begin CHARACTERISTIC TQS16_YAW_LIMIT_GAIN_M_V2 "" VALUE 0x80020A96 CalPrmLatDynsCoorrBrk_SWORD 0 Gain -32768 32767 SYMBOL_LINK "CalPrmLatDynsCoorrBrk01.TQS16_YAW_LIMIT_GAIN_M_V2" 0 /end CHARACTERISTIC
/begin CHARACTERISTIC TQS16_YAW_LIMIT_HMU_DEL_AY "" VALUE 0x80020AFC CalPrmLatDynsCoorrBrk_SWORD 0 Gain -32768 32767 SYMBOL_LINK "CalPrmLatDynsCoorrBrk01.TQS16_YAW_LIMIT_HMU_DEL_AY" 0 /end CHARACTERISTIC
/begin CHARACTERISTIC TQS16_YAW_LIMIT_H_SPEED_V1 "" VALUE 0x80020ADA CalPrmLatDynsCoorrBrk_SWORD 0 Gain -32768 32767 SYMBOL_LINK "CalPrmLatDynsCoorrBrk01.TQS16_YAW_LIMIT_H_SPEED_V1" 0 /end CHARACTERISTIC
/begin CHARACTERISTIC TQS16_YAW_LIMIT_H_SPEED_V2 "" VALUE 0x80020ADC CalPrmLatDynsCoorrBrk_SWORD 0 Gain -32768 32767 SYMBOL_LINK "CalPrmLatDynsCoorrBrk01.TQS16_YAW_LIMIT_H_SPEED_V2" 0 /end CHARACTERISTIC
/begin CHARACTERISTIC TQS16_YAW_LIMIT_H_SPEED_V3 "" VALUE 0x80020ADE CalPrmLatDynsCoorrBrk_SWORD 0 Gain -32768 32767 SYMBOL_LINK "CalPrmLatDynsCoorrBrk01.TQS16_YAW_LIMIT_H_SPEED_V3" 0 /end CHARACTERISTIC
/begin CHARACTERISTIC TQS16_YAW_LIMIT_H_V1_INC_DEL_AY "" VALUE 0x80020AE0 CalPrmLatDynsCoorrBrk_SWORD 0 Gain -32768 32767 SYMBOL_LINK "CalPrmLatDynsCoorrBrk01.TQS16_YAW_LIMIT_H_V1_INC_DEL_AY" 0 /end CHARACTERISTIC
/begin CHARACTERISTIC TQS16_YAW_LIMIT_H_V2_INC_DEL_AY "" VALUE 0x80020AE2 CalPrmLatDynsCoorrBrk_SWORD 0 Gain -32768 32767 SYMBOL_LINK "CalPrmLatDynsCoorrBrk01.TQS16_YAW_LIMIT_H_V2_INC_DEL_AY" 0 /end CHARACTERISTIC
/begin CHARACTERISTIC TQS16_YAW_LIMIT_MMU_DEL_AY "" VALUE 0x80020AFE CalPrmLatDynsCoorrBrk_SWORD 0 Gain -32768 32767 SYMBOL_LINK "CalPrmLatDynsCoorrBrk01.TQS16_YAW_LIMIT_MMU_DEL_AY" 0 /end CHARACTERISTIC
/begin CHARACTERISTIC TQS16_YAW_LIMIT_M_SPEED_V1 "" VALUE 0x80020AE4 CalPrmLatDynsCoorrBrk_SWORD 0 Gain -32768 32767 SYMBOL_LINK "CalPrmLatDynsCoorrBrk01.TQS16_YAW_LIMIT_M_SPEED_V1" 0 /end CHARACTERISTIC
/begin CHARACTERISTIC TQS16_YAW_LIMIT_M_SPEED_V2 "" VALUE 0x80020AE6 CalPrmLatDynsCoorrBrk_SWORD 0 Gain -32768 32767 SYMBOL_LINK "CalPrmLatDynsCoorrBrk01.TQS16_YAW_LIMIT_M_SPEED_V2" 0 /end CHARACTERISTIC
/begin CHARACTERISTIC TQS16_YAW_LIMIT_M_SPEED_V3 "" VALUE 0x80020AE8 CalPrmLatDynsCoorrBrk_SWORD 0 Gain -32768 32767 SYMBOL_LINK "CalPrmLatDynsCoorrBrk01.TQS16_YAW_LIMIT_M_SPEED_V3" 0 /end CHARACTERISTIC
/begin CHARACTERISTIC TQS16_YAW_LIMIT_M_V1_INC_DEL_AY "" VALUE 0x80020AEA CalPrmLatDynsCoorrBrk_SWORD 0 Gain -32768 32767 SYMBOL_LINK "CalPrmLatDynsCoorrBrk01.TQS16_YAW_LIMIT_M_V1_INC_DEL_AY" 0 /end CHARACTERISTIC
/begin CHARACTERISTIC TQS16_YAW_LIMIT_M_V2_INC_DEL_AY "" VALUE 0x80020AEC CalPrmLatDynsCoorrBrk_SWORD 0 Gain -32768 32767 SYMBOL_LINK "CalPrmLatDynsCoorrBrk01.TQS16_YAW_LIMIT_M_V2_INC_DEL_AY" 0 /end CHARACTERISTIC
/begin CHARACTERISTIC TQS16_YAW_LIMIT_ST_FAST_ENTER "" VALUE 0x80020AB0 CalPrmLatDynsCoorrBrk_SWORD 0 Gain -32768 32767 SYMBOL_LINK "CalPrmLatDynsCoorrBrk01.TQS16_YAW_LIMIT_ST_FAST_ENTER" 0 /end CHARACTERISTIC
/begin CHARACTERISTIC TQS16_YAW_LIMIT_ST_SLOW_ENTER "" VALUE 0x80020AB2 CalPrmLatDynsCoorrBrk_SWORD 0 Gain -32768 32767 SYMBOL_LINK "CalPrmLatDynsCoorrBrk01.TQS16_YAW_LIMIT_ST_SLOW_ENTER" 0 /end CHARACTERISTIC
/begin CHARACTERISTIC TQS16_YAW_LIMIT_ST_VSLOW_ENTER_H "" VALUE 0x80020AB4 CalPrmLatDynsCoorrBrk_SWORD 0 Gain -32768 32767 SYMBOL_LINK "CalPrmLatDynsCoorrBrk01.TQS16_YAW_LIMIT_ST_VSLOW_ENTER_H" 0 /end CHARACTERISTIC
/begin CHARACTERISTIC TQS16_YAW_LIMIT_ST_VSLOW_ENTER_M "" VALUE 0x80020AB6 CalPrmLatDynsCoorrBrk_SWORD 0 Gain -32768 32767 SYMBOL_LINK "CalPrmLatDynsCoorrBrk01.TQS16_YAW_LIMIT_ST_VSLOW_ENTER_M" 0 /end CHARACTERISTIC
/begin CHARACTERISTIC TQS16_YAW_LIMIT_WSTR_DEC_GAIN_H "" VALUE 0x80020A82 CalPrmLatDynsCoorrBrk_SWORD 0 Gain -32768 32767 SYMBOL_LINK "CalPrmLatDynsCoorrBrk01.TQS16_YAW_LIMIT_WSTR_DEC_GAIN_H" 0 /end CHARACTERISTIC
/begin CHARACTERISTIC TQS16_YAW_LIMIT_WSTR_DEC_GAIN_L "" VALUE 0x80020AAC CalPrmLatDynsCoorrBrk_SWORD 0 Gain -32768 32767 SYMBOL_LINK "CalPrmLatDynsCoorrBrk01.TQS16_YAW_LIMIT_WSTR_DEC_GAIN_L" 0 /end CHARACTERISTIC
/begin CHARACTERISTIC TQS16_YAW_LIMIT_WSTR_DEC_GAIN_M "" VALUE 0x80020A98 CalPrmLatDynsCoorrBrk_SWORD 0 Gain -32768 32767 SYMBOL_LINK "CalPrmLatDynsCoorrBrk01.TQS16_YAW_LIMIT_WSTR_DEC_GAIN_M" 0 /end CHARACTERISTIC
/begin CHARACTERISTIC TQS16_YAW_LMT_WEG_SLOW_STR_MU_H "" VALUE 0x80020A84 CalPrmLatDynsCoorrBrk_SWORD 0 Gain -32768 32767 SYMBOL_LINK "CalPrmLatDynsCoorrBrk01.TQS16_YAW_LMT_WEG_SLOW_STR_MU_H" 0 /end CHARACTERISTIC
/begin CHARACTERISTIC TQS16_YAW_LMT_WEG_SLOW_STR_MU_L "" VALUE 0x80020AAE CalPrmLatDynsCoorrBrk_SWORD 0 Gain -32768 32767 SYMBOL_LINK "CalPrmLatDynsCoorrBrk01.TQS16_YAW_LMT_WEG_SLOW_STR_MU_L" 0 /end CHARACTERISTIC
/begin CHARACTERISTIC TQS16_YAW_LMT_WEG_SLOW_STR_MU_M "" VALUE 0x80020A9A CalPrmLatDynsCoorrBrk_SWORD 0 Gain -32768 32767 SYMBOL_LINK "CalPrmLatDynsCoorrBrk01.TQS16_YAW_LMT_WEG_SLOW_STR_MU_M" 0 /end CHARACTERISTIC
/begin CHARACTERISTIC TQS16_YAW_SIGN_CH_THRESHOLD "" VALUE 0x800209F0 CalPrmLatDynsCoorrBrk_SWORD 0 Gain -32768 32767 SYMBOL_LINK "CalPrmLatDynsCoorrBrk01.TQS16_YAW_SIGN_CH_THRESHOLD" 0 /end CHARACTERISTIC
/begin CHARACTERISTIC TQS16_YC_AY_VX_DOT_DCT_OS_YAW "" VALUE 0x80020A20 CalPrmLatDynsCoorrBrk_SWORD 0 Gain -32768 32767 SYMBOL_LINK "CalPrmLatDynsCoorrBrk01.TQS16_YC_AY_VX_DOT_DCT_OS_YAW" 0 /end CHARACTERISTIC
/begin CHARACTERISTIC TQS16_YC_AY_VX_DOT_HIG_V_1ST "" VALUE 0x80020A24 CalPrmLatDynsCoorrBrk_SWORD 0 Gain -32768 32767 SYMBOL_LINK "CalPrmLatDynsCoorrBrk01.TQS16_YC_AY_VX_DOT_HIG_V_1ST" 0 /end CHARACTERISTIC
/begin CHARACTERISTIC TQS16_YC_AY_VX_DOT_HIG_V_1ST_Mmu "" VALUE 0x80020A42 CalPrmLatDynsCoorrBrk_SWORD 0 Gain -32768 32767 SYMBOL_LINK "CalPrmLatDynsCoorrBrk01.TQS16_YC_AY_VX_DOT_HIG_V_1ST_Mmu" 0 /end CHARACTERISTIC
/begin CHARACTERISTIC TQS16_YC_AY_VX_DOT_HIG_V_2ND "" VALUE 0x80020A2E CalPrmLatDynsCoorrBrk_SWORD 0 Gain -32768 32767 SYMBOL_LINK "CalPrmLatDynsCoorrBrk01.TQS16_YC_AY_VX_DOT_HIG_V_2ND" 0 /end CHARACTERISTIC
/begin CHARACTERISTIC TQS16_YC_AY_VX_DOT_HIG_V_2ND_Mmu "" VALUE 0x80020A4C CalPrmLatDynsCoorrBrk_SWORD 0 Gain -32768 32767 SYMBOL_LINK "CalPrmLatDynsCoorrBrk01.TQS16_YC_AY_VX_DOT_HIG_V_2ND_Mmu" 0 /end CHARACTERISTIC
/begin CHARACTERISTIC TQS16_YC_AY_VX_DOT_LOW_V_1ST "" VALUE 0x80020A28 CalPrmLatDynsCoorrBrk_SWORD 0 Gain -32768 32767 SYMBOL_LINK "CalPrmLatDynsCoorrBrk01.TQS16_YC_AY_VX_DOT_LOW_V_1ST" 0 /end CHARACTERISTIC
/begin CHARACTERISTIC TQS16_YC_AY_VX_DOT_LOW_V_1ST_Mmu "" VALUE 0x80020A44 CalPrmLatDynsCoorrBrk_SWORD 0 Gain -32768 32767 SYMBOL_LINK "CalPrmLatDynsCoorrBrk01.TQS16_YC_AY_VX_DOT_LOW_V_1ST_Mmu" 0 /end CHARACTERISTIC
/begin CHARACTERISTIC TQS16_YC_AY_VX_DOT_LOW_V_2ND "" VALUE 0x80020A32 CalPrmLatDynsCoorrBrk_SWORD 0 Gain -32768 32767 SYMBOL_LINK "CalPrmLatDynsCoorrBrk01.TQS16_YC_AY_VX_DOT_LOW_V_2ND" 0 /end CHARACTERISTIC
/begin CHARACTERISTIC TQS16_YC_AY_VX_DOT_LOW_V_2ND_Mmu "" VALUE 0x80020A4E CalPrmLatDynsCoorrBrk_SWORD 0 Gain -32768 32767 SYMBOL_LINK "CalPrmLatDynsCoorrBrk01.TQS16_YC_AY_VX_DOT_LOW_V_2ND_Mmu" 0 /end CHARACTERISTIC
/begin CHARACTERISTIC TQS16_YC_AY_VX_DOT_MED1_V_1ST "" VALUE 0x80020A26 CalPrmLatDynsCoorrBrk_SWORD 0 Gain -32768 32767 SYMBOL_LINK "CalPrmLatDynsCoorrBrk01.TQS16_YC_AY_VX_DOT_MED1_V_1ST" 0 /end CHARACTERISTIC
/begin CHARACTERISTIC TQS16_YC_AY_VX_DOT_MED1_V_1ST_Mmu "" VALUE 0x80020A46 CalPrmLatDynsCoorrBrk_SWORD 0 Gain -32768 32767 SYMBOL_LINK "CalPrmLatDynsCoorrBrk01.TQS16_YC_AY_VX_DOT_MED1_V_1ST_Mmu" 0 /end CHARACTERISTIC
/begin CHARACTERISTIC TQS16_YC_AY_VX_DOT_MED1_V_2ND "" VALUE 0x80020A30 CalPrmLatDynsCoorrBrk_SWORD 0 Gain -32768 32767 SYMBOL_LINK "CalPrmLatDynsCoorrBrk01.TQS16_YC_AY_VX_DOT_MED1_V_2ND" 0 /end CHARACTERISTIC
/begin CHARACTERISTIC TQS16_YC_AY_VX_DOT_MED1_V_2ND_Mmu "" VALUE 0x80020A50 CalPrmLatDynsCoorrBrk_SWORD 0 Gain -32768 32767 SYMBOL_LINK "CalPrmLatDynsCoorrBrk01.TQS16_YC_AY_VX_DOT_MED1_V_2ND_Mmu" 0 /end CHARACTERISTIC
/begin CHARACTERISTIC TQS16_YC_AY_VX_DOT_VER_HIG_V_1ST "" VALUE 0x80020A22 CalPrmLatDynsCoorrBrk_SWORD 0 Gain -32768 32767 SYMBOL_LINK "CalPrmLatDynsCoorrBrk01.TQS16_YC_AY_VX_DOT_VER_HIG_V_1ST" 0 /end CHARACTERISTIC
/begin CHARACTERISTIC TQS16_YC_AY_VX_DOT_VER_HIG_V_1ST_Mmu "" VALUE 0x80020A48 CalPrmLatDynsCoorrBrk_SWORD 0 Gain -32768 32767 SYMBOL_LINK "CalPrmLatDynsCoorrBrk01.TQS16_YC_AY_VX_DOT_VER_HIG_V_1ST_Mmu" 0 /end CHARACTERISTIC
/begin CHARACTERISTIC TQS16_YC_AY_VX_DOT_VER_HIG_V_2ND "" VALUE 0x80020A2C CalPrmLatDynsCoorrBrk_SWORD 0 Gain -32768 32767 SYMBOL_LINK "CalPrmLatDynsCoorrBrk01.TQS16_YC_AY_VX_DOT_VER_HIG_V_2ND" 0 /end CHARACTERISTIC
/begin CHARACTERISTIC TQS16_YC_AY_VX_DOT_VER_HIG_V_2ND_Mmu "" VALUE 0x80020A52 CalPrmLatDynsCoorrBrk_SWORD 0 Gain -32768 32767 SYMBOL_LINK "CalPrmLatDynsCoorrBrk01.TQS16_YC_AY_VX_DOT_VER_HIG_V_2ND_Mmu" 0 /end CHARACTERISTIC
/begin CHARACTERISTIC TQS16_YC_AY_VX_DOT_VLOW_V_1ST "" VALUE 0x80020A2A CalPrmLatDynsCoorrBrk_SWORD 0 Gain -32768 32767 SYMBOL_LINK "CalPrmLatDynsCoorrBrk01.TQS16_YC_AY_VX_DOT_VLOW_V_1ST" 0 /end CHARACTERISTIC
/begin CHARACTERISTIC TQS16_YC_AY_VX_DOT_VLOW_V_1ST_Mmu "" VALUE 0x80020A4A CalPrmLatDynsCoorrBrk_SWORD 0 Gain -32768 32767 SYMBOL_LINK "CalPrmLatDynsCoorrBrk01.TQS16_YC_AY_VX_DOT_VLOW_V_1ST_Mmu" 0 /end CHARACTERISTIC
/begin CHARACTERISTIC TQS16_YC_AY_VX_DOT_VLOW_V_2ND "" VALUE 0x80020A34 CalPrmLatDynsCoorrBrk_SWORD 0 Gain -32768 32767 SYMBOL_LINK "CalPrmLatDynsCoorrBrk01.TQS16_YC_AY_VX_DOT_VLOW_V_2ND" 0 /end CHARACTERISTIC
/begin CHARACTERISTIC TQS16_YC_AY_VX_DOT_VLOW_V_2ND_Mmu "" VALUE 0x80020A54 CalPrmLatDynsCoorrBrk_SWORD 0 Gain -32768 32767 SYMBOL_LINK "CalPrmLatDynsCoorrBrk01.TQS16_YC_AY_VX_DOT_VLOW_V_2ND_Mmu" 0 /end CHARACTERISTIC
/begin CHARACTERISTIC TQS16_YC_AY_VX_DOT_YAW_LMT_WEG "" VALUE 0x80020A3C CalPrmLatDynsCoorrBrk_SWORD 0 Gain -32768 32767 SYMBOL_LINK "CalPrmLatDynsCoorrBrk01.TQS16_YC_AY_VX_DOT_YAW_LMT_WEG" 0 /end CHARACTERISTIC
/begin CHARACTERISTIC TQS16_YC_AY_VX_DOT_YAW_LMT_WEG_1ST "" VALUE 0x80020A3E CalPrmLatDynsCoorrBrk_SWORD 0 Gain -32768 32767 SYMBOL_LINK "CalPrmLatDynsCoorrBrk01.TQS16_YC_AY_VX_DOT_YAW_LMT_WEG_1ST" 0 /end CHARACTERISTIC
/begin CHARACTERISTIC TQS16_YC_AY_VX_DOT_YAW_LMT_WEG_1ST_Mmu "" VALUE 0x80020A36 CalPrmLatDynsCoorrBrk_SWORD 0 Gain -32768 32767 SYMBOL_LINK "CalPrmLatDynsCoorrBrk01.TQS16_YC_AY_VX_DOT_YAW_LMT_WEG_1ST_Mmu" 0 /end CHARACTERISTIC
/begin CHARACTERISTIC TQS16_YC_AY_VX_DOT_YAW_LMT_WEG_2ND "" VALUE 0x80020A40 CalPrmLatDynsCoorrBrk_SWORD 0 Gain -32768 32767 SYMBOL_LINK "CalPrmLatDynsCoorrBrk01.TQS16_YC_AY_VX_DOT_YAW_LMT_WEG_2ND" 0 /end CHARACTERISTIC
/begin CHARACTERISTIC TQS16_YC_AY_VX_DOT_YAW_LMT_WEG_2ND_Mmu "" VALUE 0x80020A38 CalPrmLatDynsCoorrBrk_SWORD 0 Gain -32768 32767 SYMBOL_LINK "CalPrmLatDynsCoorrBrk01.TQS16_YC_AY_VX_DOT_YAW_LMT_WEG_2ND_Mmu" 0 /end CHARACTERISTIC
/begin CHARACTERISTIC TQS16_YC_AY_VX_DOT_YAW_LMT_WEG_Mmu "" VALUE 0x80020A3A CalPrmLatDynsCoorrBrk_SWORD 0 Gain -32768 32767 SYMBOL_LINK "CalPrmLatDynsCoorrBrk01.TQS16_YC_AY_VX_DOT_YAW_LMT_WEG_Mmu" 0 /end CHARACTERISTIC
/begin CHARACTERISTIC TQS16_YC_SP_DEP_HIG_ABS_GAIN "" VALUE 0x800208EE CalPrmLatDynsCoorrBrk_SWORD 0 Gain -32768 32767 SYMBOL_LINK "CalPrmLatDynsCoorrBrk01.TQS16_YC_SP_DEP_HIG_ABS_GAIN" 0 /end CHARACTERISTIC
/begin CHARACTERISTIC TQS16_YC_SP_DEP_HIG_ABS_H_GAIN "" VALUE 0x800208F8 CalPrmLatDynsCoorrBrk_SWORD 0 Gain -32768 32767 SYMBOL_LINK "CalPrmLatDynsCoorrBrk01.TQS16_YC_SP_DEP_HIG_ABS_H_GAIN" 0 /end CHARACTERISTIC
/begin CHARACTERISTIC TQS16_YC_SP_DEP_HIG_ABS_L_GAIN "" VALUE 0x800208E6 CalPrmLatDynsCoorrBrk_SWORD 0 Gain -32768 32767 SYMBOL_LINK "CalPrmLatDynsCoorrBrk01.TQS16_YC_SP_DEP_HIG_ABS_L_GAIN" 0 /end CHARACTERISTIC
/begin CHARACTERISTIC TQS16_YC_SP_DEP_HIG_ABS_VH_GAIN "" VALUE 0x80020A60 CalPrmLatDynsCoorrBrk_SWORD 0 Gain -32768 32767 SYMBOL_LINK "CalPrmLatDynsCoorrBrk01.TQS16_YC_SP_DEP_HIG_ABS_VH_GAIN" 0 /end CHARACTERISTIC
/begin CHARACTERISTIC TQS16_YC_SP_DEP_LOW_ABS_GAIN "" VALUE 0x800208F2 CalPrmLatDynsCoorrBrk_SWORD 0 Gain -32768 32767 SYMBOL_LINK "CalPrmLatDynsCoorrBrk01.TQS16_YC_SP_DEP_LOW_ABS_GAIN" 0 /end CHARACTERISTIC
/begin CHARACTERISTIC TQS16_YC_SP_DEP_LOW_ABS_H_GAIN "" VALUE 0x800208FC CalPrmLatDynsCoorrBrk_SWORD 0 Gain -32768 32767 SYMBOL_LINK "CalPrmLatDynsCoorrBrk01.TQS16_YC_SP_DEP_LOW_ABS_H_GAIN" 0 /end CHARACTERISTIC
/begin CHARACTERISTIC TQS16_YC_SP_DEP_LOW_ABS_L_GAIN "" VALUE 0x800208EA CalPrmLatDynsCoorrBrk_SWORD 0 Gain -32768 32767 SYMBOL_LINK "CalPrmLatDynsCoorrBrk01.TQS16_YC_SP_DEP_LOW_ABS_L_GAIN" 0 /end CHARACTERISTIC
/begin CHARACTERISTIC TQS16_YC_SP_DEP_LOW_ABS_VH_GAIN "" VALUE 0x80020A62 CalPrmLatDynsCoorrBrk_SWORD 0 Gain -32768 32767 SYMBOL_LINK "CalPrmLatDynsCoorrBrk01.TQS16_YC_SP_DEP_LOW_ABS_VH_GAIN" 0 /end CHARACTERISTIC
/begin CHARACTERISTIC TQS16_YC_SP_DEP_MED_ABS_GAIN "" VALUE 0x800208F0 CalPrmLatDynsCoorrBrk_SWORD 0 Gain -32768 32767 SYMBOL_LINK "CalPrmLatDynsCoorrBrk01.TQS16_YC_SP_DEP_MED_ABS_GAIN" 0 /end CHARACTERISTIC
/begin CHARACTERISTIC TQS16_YC_SP_DEP_MED_ABS_H_GAIN "" VALUE 0x800208FA CalPrmLatDynsCoorrBrk_SWORD 0 Gain -32768 32767 SYMBOL_LINK "CalPrmLatDynsCoorrBrk01.TQS16_YC_SP_DEP_MED_ABS_H_GAIN" 0 /end CHARACTERISTIC
/begin CHARACTERISTIC TQS16_YC_SP_DEP_MED_ABS_L_GAIN "" VALUE 0x800208E8 CalPrmLatDynsCoorrBrk_SWORD 0 Gain -32768 32767 SYMBOL_LINK "CalPrmLatDynsCoorrBrk01.TQS16_YC_SP_DEP_MED_ABS_L_GAIN" 0 /end CHARACTERISTIC
/begin CHARACTERISTIC TQS16_YC_SP_DEP_MED_ABS_VH_GAIN "" VALUE 0x80020A64 CalPrmLatDynsCoorrBrk_SWORD 0 Gain -32768 32767 SYMBOL_LINK "CalPrmLatDynsCoorrBrk01.TQS16_YC_SP_DEP_MED_ABS_VH_GAIN" 0 /end CHARACTERISTIC
/begin CHARACTERISTIC TQS16_YC_SP_DEP_VLOW_ABS_GAIN "" VALUE 0x800208F4 CalPrmLatDynsCoorrBrk_SWORD 0 Gain -32768 32767 SYMBOL_LINK "CalPrmLatDynsCoorrBrk01.TQS16_YC_SP_DEP_VLOW_ABS_GAIN" 0 /end CHARACTERISTIC
/begin CHARACTERISTIC TQS16_YC_SP_DEP_VLOW_ABS_H_GAIN "" VALUE 0x800208FE CalPrmLatDynsCoorrBrk_SWORD 0 Gain -32768 32767 SYMBOL_LINK "CalPrmLatDynsCoorrBrk01.TQS16_YC_SP_DEP_VLOW_ABS_H_GAIN" 0 /end CHARACTERISTIC
/begin CHARACTERISTIC TQS16_YC_SP_DEP_VLOW_ABS_L_GAIN "" VALUE 0x800208EC CalPrmLatDynsCoorrBrk_SWORD 0 Gain -32768 32767 SYMBOL_LINK "CalPrmLatDynsCoorrBrk01.TQS16_YC_SP_DEP_VLOW_ABS_L_GAIN" 0 /end CHARACTERISTIC
/begin CHARACTERISTIC TQS16_YC_SP_DEP_VLOW_ABS_VH_GAIN "" VALUE 0x80020A66 CalPrmLatDynsCoorrBrk_SWORD 0 Gain -32768 32767 SYMBOL_LINK "CalPrmLatDynsCoorrBrk01.TQS16_YC_SP_DEP_VLOW_ABS_VH_GAIN" 0 /end CHARACTERISTIC
/begin CHARACTERISTIC TQS16_YC_SP_DEP_V_HIG_ABS_GAIN "" VALUE 0x800208F6 CalPrmLatDynsCoorrBrk_SWORD 0 Gain -32768 32767 SYMBOL_LINK "CalPrmLatDynsCoorrBrk01.TQS16_YC_SP_DEP_V_HIG_ABS_GAIN" 0 /end CHARACTERISTIC
/begin CHARACTERISTIC TQS16_YC_SP_DEP_V_HIG_ABS_H_GAIN "" VALUE 0x80020900 CalPrmLatDynsCoorrBrk_SWORD 0 Gain -32768 32767 SYMBOL_LINK "CalPrmLatDynsCoorrBrk01.TQS16_YC_SP_DEP_V_HIG_ABS_H_GAIN" 0 /end CHARACTERISTIC
/begin CHARACTERISTIC TQS16_YC_SP_DEP_V_HIG_ABS_L_GAIN "" VALUE 0x80020A6A CalPrmLatDynsCoorrBrk_SWORD 0 Gain -32768 32767 SYMBOL_LINK "CalPrmLatDynsCoorrBrk01.TQS16_YC_SP_DEP_V_HIG_ABS_L_GAIN" 0 /end CHARACTERISTIC
/begin CHARACTERISTIC TQS16_YC_SP_DEP_V_HIG_ABS_VH_GAIN "" VALUE 0x80020A68 CalPrmLatDynsCoorrBrk_SWORD 0 Gain -32768 32767 SYMBOL_LINK "CalPrmLatDynsCoorrBrk01.TQS16_YC_SP_DEP_V_HIG_ABS_VH_GAIN" 0 /end CHARACTERISTIC
/begin CHARACTERISTIC TQS8_X1_FadeOut_Ay_Thres_Weg "" VALUE 0x8002082E CalPrmLatDynsCoorrBrk_SBYTE 0 Gain -128 127 SYMBOL_LINK "CalPrmLatDynsCoorrBrk01.TQS8_X1_FadeOut_Ay_Thres_Weg" 0 /end CHARACTERISTIC
/begin CHARACTERISTIC TQS8_X2_FadeOut_Ay_Thres_Weg "" VALUE 0x8002082F CalPrmLatDynsCoorrBrk_SBYTE 0 Gain -128 127 SYMBOL_LINK "CalPrmLatDynsCoorrBrk01.TQS8_X2_FadeOut_Ay_Thres_Weg" 0 /end CHARACTERISTIC
/begin CHARACTERISTIC TQS8_X3_FadeOut_Ay_Thres_Weg "" VALUE 0x80020830 CalPrmLatDynsCoorrBrk_SBYTE 0 Gain -128 127 SYMBOL_LINK "CalPrmLatDynsCoorrBrk01.TQS8_X3_FadeOut_Ay_Thres_Weg" 0 /end CHARACTERISTIC
/begin CHARACTERISTIC TQS8_X4_FadeOut_Ay_Thres_Weg "" VALUE 0x80020831 CalPrmLatDynsCoorrBrk_SBYTE 0 Gain -128 127 SYMBOL_LINK "CalPrmLatDynsCoorrBrk01.TQS8_X4_FadeOut_Ay_Thres_Weg" 0 /end CHARACTERISTIC
/begin CHARACTERISTIC U8_WPE_LFC_Rise_Duty_r_10th "Temp" VALUE 0x800216DD CalPrmBrkTqCtrlrBrk_UBYTE 0 Gain 0 255 SYMBOL_LINK "CalPrmBrkTqCtrlrBrk01.U8_WPE_LFC_Rise_Duty_r_10th" 0 /end CHARACTERISTIC
/begin CHARACTERISTIC U8_WPE_LFC_Rise_Duty_r_11th "Temp" VALUE 0x800216DE CalPrmBrkTqCtrlrBrk_UBYTE 0 Gain 0 255 SYMBOL_LINK "CalPrmBrkTqCtrlrBrk01.U8_WPE_LFC_Rise_Duty_r_11th" 0 /end CHARACTERISTIC
/begin CHARACTERISTIC U8_WPE_LFC_Rise_Duty_r_1st "Temp" VALUE 0x800216D4 CalPrmBrkTqCtrlrBrk_UBYTE 0 Gain 0 255 SYMBOL_LINK "CalPrmBrkTqCtrlrBrk01.U8_WPE_LFC_Rise_Duty_r_1st" 0 /end CHARACTERISTIC
/begin CHARACTERISTIC U8_WPE_LFC_Rise_Duty_r_2nd "Temp" VALUE 0x800216D5 CalPrmBrkTqCtrlrBrk_UBYTE 0 Gain 0 255 SYMBOL_LINK "CalPrmBrkTqCtrlrBrk01.U8_WPE_LFC_Rise_Duty_r_2nd" 0 /end CHARACTERISTIC
/begin CHARACTERISTIC U8_WPE_LFC_Rise_Duty_r_3rd "Temp" VALUE 0x800216D6 CalPrmBrkTqCtrlrBrk_UBYTE 0 Gain 0 255 SYMBOL_LINK "CalPrmBrkTqCtrlrBrk01.U8_WPE_LFC_Rise_Duty_r_3rd" 0 /end CHARACTERISTIC
/begin CHARACTERISTIC U8_WPE_LFC_Rise_Duty_r_4th "Temp" VALUE 0x800216D7 CalPrmBrkTqCtrlrBrk_UBYTE 0 Gain 0 255 SYMBOL_LINK "CalPrmBrkTqCtrlrBrk01.U8_WPE_LFC_Rise_Duty_r_4th" 0 /end CHARACTERISTIC
/begin CHARACTERISTIC U8_WPE_LFC_Rise_Duty_r_5th "Temp" VALUE 0x800216D8 CalPrmBrkTqCtrlrBrk_UBYTE 0 Gain 0 255 SYMBOL_LINK "CalPrmBrkTqCtrlrBrk01.U8_WPE_LFC_Rise_Duty_r_5th" 0 /end CHARACTERISTIC
/begin CHARACTERISTIC U8_WPE_LFC_Rise_Duty_r_6th "Temp" VALUE 0x800216D9 CalPrmBrkTqCtrlrBrk_UBYTE 0 Gain 0 255 SYMBOL_LINK "CalPrmBrkTqCtrlrBrk01.U8_WPE_LFC_Rise_Duty_r_6th" 0 /end CHARACTERISTIC
/begin CHARACTERISTIC U8_WPE_LFC_Rise_Duty_r_7th "Temp" VALUE 0x800216DA CalPrmBrkTqCtrlrBrk_UBYTE 0 Gain 0 255 SYMBOL_LINK "CalPrmBrkTqCtrlrBrk01.U8_WPE_LFC_Rise_Duty_r_7th" 0 /end CHARACTERISTIC
/begin CHARACTERISTIC U8_WPE_LFC_Rise_Duty_r_8th "Temp" VALUE 0x800216DB CalPrmBrkTqCtrlrBrk_UBYTE 0 Gain 0 255 SYMBOL_LINK "CalPrmBrkTqCtrlrBrk01.U8_WPE_LFC_Rise_Duty_r_8th" 0 /end CHARACTERISTIC
/begin CHARACTERISTIC U8_WPE_LFC_Rise_Duty_r_9th "Temp" VALUE 0x800216DC CalPrmBrkTqCtrlrBrk_UBYTE 0 Gain 0 255 SYMBOL_LINK "CalPrmBrkTqCtrlrBrk01.U8_WPE_LFC_Rise_Duty_r_9th" 0 /end CHARACTERISTIC
/begin COMPU_METHOD A20 "" LINEAR "%.15" "g" COEFFS_LINEAR 0.25 0 /end COMPU_METHOD
/begin COMPU_METHOD A41 "" LINEAR "%.15" "g" COEFFS_LINEAR 0.001 0 /end COMPU_METHOD
/begin COMPU_METHOD Gain "" LINEAR "%.15" "NA" COEFFS_LINEAR 1 0 /end COMPU_METHOD
/begin COMPU_METHOD P34 "" LINEAR "%.15" "bar" COEFFS_LINEAR 0.1 0 /end COMPU_METHOD
/begin COMPU_METHOD Perc6 "" LINEAR "%.15" "Percentage" COEFFS_LINEAR 1 0 /end COMPU_METHOD
/begin COMPU_METHOD Spd12 "" LINEAR "%.15" "kph" COEFFS_LINEAR 0.125 0 /end COMPU_METHOD
/begin COMPU_METHOD Ti21 "" LINEAR "%.15" "sec" COEFFS_LINEAR 0.01 0 /end COMPU_METHOD
/begin COMPU_METHOD Tq2 "" LINEAR "%.15" "Nm" COEFFS_LINEAR 1 0 /end COMPU_METHOD
/begin COMPU_METHOD TqGrdt10 "" LINEAR "%.15" "Nm/10ms" COEFFS_LINEAR 1 0 /end COMPU_METHOD
/begin COMPU_METHOD TqGrdt11 "" LINEAR "%.15" "Nm/100ms" COEFFS_LINEAR 1 0 /end COMPU_METHOD
/begin RECORD_LAYOUT CalPrmBrkTqCtrlrBrk_SWORD FNC_VALUES 1 SWORD COLUMN_DIR DIRECT ALIGNMENT_BYTE 1 ALIGNMENT_WORD 1 ALIGNMENT_LONG 1 ALIGNMENT_FLOAT32_IEEE 1 ALIGNMENT_FLOAT64_IEEE 1 ALIGNMENT_INT64 1 /end RECORD_LAYOUT
/begin RECORD_LAYOUT CalPrmBrkTqCtrlrBrk_UBYTE FNC_VALUES 1 UBYTE COLUMN_DIR DIRECT ALIGNMENT_BYTE 1 ALIGNMENT_WORD 1 ALIGNMENT_LONG 1 ALIGNMENT_FLOAT32_IEEE 1 ALIGNMENT_FLOAT64_IEEE 1 ALIGNMENT_INT64 1 /end RECORD_LAYOUT
/begin RECORD_LAYOUT CalPrmLatDynsCoorrBrk_SBYTE FNC_VALUES 1 SBYTE COLUMN_DIR DIRECT ALIGNMENT_BYTE 1 ALIGNMENT_WORD 1 ALIGNMENT_LONG 1 ALIGNMENT_FLOAT32_IEEE 1 ALIGNMENT_FLOAT64_IEEE 1 ALIGNMENT_INT64 1 /end RECORD_LAYOUT
/begin RECORD_LAYOUT CalPrmLatDynsCoorrBrk_SWORD FNC_VALUES 1 SWORD COLUMN_DIR DIRECT ALIGNMENT_BYTE 1 ALIGNMENT_WORD 1 ALIGNMENT_LONG 1 ALIGNMENT_FLOAT32_IEEE 1 ALIGNMENT_FLOAT64_IEEE 1 ALIGNMENT_INT64 1 /end RECORD_LAYOUT
/begin RECORD_LAYOUT CalPrmWslcBrk_SBYTE FNC_VALUES 1 SBYTE COLUMN_DIR DIRECT ALIGNMENT_BYTE 1 ALIGNMENT_WORD 1 ALIGNMENT_LONG 1 ALIGNMENT_FLOAT32_IEEE 1 ALIGNMENT_FLOAT64_IEEE 1 ALIGNMENT_INT64 1 /end RECORD_LAYOUT
/begin RECORD_LAYOUT CalPrmWslcBrk_SWORD FNC_VALUES 1 SWORD COLUMN_DIR DIRECT ALIGNMENT_BYTE 1 ALIGNMENT_WORD 1 ALIGNMENT_LONG 1 ALIGNMENT_FLOAT32_IEEE 1 ALIGNMENT_FLOAT64_IEEE 1 ALIGNMENT_INT64 1 /end RECORD_LAYOUT
/begin RECORD_LAYOUT CalPrmWslcBrk_UBYTE FNC_VALUES 1 UBYTE COLUMN_DIR DIRECT ALIGNMENT_BYTE 1 ALIGNMENT_WORD 1 ALIGNMENT_LONG 1 ALIGNMENT_FLOAT32_IEEE 1 ALIGNMENT_FLOAT64_IEEE 1 ALIGNMENT_INT64 1 /end RECORD_LAYOUT
/begin RECORD_LAYOUT CalPrmWspcEng_SBYTE FNC_VALUES 1 SBYTE COLUMN_DIR DIRECT ALIGNMENT_BYTE 1 ALIGNMENT_WORD 1 ALIGNMENT_LONG 1 ALIGNMENT_FLOAT32_IEEE 1 ALIGNMENT_FLOAT64_IEEE 1 ALIGNMENT_INT64 1 /end RECORD_LAYOUT
/begin RECORD_LAYOUT CalPrmWspcEng_SWORD FNC_VALUES 1 SWORD COLUMN_DIR DIRECT ALIGNMENT_BYTE 1 ALIGNMENT_WORD 1 ALIGNMENT_LONG 1 ALIGNMENT_FLOAT32_IEEE 1 ALIGNMENT_FLOAT64_IEEE 1 ALIGNMENT_INT64 1 /end RECORD_LAYOUT
/begin RECORD_LAYOUT CalPrmWspcEng_UBYTE FNC_VALUES 1 UBYTE COLUMN_DIR DIRECT ALIGNMENT_BYTE 1 ALIGNMENT_WORD 1 ALIGNMENT_LONG 1 ALIGNMENT_FLOAT32_IEEE 1 ALIGNMENT_FLOAT64_IEEE 1 ALIGNMENT_INT64 1 /end RECORD_LAYOUT
/begin RECORD_LAYOUT __SBYTE_Z FNC_VALUES 1 SBYTE ROW_DIR DIRECT /end RECORD_LAYOUT
/begin RECORD_LAYOUT __SLONG_S FNC_VALUES 1 SLONG COLUMN_DIR DIRECT /end RECORD_LAYOUT
/begin RECORD_LAYOUT __SLONG_Z FNC_VALUES 1 SLONG ROW_DIR DIRECT /end RECORD_LAYOUT
/begin RECORD_LAYOUT __SWORD_S FNC_VALUES 1 SWORD COLUMN_DIR DIRECT /end RECORD_LAYOUT
/begin RECORD_LAYOUT __SWORD_Z FNC_VALUES 1 SWORD ROW_DIR DIRECT /end RECORD_LAYOUT
/begin RECORD_LAYOUT __UBYTE_S FNC_VALUES 1 UBYTE COLUMN_DIR DIRECT /end RECORD_LAYOUT
/begin RECORD_LAYOUT __UBYTE_Z FNC_VALUES 1 UBYTE ROW_DIR DIRECT /end RECORD_LAYOUT
/begin RECORD_LAYOUT __ULONG_S FNC_VALUES 1 ULONG COLUMN_DIR DIRECT /end RECORD_LAYOUT
/begin RECORD_LAYOUT __ULONG_Z FNC_VALUES 1 ULONG ROW_DIR DIRECT /end RECORD_LAYOUT
/begin RECORD_LAYOUT __UWORD_S FNC_VALUES 1 UWORD COLUMN_DIR DIRECT /end RECORD_LAYOUT
/begin RECORD_LAYOUT __UWORD_Z FNC_VALUES 1 UWORD ROW_DIR DIRECT /end RECORD_LAYOUT
/begin GROUP ed.Esc_Abs_Cor ""
 /begin REF_CHARACTERISTIC TQS16_MP_X1 TQS16_MP_X2 TQS16_MP_X3 TQS16_MP_X4 TQS16_TORQ_BASE_ADD_HMU TQS16_TORQ_BASE_ADD_HMU_MP_X1 TQS16_TORQ_BASE_ADD_HMU_MP_X2 TQS16_TORQ_BASE_ADD_HMU_MP_X3 TQS16_TORQ_BASE_ADD_HMU_MP_X4 TQS16_TORQ_BASE_ADD_LMU TQS16_TORQ_BASE_ADD_LMU_MP_X1 TQS16_TORQ_BASE_ADD_LMU_MP_X2 TQS16_TORQ_BASE_ADD_LMU_MP_X3 TQS16_TORQ_BASE_ADD_LMU_MP_X4 TQS16_TORQ_BASE_ADD_MMU TQS16_TORQ_BASE_ADD_MMU_MP_X1 TQS16_TORQ_BASE_ADD_MMU_MP_X2 TQS16_TORQ_BASE_ADD_MMU_MP_X3 TQS16_TORQ_BASE_ADD_MMU_MP_X4 TQS16_YC_SP_DEP_HIG_ABS_GAIN TQS16_YC_SP_DEP_HIG_ABS_H_GAIN TQS16_YC_SP_DEP_HIG_ABS_L_GAIN TQS16_YC_SP_DEP_HIG_ABS_VH_GAIN TQS16_YC_SP_DEP_LOW_ABS_GAIN TQS16_YC_SP_DEP_LOW_ABS_H_GAIN TQS16_YC_SP_DEP_LOW_ABS_L_GAIN TQS16_YC_SP_DEP_LOW_ABS_VH_GAIN TQS16_YC_SP_DEP_MED_ABS_GAIN TQS16_YC_SP_DEP_MED_ABS_H_GAIN TQS16_YC_SP_DEP_MED_ABS_L_GAIN TQS16_YC_SP_DEP_MED_ABS_VH_GAIN TQS16_YC_SP_DEP_VLOW_ABS_GAIN TQS16_YC_SP_DEP_VLOW_ABS_H_GAIN TQS16_YC_SP_DEP_VLOW_ABS_L_GAIN TQS16_YC_SP_DEP_VLOW_ABS_VH_GAIN TQS16_YC_SP_DEP_V_HIG_ABS_GAIN TQS16_YC_SP_DEP_V_HIG_ABS_H_GAIN TQS16_YC_SP_DEP_V_HIG_ABS_L_GAIN TQS16_YC_SP_DEP_V_HIG_ABS_VH_GAIN /end REF_CHARACTERISTIC
/end GROUP
/begin GROUP ee.MuSlipCurve ""
 /begin REF_CHARACTERISTIC TQMuSlipCurve_Alpha_HM_MAX TQMuSlipCurve_Alpha_HM_MIN TQMuSlipCurve_Alpha_LM_MAX TQMuSlipCurve_Alpha_LM_MIN TQMuSlipCurve_Alpha_MM_MAX TQMuSlipCurve_Alpha_MM_MIN TQMuSlipCurve_FRICT_H_11 TQMuSlipCurve_FRICT_H_12 TQMuSlipCurve_FRICT_H_13 TQMuSlipCurve_FRICT_H_14 TQMuSlipCurve_FRICT_H_15 TQMuSlipCurve_FRICT_H_21 TQMuSlipCurve_FRICT_H_22 TQMuSlipCurve_FRICT_H_23 TQMuSlipCurve_FRICT_H_24 TQMuSlipCurve_FRICT_H_25 TQMuSlipCurve_FRICT_L_11 TQMuSlipCurve_FRICT_L_12 TQMuSlipCurve_FRICT_L_13 TQMuSlipCurve_FRICT_L_14 TQMuSlipCurve_FRICT_L_15 TQMuSlipCurve_FRICT_L_21 TQMuSlipCurve_FRICT_L_22 TQMuSlipCurve_FRICT_L_23 TQMuSlipCurve_FRICT_L_24 TQMuSlipCurve_FRICT_L_25 TQMuSlipCurve_FRICT_M_11 TQMuSlipCurve_FRICT_M_12 TQMuSlipCurve_FRICT_M_13 TQMuSlipCurve_FRICT_M_14 TQMuSlipCurve_FRICT_M_15 TQMuSlipCurve_FRICT_M_21 TQMuSlipCurve_FRICT_M_22 TQMuSlipCurve_FRICT_M_23 TQMuSlipCurve_FRICT_M_24 TQMuSlipCurve_FRICT_M_25 TQMuSlipCurve_Slip_1 TQMuSlipCurve_Slip_2 TQMuSlipCurve_Slip_3 TQMuSlipCurve_Slip_4 TQMuSlipCurve_Slip_5 /end REF_CHARACTERISTIC
/end GROUP
/begin GROUP ef.Bank_road ""
 /begin REF_CHARACTERISTIC TQS16_BANK_THRES_ADD_ALAT_COND_OF_LOW_SUS TQS16_BANK_THRES_ADD_VREF_COND_OF_LOW_SUS TQS16_X1_Lower_Sus_Bank_Angle TQS16_X2_Suspect_Bank_Angle TQS16_X3_Detect_Bank_Angle TQS16_X4_Max_Bank_Angle TQS16_Y1_Bank_Lower_Sus_Add_Thres2 TQS16_Y2_Bank_Suspect_Add_Thres2 TQS16_Y3_Bank_Detect_L_Add_Thres2 TQS16_Y4_Bank_Detect_U_Add_Thres2 /end REF_CHARACTERISTIC
/end GROUP
/begin GROUP eg.DelYaw_Thres ""
 /begin REF_CHARACTERISTIC TQS16_DEL_YAW_THR_SPD_0 TQS16_DEL_YAW_THR_SPD_HIG TQS16_DEL_YAW_THR_SPD_LOW TQS16_DEL_YAW_THR_SPD_MED TQS16_DEL_YAW_THR_WSTR_LARGE_VAL TQS16_SPEED_THR_HIG TQS16_SPEED_THR_LOW TQS16_SPEED_THR_MED TQS16_WSTR_THR_LARGE TQS16_WSTR_THR_MEDIU TQS16_WSTR_THR_SMALL TQS16_YAW_SIGN_CH_THRESHOLD /end REF_CHARACTERISTIC
/end GROUP
/begin GROUP eh.YC_Ay_Vx_Dot ""
 /begin REF_CHARACTERISTIC TQS16_YC_AY_VX_DOT_DCT_OS_YAW TQS16_YC_AY_VX_DOT_HIG_V_1ST TQS16_YC_AY_VX_DOT_HIG_V_1ST_Mmu TQS16_YC_AY_VX_DOT_HIG_V_2ND TQS16_YC_AY_VX_DOT_HIG_V_2ND_Mmu TQS16_YC_AY_VX_DOT_LOW_V_1ST TQS16_YC_AY_VX_DOT_LOW_V_1ST_Mmu TQS16_YC_AY_VX_DOT_LOW_V_2ND TQS16_YC_AY_VX_DOT_LOW_V_2ND_Mmu TQS16_YC_AY_VX_DOT_MED1_V_1ST TQS16_YC_AY_VX_DOT_MED1_V_1ST_Mmu TQS16_YC_AY_VX_DOT_MED1_V_2ND TQS16_YC_AY_VX_DOT_MED1_V_2ND_Mmu TQS16_YC_AY_VX_DOT_VER_HIG_V_1ST TQS16_YC_AY_VX_DOT_VER_HIG_V_1ST_Mmu TQS16_YC_AY_VX_DOT_VER_HIG_V_2ND TQS16_YC_AY_VX_DOT_VER_HIG_V_2ND_Mmu TQS16_YC_AY_VX_DOT_VLOW_V_1ST TQS16_YC_AY_VX_DOT_VLOW_V_1ST_Mmu TQS16_YC_AY_VX_DOT_VLOW_V_2ND TQS16_YC_AY_VX_DOT_VLOW_V_2ND_Mmu TQS16_YC_AY_VX_DOT_YAW_LMT_WEG TQS16_YC_AY_VX_DOT_YAW_LMT_WEG_1ST TQS16_YC_AY_VX_DOT_YAW_LMT_WEG_1ST_Mmu TQS16_YC_AY_VX_DOT_YAW_LMT_WEG_2ND TQS16_YC_AY_VX_DOT_YAW_LMT_WEG_2ND_Mmu TQS16_YC_AY_VX_DOT_YAW_LMT_WEG_Mmu /end REF_CHARACTERISTIC
/end GROUP
/begin GROUP f.Esc_Fade_Out ""
 /begin REF_CHARACTERISTIC TQS16_FADE_OUT_THRES_CNT TQS16_FADE_OUT_THRES_CNT_REAR TQS16_FADE_OUT_THRES_TAR_TORQ TQS16_FADE_OUT_THRES_TAR_TORQ_REAR TQS16_FADE_OUT_THRES_YAW TQS16_FADE_OUT_THRES_YAW_REAR TQS16_FadeOut_DelYaw_H_WEG TQS16_FadeOut_DelYaw_L_WEG TQS16_FadeOut_DelYaw_M_WEG TQS16_FadeOut_DelYaw_Thres_H TQS16_FadeOut_DelYaw_Thres_L TQS16_FadeOut_DelYaw_Thres_M TQS16_FadeOut_DelYaw_Thres_VH TQS16_FadeOut_DelYaw_VH_WEG TQS16_REAR_FadeOut_TorqDec_HM TQS16_REAR_FadeOut_TorqDec_LM TQS16_REAR_FadeOut_TorqDec_MM TQS16_Y1_FadeOut_TorqDec_HM TQS16_Y1_FadeOut_TorqDec_LM TQS16_Y1_FadeOut_TorqDec_MM TQS16_Y2_FadeOut_TorqDec_HM TQS16_Y2_FadeOut_TorqDec_LM TQS16_Y2_FadeOut_TorqDec_MM TQS16_Y3_FadeOut_TorqDec_HM TQS16_Y3_FadeOut_TorqDec_LM TQS16_Y3_FadeOut_TorqDec_MM TQS16_Y4_FadeOut_TorqDec_HM TQS16_Y4_FadeOut_TorqDec_LM TQS16_Y4_FadeOut_TorqDec_MM TQS8_X1_FadeOut_Ay_Thres_Weg TQS8_X2_FadeOut_Ay_Thres_Weg TQS8_X3_FadeOut_Ay_Thres_Weg TQS8_X4_FadeOut_Ay_Thres_Weg /end REF_CHARACTERISTIC
/end GROUP
/begin GROUP f.Yaw_Limit ""
 /begin REF_CHARACTERISTIC TQS16_BRK_LMT_Ax_EST_1ST TQS16_BRK_LMT_Ax_EST_2ND TQS16_BRK_LMT_Ax_EST_3RD TQS16_BRK_LMT_Ax_EST_4TH TQS16_BRK_LMT_Ay_VALUE_1ST TQS16_BRK_LMT_Ay_VALUE_2ND TQS16_BRK_LMT_Ay_VALUE_3RD TQS16_BRK_LMT_Ay_VALUE_4TH TQS16_LIMIT_WEIGHT_H TQS16_LIMIT_WEIGHT_L TQS16_LIMIT_WEIGHT_M TQS16_YAW_LIMIT_BETAD_H_SP_CON TQS16_YAW_LIMIT_BETAD_L_SP_CON TQS16_YAW_LIMIT_BETAD_M_SP_CON TQS16_YAW_LIMIT_DELTA_HIGH_FAST TQS16_YAW_LIMIT_DELTA_HIGH_FAST_ABS TQS16_YAW_LIMIT_DELTA_HIGH_SLOW TQS16_YAW_LIMIT_DELTA_HIGH_SLOW_ABS TQS16_YAW_LIMIT_DELTA_HIGH_VSLOW TQS16_YAW_LIMIT_DELTA_HIGH_VSLOW_ABS TQS16_YAW_LIMIT_DELTA_HMU_AY_L TQS16_YAW_LIMIT_DELTA_HMU_AY_M TQS16_YAW_LIMIT_DELTA_LOW_FAST TQS16_YAW_LIMIT_DELTA_LOW_FAST_ABS TQS16_YAW_LIMIT_DELTA_LOW_SLOW TQS16_YAW_LIMIT_DELTA_LOW_SLOW_ABS TQS16_YAW_LIMIT_DELTA_LOW_VSLOW TQS16_YAW_LIMIT_DELTA_LOW_VSLOW_ABS TQS16_YAW_LIMIT_DELTA_MMU_AY_L TQS16_YAW_LIMIT_DELTA_MMU_AY_M TQS16_YAW_LIMIT_ENTER_FA_ST_H_SP TQS16_YAW_LIMIT_ENTER_FA_ST_L_SP TQS16_YAW_LIMIT_ENTER_FA_ST_M_SP TQS16_YAW_LIMIT_FA_ST_H_SP_ENT_AD TQS16_YAW_LIMIT_FA_ST_M_SP_ENT_AD TQS16_YAW_LIMIT_GAIN_H TQS16_YAW_LIMIT_GAIN_HMU_ABS TQS16_YAW_LIMIT_GAIN_HMU_HSPD TQS16_YAW_LIMIT_GAIN_HMU_LSPD TQS16_YAW_LIMIT_GAIN_HMU_MSPD TQS16_YAW_LIMIT_GAIN_H_ABS TQS16_YAW_LIMIT_GAIN_H_SL TQS16_YAW_LIMIT_GAIN_H_V1 TQS16_YAW_LIMIT_GAIN_H_V2 TQS16_YAW_LIMIT_GAIN_L TQS16_YAW_LIMIT_GAIN_LIMIT_H TQS16_YAW_LIMIT_GAIN_LIMIT_H_V1 TQS16_YAW_LIMIT_GAIN_LIMIT_H_V2 TQS16_YAW_LIMIT_GAIN_LIMIT_L TQS16_YAW_LIMIT_GAIN_LIMIT_L_V1 TQS16_YAW_LIMIT_GAIN_LIMIT_L_V2 TQS16_YAW_LIMIT_GAIN_LIMIT_M TQS16_YAW_LIMIT_GAIN_LIMIT_M_V1 TQS16_YAW_LIMIT_GAIN_LIMIT_M_V2 TQS16_YAW_LIMIT_GAIN_LMU_ABS TQS16_YAW_LIMIT_GAIN_LMU_HSPD TQS16_YAW_LIMIT_GAIN_LMU_LSPD TQS16_YAW_LIMIT_GAIN_LMU_MSPD TQS16_YAW_LIMIT_GAIN_L_ABS TQS16_YAW_LIMIT_GAIN_L_V1 TQS16_YAW_LIMIT_GAIN_L_V2 TQS16_YAW_LIMIT_GAIN_M TQS16_YAW_LIMIT_GAIN_MMU_ABS TQS16_YAW_LIMIT_GAIN_MMU_HSPD TQS16_YAW_LIMIT_GAIN_MMU_LSPD TQS16_YAW_LIMIT_GAIN_MMU_MSPD TQS16_YAW_LIMIT_GAIN_M_ABS TQS16_YAW_LIMIT_GAIN_M_V1 TQS16_YAW_LIMIT_GAIN_M_V2 TQS16_YAW_LIMIT_HMU_DEL_AY TQS16_YAW_LIMIT_H_SPEED_V1 TQS16_YAW_LIMIT_H_SPEED_V2 TQS16_YAW_LIMIT_H_SPEED_V3 TQS16_YAW_LIMIT_H_V1_INC_DEL_AY TQS16_YAW_LIMIT_H_V2_INC_DEL_AY TQS16_YAW_LIMIT_MMU_DEL_AY TQS16_YAW_LIMIT_M_SPEED_V1 TQS16_YAW_LIMIT_M_SPEED_V2 TQS16_YAW_LIMIT_M_SPEED_V3 TQS16_YAW_LIMIT_M_V1_INC_DEL_AY TQS16_YAW_LIMIT_M_V2_INC_DEL_AY TQS16_YAW_LIMIT_ST_FAST_ENTER TQS16_YAW_LIMIT_ST_SLOW_ENTER TQS16_YAW_LIMIT_ST_VSLOW_ENTER_H TQS16_YAW_LIMIT_ST_VSLOW_ENTER_M TQS16_YAW_LIMIT_WSTR_DEC_GAIN_H TQS16_YAW_LIMIT_WSTR_DEC_GAIN_L TQS16_YAW_LIMIT_WSTR_DEC_GAIN_M TQS16_YAW_LMT_WEG_SLOW_STR_MU_H TQS16_YAW_LMT_WEG_SLOW_STR_MU_L TQS16_YAW_LMT_WEG_SLOW_STR_MU_M /end REF_CHARACTERISTIC
/end GROUP
/begin GROUP f_Above_150KPH ""
 /begin REF_CHARACTERISTIC TP_S8_Arad_1stPoint_Ab_150KPH TP_S8_Arad_2ndPoint_Ab_150KPH TP_S8_Arad_3rdPoint_Ab_150KPH TP_S8_Arad_Fact_1_2P_Ab_150KPH TP_S8_Arad_Fact_2_3P_Ab_150KPH TP_S8_Arad_Fact_Ab_3P_Ab_150KPH TP_S8_Arad_Fact_B_1P_Ab_150KPH /end REF_CHARACTERISTIC
/end GROUP
/begin GROUP f_CBC_Fade_Out "" /begin REF_CHARACTERISTIC TP_S16_CBC_FADE_OUT_HOLD_SCAN TP_S16_CBC_FADE_OUT_TIME /end REF_CHARACTERISTIC /end GROUP
/begin GROUP f_CBC_abs_Est_Pressure ""
 /begin REF_CHARACTERISTIC TP_S16_CBC_BRAKING_AX_THRES_BLS TP_S16_CBC_BRAKING_AX_THRES_NO_BLS TP_U8_CBC_AX_MPRES_FACTOR TP_U8_CBC_PRESS_EST_FRONT_DUMP_GAIN TP_U8_CBC_PRESS_EST_FRONT_RISE_GAIN TP_U8_CBC_PRESS_EST_REAR_DUMP_GAIN TP_U8_CBC_PRESS_EST_REAR_RISE_GAIN /end REF_CHARACTERISTIC
/end GROUP
/begin GROUP f_GMA_LFC ""
 /begin REF_CHARACTERISTIC TP_U8_GMA_LFC_INIT_DUTY TP_U8_GMA_LFC_MP_COMP_DUTY TP_U8_GMA_LFC_PULSE_UP_TIME /end REF_CHARACTERISTIC
/end GROUP
/begin GROUP f_L2H_Comp ""
 /begin REF_CHARACTERISTIC TP_U8_LFC_L2H_Comp_F TP_U8_LFC_L2H_Comp_R TP_U8_LFC_L2H_Suspect_Comp_F TP_U8_LFC_L2H_Suspect_Comp_R /end REF_CHARACTERISTIC
/end GROUP
/begin GROUP f_LowMedMu_R_Dumptime ""
 /begin REF_CHARACTERISTIC TP_U8_1st_Dumpscantime_LMMu_R TP_U8_2nd3rd_Dumpscantime_LMMu_R TP_U8_4th5th_Dumpscantime_LMMu_R TP_U8_nth_Dumpscantime_LMMu_R /end REF_CHARACTERISTIC
 /begin SUB_GROUP a_Low_Speed_LMMu_R /end SUB_GROUP
/end GROUP
/begin GROUP f_Low_Mu_UR_Time "" /begin SUB_GROUP a_Front_L_T b_Rear_L_T /end SUB_GROUP /end GROUP
/begin GROUP f_MIRC_Improve ""
 /begin REF_CHARACTERISTIC TP_S16_REAR_HOMO_SL_HLD_THR_YDF_B_L TP_S16_REAR_HOMO_SL_HLD_THR_YDF_H TP_S16_REAR_HOMO_SL_HLD_THR_YDF_L TP_S16_REAR_HOMO_SL_HLD_THR_YDF_M TP_S16_REAR_SP_SL_HLD_THRES_YDF_B_L TP_S16_REAR_SP_SL_HLD_THRES_YDF_H TP_S16_REAR_SP_SL_HLD_THRES_YDF_L TP_S16_REAR_SP_SL_HLD_THRES_YDF_M TP_S8_REAR_HOMO_SL_HOLD_THRES_SLIP TP_S8_REAR_SP_SL_HOLD_THRES_SLIP /end REF_CHARACTERISTIC
/end GROUP
/begin GROUP f_Medium_Mu_Gain_Rear ""
 /begin REF_CHARACTERISTIC TP_S16_Decel_Gain_MMu_100_150kph_R TP_S16_Decel_Gain_MMu_10_20kph_R TP_S16_Decel_Gain_MMu_20_40kph_R TP_S16_Decel_Gain_MMu_40_60kph_R TP_S16_Decel_Gain_MMu_60_100kph_R TP_S16_Decel_Gain_MMu_Ab_150kph_R TP_S16_Decel_Gain_MMu_B_10kph_R TP_S16_Slip_Gain_MMu_100_150kph_R TP_S16_Slip_Gain_MMu_10_20kph_R TP_S16_Slip_Gain_MMu_20_40kph_R TP_S16_Slip_Gain_MMu_40_60kph_R TP_S16_Slip_Gain_MMu_60_100kph_R TP_S16_Slip_Gain_MMu_Ab_150kph_R TP_S16_Slip_Gain_MMu_B_10kph_R /end REF_CHARACTERISTIC
/end GROUP
/begin GROUP f_Over_braking ""
 /begin REF_CHARACTERISTIC TP_S16TCSCpBrkTorqDecRateOfOvBrk TP_S8TCSCpOverBrkTh TP_U8TCSCpBrkTorqDecPcntOfOvBrk /end REF_CHARACTERISTIC
/end GROUP
/begin GROUP f_Rough_Road "" /begin SUB_GROUP a_Rough_Road_Detection b_Rough_Road_Comp /end SUB_GROUP /end GROUP
/begin GROUP f_Split_Mu "" /begin SUB_GROUP a_Split_Mu_HighSide_Front /end SUB_GROUP /end GROUP
/begin GROUP f_Stable_Forced_Hold ""
 /begin REF_CHARACTERISTIC TP_S8_FORCED_HOLD_SLIP_BFAFZOK_F TP_S8_FORCED_HOLD_SLIP_BFAFZOK_R TP_S8_FORCED_HOLD_SLIP_HIGH_F TP_S8_FORCED_HOLD_SLIP_HIGH_R TP_S8_FORCED_HOLD_SLIP_LOW_F TP_S8_FORCED_HOLD_SLIP_LOW_R TP_S8_FORCED_HOLD_SLIP_MED_F TP_S8_FORCED_HOLD_SLIP_MED_R TP_S8_FORCED_HOLD_SLIP_SP_HIGH_F TP_S8_MAXIMUM_FORCED_HOLD_SCAN TP_U8_DUTY_DIFF_FOR_FORCED_HOLD /end REF_CHARACTERISTIC
 /begin SUB_GROUP a_Certain_Hmu /end SUB_GROUP
/end GROUP
/begin GROUP f_Under_Low_Med_Mu_UR_Thres "" /begin SUB_GROUP a_Front_UL b_Rear_UL /end SUB_GROUP /end GROUP
/begin GROUP f_WpeLfcRiseRear ""
 /begin REF_CHARACTERISTIC S16_WPE_LFC_Rise_Gain_r_10th S16_WPE_LFC_Rise_Gain_r_11th S16_WPE_LFC_Rise_Gain_r_1st S16_WPE_LFC_Rise_Gain_r_2nd S16_WPE_LFC_Rise_Gain_r_3rd S16_WPE_LFC_Rise_Gain_r_4th S16_WPE_LFC_Rise_Gain_r_5th S16_WPE_LFC_Rise_Gain_r_6th S16_WPE_LFC_Rise_Gain_r_7th S16_WPE_LFC_Rise_Gain_r_8th S16_WPE_LFC_Rise_Gain_r_9th U8_WPE_LFC_Rise_Duty_r_10th U8_WPE_LFC_Rise_Duty_r_11th U8_WPE_LFC_Rise_Duty_r_1st U8_WPE_LFC_Rise_Duty_r_2nd U8_WPE_LFC_Rise_Duty_r_3rd U8_WPE_LFC_Rise_Duty_r_4th U8_WPE_LFC_Rise_Duty_r_5th U8_WPE_LFC_Rise_Duty_r_6th U8_WPE_LFC_Rise_Duty_r_7th U8_WPE_LFC_Rise_Duty_r_8th U8_WPE_LFC_Rise_Duty_r_9th /end REF_CHARACTERISTIC
/end GROUP
/begin GROUP f_WpeTcRelsCompRear ""
 /begin REF_CHARACTERISTIC S16_WPE_TC_Rels_Comp_Gain_r_1 S16_WPE_TC_Rels_Comp_Gain_r_2 S16_WPE_TC_Rels_Comp_Gain_r_3 S16_WPE_TC_Rels_Comp_Gain_r_4 S16_WPE_TC_Rels_Comp_Gain_r_5 S16_WPE_TC_Rels_Comp_Gain_r_6 S16_WPE_TC_Rels_Comp_Press_r_1 S16_WPE_TC_Rels_Comp_Press_r_2 S16_WPE_TC_Rels_Comp_Press_r_3 S16_WPE_TC_Rels_Comp_Press_r_4 S16_WPE_TC_Rels_Comp_Press_r_5 S16_WPE_TC_Rels_Comp_Press_r_6 /end REF_CHARACTERISTIC
/end GROUP
/begin GROUP g.Esc_Split ""
 /begin REF_CHARACTERISTIC TQS16_ESC_SPLIT_ENT_FRT_WHEEL_TH TQS16_ESC_SPLIT_ENT_REAR_WHEEL_TH TQS16_ESC_SPLIT_EXIT_ALAT_TH TQS16_ESC_SPLIT_HOMO_DET_DIFF_TH TQS16_ESC_SPLIT_MU_TRANS_WHEEL_TH /end REF_CHARACTERISTIC
/end GROUP
/begin GROUP g_ABS_in_ESC_system ""
 /begin SUB_GROUP a_GMA_Control b_Yaw_Stability_Improve c_Limit_Cornering_Brake d_LFC_ABS_in_ESC e_ABS_in_Active_braking /end SUB_GROUP
/end GROUP
/begin GROUP g_CBC_Front_Thres ""
 /begin REF_CHARACTERISTIC TP_S16_CBC_FRONT_ENTER_DV_SPD_H TP_S16_CBC_FRONT_ENTER_DV_SPD_M TP_S16_CBC_FRONT_ENTER_DV_SPD_S TP_S16_CBC_FRONT_EXIT_DV_SPD_H TP_S16_CBC_FRONT_EXIT_DV_SPD_M TP_S16_CBC_FRONT_EXIT_DV_SPD_S TP_S16_CBC_FRONT_MEDIUM_DV_SPD_H TP_S16_CBC_FRONT_MEDIUM_DV_SPD_M TP_S16_CBC_FRONT_MEDIUM_DV_SPD_S /end REF_CHARACTERISTIC
/end GROUP
/begin GROUP g_CBC_abs_Est_Ay ""
 /begin REF_CHARACTERISTIC TP_S16_CBC_AY_EST_REF_SPD_H TP_S16_CBC_AY_EST_REF_SPD_M TP_S16_CBC_AY_EST_REF_SPD_S TP_U8_CBC_AY_EST_GAIN_SPD_H TP_U8_CBC_AY_EST_GAIN_SPD_M TP_U8_CBC_AY_EST_GAIN_SPD_S /end REF_CHARACTERISTIC
/end GROUP
/begin GROUP g_Driver_Accel_Detect ""
 /begin REF_CHARACTERISTIC TP_S8_DetectAccel_EngTorq_L1 TP_S8_DetectAccel_EngTorq_L2 TP_S8_DetectAccel_EngTorq_L3 TP_S8_DetectAccel_Throttle_P1 TP_S8_DetectAccel_Throttle_P2 TP_S8_DetectAccel_Throttle_P3 /end REF_CHARACTERISTIC
 /begin SUB_GROUP a_Release_detect /end SUB_GROUP
/end GROUP
/begin GROUP g_Fadeout ""
 /begin REF_CHARACTERISTIC TP_S16TCSCpWLSpdCrosTh4QuickFadOut TP_U8TCSCpFadeOutDctScan TP_U8TCSCpFadeOutExitScan TP_U8TCSCpFadeOutSpdDiffThr TP_U8TCSCpSymSpFadeOutHystSpd TP_U8TCSFadeOutBrkCtrlMinTorq[0] TP_U8TCSFadeOutBrkCtrlMinTorq[1] /end REF_CHARACTERISTIC
 /begin SUB_GROUP a_Fadeout_straight_FA b_Fadeout_straight_RA c_Fadeout_turn_FA d_Fadeout_turn_RA /end SUB_GROUP
/end GROUP
/begin GROUP g_InGear_Vib_Detect ""
 /begin REF_CHARACTERISTIC TP_S8_Dec_Hump_Counting_arad TP_S8_IN_GEAR_Vib_Detect_arad1 TP_S8_IN_GEAR_Vib_Detect_arad2 TP_U8_IN_GEAR_Vib_Acc_to_Dec_time TP_U8_IN_GEAR_detect_Dec_Hump_cnt TP_U8_IN_GEAR_detect_Vib_cnt TP_U8_IN_GEAR_detect_cycle /end REF_CHARACTERISTIC
/end GROUP
/begin GROUP g_LowMed_Mu_Gain_Front ""
 /begin REF_CHARACTERISTIC TP_S16_Decel_Gain_LMMu_100_150kph_F TP_S16_Decel_Gain_LMMu_10_20kph_F TP_S16_Decel_Gain_LMMu_20_40kph_F TP_S16_Decel_Gain_LMMu_40_60kph_F TP_S16_Decel_Gain_LMMu_60_100kph_F TP_S16_Decel_Gain_LMMu_Ab_150kph_F TP_S16_Decel_Gain_LMMu_B_10kph_F TP_S16_Slip_Gain_LMMu_100_150kph_F TP_S16_Slip_Gain_LMMu_10_20kph_F TP_S16_Slip_Gain_LMMu_20_40kph_F TP_S16_Slip_Gain_LMMu_40_60kph_F TP_S16_Slip_Gain_LMMu_60_100kph_F TP_S16_Slip_Gain_LMMu_Ab_150kph_F TP_S16_Slip_Gain_LMMu_B_10kph_F /end REF_CHARACTERISTIC
/end GROUP
/begin GROUP g_LowMu_F_Dumptime ""
 /begin REF_CHARACTERISTIC TP_U8_1st_Dumpscantime_LMu_F TP_U8_2nd3rd_Dumpscantime_LMu_F TP_U8_4th5th_Dumpscantime_LMu_F TP_U8_UnstableTim_for_IncDumptime TP_U8_nth_Dumpscantime_LMu_F /end REF_CHARACTERISTIC
 /begin SUB_GROUP a_Low_Speed_LMu_F /end SUB_GROUP
/end GROUP
/begin GROUP g_Low_Mu_UR_Thres "" /begin SUB_GROUP a_Front_L b_Rear_L /end SUB_GROUP /end GROUP
/begin GROUP g_Split_Mu_UR_Time "" /begin SUB_GROUP a_Front_SP_HighSide_T /end SUB_GROUP /end GROUP
/begin GROUP g_WpeMpRiseFront ""
 /begin REF_CHARACTERISTIC S16_WPE_MP_Rise_Gain_f_1_volume S16_WPE_MP_Rise_Gain_f_2_volume S16_WPE_MP_Rise_Gain_f_3_volume S16_WPE_MP_Rise_Gain_f_4_volume S16_WPE_MP_Rise_Gain_f_5_volume S16_WPE_MP_Rise_Gain_f_6_volume S16_WPE_MP_Rise_Press_f_1_volume S16_WPE_MP_Rise_Press_f_2_volume S16_WPE_MP_Rise_Press_f_3_volume S16_WPE_MP_Rise_Press_f_4_volume S16_WPE_MP_Rise_Press_f_5_volume S16_WPE_MP_Rise_Press_f_6_volume /end REF_CHARACTERISTIC
/end GROUP
/begin GROUP h_ABS_Bump_detection "" /begin SUB_GROUP a_ABS_Bump_detection_1 b_ABS_Bump_detection_2 /end SUB_GROUP /end GROUP
/begin GROUP h_CBC_Front_Delta_P ""
 /begin REF_CHARACTERISTIC TP_S16_CBC_FRONT_DEL_PRESS_H_SPD_H TP_S16_CBC_FRONT_DEL_PRESS_H_SPD_M TP_S16_CBC_FRONT_DEL_PRESS_H_SPD_S TP_S16_CBC_FRONT_DEL_PRESS_S_SPD_H TP_S16_CBC_FRONT_DEL_PRESS_S_SPD_M TP_S16_CBC_FRONT_DEL_PRESS_S_SPD_S /end REF_CHARACTERISTIC
/end GROUP
/begin GROUP h_CBC_abs_Ay_Reliability "" /begin SUB_GROUP a_Steady_State_Condition b_Ay_Reliability_Check /end SUB_GROUP /end GROUP
/begin GROUP h_HIgh_side_spin ""
 /begin REF_CHARACTERISTIC TP_S16TCSCpBrkTorq1stDecTrqOfHWIS TP_S16TCSCpBrkTq1stDecTrqOfHWISHill TP_U8CpAfterHghMuUnstbCntTh TP_U8TCSCpBrkTorqDecRateOfHWIS TP_U8TCSCpBrkTorqFastDecRateOfHWIS TP_U8TCSCpBrkTorqRecPcntOfHWIS TP_U8TCSCpHghMuWhlDelSpinTh TP_U8TCSCpHghMuWhlHuntSpinTh TP_U8TCSCpHghMuWhlSpinTh TP_U8TCSCpHghMuWhlSpinThHill TP_U8TCSCpHghMuWhlSpinTm TP_U8TCSCpMtrFstRnTmrAftHghMuWhStb TP_U8TCSHghMuUnstbRecoveryTh /end REF_CHARACTERISTIC
/end GROUP
/begin GROUP h_LowMed_Mu_Gain_Rear ""
 /begin REF_CHARACTERISTIC TP_S16_Decel_Gain_LMMu_100_150kph_R TP_S16_Decel_Gain_LMMu_10_20kph_R TP_S16_Decel_Gain_LMMu_20_40kph_R TP_S16_Decel_Gain_LMMu_40_60kph_R TP_S16_Decel_Gain_LMMu_60_100kph_R TP_S16_Decel_Gain_LMMu_Ab_150kph_R TP_S16_Decel_Gain_LMMu_B_10kph_R TP_S16_Slip_Gain_LMMu_100_150kph_R TP_S16_Slip_Gain_LMMu_10_20kph_R TP_S16_Slip_Gain_LMMu_20_40kph_R TP_S16_Slip_Gain_LMMu_40_60kph_R TP_S16_Slip_Gain_LMMu_60_100kph_R TP_S16_Slip_Gain_LMMu_Ab_150kph_R TP_S16_Slip_Gain_LMMu_B_10kph_R /end REF_CHARACTERISTIC
/end GROUP
/begin GROUP h_LowMu_R_Dumptime ""
 /begin REF_CHARACTERISTIC TP_U8_1st_Dumpscantime_LMu_R TP_U8_2nd3rd_Dumpscantime_LMu_R TP_U8_4th5th_Dumpscantime_LMu_R TP_U8_nth_Dumpscantime_LMu_R /end REF_CHARACTERISTIC
 /begin SUB_GROUP a_Low_Speed_LMu_R /end SUB_GROUP
/end GROUP
/begin GROUP h_Split_Mu_UR_Thres "" /begin SUB_GROUP a_Front_SP_HighSide /end SUB_GROUP /end GROUP
/begin GROUP h_UR_Time_MIN_MAX ""
 /begin REF_CHARACTERISTIC TP_U8_MAXIMUM_dP_RISESCAN_F TP_U8_MAXIMUM_dP_RISESCAN_R TP_U8_MINIMUM_dP_RISESCAN_F TP_U8_MINIMUM_dP_RISESCAN_R TP_U8_MIN_dP_RISE_AT_LOW_MP_F TP_U8_MIN_dP_RISE_AT_LOW_MP_R TP_U8_MIN_dP_RISE_Bw_15kph_F TP_U8_MIN_dP_RISE_Bw_15kph_R /end REF_CHARACTERISTIC
/end GROUP
/begin GROUP h_WpeMpRiseRear ""
 /begin REF_CHARACTERISTIC S16_WPE_MP_Rise_Gain_r_1_volume S16_WPE_MP_Rise_Gain_r_2_volume S16_WPE_MP_Rise_Gain_r_3_volume S16_WPE_MP_Rise_Gain_r_4_volume S16_WPE_MP_Rise_Gain_r_5_volume S16_WPE_MP_Rise_Gain_r_6_volume S16_WPE_MP_Rise_Press_r_1_volume S16_WPE_MP_Rise_Press_r_2_volume S16_WPE_MP_Rise_Press_r_3_volume S16_WPE_MP_Rise_Press_r_4_volume S16_WPE_MP_Rise_Press_r_5_volume S16_WPE_MP_Rise_Press_r_6_volume /end REF_CHARACTERISTIC
/end GROUP
/begin GROUP i_1st_cycle "" /begin REF_CHARACTERISTIC TP_S16_WPThres_for_IncDumptim_1st /end REF_CHARACTERISTIC /end GROUP
/begin GROUP i_CBC_Rear_Slip_Control ""
 /begin REF_CHARACTERISTIC TP_S16_CBC_REAR_ENTER_DV_SPD_H TP_S16_CBC_REAR_ENTER_DV_SPD_M TP_S16_CBC_REAR_ENTER_DV_SPD_S TP_S16_CBC_REAR_EXIT_DV TP_S16_CBC_REAR_SLIP_DEL_P_SPD_H TP_S16_CBC_REAR_SLIP_DEL_P_SPD_M TP_S16_CBC_REAR_SLIP_DEL_P_SPD_S /end REF_CHARACTERISTIC
/end GROUP
/begin GROUP i_CBC_abs_Rear_Slip_Control ""
 /begin REF_CHARACTERISTIC TP_S16_CBC_ABS_REAR_ENTER_DV_SPD_H TP_S16_CBC_ABS_REAR_ENTER_DV_SPD_M TP_S16_CBC_ABS_REAR_ENTER_DV_SPD_S TP_S16_CBC_ABS_REAR_EXIT_DV TP_S16_CBC_ABS_REAR_SLIP_DEL_P_SPD_H TP_S16_CBC_ABS_REAR_SLIP_DEL_P_SPD_M TP_S16_CBC_ABS_REAR_SLIP_DEL_P_SPD_S /end REF_CHARACTERISTIC
/end GROUP
/begin GROUP i_Gear_shift "" /begin REF_CHARACTERISTIC TP_U8TCSCpReducePgainF4GearShift /end REF_CHARACTERISTIC /end GROUP
/begin GROUP i_L2H_Detection ""
 /begin SUB_GROUP a_L2H_Decel_Threshold b_L2H_Slip_Threshold c_L2H_Detection_Time d_L2H_Detect_By_Wheel_Press /end SUB_GROUP
/end GROUP
/begin GROUP i_Low_Mu_Gain_Front ""
 /begin REF_CHARACTERISTIC TP_S16_Decel_Gain_LMu_100_150kph_F TP_S16_Decel_Gain_LMu_10_20kph_F TP_S16_Decel_Gain_LMu_20_40kph_F TP_S16_Decel_Gain_LMu_40_60kph_F TP_S16_Decel_Gain_LMu_60_100kph_F TP_S16_Decel_Gain_LMu_Ab_150kph_F TP_S16_Decel_Gain_LMu_B_10kph_F TP_S16_Slip_Gain_LMu_100_150kph_F TP_S16_Slip_Gain_LMu_10_20kph_F TP_S16_Slip_Gain_LMu_20_40kph_F TP_S16_Slip_Gain_LMu_40_60kph_F TP_S16_Slip_Gain_LMu_60_100kph_F TP_S16_Slip_Gain_LMu_Ab_150kph_F TP_S16_Slip_Gain_LMu_B_10kph_F /end REF_CHARACTERISTIC
/end GROUP
/begin GROUP j_Hunting ""
 /begin REF_CHARACTERISTIC TP_S16TCSCpWorkTh4HuntDctReset TP_S16TCSCpWorkTh4L2SplitSuspect TP_U8TCSCpFFReductFactInHunting TP_U8TCSCpL2SplitSuspectTorq /end REF_CHARACTERISTIC
/end GROUP
/begin GROUP j_Low_Mu_Gain_Rear ""
 /begin REF_CHARACTERISTIC TP_S16_Decel_Gain_LMu_100_150kph_R TP_S16_Decel_Gain_LMu_10_20kph_R TP_S16_Decel_Gain_LMu_20_40kph_R TP_S16_Decel_Gain_LMu_40_60kph_R TP_S16_Decel_Gain_LMu_60_100kph_R TP_S16_Decel_Gain_LMu_Ab_150kph_R TP_S16_Decel_Gain_LMu_B_10kph_R TP_S16_Slip_Gain_LMu_100_150kph_R TP_S16_Slip_Gain_LMu_10_20kph_R TP_S16_Slip_Gain_LMu_20_40kph_R TP_S16_Slip_Gain_LMu_40_60kph_R TP_S16_Slip_Gain_LMu_60_100kph_R TP_S16_Slip_Gain_LMu_Ab_150kph_R TP_S16_Slip_Gain_LMu_B_10kph_R /end REF_CHARACTERISTIC
/end GROUP
/begin GROUP j_Wheel_Press_Est_Gain_ABS ""
 /begin REF_CHARACTERISTIC TP_Press_Dec_gain_Front_10_70bar TP_Press_Dec_gain_Front_5_10bar TP_Press_Dec_gain_Front_Above_70bar TP_Press_Dec_gain_Front_below_5bar TP_Press_Dec_gain_Rear_10_70bar TP_Press_Dec_gain_Rear_5_10bar TP_Press_Dec_gain_Rear_Above_70bar TP_Press_Dec_gain_Rear_below_5bar /end REF_CHARACTERISTIC
/end GROUP
/begin GROUP k_Feedforward_adaptation ""
 /begin REF_CHARACTERISTIC TP_S16TCSCpBrkTrqMaxIncStartTime TP_S16TCSCpWorkTh4BrkTrqMaxLim TP_S16TCSCpWorkTh4FFAdapt TP_S16TCSCpWorkTh4FFAdaptReset TP_U8TCSCpBrkTrqMaxIncRate /end REF_CHARACTERISTIC
/end GROUP
/begin GROUP k_OutABS_YMR ""
 /begin REF_CHARACTERISTIC TP_S16_OUTABS_YMR_ALLOW_SPEED TP_S16_OUTABS_YMR_DUMP_ALLOW_SPEED TP_S16_OUTABS_YMR_DUMP_HIGH_SPEED TP_S16_OUTABS_YMR_DUMP_MAX TP_S16_OUTABS_YMR_DUMP_MIN TP_S8_L1_LOWSIDE_PEAK_DEC TP_S8_L1_SLIP_DIFF_50_80 TP_S8_L1_SLIP_DIFF_80_M TP_S8_L2_LOWSIDE_PEAK_DEC TP_S8_L2_SLIP_DIFF_50_80 TP_S8_L2_SLIP_DIFF_80_M /end REF_CHARACTERISTIC
/end GROUP
/begin GROUP k_Split_HighSide_Gain_Front ""
 /begin REF_CHARACTERISTIC TP_S16_Decel_Gain_SpHMu_100_150_F TP_S16_Decel_Gain_SpHMu_10_20kph_F TP_S16_Decel_Gain_SpHMu_20_40kph_F TP_S16_Decel_Gain_SpHMu_40_60kph_F TP_S16_Decel_Gain_SpHMu_60_100kph_F TP_S16_Decel_Gain_SpHMu_Ab_150kph_F TP_S16_Decel_Gain_SpHMu_B_10kph_F TP_S16_Slip_Gain_SpHMu_100_150_F TP_S16_Slip_Gain_SpHMu_10_20kph_F TP_S16_Slip_Gain_SpHMu_20_40kph_F TP_S16_Slip_Gain_SpHMu_40_60kph_F TP_S16_Slip_Gain_SpHMu_60_100kph_F TP_S16_Slip_Gain_SpHMu_Ab_150kph_F TP_S16_Slip_Gain_SpHMu_B_10kph_F /end REF_CHARACTERISTIC
/end GROUP
/begin GROUP l_FrntAsymFacAtRearSym "" /begin REF_CHARACTERISTIC TP_U8TCSCpBrkTqDecFacOfFrntAtReSym /end REF_CHARACTERISTIC /end GROUP
/begin GROUP l_Pedal_effort_change "" /begin REF_CHARACTERISTIC TP_S16_PEDAL_CHANGE_DCT_TH1 TP_S16_PEDAL_CHANGE_DCT_TH2 /end REF_CHARACTERISTIC /end GROUP
/begin GROUP m_Slight_braking_detection ""
 /begin REF_CHARACTERISTIC TP_S16_SLIGHT_BRAKING_PRESS TP_S16_VERY_SLIGHT_BRAKING_PRESS /end REF_CHARACTERISTIC
/end GROUP
/end MODULE
/end PROJECT
