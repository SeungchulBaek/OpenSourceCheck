ASAP2_VERSION 1 60
/begin PROJECT Master ""
/begin MODULE CPP ""
/begin MOD_COMMON "" BYTE_ORDER MSB_LAST ALIGNMENT_BYTE 1 ALIGNMENT_WORD 1 ALIGNMENT_LONG 1 ALIGNMENT_FLOAT32_IEEE 1 ALIGNMENT_FLOAT64_IEEE 1 ALIGNMENT_INT64 1 /end MOD_COMMON
/begin CHARACTERISTIC BrkCalVrntCtaDft "" VALUE 0x80020000 CalVrntCta_UBYTE 0 BrkCalVariantCriterion.Selector.Conversion 0 255 SYMBOL_LINK "CalVrntCta.BrkCalVrntCtaDft" 0 /end CHARACTERISTIC
/begin CHARACTERISTIC EngCalVrntCtaDft "" VALUE 0x80020001 CalVrntCta_UBYTE 0 EngCalVariantCriterion.Selector.Conversion 0 255 SYMBOL_LINK "CalVrntCta.EngCalVrntCtaDft" 0 /end CHARACTERISTIC
/begin CHARACTERISTIC S16_VLC_BRAKE_CONTROL_MIN_TORQUE "VLC Common calibration of minimum brake torque offset for brake control engaged." VALUE 0x8003A8CC CalPrmVehLgtCoorrEng_SWORD 0 Fac31 -32768 32767 SYMBOL_LINK "CalPrmVehLgtCoorrEng01.S16_VLC_BRAKE_CONTROL_MIN_TORQUE" 0 /end CHARACTERISTIC
/begin CHARACTERISTIC S16_VLC_MAX_ENGINE_DRAG_TORQUE_COMP "VLC Common calibration of maximum engine drag torque" VALUE 0x8003A8CE CalPrmVehLgtCoorrEng_SWORD 0 Fac31 -32768 32767 SYMBOL_LINK "CalPrmVehLgtCoorrEng01.S16_VLC_MAX_ENGINE_DRAG_TORQUE_COMP" 0 /end CHARACTERISTIC
/begin CHARACTERISTIC SSM_K_AutoAdjust_Apply_Feature_En "" VALUE 0x8003A86C CalPrmSsmBrk_UBYTE 0 OnOff1 0 255 SYMBOL_LINK "CalPrmSsmEng01.SSM_K_AutoAdjust_Apply_Feature_En" 0 /end CHARACTERISTIC
/begin CHARACTERISTIC SSM_K_AutoAdjust_Apply_OdoMeter "" VALUE 0x8003A86E CalPrmSsmBrk_UWORD 0 Gain 0 65535 SYMBOL_LINK "CalPrmSsmEng01.SSM_K_AutoAdjust_Apply_OdoMeter" 0 /end CHARACTERISTIC
/begin CHARACTERISTIC SSM_K_ClutchSwitch_From_ClutchSensor "" VALUE 0x8003A7FA CalPrmSsmBrk_UBYTE 0 OnOff1 0 255 SYMBOL_LINK "CalPrmSsmEng01.SSM_K_ClutchSwitch_From_ClutchSensor" 0 /end CHARACTERISTIC
/begin CHARACTERISTIC SSM_K_Clutch_Engage_LongG_Avr_Max "" VALUE 0x8003A7FC CalPrmSsmBrk_SWORD 0 A48 -3.2768 3.2767 SYMBOL_LINK "CalPrmSsmEng01.SSM_K_Clutch_Engage_LongG_Avr_Max" 0 /end CHARACTERISTIC
/begin CHARACTERISTIC SSM_K_Clutch_Engage_LongG_Avr_Min "" VALUE 0x8003A7FE CalPrmSsmBrk_SWORD 0 A48 -3.2768 3.2767 SYMBOL_LINK "CalPrmSsmEng01.SSM_K_Clutch_Engage_LongG_Avr_Min" 0 /end CHARACTERISTIC
/begin CHARACTERISTIC SSM_K_Clutch_Engage_Study_LongG_Th1 "" VALUE 0x8003A800 CalPrmSsmBrk_SWORD 0 A48 -3.2768 3.2767 SYMBOL_LINK "CalPrmSsmEng01.SSM_K_Clutch_Engage_Study_LongG_Th1" 0 /end CHARACTERISTIC
/begin CHARACTERISTIC SSM_K_Clutch_Engage_Study_LongG_Th2 "" VALUE 0x8003A802 CalPrmSsmBrk_SWORD 0 A48 -3.2768 3.2767 SYMBOL_LINK "CalPrmSsmEng01.SSM_K_Clutch_Engage_Study_LongG_Th2" 0 /end CHARACTERISTIC
/begin CHARACTERISTIC SSM_K_Clutch_Engage_Study_LongG_Th3 "" VALUE 0x8003A804 CalPrmSsmBrk_SWORD 0 A48 -3.2768 3.2767 SYMBOL_LINK "CalPrmSsmEng01.SSM_K_Clutch_Engage_Study_LongG_Th3" 0 /end CHARACTERISTIC
/begin CHARACTERISTIC SSM_K_Clutch_Engage_Study_LongG_Th4 "" VALUE 0x8003A806 CalPrmSsmBrk_SWORD 0 A48 -3.2768 3.2767 SYMBOL_LINK "CalPrmSsmEng01.SSM_K_Clutch_Engage_Study_LongG_Th4" 0 /end CHARACTERISTIC
/begin CHARACTERISTIC SSM_K_EPB_AVH_TimeOut_Suspect_Time_Th "" VALUE 0x8003A84B CalPrmSsmBrk_UBYTE 0 Ti21 0 2.55 SYMBOL_LINK "CalPrmSsmEng01.SSM_K_EPB_AVH_TimeOut_Suspect_Time_Th" 0 /end CHARACTERISTIC
/begin CHARACTERISTIC SSM_K_EPB_Auto_Release_Door_Close_Act "" VALUE 0x8003A844 CalPrmSsmBrk_UBYTE 0 OnOff1 0 255 SYMBOL_LINK "CalPrmSsmEng01.SSM_K_EPB_Auto_Release_Door_Close_Act" 0 /end CHARACTERISTIC
/begin CHARACTERISTIC SSM_K_EPB_Auto_Release_MT_IN_Gear_Act "" VALUE 0x8003A845 CalPrmSsmBrk_UBYTE 0 OnOff1 0 255 SYMBOL_LINK "CalPrmSsmEng01.SSM_K_EPB_Auto_Release_MT_IN_Gear_Act" 0 /end CHARACTERISTIC
/begin CHARACTERISTIC SSM_K_EPB_Automatic_Apply_Key_Out_Inibit_Time "" VALUE 0x8003A838 CalPrmSsmBrk_UWORD 0 Ti21 0 655.35 SYMBOL_LINK "CalPrmSsmEng01.SSM_K_EPB_Automatic_Apply_Key_Out_Inibit_Time" 0 /end CHARACTERISTIC
/begin CHARACTERISTIC SSM_K_EPB_Automatic_Release_Feature_En "" VALUE 0x8003A843 CalPrmSsmBrk_UBYTE 0 OnOff1 0 255 SYMBOL_LINK "CalPrmSsmEng01.SSM_K_EPB_Automatic_Release_Feature_En" 0 /end CHARACTERISTIC
/begin CHARACTERISTIC SSM_K_EPB_Autonomous_Apply_Driven_Spd_Th "" VALUE 0x8003A846 CalPrmSsmBrk_SWORD 0 Spd12 -4096 4095.875 SYMBOL_LINK "CalPrmSsmEng01.SSM_K_EPB_Autonomous_Apply_Driven_Spd_Th" 0 /end CHARACTERISTIC
/begin CHARACTERISTIC SSM_K_EPB_Autonomous_Apply_ESC_Feature_En "" VALUE 0x8003A848 CalPrmSsmBrk_UBYTE 0 OnOff1 0 255 SYMBOL_LINK "CalPrmSsmEng01.SSM_K_EPB_Autonomous_Apply_ESC_Feature_En" 0 /end CHARACTERISTIC
/begin CHARACTERISTIC SSM_K_EPB_Autonomous_Apply_ETRS_Feature_En "" VALUE 0x8003A849 CalPrmSsmBrk_UBYTE 0 OnOff1 0 255 SYMBOL_LINK "CalPrmSsmEng01.SSM_K_EPB_Autonomous_Apply_ETRS_Feature_En" 0 /end CHARACTERISTIC
/begin CHARACTERISTIC SSM_K_EPB_Autonomous_Apply_VICM_Feature_En "" VALUE 0x8003A84A CalPrmSsmBrk_UBYTE 0 OnOff1 0 255 SYMBOL_LINK "CalPrmSsmEng01.SSM_K_EPB_Autonomous_Apply_VICM_Feature_En" 0 /end CHARACTERISTIC
/begin CHARACTERISTIC SSM_K_EPB_ClutchEngageStudy_Feature_En "" VALUE 0x8003A808 CalPrmSsmBrk_UBYTE 0 OnOff1 0 255 SYMBOL_LINK "CalPrmSsmEng01.SSM_K_EPB_ClutchEngageStudy_Feature_En" 0 /end CHARACTERISTIC
/begin CHARACTERISTIC SSM_K_EPB_Clutch_Engage_Detect_Speed "" VALUE 0x8003A809 CalPrmSsmBrk_UBYTE 0 OnOff1 0 255 SYMBOL_LINK "CalPrmSsmEng01.SSM_K_EPB_Clutch_Engage_Detect_Speed" 0 /end CHARACTERISTIC
/begin CHARACTERISTIC SSM_K_EPB_Clutch_Engage_Rpm_Comp_Max "" VALUE 0x8003A80A CalPrmSsmBrk_UBYTE 0 Perc2 0 127.5 SYMBOL_LINK "CalPrmSsmEng01.SSM_K_EPB_Clutch_Engage_Rpm_Comp_Max" 0 /end CHARACTERISTIC
/begin CHARACTERISTIC SSM_K_EPB_Clutch_Engage_Study_Comp "" VALUE 0x8003A80B CalPrmSsmBrk_UBYTE 0 Perc2 0 127.5 SYMBOL_LINK "CalPrmSsmEng01.SSM_K_EPB_Clutch_Engage_Study_Comp" 0 /end CHARACTERISTIC
/begin CHARACTERISTIC SSM_K_EPB_Clutch_Pedal_Back "" VALUE 0x8003A80C CalPrmSsmBrk_UBYTE 0 Perc2 0 127.5 SYMBOL_LINK "CalPrmSsmEng01.SSM_K_EPB_Clutch_Pedal_Back" 0 /end CHARACTERISTIC
/begin CHARACTERISTIC SSM_K_EPB_Clutch_Pedal_Friction_Th "" VALUE 0x8003A80D CalPrmSsmBrk_UBYTE 0 Perc2 0 127.5 SYMBOL_LINK "CalPrmSsmEng01.SSM_K_EPB_Clutch_Pedal_Friction_Th" 0 /end CHARACTERISTIC
/begin CHARACTERISTIC SSM_K_EPB_Clutch_Pedal_Max_Th "" VALUE 0x8003A80E CalPrmSsmBrk_UBYTE 0 Perc2 0 127.5 SYMBOL_LINK "CalPrmSsmEng01.SSM_K_EPB_Clutch_Pedal_Max_Th" 0 /end CHARACTERISTIC
/begin CHARACTERISTIC SSM_K_EPB_Clutch_Pedal_Min_Th "" VALUE 0x8003A80F CalPrmSsmBrk_UBYTE 0 Perc2 0 127.5 SYMBOL_LINK "CalPrmSsmEng01.SSM_K_EPB_Clutch_Pedal_Min_Th" 0 /end CHARACTERISTIC
/begin CHARACTERISTIC SSM_K_EPB_Clutch_Pedal_Z0_Th "" VALUE 0x8003A810 CalPrmSsmBrk_UBYTE 0 Perc2 0 127.5 SYMBOL_LINK "CalPrmSsmEng01.SSM_K_EPB_Clutch_Pedal_Z0_Th" 0 /end CHARACTERISTIC
/begin CHARACTERISTIC SSM_K_EPB_Clutch_Pedal_Z1_Th "" VALUE 0x8003A811 CalPrmSsmBrk_UBYTE 0 Perc2 0 127.5 SYMBOL_LINK "CalPrmSsmEng01.SSM_K_EPB_Clutch_Pedal_Z1_Th" 0 /end CHARACTERISTIC
/begin CHARACTERISTIC SSM_K_EPB_Clutch_Pedal_Z2_Th "" VALUE 0x8003A812 CalPrmSsmBrk_UBYTE 0 Perc2 0 127.5 SYMBOL_LINK "CalPrmSsmEng01.SSM_K_EPB_Clutch_Pedal_Z2_Th" 0 /end CHARACTERISTIC
/begin CHARACTERISTIC SSM_K_EPB_Clutch_Pedal_Z3_Th "" VALUE 0x8003A813 CalPrmSsmBrk_UBYTE 0 Perc2 0 127.5 SYMBOL_LINK "CalPrmSsmEng01.SSM_K_EPB_Clutch_Pedal_Z3_Th" 0 /end CHARACTERISTIC
/begin CHARACTERISTIC SSM_K_EPB_Clutch_Pedal_ZU_Th "" VALUE 0x8003A814 CalPrmSsmBrk_UBYTE 0 Perc2 0 127.5 SYMBOL_LINK "CalPrmSsmEng01.SSM_K_EPB_Clutch_Pedal_ZU_Th" 0 /end CHARACTERISTIC
/begin CHARACTERISTIC SSM_K_EPB_Crazy_Mode_Feature_En "" VALUE 0x8003A84C CalPrmSsmBrk_UBYTE 0 OnOff1 0 255 SYMBOL_LINK "CalPrmSsmEng01.SSM_K_EPB_Crazy_Mode_Feature_En" 0 /end CHARACTERISTIC
/begin CHARACTERISTIC SSM_K_EPB_Crazy_Mode_Hold_Time "" VALUE 0x8003A84E CalPrmSsmBrk_UWORD 0 Ti21 0 655.35 SYMBOL_LINK "CalPrmSsmEng01.SSM_K_EPB_Crazy_Mode_Hold_Time" 0 /end CHARACTERISTIC
/begin CHARACTERISTIC SSM_K_EPB_Crazy_Mode_Max_Cnt "" VALUE 0x8003A850 CalPrmSsmBrk_SWORD 0 OnOff1 -32768 32767 SYMBOL_LINK "CalPrmSsmEng01.SSM_K_EPB_Crazy_Mode_Max_Cnt" 0 /end CHARACTERISTIC
/begin CHARACTERISTIC SSM_K_EPB_DPB_REQ_OVERRIDE_TIME "" VALUE 0x8003A8A1 CalPrmSsmBrk_UBYTE 0 Ti21 0 2.55 SYMBOL_LINK "CalPrmSsmEng01.SSM_K_EPB_DPB_REQ_OVERRIDE_TIME" 0 /end CHARACTERISTIC
/begin CHARACTERISTIC SSM_K_EPB_DectGear_D_Position_Th "" VALUE 0x8003A877 CalPrmSsmBrk_UBYTE 0 Ti21 0 2.55 SYMBOL_LINK "CalPrmSsmEng01.SSM_K_EPB_DectGear_D_Position_Th" 0 /end CHARACTERISTIC
/begin CHARACTERISTIC SSM_K_EPB_DectGear_N_Position_Th "" VALUE 0x8003A878 CalPrmSsmBrk_UBYTE 0 Ti21 0 2.55 SYMBOL_LINK "CalPrmSsmEng01.SSM_K_EPB_DectGear_N_Position_Th" 0 /end CHARACTERISTIC
/begin CHARACTERISTIC SSM_K_EPB_DectGear_P_Position_Th "" VALUE 0x8003A879 CalPrmSsmBrk_UBYTE 0 Ti21 0 2.55 SYMBOL_LINK "CalPrmSsmEng01.SSM_K_EPB_DectGear_P_Position_Th" 0 /end CHARACTERISTIC
/begin CHARACTERISTIC SSM_K_EPB_DectGear_R_Position_Th "" VALUE 0x8003A87A CalPrmSsmBrk_UBYTE 0 Ti21 0 2.55 SYMBOL_LINK "CalPrmSsmEng01.SSM_K_EPB_DectGear_R_Position_Th" 0 /end CHARACTERISTIC
/begin CHARACTERISTIC SSM_K_EPB_Degrad_Release_SWOFF_Time_Th "" VALUE 0x8003A85C CalPrmSsmBrk_UWORD 0 Ti21 0 655.35 SYMBOL_LINK "CalPrmSsmEng01.SSM_K_EPB_Degrad_Release_SWOFF_Time_Th" 0 /end CHARACTERISTIC
/begin CHARACTERISTIC SSM_K_EPB_Degraded_Apply_Feature_En "" VALUE 0x8003A852 CalPrmSsmBrk_UBYTE 0 OnOff1 0 255 SYMBOL_LINK "CalPrmSsmEng01.SSM_K_EPB_Degraded_Apply_Feature_En" 0 /end CHARACTERISTIC
/begin CHARACTERISTIC SSM_K_EPB_Degraded_Apply_Time_Periode "" VALUE 0x8003A854 CalPrmSsmBrk_UWORD 0 Ti21 0 655.35 SYMBOL_LINK "CalPrmSsmEng01.SSM_K_EPB_Degraded_Apply_Time_Periode" 0 /end CHARACTERISTIC
/begin CHARACTERISTIC SSM_K_EPB_Degraded_Apply_Time_TH "" VALUE 0x8003A856 CalPrmSsmBrk_UWORD 0 Ti21 0 655.35 SYMBOL_LINK "CalPrmSsmEng01.SSM_K_EPB_Degraded_Apply_Time_TH" 0 /end CHARACTERISTIC
/begin CHARACTERISTIC SSM_K_EPB_Degraded_Release_Feature_En "" VALUE 0x8003A858 CalPrmSsmBrk_UBYTE 0 OnOff1 0 255 SYMBOL_LINK "CalPrmSsmEng01.SSM_K_EPB_Degraded_Release_Feature_En" 0 /end CHARACTERISTIC
/begin CHARACTERISTIC SSM_K_EPB_Degraded_Release_Time_Th "" VALUE 0x8003A85A CalPrmSsmBrk_UWORD 0 Ti21 0 655.35 SYMBOL_LINK "CalPrmSsmEng01.SSM_K_EPB_Degraded_Release_Time_Th" 0 /end CHARACTERISTIC
/begin CHARACTERISTIC SSM_K_EPB_Dynamic_Brake_Decel_Rate_ESC "" VALUE 0x8003A866 CalPrmSsmBrk_SWORD 0 A48 -3.2768 3.2767 SYMBOL_LINK "CalPrmSsmEng01.SSM_K_EPB_Dynamic_Brake_Decel_Rate_ESC" 0 /end CHARACTERISTIC
/begin CHARACTERISTIC SSM_K_EPB_Dynamic_Brake_Decel_Rate_ESC_No_Brk "" VALUE 0x8003A868 CalPrmSsmBrk_SWORD 0 A48 -3.2768 3.2767 SYMBOL_LINK "CalPrmSsmEng01.SSM_K_EPB_Dynamic_Brake_Decel_Rate_ESC_No_Brk" 0 /end CHARACTERISTIC
/begin CHARACTERISTIC SSM_K_EPB_Dynamic_Brake_EPB_Feature_En "" VALUE 0x8003A86A CalPrmSsmBrk_UBYTE 0 OnOff1 0 255 SYMBOL_LINK "CalPrmSsmEng01.SSM_K_EPB_Dynamic_Brake_EPB_Feature_En" 0 /end CHARACTERISTIC
/begin CHARACTERISTIC SSM_K_EPB_Dynamic_Brake_ESC_Feature_En "" VALUE 0x8003A86B CalPrmSsmBrk_UBYTE 0 OnOff1 0 255 SYMBOL_LINK "CalPrmSsmEng01.SSM_K_EPB_Dynamic_Brake_ESC_Feature_En" 0 /end CHARACTERISTIC
/begin CHARACTERISTIC SSM_K_EPB_Intelligent_Apply_Belt_Feature_En "" VALUE 0x8003A85E CalPrmSsmBrk_UBYTE 0 OnOff1 0 255 SYMBOL_LINK "CalPrmSsmEng01.SSM_K_EPB_Intelligent_Apply_Belt_Feature_En" 0 /end CHARACTERISTIC
/begin CHARACTERISTIC SSM_K_EPB_Intelligent_Apply_Feature_En "" VALUE 0x8003A85F CalPrmSsmBrk_UBYTE 0 OnOff1 0 255 SYMBOL_LINK "CalPrmSsmEng01.SSM_K_EPB_Intelligent_Apply_Feature_En" 0 /end CHARACTERISTIC
/begin CHARACTERISTIC SSM_K_EPB_Intelligent_Apply_Switch_Feature_En "" VALUE 0x8003A860 CalPrmSsmBrk_UBYTE 0 OnOff1 0 255 SYMBOL_LINK "CalPrmSsmEng01.SSM_K_EPB_Intelligent_Apply_Switch_Feature_En" 0 /end CHARACTERISTIC
/begin CHARACTERISTIC SSM_K_EPB_Intelligent_Apply_Switch_Hold_On_Act "" VALUE 0x8003A861 CalPrmSsmBrk_UBYTE 0 OnOff1 0 255 SYMBOL_LINK "CalPrmSsmEng01.SSM_K_EPB_Intelligent_Apply_Switch_Hold_On_Act" 0 /end CHARACTERISTIC
/begin CHARACTERISTIC SSM_K_EPB_Intelligent_Apply_Switch_Re_On_Act "" VALUE 0x8003A862 CalPrmSsmBrk_UBYTE 0 OnOff1 0 255 SYMBOL_LINK "CalPrmSsmEng01.SSM_K_EPB_Intelligent_Apply_Switch_Re_On_Act" 0 /end CHARACTERISTIC
/begin CHARACTERISTIC SSM_K_EPB_Intelligent_Apply_Switch_Time_Th "" VALUE 0x8003A864 CalPrmSsmBrk_UWORD 0 OnOff1 0 65535 SYMBOL_LINK "CalPrmSsmEng01.SSM_K_EPB_Intelligent_Apply_Switch_Time_Th" 0 /end CHARACTERISTIC
/begin CHARACTERISTIC SSM_K_EPB_Maunal_Apply_Feature_En "" VALUE 0x8003A82F CalPrmSsmBrk_UBYTE 0 OnOff1 0 255 SYMBOL_LINK "CalPrmSsmEng01.SSM_K_EPB_Maunal_Apply_Feature_En" 0 /end CHARACTERISTIC
/begin CHARACTERISTIC SSM_K_EPB_Maunal_Release_Feature_En "" VALUE 0x8003A830 CalPrmSsmBrk_UBYTE 0 OnOff1 0 255 SYMBOL_LINK "CalPrmSsmEng01.SSM_K_EPB_Maunal_Release_Feature_En" 0 /end CHARACTERISTIC
/begin CHARACTERISTIC SSM_K_EPB_P2X_Gear_Change_Time_Th "" VALUE 0x8003A87C CalPrmSsmBrk_UWORD 0 Ti21 0 655.35 SYMBOL_LINK "CalPrmSsmEng01.SSM_K_EPB_P2X_Gear_Change_Time_Th" 0 /end CHARACTERISTIC
/begin CHARACTERISTIC SSM_K_EPB_Pre_Release_Feature_En "" VALUE 0x8003A876 CalPrmSsmBrk_UBYTE 0 OnOff1 0 255 SYMBOL_LINK "CalPrmSsmEng01.SSM_K_EPB_Pre_Release_Feature_En" 0 /end CHARACTERISTIC
/begin CHARACTERISTIC SSM_K_EPB_PtoX_D_BrakeOnTime "" VALUE 0x8003A898 CalPrmSsmBrk_UBYTE 0 Ti21 0 2.55 SYMBOL_LINK "CalPrmSsmEng01.SSM_K_EPB_PtoX_D_BrakeOnTime" 0 /end CHARACTERISTIC
/begin CHARACTERISTIC SSM_K_EPB_PtoX_N_BrakeOnTime "" VALUE 0x8003A896 CalPrmSsmBrk_UBYTE 0 Ti21 0 2.55 SYMBOL_LINK "CalPrmSsmEng01.SSM_K_EPB_PtoX_N_BrakeOnTime" 0 /end CHARACTERISTIC
/begin CHARACTERISTIC SSM_K_EPB_PtoX_P_BrakeOnTime "" VALUE 0x8003A895 CalPrmSsmBrk_UBYTE 0 Ti21 0 2.55 SYMBOL_LINK "CalPrmSsmEng01.SSM_K_EPB_PtoX_P_BrakeOnTime" 0 /end CHARACTERISTIC
/begin CHARACTERISTIC SSM_K_EPB_PtoX_R_BrakeOnTime "" VALUE 0x8003A897 CalPrmSsmBrk_UBYTE 0 Ti21 0 2.55 SYMBOL_LINK "CalPrmSsmEng01.SSM_K_EPB_PtoX_R_BrakeOnTime" 0 /end CHARACTERISTIC
/begin CHARACTERISTIC SSM_K_EPB_PtoX_Release_DtoD_On_Act "" VALUE 0x8003A899 CalPrmSsmBrk_UBYTE 0 OnOff1 0 255 SYMBOL_LINK "CalPrmSsmEng01.SSM_K_EPB_PtoX_Release_DtoD_On_Act" 0 /end CHARACTERISTIC
/begin CHARACTERISTIC SSM_K_EPB_PtoX_Release_DtoX_On_Act "" VALUE 0x8003A87E CalPrmSsmBrk_UBYTE 0 OnOff1 0 255 SYMBOL_LINK "CalPrmSsmEng01.SSM_K_EPB_PtoX_Release_DtoX_On_Act" 0 /end CHARACTERISTIC
/begin CHARACTERISTIC SSM_K_EPB_PtoX_Release_Feature_En "" VALUE 0x8003A87F CalPrmSsmBrk_UBYTE 0 OnOff1 0 255 SYMBOL_LINK "CalPrmSsmEng01.SSM_K_EPB_PtoX_Release_Feature_En" 0 /end CHARACTERISTIC
/begin CHARACTERISTIC SSM_K_EPB_PtoX_Release_HillStop_Act "" VALUE 0x8003A880 CalPrmSsmBrk_UBYTE 0 OnOff1 0 255 SYMBOL_LINK "CalPrmSsmEng01.SSM_K_EPB_PtoX_Release_HillStop_Act" 0 /end CHARACTERISTIC
/begin CHARACTERISTIC SSM_K_EPB_PtoX_Release_NtoX_On_Act "" VALUE 0x8003A881 CalPrmSsmBrk_UBYTE 0 OnOff1 0 255 SYMBOL_LINK "CalPrmSsmEng01.SSM_K_EPB_PtoX_Release_NtoX_On_Act" 0 /end CHARACTERISTIC
/begin CHARACTERISTIC SSM_K_EPB_PtoX_Release_PtoX_On_Act "" VALUE 0x8003A882 CalPrmSsmBrk_UBYTE 0 OnOff1 0 255 SYMBOL_LINK "CalPrmSsmEng01.SSM_K_EPB_PtoX_Release_PtoX_On_Act" 0 /end CHARACTERISTIC
/begin CHARACTERISTIC SSM_K_EPB_PtoX_Release_RtoR_On_Act "" VALUE 0x8003A89A CalPrmSsmBrk_UBYTE 0 OnOff1 0 255 SYMBOL_LINK "CalPrmSsmEng01.SSM_K_EPB_PtoX_Release_RtoR_On_Act" 0 /end CHARACTERISTIC
/begin CHARACTERISTIC SSM_K_EPB_PtoX_Release_RtoX_On_Act "" VALUE 0x8003A883 CalPrmSsmBrk_UBYTE 0 OnOff1 0 255 SYMBOL_LINK "CalPrmSsmEng01.SSM_K_EPB_PtoX_Release_RtoX_On_Act" 0 /end CHARACTERISTIC
/begin CHARACTERISTIC SSM_K_EPB_Rollbench_Front_SPD_TH_H "" VALUE 0x8003A8A2 CalPrmSsmBrk_SWORD 0 Spd12 -4096 4095.875 SYMBOL_LINK "CalPrmSsmEng01.SSM_K_EPB_Rollbench_Front_SPD_TH_H" 0 /end CHARACTERISTIC
/begin CHARACTERISTIC SSM_K_EPB_Rollbench_Front_SPD_TH_L "" VALUE 0x8003A8A4 CalPrmSsmBrk_SWORD 0 Spd12 -4096 4095.875 SYMBOL_LINK "CalPrmSsmEng01.SSM_K_EPB_Rollbench_Front_SPD_TH_L" 0 /end CHARACTERISTIC
/begin CHARACTERISTIC SSM_K_EPB_Rollbench_Rear_SPD_TH_H "" VALUE 0x8003A8A6 CalPrmSsmBrk_SWORD 0 Spd12 -4096 4095.875 SYMBOL_LINK "CalPrmSsmEng01.SSM_K_EPB_Rollbench_Rear_SPD_TH_H" 0 /end CHARACTERISTIC
/begin CHARACTERISTIC SSM_K_EPB_Rollbench_Rear_SPD_TH_L "" VALUE 0x8003A8A8 CalPrmSsmBrk_SWORD 0 Spd12 -4096 4095.875 SYMBOL_LINK "CalPrmSsmEng01.SSM_K_EPB_Rollbench_Rear_SPD_TH_L" 0 /end CHARACTERISTIC
/begin CHARACTERISTIC SSM_K_EPB_Service_Release_DectTime "" VALUE 0x8003A870 CalPrmSsmBrk_UWORD 0 Ti21 0 655.35 SYMBOL_LINK "CalPrmSsmEng01.SSM_K_EPB_Service_Release_DectTime" 0 /end CHARACTERISTIC
/begin CHARACTERISTIC SSM_K_EPB_Service_Release_Feature_En "" VALUE 0x8003A872 CalPrmSsmBrk_UBYTE 0 OnOff1 0 255 SYMBOL_LINK "CalPrmSsmEng01.SSM_K_EPB_Service_Release_Feature_En" 0 /end CHARACTERISTIC
/begin CHARACTERISTIC SSM_K_EPB_Service_Release_Switch_On_Time "" VALUE 0x8003A874 CalPrmSsmBrk_UWORD 0 Ti21 0 655.35 SYMBOL_LINK "CalPrmSsmEng01.SSM_K_EPB_Service_Release_Switch_On_Time" 0 /end CHARACTERISTIC
/begin CHARACTERISTIC SSM_K_RollBench_Apply_Feature_En "" VALUE 0x8003A884 CalPrmSsmBrk_UBYTE 0 OnOff1 0 255 SYMBOL_LINK "CalPrmSsmEng01.SSM_K_RollBench_Apply_Feature_En" 0 /end CHARACTERISTIC
/begin CHARACTERISTIC TP_S16ETCSCpAftTrnMaxCnt "" VALUE 0x8003A38A CalPrmWspcEng_SWORD 0 Ti51 -655.36 655.34 SYMBOL_LINK "CalPrmWspcEng01.TP_S16ETCSCpAftTrnMaxCnt" 0 /end CHARACTERISTIC
/begin CHARACTERISTIC TP_S16ETCSCpAftTrnResetSpnCnt "" VALUE 0x8003A38C CalPrmWspcEng_SWORD 0 Gain -32768 32767 SYMBOL_LINK "CalPrmWspcEng01.TP_S16ETCSCpAftTrnResetSpnCnt" 0 /end CHARACTERISTIC
/begin CHARACTERISTIC TP_S16ETCSCpCdrnTrqDrpLmtCr[0][0] "" VALUE 0x8003A3B2 CalPrmWspcEng_SWORD 0 Tq2 -32768 32767 SYMBOL_LINK "CalPrmWspcEng01.TP_S16ETCSCpCdrnTrqDrpLmtCr[0][0]" 0 /end CHARACTERISTIC
/begin CHARACTERISTIC TP_S16ETCSCpCdrnTrqDrpLmtCr[0][1] "" VALUE 0x8003A3B4 CalPrmWspcEng_SWORD 0 Tq2 -32768 32767 SYMBOL_LINK "CalPrmWspcEng01.TP_S16ETCSCpCdrnTrqDrpLmtCr[0][1]" 0 /end CHARACTERISTIC
/begin CHARACTERISTIC TP_S16ETCSCpCdrnTrqDrpLmtCr[0][2] "" VALUE 0x8003A3B6 CalPrmWspcEng_SWORD 0 Tq2 -32768 32767 SYMBOL_LINK "CalPrmWspcEng01.TP_S16ETCSCpCdrnTrqDrpLmtCr[0][2]" 0 /end CHARACTERISTIC
/begin CHARACTERISTIC TP_S16ETCSCpCdrnTrqDrpLmtCr[1][0] "" VALUE 0x8003A3B8 CalPrmWspcEng_SWORD 0 Tq2 -32768 32767 SYMBOL_LINK "CalPrmWspcEng01.TP_S16ETCSCpCdrnTrqDrpLmtCr[1][0]" 0 /end CHARACTERISTIC
/begin CHARACTERISTIC TP_S16ETCSCpCdrnTrqDrpLmtCr[1][1] "" VALUE 0x8003A3BA CalPrmWspcEng_SWORD 0 Tq2 -32768 32767 SYMBOL_LINK "CalPrmWspcEng01.TP_S16ETCSCpCdrnTrqDrpLmtCr[1][1]" 0 /end CHARACTERISTIC
/begin CHARACTERISTIC TP_S16ETCSCpCdrnTrqDrpLmtCr[1][2] "" VALUE 0x8003A3BC CalPrmWspcEng_SWORD 0 Tq2 -32768 32767 SYMBOL_LINK "CalPrmWspcEng01.TP_S16ETCSCpCdrnTrqDrpLmtCr[1][2]" 0 /end CHARACTERISTIC
/begin CHARACTERISTIC TP_S16ETCSCpCdrnTrqDrpLmtCr[2][0] "" VALUE 0x8003A3BE CalPrmWspcEng_SWORD 0 Tq2 -32768 32767 SYMBOL_LINK "CalPrmWspcEng01.TP_S16ETCSCpCdrnTrqDrpLmtCr[2][0]" 0 /end CHARACTERISTIC
/begin CHARACTERISTIC TP_S16ETCSCpCdrnTrqDrpLmtCr[2][1] "" VALUE 0x8003A3C0 CalPrmWspcEng_SWORD 0 Tq2 -32768 32767 SYMBOL_LINK "CalPrmWspcEng01.TP_S16ETCSCpCdrnTrqDrpLmtCr[2][1]" 0 /end CHARACTERISTIC
/begin CHARACTERISTIC TP_S16ETCSCpCdrnTrqDrpLmtCr[2][2] "" VALUE 0x8003A3C2 CalPrmWspcEng_SWORD 0 Tq2 -32768 32767 SYMBOL_LINK "CalPrmWspcEng01.TP_S16ETCSCpCdrnTrqDrpLmtCr[2][2]" 0 /end CHARACTERISTIC
/begin CHARACTERISTIC TP_S16ETCSCpCircumferenceOfTire "" VALUE 0x8003A3C4 CalPrmWspcEng_SWORD 0 Len51 -32.768 32.767 SYMBOL_LINK "CalPrmWspcEng01.TP_S16ETCSCpCircumferenceOfTire" 0 /end CHARACTERISTIC
/begin CHARACTERISTIC TP_S16ETCSCpEngCmdTransTrq "" VALUE 0x8003A3CA CalPrmWspcEng_SWORD 0 Tq51 -3276.8 3276.7 SYMBOL_LINK "CalPrmWspcEng01.TP_S16ETCSCpEngCmdTransTrq" 0 /end CHARACTERISTIC
/begin CHARACTERISTIC TP_S16ETCSCpEngSpd[0] "" VALUE 0x8003A3CC CalPrmWspcEng_SWORD 0 N10 -32768 32767 SYMBOL_LINK "CalPrmWspcEng01.TP_S16ETCSCpEngSpd[0]" 0 /end CHARACTERISTIC
/begin CHARACTERISTIC TP_S16ETCSCpEngSpd[1] "" VALUE 0x8003A3CE CalPrmWspcEng_SWORD 0 N10 -32768 32767 SYMBOL_LINK "CalPrmWspcEng01.TP_S16ETCSCpEngSpd[1]" 0 /end CHARACTERISTIC
/begin CHARACTERISTIC TP_S16ETCSCpEngSpd[2] "" VALUE 0x8003A3D0 CalPrmWspcEng_SWORD 0 N10 -32768 32767 SYMBOL_LINK "CalPrmWspcEng01.TP_S16ETCSCpEngSpd[2]" 0 /end CHARACTERISTIC
/begin CHARACTERISTIC TP_S16ETCSCpEngSpd[3] "" VALUE 0x8003A3D2 CalPrmWspcEng_SWORD 0 N10 -32768 32767 SYMBOL_LINK "CalPrmWspcEng01.TP_S16ETCSCpEngSpd[3]" 0 /end CHARACTERISTIC
/begin CHARACTERISTIC TP_S16ETCSCpEngSpd[4] "" VALUE 0x8003A3D4 CalPrmWspcEng_SWORD 0 N10 -32768 32767 SYMBOL_LINK "CalPrmWspcEng01.TP_S16ETCSCpEngSpd[4]" 0 /end CHARACTERISTIC
/begin CHARACTERISTIC TP_S16ETCSCpFuncLampOffBrkTrq[0] "" VALUE 0x8003A3DC CalPrmWspcEng_SWORD 0 Tq31 -327680 327670 SYMBOL_LINK "CalPrmWspcEng01.TP_S16ETCSCpFuncLampOffBrkTrq[0]" 0 /end CHARACTERISTIC
/begin CHARACTERISTIC TP_S16ETCSCpFuncLampOffBrkTrq[1] "" VALUE 0x8003A3DE CalPrmWspcEng_SWORD 0 Tq31 -327680 327670 SYMBOL_LINK "CalPrmWspcEng01.TP_S16ETCSCpFuncLampOffBrkTrq[1]" 0 /end CHARACTERISTIC
/begin CHARACTERISTIC TP_S16ETCSCpLdTrqAsymSpinCplCnt "" VALUE 0x8003A3EE CalPrmWspcEng_SWORD 0 Ti51 -655.36 655.34 SYMBOL_LINK "CalPrmWspcEng01.TP_S16ETCSCpLdTrqAsymSpinCplCnt" 0 /end CHARACTERISTIC
/begin CHARACTERISTIC TP_S16ETCSCpLdTrqAsymSpinMaxCnt "" VALUE 0x8003A3F0 CalPrmWspcEng_SWORD 0 Ti51 -655.36 655.34 SYMBOL_LINK "CalPrmWspcEng01.TP_S16ETCSCpLdTrqAsymSpinMaxCnt" 0 /end CHARACTERISTIC
/begin CHARACTERISTIC TP_S16ETCSCpLdTrqAsymSpinMinCnt "" VALUE 0x8003A3F2 CalPrmWspcEng_SWORD 0 Ti51 -655.36 655.34 SYMBOL_LINK "CalPrmWspcEng01.TP_S16ETCSCpLdTrqAsymSpinMinCnt" 0 /end CHARACTERISTIC
/begin CHARACTERISTIC TP_S16ETCSCpLdTrqByAsymSpin "" VALUE 0x8003A3F4 CalPrmWspcEng_SWORD 0 Tq2 -32768 32767 SYMBOL_LINK "CalPrmWspcEng01.TP_S16ETCSCpLdTrqByAsymSpin" 0 /end CHARACTERISTIC
/begin CHARACTERISTIC TP_S16ETCSCpLdTrqByAsymSpinHill "" VALUE 0x8003A3F6 CalPrmWspcEng_SWORD 0 Tq2 -32768 32767 SYMBOL_LINK "CalPrmWspcEng01.TP_S16ETCSCpLdTrqByAsymSpinHill" 0 /end CHARACTERISTIC
/begin CHARACTERISTIC TP_S16ETCSCpLdTrqCntLwToSplt "" VALUE 0x8003A3F8 CalPrmWspcEng_SWORD 0 Ti51 -655.36 655.34 SYMBOL_LINK "CalPrmWspcEng01.TP_S16ETCSCpLdTrqCntLwToSplt" 0 /end CHARACTERISTIC
/begin CHARACTERISTIC TP_S16ETCSCpLmtCrngTarTrq[0] "" VALUE 0x8003A3FA CalPrmWspcEng_SWORD 0 Tq2 -32768 32767 SYMBOL_LINK "CalPrmWspcEng01.TP_S16ETCSCpLmtCrngTarTrq[0]" 0 /end CHARACTERISTIC
/begin CHARACTERISTIC TP_S16ETCSCpLmtCrngTarTrq[1] "" VALUE 0x8003A3FC CalPrmWspcEng_SWORD 0 Tq2 -32768 32767 SYMBOL_LINK "CalPrmWspcEng01.TP_S16ETCSCpLmtCrngTarTrq[1]" 0 /end CHARACTERISTIC
/begin CHARACTERISTIC TP_S16ETCSCpLmtCrngTarTrq[2] "" VALUE 0x8003A3FE CalPrmWspcEng_SWORD 0 Tq2 -32768 32767 SYMBOL_LINK "CalPrmWspcEng01.TP_S16ETCSCpLmtCrngTarTrq[2]" 0 /end CHARACTERISTIC
/begin CHARACTERISTIC TP_S16ETCSCpMaxEngTrq "" VALUE 0x8003A40A CalPrmWspcEng_SWORD 0 Tq2 -32768 32767 SYMBOL_LINK "CalPrmWspcEng01.TP_S16ETCSCpMaxEngTrq" 0 /end CHARACTERISTIC
/begin CHARACTERISTIC TP_S16ETCSCpMinCrdnCmdTrq "" VALUE 0x8003A410 CalPrmWspcEng_SWORD 0 Tq51 -3276.8 3276.7 SYMBOL_LINK "CalPrmWspcEng01.TP_S16ETCSCpMinCrdnCmdTrq" 0 /end CHARACTERISTIC
/begin CHARACTERISTIC TP_S16ETCSCpSpd[0] "" VALUE 0x8003A41C CalPrmWspcEng_SWORD 0 Spd12 -4096 4095.875 SYMBOL_LINK "CalPrmWspcEng01.TP_S16ETCSCpSpd[0]" 0 /end CHARACTERISTIC
/begin CHARACTERISTIC TP_S16ETCSCpSpd[1] "" VALUE 0x8003A41E CalPrmWspcEng_SWORD 0 Spd12 -4096 4095.875 SYMBOL_LINK "CalPrmWspcEng01.TP_S16ETCSCpSpd[1]" 0 /end CHARACTERISTIC
/begin CHARACTERISTIC TP_S16ETCSCpSpd[2] "" VALUE 0x8003A420 CalPrmWspcEng_SWORD 0 Spd12 -4096 4095.875 SYMBOL_LINK "CalPrmWspcEng01.TP_S16ETCSCpSpd[2]" 0 /end CHARACTERISTIC
/begin CHARACTERISTIC TP_S16ETCSCpSpd[3] "" VALUE 0x8003A422 CalPrmWspcEng_SWORD 0 Spd12 -4096 4095.875 SYMBOL_LINK "CalPrmWspcEng01.TP_S16ETCSCpSpd[3]" 0 /end CHARACTERISTIC
/begin CHARACTERISTIC TP_S16ETCSCpSpd[4] "" VALUE 0x8003A424 CalPrmWspcEng_SWORD 0 Spd12 -4096 4095.875 SYMBOL_LINK "CalPrmWspcEng01.TP_S16ETCSCpSpd[4]" 0 /end CHARACTERISTIC
/begin CHARACTERISTIC TP_S16ETCSCpSplitDecCrdnTrq "" VALUE 0x8003A426 CalPrmWspcEng_SWORD 0 Tq2 -32768 32767 SYMBOL_LINK "CalPrmWspcEng01.TP_S16ETCSCpSplitDecCrdnTrq" 0 /end CHARACTERISTIC
/begin CHARACTERISTIC TP_S16ETCSCpSplitDecTrqCplSpnErr "" VALUE 0x8003A428 CalPrmWspcEng_SWORD 0 Spd12 -4096 4095.875 SYMBOL_LINK "CalPrmWspcEng01.TP_S16ETCSCpSplitDecTrqCplSpnErr" 0 /end CHARACTERISTIC
/begin CHARACTERISTIC TP_S16ETCSCpSplitDecTrqStrSpnErr "" VALUE 0x8003A42A CalPrmWspcEng_SWORD 0 Spd12 -4096 4095.875 SYMBOL_LINK "CalPrmWspcEng01.TP_S16ETCSCpSplitDecTrqStrSpnErr" 0 /end CHARACTERISTIC
/begin CHARACTERISTIC TP_S16ETCSCpSpltPatFasIncTrqRate "" VALUE 0x8003A430 CalPrmWspcEng_SWORD 0 Ti51 -655.36 655.34 SYMBOL_LINK "CalPrmWspcEng01.TP_S16ETCSCpSpltPatFasIncTrqRate" 0 /end CHARACTERISTIC
/begin CHARACTERISTIC TP_S16ETCSCpSpltPatSlwDecTrqRate "" VALUE 0x8003A432 CalPrmWspcEng_SWORD 0 Tq51 -3276.8 3276.7 SYMBOL_LINK "CalPrmWspcEng01.TP_S16ETCSCpSpltPatSlwDecTrqRate" 0 /end CHARACTERISTIC
/begin CHARACTERISTIC TP_S16ETCSCpSpltPatSlwIncTrqRate "" VALUE 0x8003A434 CalPrmWspcEng_SWORD 0 Ti51 -655.36 655.34 SYMBOL_LINK "CalPrmWspcEng01.TP_S16ETCSCpSpltPatSlwIncTrqRate" 0 /end CHARACTERISTIC
/begin CHARACTERISTIC TP_S16ETCSCpSpltToLwTrqDrp[0][0] "" VALUE 0x8003A436 CalPrmWspcEng_SWORD 0 Tq2 -32768 32767 SYMBOL_LINK "CalPrmWspcEng01.TP_S16ETCSCpSpltToLwTrqDrp[0][0]" 0 /end CHARACTERISTIC
/begin CHARACTERISTIC TP_S16ETCSCpSpltToLwTrqDrp[0][1] "" VALUE 0x8003A438 CalPrmWspcEng_SWORD 0 Tq2 -32768 32767 SYMBOL_LINK "CalPrmWspcEng01.TP_S16ETCSCpSpltToLwTrqDrp[0][1]" 0 /end CHARACTERISTIC
/begin CHARACTERISTIC TP_S16ETCSCpSpltToLwTrqDrp[0][2] "" VALUE 0x8003A43A CalPrmWspcEng_SWORD 0 Tq2 -32768 32767 SYMBOL_LINK "CalPrmWspcEng01.TP_S16ETCSCpSpltToLwTrqDrp[0][2]" 0 /end CHARACTERISTIC
/begin CHARACTERISTIC TP_S16ETCSCpSpltToLwTrqDrp[1][0] "" VALUE 0x8003A43C CalPrmWspcEng_SWORD 0 Tq2 -32768 32767 SYMBOL_LINK "CalPrmWspcEng01.TP_S16ETCSCpSpltToLwTrqDrp[1][0]" 0 /end CHARACTERISTIC
/begin CHARACTERISTIC TP_S16ETCSCpSpltToLwTrqDrp[1][1] "" VALUE 0x8003A43E CalPrmWspcEng_SWORD 0 Tq2 -32768 32767 SYMBOL_LINK "CalPrmWspcEng01.TP_S16ETCSCpSpltToLwTrqDrp[1][1]" 0 /end CHARACTERISTIC
/begin CHARACTERISTIC TP_S16ETCSCpSpltToLwTrqDrp[1][2] "" VALUE 0x8003A440 CalPrmWspcEng_SWORD 0 Tq2 -32768 32767 SYMBOL_LINK "CalPrmWspcEng01.TP_S16ETCSCpSpltToLwTrqDrp[1][2]" 0 /end CHARACTERISTIC
/begin CHARACTERISTIC TP_S16ETCSCpSpltToLwTrqDrp[2][0] "" VALUE 0x8003A442 CalPrmWspcEng_SWORD 0 Tq2 -32768 32767 SYMBOL_LINK "CalPrmWspcEng01.TP_S16ETCSCpSpltToLwTrqDrp[2][0]" 0 /end CHARACTERISTIC
/begin CHARACTERISTIC TP_S16ETCSCpSpltToLwTrqDrp[2][1] "" VALUE 0x8003A444 CalPrmWspcEng_SWORD 0 Tq2 -32768 32767 SYMBOL_LINK "CalPrmWspcEng01.TP_S16ETCSCpSpltToLwTrqDrp[2][1]" 0 /end CHARACTERISTIC
/begin CHARACTERISTIC TP_S16ETCSCpSpltToLwTrqDrp[2][2] "" VALUE 0x8003A446 CalPrmWspcEng_SWORD 0 Tq2 -32768 32767 SYMBOL_LINK "CalPrmWspcEng01.TP_S16ETCSCpSpltToLwTrqDrp[2][2]" 0 /end CHARACTERISTIC
/begin CHARACTERISTIC TP_S16ETCSCpTEGWheelSpinThr "" VALUE 0x8003A44A CalPrmWspcEng_SWORD 0 Perc6 -32768 32767 SYMBOL_LINK "CalPrmWspcEng01.TP_S16ETCSCpTEGWheelSpinThr" 0 /end CHARACTERISTIC
/begin CHARACTERISTIC TP_S16ETCSCpTireRadi "" VALUE 0x8003A44C CalPrmWspcEng_SWORD 0 Len51 -32.768 32.767 SYMBOL_LINK "CalPrmWspcEng01.TP_S16ETCSCpTireRadi" 0 /end CHARACTERISTIC
/begin CHARACTERISTIC TP_S16ETCSCpTransTmAftDrvVib "" VALUE 0x8003A44E CalPrmWspcEng_SWORD 0 Ti51 -655.36 655.34 SYMBOL_LINK "CalPrmWspcEng01.TP_S16ETCSCpTransTmAftDrvVib" 0 /end CHARACTERISTIC
/begin CHARACTERISTIC TP_S16ETCSCpTrgtEngSpdStlDetd "" VALUE 0x8003A450 CalPrmWspcEng_SWORD 0 N10 -32768 32767 SYMBOL_LINK "CalPrmWspcEng01.TP_S16ETCSCpTrgtEngSpdStlDetd" 0 /end CHARACTERISTIC
/begin CHARACTERISTIC TP_S16ETCSCpTrgtOffStEngSpdStlDetd "" VALUE 0x8003A452 CalPrmWspcEng_SWORD 0 Gain -32768 32767 SYMBOL_LINK "CalPrmWspcEng01.TP_S16ETCSCpTrgtOffStEngSpdStlDetd" 0 /end CHARACTERISTIC
/begin CHARACTERISTIC TP_S16ETCSCpTrnfrCsGrRtoHgMd "" VALUE 0x8003A454 CalPrmWspcEng_SWORD 0 Fac31 -32768 32767 SYMBOL_LINK "CalPrmWspcEng01.TP_S16ETCSCpTrnfrCsGrRtoHgMd" 0 /end CHARACTERISTIC
/begin CHARACTERISTIC TP_S16ETCSCpTrnfrCsGrRtoLwMd "" VALUE 0x8003A456 CalPrmWspcEng_SWORD 0 Fac31 -32768 32767 SYMBOL_LINK "CalPrmWspcEng01.TP_S16ETCSCpTrnfrCsGrRtoLwMd" 0 /end CHARACTERISTIC
/begin CHARACTERISTIC TP_S16ETCSCpTtlVehMass "" VALUE 0x8003A45A CalPrmWspcEng_SWORD 0 M1 -32768 32767 SYMBOL_LINK "CalPrmWspcEng01.TP_S16ETCSCpTtlVehMass" 0 /end CHARACTERISTIC
/begin CHARACTERISTIC TP_S16TotalGearRatio_1 "This calibration parameter represents total gear ratio(=transmission gear ratio * final drive gear ratio) at 1st gear. This value can be obtained from vehicle specification or through the vehicle test which is designed for it." VALUE 0x8003A010 CalPrmCmnEng_SWORD 0 Fac31 -32768 32767 SYMBOL_LINK "CalPrmCmnEng01.TP_S16TotalGearRatio_1" 0 /end CHARACTERISTIC
/begin CHARACTERISTIC TP_S16TotalGearRatio_2 "This calibration parameter represents total gear ratio(=transmission gear ratio * final drive gear ratio) at 2nd gear. This value can be obtained from vehicle specification or through the vehicle test which is designed for it." VALUE 0x8003A012 CalPrmCmnEng_SWORD 0 Fac31 -32768 32767 SYMBOL_LINK "CalPrmCmnEng01.TP_S16TotalGearRatio_2" 0 /end CHARACTERISTIC
/begin CHARACTERISTIC TP_S16TotalGearRatio_3 "This calibration parameter represents total gear ratio(=transmission gear ratio * final drive gear ratio) at 3rd gear. This value can be obtained from vehicle specification or through the vehicle test which is designed for it." VALUE 0x8003A014 CalPrmCmnEng_SWORD 0 Fac31 -32768 32767 SYMBOL_LINK "CalPrmCmnEng01.TP_S16TotalGearRatio_3" 0 /end CHARACTERISTIC
/begin CHARACTERISTIC TP_S16TotalGearRatio_4 "This calibration parameter represents total gear ratio(=transmission gear ratio * final drive gear ratio) at 4th gear. This value can be obtained from vehicle specification or through the vehicle test which is designed for it." VALUE 0x8003A016 CalPrmCmnEng_SWORD 0 Fac31 -32768 32767 SYMBOL_LINK "CalPrmCmnEng01.TP_S16TotalGearRatio_4" 0 /end CHARACTERISTIC
/begin CHARACTERISTIC TP_S16TotalGearRatio_5 "This calibration parameter represents total gear ratio(=transmission gear ratio * final drive gear ratio) at 5th gear. This value can be obtained from vehicle specification or through the vehicle test which is designed for it." VALUE 0x8003A018 CalPrmCmnEng_SWORD 0 Fac31 -32768 32767 SYMBOL_LINK "CalPrmCmnEng01.TP_S16TotalGearRatio_5" 0 /end CHARACTERISTIC
/begin CHARACTERISTIC TP_S16TotalGearRatio_6 "This calibration parameter represents total gear ratio(=transmission gear ratio * final drive gear ratio) at 6th gear. This value can be obtained from vehicle specification or through the vehicle test which is designed for it." VALUE 0x8003A01A CalPrmCmnEng_SWORD 0 Fac31 -32768 32767 SYMBOL_LINK "CalPrmCmnEng01.TP_S16TotalGearRatio_6" 0 /end CHARACTERISTIC
/begin CHARACTERISTIC TP_S16TotalGearRatio_7 "This calibration parameter represents total gear ratio(=transmission gear ratio * final drive gear ratio) at 7th gear. This value can be obtained from vehicle specification or through the vehicle test which is designed for it." VALUE 0x8003A01C CalPrmCmnEng_SWORD 0 Fac31 -32768 32767 SYMBOL_LINK "CalPrmCmnEng01.TP_S16TotalGearRatio_7" 0 /end CHARACTERISTIC
/begin CHARACTERISTIC TP_S16TotalGearRatio_8 "This calibration parameter represents total gear ratio(=transmission gear ratio * final drive gear ratio) at 8th gear. This value can be obtained from vehicle specification or through the vehicle test which is designed for it." VALUE 0x8003A01E CalPrmCmnEng_SWORD 0 Fac31 -32768 32767 SYMBOL_LINK "CalPrmCmnEng01.TP_S16TotalGearRatio_8" 0 /end CHARACTERISTIC
/begin CHARACTERISTIC TP_S16TotalGearRatio_R "This calibration parameter represents total gear ratio(=transmission gear ratio * final drive gear ratio) at reverse gear. This value can be obtained from vehicle specification or through the vehicle test which is designed for it." VALUE 0x8003A020 CalPrmCmnEng_SWORD 0 Fac31 -32768 32767 SYMBOL_LINK "CalPrmCmnEng01.TP_S16TotalGearRatio_R" 0 /end CHARACTERISTIC
/begin CHARACTERISTIC TP_S16_AT_Eng_Status_Threshold "" VALUE 0x8003A162 CalPrmWslcEng_SWORD 0 Gain -32768 32767 SYMBOL_LINK "CalPrmWslcEng01.TP_S16_AT_Eng_Status_Threshold" 0 /end CHARACTERISTIC
/begin CHARACTERISTIC TP_S16_TOD_TORQ_CST_OVER1 "TOD Control Torque, while coasting, for oversteer" VALUE 0x8003A6AC CalPrmAwdCtrlrEng_SWORD 0 Gain -32768 32767 SYMBOL_LINK "CalPrmAwdCtrlrEng01.TP_S16_TOD_TORQ_CST_OVER1" 0 /end CHARACTERISTIC
/begin CHARACTERISTIC TP_S16_TOD_TORQ_CST_OVER2 "TOD Control Torque, while coasting, for severe oversteer" VALUE 0x8003A6AE CalPrmAwdCtrlrEng_SWORD 0 Gain -32768 32767 SYMBOL_LINK "CalPrmAwdCtrlrEng01.TP_S16_TOD_TORQ_CST_OVER2" 0 /end CHARACTERISTIC
/begin CHARACTERISTIC TP_S16_TOD_TORQ_CST_STABL "TOD Control Torque, while coasting, for stable" VALUE 0x8003A6B0 CalPrmAwdCtrlrEng_SWORD 0 Gain -32768 32767 SYMBOL_LINK "CalPrmAwdCtrlrEng01.TP_S16_TOD_TORQ_CST_STABL" 0 /end CHARACTERISTIC
/begin CHARACTERISTIC TP_S16_TOD_TORQ_CST_UNDER1 "TOD Control Torque, while coasting, for understeer" VALUE 0x8003A6B2 CalPrmAwdCtrlrEng_SWORD 0 Gain -32768 32767 SYMBOL_LINK "CalPrmAwdCtrlrEng01.TP_S16_TOD_TORQ_CST_UNDER1" 0 /end CHARACTERISTIC
/begin CHARACTERISTIC TP_S16_TOD_TORQ_CST_UNDER2 "TOD Control Torque, while coasting, for severe understeer" VALUE 0x8003A6B4 CalPrmAwdCtrlrEng_SWORD 0 Gain -32768 32767 SYMBOL_LINK "CalPrmAwdCtrlrEng01.TP_S16_TOD_TORQ_CST_UNDER2" 0 /end CHARACTERISTIC
/begin CHARACTERISTIC TP_S16_TOD_TORQ_HOT_OVER1 "TOD Control Torque, while driving with half open throttle, for oversteer" VALUE 0x8003A6B6 CalPrmAwdCtrlrEng_SWORD 0 Gain -32768 32767 SYMBOL_LINK "CalPrmAwdCtrlrEng01.TP_S16_TOD_TORQ_HOT_OVER1" 0 /end CHARACTERISTIC
/begin CHARACTERISTIC TP_S16_TOD_TORQ_HOT_OVER2 "TOD Control Torque, while driving with half open throttle, for severe oversteer" VALUE 0x8003A6B8 CalPrmAwdCtrlrEng_SWORD 0 Gain -32768 32767 SYMBOL_LINK "CalPrmAwdCtrlrEng01.TP_S16_TOD_TORQ_HOT_OVER2" 0 /end CHARACTERISTIC
/begin CHARACTERISTIC TP_S16_TOD_TORQ_HOT_STABL "TOD Control Torque, while driving with half open throttle, for stable" VALUE 0x8003A6BA CalPrmAwdCtrlrEng_SWORD 0 Gain -32768 32767 SYMBOL_LINK "CalPrmAwdCtrlrEng01.TP_S16_TOD_TORQ_HOT_STABL" 0 /end CHARACTERISTIC
/begin CHARACTERISTIC TP_S16_TOD_TORQ_HOT_UNDER1 "TOD Control Torque, while driving with half open throttle, for understeer" VALUE 0x8003A6BC CalPrmAwdCtrlrEng_SWORD 0 Gain -32768 32767 SYMBOL_LINK "CalPrmAwdCtrlrEng01.TP_S16_TOD_TORQ_HOT_UNDER1" 0 /end CHARACTERISTIC
/begin CHARACTERISTIC TP_S16_TOD_TORQ_HOT_UNDER2 "TOD Control Torque, while driving with half open throttle, for severe understeer" VALUE 0x8003A6BE CalPrmAwdCtrlrEng_SWORD 0 Gain -32768 32767 SYMBOL_LINK "CalPrmAwdCtrlrEng01.TP_S16_TOD_TORQ_HOT_UNDER2" 0 /end CHARACTERISTIC
/begin CHARACTERISTIC TP_S16_TOD_TORQ_WOT_OVER1 "TOD Control Torque, while driving with wide open throttle, for oversteer" VALUE 0x8003A6C0 CalPrmAwdCtrlrEng_SWORD 0 Gain -32768 32767 SYMBOL_LINK "CalPrmAwdCtrlrEng01.TP_S16_TOD_TORQ_WOT_OVER1" 0 /end CHARACTERISTIC
/begin CHARACTERISTIC TP_S16_TOD_TORQ_WOT_OVER2 "TOD Control Torque, while driving with wide open throttle, for severe oversteer" VALUE 0x8003A6C2 CalPrmAwdCtrlrEng_SWORD 0 Gain -32768 32767 SYMBOL_LINK "CalPrmAwdCtrlrEng01.TP_S16_TOD_TORQ_WOT_OVER2" 0 /end CHARACTERISTIC
/begin CHARACTERISTIC TP_S16_TOD_TORQ_WOT_STABL "TOD Control Torque, while driving with wide open throttle, for stable" VALUE 0x8003A6C4 CalPrmAwdCtrlrEng_SWORD 0 Gain -32768 32767 SYMBOL_LINK "CalPrmAwdCtrlrEng01.TP_S16_TOD_TORQ_WOT_STABL" 0 /end CHARACTERISTIC
/begin CHARACTERISTIC TP_S16_TOD_TORQ_WOT_UNDER1 "TOD Control Torque, while driving with wide open throttle, for understeer" VALUE 0x8003A6C6 CalPrmAwdCtrlrEng_SWORD 0 Gain -32768 32767 SYMBOL_LINK "CalPrmAwdCtrlrEng01.TP_S16_TOD_TORQ_WOT_UNDER1" 0 /end CHARACTERISTIC
/begin CHARACTERISTIC TP_S16_TOD_TORQ_WOT_UNDER2 "TOD Control Torque, while driving with wide open throttle, for severe understeer" VALUE 0x8003A6C8 CalPrmAwdCtrlrEng_SWORD 0 Gain -32768 32767 SYMBOL_LINK "CalPrmAwdCtrlrEng01.TP_S16_TOD_TORQ_WOT_UNDER2" 0 /end CHARACTERISTIC
/begin CHARACTERISTIC TP_S8ETCSCpLmtCrngTarSpn[0][0] "" VALUE 0x8003A474 CalPrmWspcEng_SBYTE 0 Spd12 -16 15.875 SYMBOL_LINK "CalPrmWspcEng01.TP_S8ETCSCpLmtCrngTarSpn[0][0]" 0 /end CHARACTERISTIC
/begin CHARACTERISTIC TP_S8ETCSCpLmtCrngTarSpn[0][1] "" VALUE 0x8003A475 CalPrmWspcEng_SBYTE 0 Spd12 -16 15.875 SYMBOL_LINK "CalPrmWspcEng01.TP_S8ETCSCpLmtCrngTarSpn[0][1]" 0 /end CHARACTERISTIC
/begin CHARACTERISTIC TP_S8ETCSCpLmtCrngTarSpn[0][2] "" VALUE 0x8003A476 CalPrmWspcEng_SBYTE 0 Spd12 -16 15.875 SYMBOL_LINK "CalPrmWspcEng01.TP_S8ETCSCpLmtCrngTarSpn[0][2]" 0 /end CHARACTERISTIC
/begin CHARACTERISTIC TP_S8ETCSCpLmtCrngTarSpn[0][3] "" VALUE 0x8003A477 CalPrmWspcEng_SBYTE 0 Spd12 -16 15.875 SYMBOL_LINK "CalPrmWspcEng01.TP_S8ETCSCpLmtCrngTarSpn[0][3]" 0 /end CHARACTERISTIC
/begin CHARACTERISTIC TP_S8ETCSCpLmtCrngTarSpn[0][4] "" VALUE 0x8003A478 CalPrmWspcEng_SBYTE 0 Spd12 -16 15.875 SYMBOL_LINK "CalPrmWspcEng01.TP_S8ETCSCpLmtCrngTarSpn[0][4]" 0 /end CHARACTERISTIC
/begin CHARACTERISTIC TP_S8ETCSCpLmtCrngTarSpn[1][0] "" VALUE 0x8003A479 CalPrmWspcEng_SBYTE 0 Spd12 -16 15.875 SYMBOL_LINK "CalPrmWspcEng01.TP_S8ETCSCpLmtCrngTarSpn[1][0]" 0 /end CHARACTERISTIC
/begin CHARACTERISTIC TP_S8ETCSCpLmtCrngTarSpn[1][1] "" VALUE 0x8003A47A CalPrmWspcEng_SBYTE 0 Spd12 -16 15.875 SYMBOL_LINK "CalPrmWspcEng01.TP_S8ETCSCpLmtCrngTarSpn[1][1]" 0 /end CHARACTERISTIC
/begin CHARACTERISTIC TP_S8ETCSCpLmtCrngTarSpn[1][2] "" VALUE 0x8003A47B CalPrmWspcEng_SBYTE 0 Spd12 -16 15.875 SYMBOL_LINK "CalPrmWspcEng01.TP_S8ETCSCpLmtCrngTarSpn[1][2]" 0 /end CHARACTERISTIC
/begin CHARACTERISTIC TP_S8ETCSCpLmtCrngTarSpn[1][3] "" VALUE 0x8003A47C CalPrmWspcEng_SBYTE 0 Spd12 -16 15.875 SYMBOL_LINK "CalPrmWspcEng01.TP_S8ETCSCpLmtCrngTarSpn[1][3]" 0 /end CHARACTERISTIC
/begin CHARACTERISTIC TP_S8ETCSCpLmtCrngTarSpn[1][4] "" VALUE 0x8003A47D CalPrmWspcEng_SBYTE 0 Spd12 -16 15.875 SYMBOL_LINK "CalPrmWspcEng01.TP_S8ETCSCpLmtCrngTarSpn[1][4]" 0 /end CHARACTERISTIC
/begin CHARACTERISTIC TP_S8ETCSCpLmtCrngTarSpn[2][0] "" VALUE 0x8003A47E CalPrmWspcEng_SBYTE 0 Spd12 -16 15.875 SYMBOL_LINK "CalPrmWspcEng01.TP_S8ETCSCpLmtCrngTarSpn[2][0]" 0 /end CHARACTERISTIC
/begin CHARACTERISTIC TP_S8ETCSCpLmtCrngTarSpn[2][1] "" VALUE 0x8003A47F CalPrmWspcEng_SBYTE 0 Spd12 -16 15.875 SYMBOL_LINK "CalPrmWspcEng01.TP_S8ETCSCpLmtCrngTarSpn[2][1]" 0 /end CHARACTERISTIC
/begin CHARACTERISTIC TP_S8ETCSCpLmtCrngTarSpn[2][2] "" VALUE 0x8003A480 CalPrmWspcEng_SBYTE 0 Spd12 -16 15.875 SYMBOL_LINK "CalPrmWspcEng01.TP_S8ETCSCpLmtCrngTarSpn[2][2]" 0 /end CHARACTERISTIC
/begin CHARACTERISTIC TP_S8ETCSCpLmtCrngTarSpn[2][3] "" VALUE 0x8003A481 CalPrmWspcEng_SBYTE 0 Spd12 -16 15.875 SYMBOL_LINK "CalPrmWspcEng01.TP_S8ETCSCpLmtCrngTarSpn[2][3]" 0 /end CHARACTERISTIC
/begin CHARACTERISTIC TP_S8ETCSCpLmtCrngTarSpn[2][4] "" VALUE 0x8003A482 CalPrmWspcEng_SBYTE 0 Spd12 -16 15.875 SYMBOL_LINK "CalPrmWspcEng01.TP_S8ETCSCpLmtCrngTarSpn[2][4]" 0 /end CHARACTERISTIC
/begin CHARACTERISTIC TP_S8ETCSCpPgTransTmDrvVib "" VALUE 0x8003A483 CalPrmWspcEng_SBYTE 0 Ti51 -2.56 2.54 SYMBOL_LINK "CalPrmWspcEng01.TP_S8ETCSCpPgTransTmDrvVib" 0 /end CHARACTERISTIC
/begin CHARACTERISTIC TP_S8ETCSCpTarSpnDec4Vib "" VALUE 0x8003A484 CalPrmWspcEng_SBYTE 0 Spd12 -16 15.875 SYMBOL_LINK "CalPrmWspcEng01.TP_S8ETCSCpTarSpnDec4Vib" 0 /end CHARACTERISTIC
/begin CHARACTERISTIC TP_S8ETCSCpTarSpnInc4Vib "" VALUE 0x8003A485 CalPrmWspcEng_SBYTE 0 Spd12 -16 15.875 SYMBOL_LINK "CalPrmWspcEng01.TP_S8ETCSCpTarSpnInc4Vib" 0 /end CHARACTERISTIC
/begin CHARACTERISTIC TP_S8_EDC_ENTRY_THR0_ESC_S1 "" VALUE 0x8003A0A3 CalPrmWslcEng_SBYTE 0 Spd12 -16 15.875 SYMBOL_LINK "CalPrmWslcEng01.TP_S8_EDC_ENTRY_THR0_ESC_S1" 0 /end CHARACTERISTIC
/begin CHARACTERISTIC TP_S8_EDC_ENTRY_THR0_ESC_S2 "" VALUE 0x8003A0A4 CalPrmWslcEng_SBYTE 0 Spd12 -16 15.875 SYMBOL_LINK "CalPrmWslcEng01.TP_S8_EDC_ENTRY_THR0_ESC_S2" 0 /end CHARACTERISTIC
/begin CHARACTERISTIC TP_S8_EDC_ENTRY_THR0_ESC_S3 "" VALUE 0x8003A0A5 CalPrmWslcEng_SBYTE 0 Spd12 -16 15.875 SYMBOL_LINK "CalPrmWslcEng01.TP_S8_EDC_ENTRY_THR0_ESC_S3" 0 /end CHARACTERISTIC
/begin CHARACTERISTIC TP_S8_EDC_ENTRY_THR0_ESC_S4 "" VALUE 0x8003A0A6 CalPrmWslcEng_SBYTE 0 Spd12 -16 15.875 SYMBOL_LINK "CalPrmWslcEng01.TP_S8_EDC_ENTRY_THR0_ESC_S4" 0 /end CHARACTERISTIC
/begin CHARACTERISTIC TP_S8_EDC_ENTRY_THR1_ESC_S1 "" VALUE 0x8003A0A7 CalPrmWslcEng_SBYTE 0 Spd12 -16 15.875 SYMBOL_LINK "CalPrmWslcEng01.TP_S8_EDC_ENTRY_THR1_ESC_S1" 0 /end CHARACTERISTIC
/begin CHARACTERISTIC TP_S8_EDC_ENTRY_THR1_ESC_S2 "" VALUE 0x8003A0A8 CalPrmWslcEng_SBYTE 0 Spd12 -16 15.875 SYMBOL_LINK "CalPrmWslcEng01.TP_S8_EDC_ENTRY_THR1_ESC_S2" 0 /end CHARACTERISTIC
/begin CHARACTERISTIC TP_S8_EDC_ENTRY_THR1_ESC_S3 "" VALUE 0x8003A0A9 CalPrmWslcEng_SBYTE 0 Spd12 -16 15.875 SYMBOL_LINK "CalPrmWslcEng01.TP_S8_EDC_ENTRY_THR1_ESC_S3" 0 /end CHARACTERISTIC
/begin CHARACTERISTIC TP_S8_EDC_ENTRY_THR1_ESC_S4 "" VALUE 0x8003A0AA CalPrmWslcEng_SBYTE 0 Spd12 -16 15.875 SYMBOL_LINK "CalPrmWslcEng01.TP_S8_EDC_ENTRY_THR1_ESC_S4" 0 /end CHARACTERISTIC
/begin CHARACTERISTIC TP_S8_EDC_ENTRY_THR2_ESC_S1 "" VALUE 0x8003A0AB CalPrmWslcEng_SBYTE 0 Spd12 -16 15.875 SYMBOL_LINK "CalPrmWslcEng01.TP_S8_EDC_ENTRY_THR2_ESC_S1" 0 /end CHARACTERISTIC
/begin CHARACTERISTIC TP_S8_EDC_ENTRY_THR2_ESC_S2 "" VALUE 0x8003A0AC CalPrmWslcEng_SBYTE 0 Spd12 -16 15.875 SYMBOL_LINK "CalPrmWslcEng01.TP_S8_EDC_ENTRY_THR2_ESC_S2" 0 /end CHARACTERISTIC
/begin CHARACTERISTIC TP_S8_EDC_ENTRY_THR2_ESC_S3 "" VALUE 0x8003A0AD CalPrmWslcEng_SBYTE 0 Spd12 -16 15.875 SYMBOL_LINK "CalPrmWslcEng01.TP_S8_EDC_ENTRY_THR2_ESC_S3" 0 /end CHARACTERISTIC
/begin CHARACTERISTIC TP_S8_EDC_ENTRY_THR2_ESC_S4 "" VALUE 0x8003A0AE CalPrmWslcEng_SBYTE 0 Spd12 -16 15.875 SYMBOL_LINK "CalPrmWslcEng01.TP_S8_EDC_ENTRY_THR2_ESC_S4" 0 /end CHARACTERISTIC
/begin CHARACTERISTIC TP_S8_EDC_EXIT_RELLAM_THR "" VALUE 0x8003A0B3 CalPrmWslcEng_SBYTE 0 Perc6 -128 127 SYMBOL_LINK "CalPrmWslcEng01.TP_S8_EDC_EXIT_RELLAM_THR" 0 /end CHARACTERISTIC
/begin CHARACTERISTIC TP_S8_EDC_EXIT_RELLAM_THR_3G0 "" VALUE 0x8003A0B4 CalPrmWslcEng_SBYTE 0 Perc6 -128 127 SYMBOL_LINK "CalPrmWslcEng01.TP_S8_EDC_EXIT_RELLAM_THR_3G0" 0 /end CHARACTERISTIC
/begin CHARACTERISTIC TP_S8_EDC_EXIT_SPEED_THR "" VALUE 0x8003A0B5 CalPrmWslcEng_SBYTE 0 Spd12 -16 15.875 SYMBOL_LINK "CalPrmWslcEng01.TP_S8_EDC_EXIT_SPEED_THR" 0 /end CHARACTERISTIC
/begin CHARACTERISTIC TP_S8_EDC_EXIT_SPEED_THR_3G0 "" VALUE 0x8003A0B6 CalPrmWslcEng_SBYTE 0 Spd12 -16 15.875 SYMBOL_LINK "CalPrmWslcEng01.TP_S8_EDC_EXIT_SPEED_THR_3G0" 0 /end CHARACTERISTIC
/begin CHARACTERISTIC TP_S8_EDC_TARGET_DELTA_V_ESC_S1 "" VALUE 0x8003A0BF CalPrmWslcEng_SBYTE 0 Spd12 -16 15.875 SYMBOL_LINK "CalPrmWslcEng01.TP_S8_EDC_TARGET_DELTA_V_ESC_S1" 0 /end CHARACTERISTIC
/begin CHARACTERISTIC TP_S8_EDC_TARGET_DELTA_V_ESC_S2 "" VALUE 0x8003A0C0 CalPrmWslcEng_SBYTE 0 Spd12 -16 15.875 SYMBOL_LINK "CalPrmWslcEng01.TP_S8_EDC_TARGET_DELTA_V_ESC_S2" 0 /end CHARACTERISTIC
/begin CHARACTERISTIC TP_S8_EDC_TARGET_DELTA_V_ESC_S3 "" VALUE 0x8003A0C1 CalPrmWslcEng_SBYTE 0 Spd12 -16 15.875 SYMBOL_LINK "CalPrmWslcEng01.TP_S8_EDC_TARGET_DELTA_V_ESC_S3" 0 /end CHARACTERISTIC
/begin CHARACTERISTIC TP_S8_EDC_TARGET_DELTA_V_ESC_S4 "" VALUE 0x8003A0C2 CalPrmWslcEng_SBYTE 0 Spd12 -16 15.875 SYMBOL_LINK "CalPrmWslcEng01.TP_S8_EDC_TARGET_DELTA_V_ESC_S4" 0 /end CHARACTERISTIC
/begin CHARACTERISTIC TP_S8_MT_Eng_Status_Threshold "" VALUE 0x8003A164 CalPrmWslcEng_SBYTE 0 Perc9 -12.8 12.7 SYMBOL_LINK "CalPrmWslcEng01.TP_S8_MT_Eng_Status_Threshold" 0 /end CHARACTERISTIC
/begin CHARACTERISTIC TP_U16ETCSCpStrCnvrgWhAngGrdThr "" VALUE 0x8003A488 CalPrmWspcEng_UWORD 0 Gain 0 65535 SYMBOL_LINK "CalPrmWspcEng01.TP_U16ETCSCpStrCnvrgWhAngGrdThr" 0 /end CHARACTERISTIC
/begin CHARACTERISTIC TP_U16ETCSCpStrCnvrgWhAngThr "" VALUE 0x8003A48A CalPrmWspcEng_UWORD 0 Gain 0 65535 SYMBOL_LINK "CalPrmWspcEng01.TP_U16ETCSCpStrCnvrgWhAngThr" 0 /end CHARACTERISTIC
/begin CHARACTERISTIC TP_U16ETCSCpTEGTimeAcclPdlThr "" VALUE 0x8003A48C CalPrmWspcEng_UWORD 0 Ti51 0 1310.7 SYMBOL_LINK "CalPrmWspcEng01.TP_U16ETCSCpTEGTimeAcclPdlThr" 0 /end CHARACTERISTIC
/begin CHARACTERISTIC TP_U8ETCSCpAddBstTarWhlSpn[0] "" VALUE 0x8003A490 CalPrmWspcEng_UBYTE 0 Spd12 0 31.875 SYMBOL_LINK "CalPrmWspcEng01.TP_U8ETCSCpAddBstTarWhlSpn[0]" 0 /end CHARACTERISTIC
/begin CHARACTERISTIC TP_U8ETCSCpAddBstTarWhlSpn[1] "" VALUE 0x8003A491 CalPrmWspcEng_UBYTE 0 Spd12 0 31.875 SYMBOL_LINK "CalPrmWspcEng01.TP_U8ETCSCpAddBstTarWhlSpn[1]" 0 /end CHARACTERISTIC
/begin CHARACTERISTIC TP_U8ETCSCpAddBstTarWhlSpn[2] "" VALUE 0x8003A492 CalPrmWspcEng_UBYTE 0 Spd12 0 31.875 SYMBOL_LINK "CalPrmWspcEng01.TP_U8ETCSCpAddBstTarWhlSpn[2]" 0 /end CHARACTERISTIC
/begin CHARACTERISTIC TP_U8ETCSCpAddTarWhlSpnLwToSp "" VALUE 0x8003A494 CalPrmWspcEng_UBYTE 0 Spd12 0 31.875 SYMBOL_LINK "CalPrmWspcEng01.TP_U8ETCSCpAddTarWhlSpnLwToSp" 0 /end CHARACTERISTIC
/begin CHARACTERISTIC TP_U8ETCSCpAddTarWhlSpnSp "" VALUE 0x8003A495 CalPrmWspcEng_UBYTE 0 Spd12 0 31.875 SYMBOL_LINK "CalPrmWspcEng01.TP_U8ETCSCpAddTarWhlSpnSp" 0 /end CHARACTERISTIC
/begin CHARACTERISTIC TP_U8ETCSCpAlwAddTar4DepSnwSpd "" VALUE 0x8003A496 CalPrmWspcEng_UBYTE 0 Spd12 0 31.875 SYMBOL_LINK "CalPrmWspcEng01.TP_U8ETCSCpAlwAddTar4DepSnwSpd" 0 /end CHARACTERISTIC
/begin CHARACTERISTIC TP_U8ETCSCpAxSenAvail "" VALUE 0x8003A4A9 CalPrmWspcEng_UBYTE 0 Fac31 0 255 SYMBOL_LINK "CalPrmWspcEng01.TP_U8ETCSCpAxSenAvail" 0 /end CHARACTERISTIC
/begin CHARACTERISTIC TP_U8ETCSCpAy[0] "" VALUE 0x8003A4AA CalPrmWspcEng_UBYTE 0 A42 0 2.55 SYMBOL_LINK "CalPrmWspcEng01.TP_U8ETCSCpAy[0]" 0 /end CHARACTERISTIC
/begin CHARACTERISTIC TP_U8ETCSCpAy[1] "" VALUE 0x8003A4AB CalPrmWspcEng_UBYTE 0 A42 0 2.55 SYMBOL_LINK "CalPrmWspcEng01.TP_U8ETCSCpAy[1]" 0 /end CHARACTERISTIC
/begin CHARACTERISTIC TP_U8ETCSCpAy[2] "" VALUE 0x8003A4AC CalPrmWspcEng_UBYTE 0 A42 0 2.55 SYMBOL_LINK "CalPrmWspcEng01.TP_U8ETCSCpAy[2]" 0 /end CHARACTERISTIC
/begin CHARACTERISTIC TP_U8ETCSCpBigEngSpdIgFac[0][0] "" VALUE 0x8003A4AD CalPrmWspcEng_UBYTE 0 Gain 0 255 SYMBOL_LINK "CalPrmWspcEng01.TP_U8ETCSCpBigEngSpdIgFac[0][0]" 0 /end CHARACTERISTIC
/begin CHARACTERISTIC TP_U8ETCSCpBigEngSpdIgFac[0][1] "" VALUE 0x8003A4AE CalPrmWspcEng_UBYTE 0 Gain 0 255 SYMBOL_LINK "CalPrmWspcEng01.TP_U8ETCSCpBigEngSpdIgFac[0][1]" 0 /end CHARACTERISTIC
/begin CHARACTERISTIC TP_U8ETCSCpBigEngSpdIgFac[0][2] "" VALUE 0x8003A4AF CalPrmWspcEng_UBYTE 0 Gain 0 255 SYMBOL_LINK "CalPrmWspcEng01.TP_U8ETCSCpBigEngSpdIgFac[0][2]" 0 /end CHARACTERISTIC
/begin CHARACTERISTIC TP_U8ETCSCpBigEngSpdIgFac[1][0] "" VALUE 0x8003A4B0 CalPrmWspcEng_UBYTE 0 Gain 0 255 SYMBOL_LINK "CalPrmWspcEng01.TP_U8ETCSCpBigEngSpdIgFac[1][0]" 0 /end CHARACTERISTIC
/begin CHARACTERISTIC TP_U8ETCSCpBigEngSpdIgFac[1][1] "" VALUE 0x8003A4B1 CalPrmWspcEng_UBYTE 0 Gain 0 255 SYMBOL_LINK "CalPrmWspcEng01.TP_U8ETCSCpBigEngSpdIgFac[1][1]" 0 /end CHARACTERISTIC
/begin CHARACTERISTIC TP_U8ETCSCpBigEngSpdIgFac[1][2] "" VALUE 0x8003A4B2 CalPrmWspcEng_UBYTE 0 Gain 0 255 SYMBOL_LINK "CalPrmWspcEng01.TP_U8ETCSCpBigEngSpdIgFac[1][2]" 0 /end CHARACTERISTIC
/begin CHARACTERISTIC TP_U8ETCSCpBigEngSpdIgFac[2][0] "" VALUE 0x8003A4B3 CalPrmWspcEng_UBYTE 0 Gain 0 255 SYMBOL_LINK "CalPrmWspcEng01.TP_U8ETCSCpBigEngSpdIgFac[2][0]" 0 /end CHARACTERISTIC
/begin CHARACTERISTIC TP_U8ETCSCpBigEngSpdIgFac[2][1] "" VALUE 0x8003A4B4 CalPrmWspcEng_UBYTE 0 Gain 0 255 SYMBOL_LINK "CalPrmWspcEng01.TP_U8ETCSCpBigEngSpdIgFac[2][1]" 0 /end CHARACTERISTIC
/begin CHARACTERISTIC TP_U8ETCSCpBigEngSpdIgFac[2][2] "" VALUE 0x8003A4B5 CalPrmWspcEng_UBYTE 0 Gain 0 255 SYMBOL_LINK "CalPrmWspcEng01.TP_U8ETCSCpBigEngSpdIgFac[2][2]" 0 /end CHARACTERISTIC
/begin CHARACTERISTIC TP_U8ETCSCpBigSpnIgFac[0][0] "" VALUE 0x8003A4B6 CalPrmWspcEng_UBYTE 0 Perc6 0 255 SYMBOL_LINK "CalPrmWspcEng01.TP_U8ETCSCpBigSpnIgFac[0][0]" 0 /end CHARACTERISTIC
/begin CHARACTERISTIC TP_U8ETCSCpBigSpnIgFac[0][1] "" VALUE 0x8003A4B7 CalPrmWspcEng_UBYTE 0 Perc6 0 255 SYMBOL_LINK "CalPrmWspcEng01.TP_U8ETCSCpBigSpnIgFac[0][1]" 0 /end CHARACTERISTIC
/begin CHARACTERISTIC TP_U8ETCSCpBigSpnIgFac[0][2] "" VALUE 0x8003A4B8 CalPrmWspcEng_UBYTE 0 Perc6 0 255 SYMBOL_LINK "CalPrmWspcEng01.TP_U8ETCSCpBigSpnIgFac[0][2]" 0 /end CHARACTERISTIC
/begin CHARACTERISTIC TP_U8ETCSCpBigSpnIgFac[1][0] "" VALUE 0x8003A4B9 CalPrmWspcEng_UBYTE 0 Perc6 0 255 SYMBOL_LINK "CalPrmWspcEng01.TP_U8ETCSCpBigSpnIgFac[1][0]" 0 /end CHARACTERISTIC
/begin CHARACTERISTIC TP_U8ETCSCpBigSpnIgFac[1][1] "" VALUE 0x8003A4BA CalPrmWspcEng_UBYTE 0 Perc6 0 255 SYMBOL_LINK "CalPrmWspcEng01.TP_U8ETCSCpBigSpnIgFac[1][1]" 0 /end CHARACTERISTIC
/begin CHARACTERISTIC TP_U8ETCSCpBigSpnIgFac[1][2] "" VALUE 0x8003A4BB CalPrmWspcEng_UBYTE 0 Perc6 0 255 SYMBOL_LINK "CalPrmWspcEng01.TP_U8ETCSCpBigSpnIgFac[1][2]" 0 /end CHARACTERISTIC
/begin CHARACTERISTIC TP_U8ETCSCpCnt4Tar1stIncInTrn "" VALUE 0x8003A4BC CalPrmWspcEng_UBYTE 0 Ti51 0 5.1 SYMBOL_LINK "CalPrmWspcEng01.TP_U8ETCSCpCnt4Tar1stIncInTrn" 0 /end CHARACTERISTIC
/begin CHARACTERISTIC TP_U8ETCSCpCnt4TarMaxDecInTrn "" VALUE 0x8003A4BD CalPrmWspcEng_UBYTE 0 Ti51 0 5.1 SYMBOL_LINK "CalPrmWspcEng01.TP_U8ETCSCpCnt4TarMaxDecInTrn" 0 /end CHARACTERISTIC
/begin CHARACTERISTIC TP_U8ETCSCpCrnExDctCnt "" VALUE 0x8003A4BE CalPrmWspcEng_UBYTE 0 Ti51 0 5.1 SYMBOL_LINK "CalPrmWspcEng01.TP_U8ETCSCpCrnExDctCnt" 0 /end CHARACTERISTIC
/begin CHARACTERISTIC TP_U8ETCSCpCtlActTmThInLmtCnrg "" VALUE 0x8003A4C1 CalPrmWspcEng_UBYTE 0 Ti51 0 5.1 SYMBOL_LINK "CalPrmWspcEng01.TP_U8ETCSCpCtlActTmThInLmtCnrg" 0 /end CHARACTERISTIC
/begin CHARACTERISTIC TP_U8ETCSCpDelYawDivrgGain[0][0] "" VALUE 0x8003A4C4 CalPrmWspcEng_UBYTE 0 Fac31 0 255 SYMBOL_LINK "CalPrmWspcEng01.TP_U8ETCSCpDelYawDivrgGain[0][0]" 0 /end CHARACTERISTIC
/begin CHARACTERISTIC TP_U8ETCSCpDelYawDivrgGain[0][1] "" VALUE 0x8003A4C5 CalPrmWspcEng_UBYTE 0 Fac31 0 255 SYMBOL_LINK "CalPrmWspcEng01.TP_U8ETCSCpDelYawDivrgGain[0][1]" 0 /end CHARACTERISTIC
/begin CHARACTERISTIC TP_U8ETCSCpDelYawDivrgGain[0][2] "" VALUE 0x8003A4C6 CalPrmWspcEng_UBYTE 0 Fac31 0 255 SYMBOL_LINK "CalPrmWspcEng01.TP_U8ETCSCpDelYawDivrgGain[0][2]" 0 /end CHARACTERISTIC
/begin CHARACTERISTIC TP_U8ETCSCpDelYawDivrgGain[0][3] "" VALUE 0x8003A4C7 CalPrmWspcEng_UBYTE 0 Fac31 0 255 SYMBOL_LINK "CalPrmWspcEng01.TP_U8ETCSCpDelYawDivrgGain[0][3]" 0 /end CHARACTERISTIC
/begin CHARACTERISTIC TP_U8ETCSCpDelYawDivrgGain[0][4] "" VALUE 0x8003A4C8 CalPrmWspcEng_UBYTE 0 Fac31 0 255 SYMBOL_LINK "CalPrmWspcEng01.TP_U8ETCSCpDelYawDivrgGain[0][4]" 0 /end CHARACTERISTIC
/begin CHARACTERISTIC TP_U8ETCSCpDelYawDivrgGain[1][0] "" VALUE 0x8003A4C9 CalPrmWspcEng_UBYTE 0 Fac31 0 255 SYMBOL_LINK "CalPrmWspcEng01.TP_U8ETCSCpDelYawDivrgGain[1][0]" 0 /end CHARACTERISTIC
/begin CHARACTERISTIC TP_U8ETCSCpDelYawDivrgGain[1][1] "" VALUE 0x8003A4CA CalPrmWspcEng_UBYTE 0 Fac31 0 255 SYMBOL_LINK "CalPrmWspcEng01.TP_U8ETCSCpDelYawDivrgGain[1][1]" 0 /end CHARACTERISTIC
/begin CHARACTERISTIC TP_U8ETCSCpDelYawDivrgGain[1][2] "" VALUE 0x8003A4CB CalPrmWspcEng_UBYTE 0 Fac31 0 255 SYMBOL_LINK "CalPrmWspcEng01.TP_U8ETCSCpDelYawDivrgGain[1][2]" 0 /end CHARACTERISTIC
/begin CHARACTERISTIC TP_U8ETCSCpDelYawDivrgGain[1][3] "" VALUE 0x8003A4CC CalPrmWspcEng_UBYTE 0 Fac31 0 255 SYMBOL_LINK "CalPrmWspcEng01.TP_U8ETCSCpDelYawDivrgGain[1][3]" 0 /end CHARACTERISTIC
/begin CHARACTERISTIC TP_U8ETCSCpDelYawDivrgGain[1][4] "" VALUE 0x8003A4CD CalPrmWspcEng_UBYTE 0 Fac31 0 255 SYMBOL_LINK "CalPrmWspcEng01.TP_U8ETCSCpDelYawDivrgGain[1][4]" 0 /end CHARACTERISTIC
/begin CHARACTERISTIC TP_U8ETCSCpDelYawDivrgGain[2][0] "" VALUE 0x8003A4CE CalPrmWspcEng_UBYTE 0 Fac31 0 255 SYMBOL_LINK "CalPrmWspcEng01.TP_U8ETCSCpDelYawDivrgGain[2][0]" 0 /end CHARACTERISTIC
/begin CHARACTERISTIC TP_U8ETCSCpDelYawDivrgGain[2][1] "" VALUE 0x8003A4CF CalPrmWspcEng_UBYTE 0 Fac31 0 255 SYMBOL_LINK "CalPrmWspcEng01.TP_U8ETCSCpDelYawDivrgGain[2][1]" 0 /end CHARACTERISTIC
/begin CHARACTERISTIC TP_U8ETCSCpDelYawDivrgGain[2][2] "" VALUE 0x8003A4D0 CalPrmWspcEng_UBYTE 0 Fac31 0 255 SYMBOL_LINK "CalPrmWspcEng01.TP_U8ETCSCpDelYawDivrgGain[2][2]" 0 /end CHARACTERISTIC
/begin CHARACTERISTIC TP_U8ETCSCpDelYawDivrgGain[2][3] "" VALUE 0x8003A4D1 CalPrmWspcEng_UBYTE 0 Fac31 0 255 SYMBOL_LINK "CalPrmWspcEng01.TP_U8ETCSCpDelYawDivrgGain[2][3]" 0 /end CHARACTERISTIC
/begin CHARACTERISTIC TP_U8ETCSCpDelYawDivrgGain[2][4] "" VALUE 0x8003A4D2 CalPrmWspcEng_UBYTE 0 Fac31 0 255 SYMBOL_LINK "CalPrmWspcEng01.TP_U8ETCSCpDelYawDivrgGain[2][4]" 0 /end CHARACTERISTIC
/begin CHARACTERISTIC TP_U8ETCSCpDelYawFstIncGain[0][0] "" VALUE 0x8003A4D3 CalPrmWspcEng_UBYTE 0 Fac31 0 255 SYMBOL_LINK "CalPrmWspcEng01.TP_U8ETCSCpDelYawFstIncGain[0][0]" 0 /end CHARACTERISTIC
/begin CHARACTERISTIC TP_U8ETCSCpDelYawFstIncGain[0][1] "" VALUE 0x8003A4D4 CalPrmWspcEng_UBYTE 0 Fac31 0 255 SYMBOL_LINK "CalPrmWspcEng01.TP_U8ETCSCpDelYawFstIncGain[0][1]" 0 /end CHARACTERISTIC
/begin CHARACTERISTIC TP_U8ETCSCpDelYawFstIncGain[0][2] "" VALUE 0x8003A4D5 CalPrmWspcEng_UBYTE 0 Fac31 0 255 SYMBOL_LINK "CalPrmWspcEng01.TP_U8ETCSCpDelYawFstIncGain[0][2]" 0 /end CHARACTERISTIC
/begin CHARACTERISTIC TP_U8ETCSCpDelYawFstIncGain[0][3] "" VALUE 0x8003A4D6 CalPrmWspcEng_UBYTE 0 Fac31 0 255 SYMBOL_LINK "CalPrmWspcEng01.TP_U8ETCSCpDelYawFstIncGain[0][3]" 0 /end CHARACTERISTIC
/begin CHARACTERISTIC TP_U8ETCSCpDelYawFstIncGain[0][4] "" VALUE 0x8003A4D7 CalPrmWspcEng_UBYTE 0 Fac31 0 255 SYMBOL_LINK "CalPrmWspcEng01.TP_U8ETCSCpDelYawFstIncGain[0][4]" 0 /end CHARACTERISTIC
/begin CHARACTERISTIC TP_U8ETCSCpDelYawFstIncGain[1][0] "" VALUE 0x8003A4D8 CalPrmWspcEng_UBYTE 0 Fac31 0 255 SYMBOL_LINK "CalPrmWspcEng01.TP_U8ETCSCpDelYawFstIncGain[1][0]" 0 /end CHARACTERISTIC
/begin CHARACTERISTIC TP_U8ETCSCpDelYawFstIncGain[1][1] "" VALUE 0x8003A4D9 CalPrmWspcEng_UBYTE 0 Fac31 0 255 SYMBOL_LINK "CalPrmWspcEng01.TP_U8ETCSCpDelYawFstIncGain[1][1]" 0 /end CHARACTERISTIC
/begin CHARACTERISTIC TP_U8ETCSCpDelYawFstIncGain[1][2] "" VALUE 0x8003A4DA CalPrmWspcEng_UBYTE 0 Fac31 0 255 SYMBOL_LINK "CalPrmWspcEng01.TP_U8ETCSCpDelYawFstIncGain[1][2]" 0 /end CHARACTERISTIC
/begin CHARACTERISTIC TP_U8ETCSCpDelYawFstIncGain[1][3] "" VALUE 0x8003A4DB CalPrmWspcEng_UBYTE 0 Fac31 0 255 SYMBOL_LINK "CalPrmWspcEng01.TP_U8ETCSCpDelYawFstIncGain[1][3]" 0 /end CHARACTERISTIC
/begin CHARACTERISTIC TP_U8ETCSCpDelYawFstIncGain[1][4] "" VALUE 0x8003A4DC CalPrmWspcEng_UBYTE 0 Fac31 0 255 SYMBOL_LINK "CalPrmWspcEng01.TP_U8ETCSCpDelYawFstIncGain[1][4]" 0 /end CHARACTERISTIC
/begin CHARACTERISTIC TP_U8ETCSCpDelYawFstIncGain[2][0] "" VALUE 0x8003A4DD CalPrmWspcEng_UBYTE 0 Fac31 0 255 SYMBOL_LINK "CalPrmWspcEng01.TP_U8ETCSCpDelYawFstIncGain[2][0]" 0 /end CHARACTERISTIC
/begin CHARACTERISTIC TP_U8ETCSCpDelYawFstIncGain[2][1] "" VALUE 0x8003A4DE CalPrmWspcEng_UBYTE 0 Fac31 0 255 SYMBOL_LINK "CalPrmWspcEng01.TP_U8ETCSCpDelYawFstIncGain[2][1]" 0 /end CHARACTERISTIC
/begin CHARACTERISTIC TP_U8ETCSCpDelYawFstIncGain[2][2] "" VALUE 0x8003A4DF CalPrmWspcEng_UBYTE 0 Fac31 0 255 SYMBOL_LINK "CalPrmWspcEng01.TP_U8ETCSCpDelYawFstIncGain[2][2]" 0 /end CHARACTERISTIC
/begin CHARACTERISTIC TP_U8ETCSCpDelYawFstIncGain[2][3] "" VALUE 0x8003A4E0 CalPrmWspcEng_UBYTE 0 Fac31 0 255 SYMBOL_LINK "CalPrmWspcEng01.TP_U8ETCSCpDelYawFstIncGain[2][3]" 0 /end CHARACTERISTIC
/begin CHARACTERISTIC TP_U8ETCSCpDelYawFstIncGain[2][4] "" VALUE 0x8003A4E1 CalPrmWspcEng_UBYTE 0 Fac31 0 255 SYMBOL_LINK "CalPrmWspcEng01.TP_U8ETCSCpDelYawFstIncGain[2][4]" 0 /end CHARACTERISTIC
/begin CHARACTERISTIC TP_U8ETCSCpDelYawLowTrqGain[0] "" VALUE 0x8003A4E2 CalPrmWspcEng_UBYTE 0 Fac31 0 255 SYMBOL_LINK "CalPrmWspcEng01.TP_U8ETCSCpDelYawLowTrqGain[0]" 0 /end CHARACTERISTIC
/begin CHARACTERISTIC TP_U8ETCSCpDelYawLowTrqGain[1] "" VALUE 0x8003A4E3 CalPrmWspcEng_UBYTE 0 Fac31 0 255 SYMBOL_LINK "CalPrmWspcEng01.TP_U8ETCSCpDelYawLowTrqGain[1]" 0 /end CHARACTERISTIC
/begin CHARACTERISTIC TP_U8ETCSCpDelYawLowTrqGain[2] "" VALUE 0x8003A4E4 CalPrmWspcEng_UBYTE 0 Fac31 0 255 SYMBOL_LINK "CalPrmWspcEng01.TP_U8ETCSCpDelYawLowTrqGain[2]" 0 /end CHARACTERISTIC
/begin CHARACTERISTIC TP_U8ETCSCpDelYawSlwIncGain[0][0] "" VALUE 0x8003A4E5 CalPrmWspcEng_UBYTE 0 Fac31 0 255 SYMBOL_LINK "CalPrmWspcEng01.TP_U8ETCSCpDelYawSlwIncGain[0][0]" 0 /end CHARACTERISTIC
/begin CHARACTERISTIC TP_U8ETCSCpDelYawSlwIncGain[0][1] "" VALUE 0x8003A4E6 CalPrmWspcEng_UBYTE 0 Fac31 0 255 SYMBOL_LINK "CalPrmWspcEng01.TP_U8ETCSCpDelYawSlwIncGain[0][1]" 0 /end CHARACTERISTIC
/begin CHARACTERISTIC TP_U8ETCSCpDelYawSlwIncGain[0][2] "" VALUE 0x8003A4E7 CalPrmWspcEng_UBYTE 0 Fac31 0 255 SYMBOL_LINK "CalPrmWspcEng01.TP_U8ETCSCpDelYawSlwIncGain[0][2]" 0 /end CHARACTERISTIC
/begin CHARACTERISTIC TP_U8ETCSCpDelYawSlwIncGain[0][3] "" VALUE 0x8003A4E8 CalPrmWspcEng_UBYTE 0 Fac31 0 255 SYMBOL_LINK "CalPrmWspcEng01.TP_U8ETCSCpDelYawSlwIncGain[0][3]" 0 /end CHARACTERISTIC
/begin CHARACTERISTIC TP_U8ETCSCpDelYawSlwIncGain[0][4] "" VALUE 0x8003A4E9 CalPrmWspcEng_UBYTE 0 Fac31 0 255 SYMBOL_LINK "CalPrmWspcEng01.TP_U8ETCSCpDelYawSlwIncGain[0][4]" 0 /end CHARACTERISTIC
/begin CHARACTERISTIC TP_U8ETCSCpDelYawSlwIncGain[1][0] "" VALUE 0x8003A4EA CalPrmWspcEng_UBYTE 0 Fac31 0 255 SYMBOL_LINK "CalPrmWspcEng01.TP_U8ETCSCpDelYawSlwIncGain[1][0]" 0 /end CHARACTERISTIC
/begin CHARACTERISTIC TP_U8ETCSCpDelYawSlwIncGain[1][1] "" VALUE 0x8003A4EB CalPrmWspcEng_UBYTE 0 Fac31 0 255 SYMBOL_LINK "CalPrmWspcEng01.TP_U8ETCSCpDelYawSlwIncGain[1][1]" 0 /end CHARACTERISTIC
/begin CHARACTERISTIC TP_U8ETCSCpDelYawSlwIncGain[1][2] "" VALUE 0x8003A4EC CalPrmWspcEng_UBYTE 0 Fac31 0 255 SYMBOL_LINK "CalPrmWspcEng01.TP_U8ETCSCpDelYawSlwIncGain[1][2]" 0 /end CHARACTERISTIC
/begin CHARACTERISTIC TP_U8ETCSCpDelYawSlwIncGain[1][3] "" VALUE 0x8003A4ED CalPrmWspcEng_UBYTE 0 Fac31 0 255 SYMBOL_LINK "CalPrmWspcEng01.TP_U8ETCSCpDelYawSlwIncGain[1][3]" 0 /end CHARACTERISTIC
/begin CHARACTERISTIC TP_U8ETCSCpDelYawSlwIncGain[1][4] "" VALUE 0x8003A4EE CalPrmWspcEng_UBYTE 0 Fac31 0 255 SYMBOL_LINK "CalPrmWspcEng01.TP_U8ETCSCpDelYawSlwIncGain[1][4]" 0 /end CHARACTERISTIC
/begin CHARACTERISTIC TP_U8ETCSCpDelYawSlwIncGain[2][0] "" VALUE 0x8003A4EF CalPrmWspcEng_UBYTE 0 Fac31 0 255 SYMBOL_LINK "CalPrmWspcEng01.TP_U8ETCSCpDelYawSlwIncGain[2][0]" 0 /end CHARACTERISTIC
/begin CHARACTERISTIC TP_U8ETCSCpDelYawSlwIncGain[2][1] "" VALUE 0x8003A4F0 CalPrmWspcEng_UBYTE 0 Fac31 0 255 SYMBOL_LINK "CalPrmWspcEng01.TP_U8ETCSCpDelYawSlwIncGain[2][1]" 0 /end CHARACTERISTIC
/begin CHARACTERISTIC TP_U8ETCSCpDelYawSlwIncGain[2][2] "" VALUE 0x8003A4F1 CalPrmWspcEng_UBYTE 0 Fac31 0 255 SYMBOL_LINK "CalPrmWspcEng01.TP_U8ETCSCpDelYawSlwIncGain[2][2]" 0 /end CHARACTERISTIC
/begin CHARACTERISTIC TP_U8ETCSCpDelYawSlwIncGain[2][3] "" VALUE 0x8003A4F2 CalPrmWspcEng_UBYTE 0 Fac31 0 255 SYMBOL_LINK "CalPrmWspcEng01.TP_U8ETCSCpDelYawSlwIncGain[2][3]" 0 /end CHARACTERISTIC
/begin CHARACTERISTIC TP_U8ETCSCpDelYawSlwIncGain[2][4] "" VALUE 0x8003A4F3 CalPrmWspcEng_UBYTE 0 Fac31 0 255 SYMBOL_LINK "CalPrmWspcEng01.TP_U8ETCSCpDelYawSlwIncGain[2][4]" 0 /end CHARACTERISTIC
/begin CHARACTERISTIC TP_U8ETCSCpDltYawOffset4MinTrgtSpn "" VALUE 0x8003A4F6 CalPrmWspcEng_UBYTE 0 AgSpd31 0 2.55 SYMBOL_LINK "CalPrmWspcEng01.TP_U8ETCSCpDltYawOffset4MinTrgtSpn" 0 /end CHARACTERISTIC
/begin CHARACTERISTIC TP_U8ETCSCpDltYawStbDctCnt "" VALUE 0x8003A4F7 CalPrmWspcEng_UBYTE 0 Ti51 0 5.1 SYMBOL_LINK "CalPrmWspcEng01.TP_U8ETCSCpDltYawStbDctCnt" 0 /end CHARACTERISTIC
/begin CHARACTERISTIC TP_U8ETCSCpEngTrqFltGainCmdDec "" VALUE 0x8003A4FA CalPrmWspcEng_UBYTE 0 Fac31 0 255 SYMBOL_LINK "CalPrmWspcEng01.TP_U8ETCSCpEngTrqFltGainCmdDec" 0 /end CHARACTERISTIC
/begin CHARACTERISTIC TP_U8ETCSCpEngTrqFltGainCmdInc "" VALUE 0x8003A4FB CalPrmWspcEng_UBYTE 0 Fac31 0 255 SYMBOL_LINK "CalPrmWspcEng01.TP_U8ETCSCpEngTrqFltGainCmdInc" 0 /end CHARACTERISTIC
/begin CHARACTERISTIC TP_U8ETCSCpFunLampOffCnt "" VALUE 0x8003A507 CalPrmWspcEng_UBYTE 0 Fac31 0 255 SYMBOL_LINK "CalPrmWspcEng01.TP_U8ETCSCpFunLampOffCnt" 0 /end CHARACTERISTIC
/begin CHARACTERISTIC TP_U8ETCSCpGainFacTransTme "" VALUE 0x8003A508 CalPrmWspcEng_UBYTE 0 Ti51 0 5.1 SYMBOL_LINK "CalPrmWspcEng01.TP_U8ETCSCpGainFacTransTme" 0 /end CHARACTERISTIC
/begin CHARACTERISTIC TP_U8ETCSCpGrHoldingTme "" VALUE 0x8003A50D CalPrmWspcEng_UBYTE 0 Ti51 0 5.1 SYMBOL_LINK "CalPrmWspcEng01.TP_U8ETCSCpGrHoldingTme" 0 /end CHARACTERISTIC
/begin CHARACTERISTIC TP_U8ETCSCpGrRtErrThr_ABS "" VALUE 0x8003A50E CalPrmWspcEng_UBYTE 0 Perc6 0 255 SYMBOL_LINK "CalPrmWspcEng01.TP_U8ETCSCpGrRtErrThr_ABS" 0 /end CHARACTERISTIC
/begin CHARACTERISTIC TP_U8ETCSCpGrRtErrThr_Cstng "" VALUE 0x8003A50F CalPrmWspcEng_UBYTE 0 Perc6 0 255 SYMBOL_LINK "CalPrmWspcEng01.TP_U8ETCSCpGrRtErrThr_Cstng" 0 /end CHARACTERISTIC
/begin CHARACTERISTIC TP_U8ETCSCpGrRtErrThr_Shftng "" VALUE 0x8003A510 CalPrmWspcEng_UBYTE 0 Perc6 0 255 SYMBOL_LINK "CalPrmWspcEng01.TP_U8ETCSCpGrRtErrThr_Shftng" 0 /end CHARACTERISTIC
/begin CHARACTERISTIC TP_U8ETCSCpGrRtErrThr_Smth "" VALUE 0x8003A511 CalPrmWspcEng_UBYTE 0 Perc6 0 255 SYMBOL_LINK "CalPrmWspcEng01.TP_U8ETCSCpGrRtErrThr_Smth" 0 /end CHARACTERISTIC
/begin CHARACTERISTIC TP_U8ETCSCpGrRtErrThr_Spin_HghLmt "" VALUE 0x8003A512 CalPrmWspcEng_UBYTE 0 Perc6 0 255 SYMBOL_LINK "CalPrmWspcEng01.TP_U8ETCSCpGrRtErrThr_Spin_HghLmt" 0 /end CHARACTERISTIC
/begin CHARACTERISTIC TP_U8ETCSCpGrRtErrThr_Spin_LowLmt "" VALUE 0x8003A513 CalPrmWspcEng_UBYTE 0 Perc6 0 255 SYMBOL_LINK "CalPrmWspcEng01.TP_U8ETCSCpGrRtErrThr_Spin_LowLmt" 0 /end CHARACTERISTIC
/begin CHARACTERISTIC TP_U8ETCSCpGrRtErrThr_Trctn "" VALUE 0x8003A514 CalPrmWspcEng_UBYTE 0 Perc6 0 255 SYMBOL_LINK "CalPrmWspcEng01.TP_U8ETCSCpGrRtErrThr_Trctn" 0 /end CHARACTERISTIC
/begin CHARACTERISTIC TP_U8ETCSCpGrTransTme "" VALUE 0x8003A515 CalPrmWspcEng_UBYTE 0 Ti51 0 5.1 SYMBOL_LINK "CalPrmWspcEng01.TP_U8ETCSCpGrTransTme" 0 /end CHARACTERISTIC
/begin CHARACTERISTIC TP_U8ETCSCpGrdLdTrqChngFac "" VALUE 0x8003A50B CalPrmWspcEng_UBYTE 0 Gain 0 255 SYMBOL_LINK "CalPrmWspcEng01.TP_U8ETCSCpGrdLdTrqChngFac" 0 /end CHARACTERISTIC
/begin CHARACTERISTIC TP_U8ETCSCpHighBigSpnTh "" VALUE 0x8003A51A CalPrmWspcEng_UBYTE 0 Spd12 0 31.875 SYMBOL_LINK "CalPrmWspcEng01.TP_U8ETCSCpHighBigSpnTh" 0 /end CHARACTERISTIC
/begin CHARACTERISTIC TP_U8ETCSCpHighSpnTh "" VALUE 0x8003A51C CalPrmWspcEng_UBYTE 0 Spd12 0 31.875 SYMBOL_LINK "CalPrmWspcEng01.TP_U8ETCSCpHighSpnTh" 0 /end CHARACTERISTIC
/begin CHARACTERISTIC TP_U8ETCSCpIGainIncFacAsymVib "" VALUE 0x8003A535 CalPrmWspcEng_UBYTE 0 Perc3 0 2550 SYMBOL_LINK "CalPrmWspcEng01.TP_U8ETCSCpIGainIncFacAsymVib" 0 /end CHARACTERISTIC
/begin CHARACTERISTIC TP_U8ETCSCpIGainIncFacHldVib "" VALUE 0x8003A536 CalPrmWspcEng_UBYTE 0 Perc3 0 2550 SYMBOL_LINK "CalPrmWspcEng01.TP_U8ETCSCpIGainIncFacHldVib" 0 /end CHARACTERISTIC
/begin CHARACTERISTIC TP_U8ETCSCpIGainIncFacVib "" VALUE 0x8003A537 CalPrmWspcEng_UBYTE 0 Perc3 0 2550 SYMBOL_LINK "CalPrmWspcEng01.TP_U8ETCSCpIGainIncFacVib" 0 /end CHARACTERISTIC
/begin CHARACTERISTIC TP_U8ETCSCpIGainLmtFac[0][0] "" VALUE 0x8003A538 CalPrmWspcEng_UBYTE 0 Gain 0 255 SYMBOL_LINK "CalPrmWspcEng01.TP_U8ETCSCpIGainLmtFac[0][0]" 0 /end CHARACTERISTIC
/begin CHARACTERISTIC TP_U8ETCSCpIGainLmtFac[0][1] "" VALUE 0x8003A539 CalPrmWspcEng_UBYTE 0 Gain 0 255 SYMBOL_LINK "CalPrmWspcEng01.TP_U8ETCSCpIGainLmtFac[0][1]" 0 /end CHARACTERISTIC
/begin CHARACTERISTIC TP_U8ETCSCpIGainLmtFac[0][2] "" VALUE 0x8003A53A CalPrmWspcEng_UBYTE 0 Gain 0 255 SYMBOL_LINK "CalPrmWspcEng01.TP_U8ETCSCpIGainLmtFac[0][2]" 0 /end CHARACTERISTIC
/begin CHARACTERISTIC TP_U8ETCSCpIGainLmtFac[1][0] "" VALUE 0x8003A53B CalPrmWspcEng_UBYTE 0 Gain 0 255 SYMBOL_LINK "CalPrmWspcEng01.TP_U8ETCSCpIGainLmtFac[1][0]" 0 /end CHARACTERISTIC
/begin CHARACTERISTIC TP_U8ETCSCpIGainLmtFac[1][1] "" VALUE 0x8003A53C CalPrmWspcEng_UBYTE 0 Gain 0 255 SYMBOL_LINK "CalPrmWspcEng01.TP_U8ETCSCpIGainLmtFac[1][1]" 0 /end CHARACTERISTIC
/begin CHARACTERISTIC TP_U8ETCSCpIGainLmtFac[1][2] "" VALUE 0x8003A53D CalPrmWspcEng_UBYTE 0 Gain 0 255 SYMBOL_LINK "CalPrmWspcEng01.TP_U8ETCSCpIGainLmtFac[1][2]" 0 /end CHARACTERISTIC
/begin CHARACTERISTIC TP_U8ETCSCpIGainLmtFac[2][0] "" VALUE 0x8003A53E CalPrmWspcEng_UBYTE 0 Gain 0 255 SYMBOL_LINK "CalPrmWspcEng01.TP_U8ETCSCpIGainLmtFac[2][0]" 0 /end CHARACTERISTIC
/begin CHARACTERISTIC TP_U8ETCSCpIGainLmtFac[2][1] "" VALUE 0x8003A53F CalPrmWspcEng_UBYTE 0 Gain 0 255 SYMBOL_LINK "CalPrmWspcEng01.TP_U8ETCSCpIGainLmtFac[2][1]" 0 /end CHARACTERISTIC
/begin CHARACTERISTIC TP_U8ETCSCpIGainLmtFac[2][2] "" VALUE 0x8003A540 CalPrmWspcEng_UBYTE 0 Gain 0 255 SYMBOL_LINK "CalPrmWspcEng01.TP_U8ETCSCpIGainLmtFac[2][2]" 0 /end CHARACTERISTIC
/begin CHARACTERISTIC TP_U8ETCSCpIgFacGrChgErrNeg[0] "" VALUE 0x8003A541 CalPrmWspcEng_UBYTE 0 Fac31 0 255 SYMBOL_LINK "CalPrmWspcEng01.TP_U8ETCSCpIgFacGrChgErrNeg[0]" 0 /end CHARACTERISTIC
/begin CHARACTERISTIC TP_U8ETCSCpIgFacGrChgErrNeg[1] "" VALUE 0x8003A542 CalPrmWspcEng_UBYTE 0 Fac31 0 255 SYMBOL_LINK "CalPrmWspcEng01.TP_U8ETCSCpIgFacGrChgErrNeg[1]" 0 /end CHARACTERISTIC
/begin CHARACTERISTIC TP_U8ETCSCpIgFacGrChgErrNeg[2] "" VALUE 0x8003A543 CalPrmWspcEng_UBYTE 0 Fac31 0 255 SYMBOL_LINK "CalPrmWspcEng01.TP_U8ETCSCpIgFacGrChgErrNeg[2]" 0 /end CHARACTERISTIC
/begin CHARACTERISTIC TP_U8ETCSCpIgFacGrChgErrNeg[3] "" VALUE 0x8003A544 CalPrmWspcEng_UBYTE 0 Fac31 0 255 SYMBOL_LINK "CalPrmWspcEng01.TP_U8ETCSCpIgFacGrChgErrNeg[3]" 0 /end CHARACTERISTIC
/begin CHARACTERISTIC TP_U8ETCSCpIgFacGrChgErrNeg[4] "" VALUE 0x8003A545 CalPrmWspcEng_UBYTE 0 Fac31 0 255 SYMBOL_LINK "CalPrmWspcEng01.TP_U8ETCSCpIgFacGrChgErrNeg[4]" 0 /end CHARACTERISTIC
/begin CHARACTERISTIC TP_U8ETCSCpIgFacGrChgErrPos[0] "" VALUE 0x8003A546 CalPrmWspcEng_UBYTE 0 Fac31 0 255 SYMBOL_LINK "CalPrmWspcEng01.TP_U8ETCSCpIgFacGrChgErrPos[0]" 0 /end CHARACTERISTIC
/begin CHARACTERISTIC TP_U8ETCSCpIgFacGrChgErrPos[1] "" VALUE 0x8003A547 CalPrmWspcEng_UBYTE 0 Fac31 0 255 SYMBOL_LINK "CalPrmWspcEng01.TP_U8ETCSCpIgFacGrChgErrPos[1]" 0 /end CHARACTERISTIC
/begin CHARACTERISTIC TP_U8ETCSCpIgFacGrChgErrPos[2] "" VALUE 0x8003A548 CalPrmWspcEng_UBYTE 0 Fac31 0 255 SYMBOL_LINK "CalPrmWspcEng01.TP_U8ETCSCpIgFacGrChgErrPos[2]" 0 /end CHARACTERISTIC
/begin CHARACTERISTIC TP_U8ETCSCpIgFacGrChgErrPos[3] "" VALUE 0x8003A549 CalPrmWspcEng_UBYTE 0 Fac31 0 255 SYMBOL_LINK "CalPrmWspcEng01.TP_U8ETCSCpIgFacGrChgErrPos[3]" 0 /end CHARACTERISTIC
/begin CHARACTERISTIC TP_U8ETCSCpIgFacGrChgErrPos[4] "" VALUE 0x8003A54A CalPrmWspcEng_UBYTE 0 Fac31 0 255 SYMBOL_LINK "CalPrmWspcEng01.TP_U8ETCSCpIgFacGrChgErrPos[4]" 0 /end CHARACTERISTIC
/begin CHARACTERISTIC TP_U8ETCSCpIgFacInTrn[0][0] "" VALUE 0x8003A54B CalPrmWspcEng_UBYTE 0 Fac31 0 255 SYMBOL_LINK "CalPrmWspcEng01.TP_U8ETCSCpIgFacInTrn[0][0]" 0 /end CHARACTERISTIC
/begin CHARACTERISTIC TP_U8ETCSCpIgFacInTrn[0][1] "" VALUE 0x8003A54C CalPrmWspcEng_UBYTE 0 Fac31 0 255 SYMBOL_LINK "CalPrmWspcEng01.TP_U8ETCSCpIgFacInTrn[0][1]" 0 /end CHARACTERISTIC
/begin CHARACTERISTIC TP_U8ETCSCpIgFacInTrn[0][2] "" VALUE 0x8003A54D CalPrmWspcEng_UBYTE 0 Fac31 0 255 SYMBOL_LINK "CalPrmWspcEng01.TP_U8ETCSCpIgFacInTrn[0][2]" 0 /end CHARACTERISTIC
/begin CHARACTERISTIC TP_U8ETCSCpIgFacInTrn[0][3] "" VALUE 0x8003A54E CalPrmWspcEng_UBYTE 0 Fac31 0 255 SYMBOL_LINK "CalPrmWspcEng01.TP_U8ETCSCpIgFacInTrn[0][3]" 0 /end CHARACTERISTIC
/begin CHARACTERISTIC TP_U8ETCSCpIgFacInTrn[0][4] "" VALUE 0x8003A54F CalPrmWspcEng_UBYTE 0 Fac31 0 255 SYMBOL_LINK "CalPrmWspcEng01.TP_U8ETCSCpIgFacInTrn[0][4]" 0 /end CHARACTERISTIC
/begin CHARACTERISTIC TP_U8ETCSCpIgFacInTrn[1][0] "" VALUE 0x8003A550 CalPrmWspcEng_UBYTE 0 Fac31 0 255 SYMBOL_LINK "CalPrmWspcEng01.TP_U8ETCSCpIgFacInTrn[1][0]" 0 /end CHARACTERISTIC
/begin CHARACTERISTIC TP_U8ETCSCpIgFacInTrn[1][1] "" VALUE 0x8003A551 CalPrmWspcEng_UBYTE 0 Fac31 0 255 SYMBOL_LINK "CalPrmWspcEng01.TP_U8ETCSCpIgFacInTrn[1][1]" 0 /end CHARACTERISTIC
/begin CHARACTERISTIC TP_U8ETCSCpIgFacInTrn[1][2] "" VALUE 0x8003A552 CalPrmWspcEng_UBYTE 0 Fac31 0 255 SYMBOL_LINK "CalPrmWspcEng01.TP_U8ETCSCpIgFacInTrn[1][2]" 0 /end CHARACTERISTIC
/begin CHARACTERISTIC TP_U8ETCSCpIgFacInTrn[1][3] "" VALUE 0x8003A553 CalPrmWspcEng_UBYTE 0 Fac31 0 255 SYMBOL_LINK "CalPrmWspcEng01.TP_U8ETCSCpIgFacInTrn[1][3]" 0 /end CHARACTERISTIC
/begin CHARACTERISTIC TP_U8ETCSCpIgFacInTrn[1][4] "" VALUE 0x8003A554 CalPrmWspcEng_UBYTE 0 Fac31 0 255 SYMBOL_LINK "CalPrmWspcEng01.TP_U8ETCSCpIgFacInTrn[1][4]" 0 /end CHARACTERISTIC
/begin CHARACTERISTIC TP_U8ETCSCpIgFacInTrn[2][0] "" VALUE 0x8003A555 CalPrmWspcEng_UBYTE 0 Fac31 0 255 SYMBOL_LINK "CalPrmWspcEng01.TP_U8ETCSCpIgFacInTrn[2][0]" 0 /end CHARACTERISTIC
/begin CHARACTERISTIC TP_U8ETCSCpIgFacInTrn[2][1] "" VALUE 0x8003A556 CalPrmWspcEng_UBYTE 0 Fac31 0 255 SYMBOL_LINK "CalPrmWspcEng01.TP_U8ETCSCpIgFacInTrn[2][1]" 0 /end CHARACTERISTIC
/begin CHARACTERISTIC TP_U8ETCSCpIgFacInTrn[2][2] "" VALUE 0x8003A557 CalPrmWspcEng_UBYTE 0 Fac31 0 255 SYMBOL_LINK "CalPrmWspcEng01.TP_U8ETCSCpIgFacInTrn[2][2]" 0 /end CHARACTERISTIC
/begin CHARACTERISTIC TP_U8ETCSCpIgFacInTrn[2][3] "" VALUE 0x8003A558 CalPrmWspcEng_UBYTE 0 Fac31 0 255 SYMBOL_LINK "CalPrmWspcEng01.TP_U8ETCSCpIgFacInTrn[2][3]" 0 /end CHARACTERISTIC
/begin CHARACTERISTIC TP_U8ETCSCpIgFacInTrn[2][4] "" VALUE 0x8003A559 CalPrmWspcEng_UBYTE 0 Fac31 0 255 SYMBOL_LINK "CalPrmWspcEng01.TP_U8ETCSCpIgFacInTrn[2][4]" 0 /end CHARACTERISTIC
/begin CHARACTERISTIC TP_U8ETCSCpIgainFacAftrTrn[0][0] "" VALUE 0x8003A526 CalPrmWspcEng_UBYTE 0 Fac31 0 255 SYMBOL_LINK "CalPrmWspcEng01.TP_U8ETCSCpIgainFacAftrTrn[0][0]" 0 /end CHARACTERISTIC
/begin CHARACTERISTIC TP_U8ETCSCpIgainFacAftrTrn[0][1] "" VALUE 0x8003A527 CalPrmWspcEng_UBYTE 0 Fac31 0 255 SYMBOL_LINK "CalPrmWspcEng01.TP_U8ETCSCpIgainFacAftrTrn[0][1]" 0 /end CHARACTERISTIC
/begin CHARACTERISTIC TP_U8ETCSCpIgainFacAftrTrn[0][2] "" VALUE 0x8003A528 CalPrmWspcEng_UBYTE 0 Fac31 0 255 SYMBOL_LINK "CalPrmWspcEng01.TP_U8ETCSCpIgainFacAftrTrn[0][2]" 0 /end CHARACTERISTIC
/begin CHARACTERISTIC TP_U8ETCSCpIgainFacAftrTrn[0][3] "" VALUE 0x8003A529 CalPrmWspcEng_UBYTE 0 Fac31 0 255 SYMBOL_LINK "CalPrmWspcEng01.TP_U8ETCSCpIgainFacAftrTrn[0][3]" 0 /end CHARACTERISTIC
/begin CHARACTERISTIC TP_U8ETCSCpIgainFacAftrTrn[0][4] "" VALUE 0x8003A52A CalPrmWspcEng_UBYTE 0 Fac31 0 255 SYMBOL_LINK "CalPrmWspcEng01.TP_U8ETCSCpIgainFacAftrTrn[0][4]" 0 /end CHARACTERISTIC
/begin CHARACTERISTIC TP_U8ETCSCpIgainFacAftrTrn[1][0] "" VALUE 0x8003A52B CalPrmWspcEng_UBYTE 0 Fac31 0 255 SYMBOL_LINK "CalPrmWspcEng01.TP_U8ETCSCpIgainFacAftrTrn[1][0]" 0 /end CHARACTERISTIC
/begin CHARACTERISTIC TP_U8ETCSCpIgainFacAftrTrn[1][1] "" VALUE 0x8003A52C CalPrmWspcEng_UBYTE 0 Fac31 0 255 SYMBOL_LINK "CalPrmWspcEng01.TP_U8ETCSCpIgainFacAftrTrn[1][1]" 0 /end CHARACTERISTIC
/begin CHARACTERISTIC TP_U8ETCSCpIgainFacAftrTrn[1][2] "" VALUE 0x8003A52D CalPrmWspcEng_UBYTE 0 Fac31 0 255 SYMBOL_LINK "CalPrmWspcEng01.TP_U8ETCSCpIgainFacAftrTrn[1][2]" 0 /end CHARACTERISTIC
/begin CHARACTERISTIC TP_U8ETCSCpIgainFacAftrTrn[1][3] "" VALUE 0x8003A52E CalPrmWspcEng_UBYTE 0 Fac31 0 255 SYMBOL_LINK "CalPrmWspcEng01.TP_U8ETCSCpIgainFacAftrTrn[1][3]" 0 /end CHARACTERISTIC
/begin CHARACTERISTIC TP_U8ETCSCpIgainFacAftrTrn[1][4] "" VALUE 0x8003A52F CalPrmWspcEng_UBYTE 0 Fac31 0 255 SYMBOL_LINK "CalPrmWspcEng01.TP_U8ETCSCpIgainFacAftrTrn[1][4]" 0 /end CHARACTERISTIC
/begin CHARACTERISTIC TP_U8ETCSCpIgainFacAftrTrn[2][0] "" VALUE 0x8003A530 CalPrmWspcEng_UBYTE 0 Fac31 0 255 SYMBOL_LINK "CalPrmWspcEng01.TP_U8ETCSCpIgainFacAftrTrn[2][0]" 0 /end CHARACTERISTIC
/begin CHARACTERISTIC TP_U8ETCSCpIgainFacAftrTrn[2][1] "" VALUE 0x8003A531 CalPrmWspcEng_UBYTE 0 Fac31 0 255 SYMBOL_LINK "CalPrmWspcEng01.TP_U8ETCSCpIgainFacAftrTrn[2][1]" 0 /end CHARACTERISTIC
/begin CHARACTERISTIC TP_U8ETCSCpIgainFacAftrTrn[2][2] "" VALUE 0x8003A532 CalPrmWspcEng_UBYTE 0 Fac31 0 255 SYMBOL_LINK "CalPrmWspcEng01.TP_U8ETCSCpIgainFacAftrTrn[2][2]" 0 /end CHARACTERISTIC
/begin CHARACTERISTIC TP_U8ETCSCpIgainFacAftrTrn[2][3] "" VALUE 0x8003A533 CalPrmWspcEng_UBYTE 0 Fac31 0 255 SYMBOL_LINK "CalPrmWspcEng01.TP_U8ETCSCpIgainFacAftrTrn[2][3]" 0 /end CHARACTERISTIC
/begin CHARACTERISTIC TP_U8ETCSCpIgainFacAftrTrn[2][4] "" VALUE 0x8003A534 CalPrmWspcEng_UBYTE 0 Fac31 0 255 SYMBOL_LINK "CalPrmWspcEng01.TP_U8ETCSCpIgainFacAftrTrn[2][4]" 0 /end CHARACTERISTIC
/begin CHARACTERISTIC TP_U8ETCSCpInGrCntThr4MultShft4TCS "" VALUE 0x8003A55A CalPrmWspcEng_UBYTE 0 Ti51 0 5.1 SYMBOL_LINK "CalPrmWspcEng01.TP_U8ETCSCpInGrCntThr4MultShft4TCS" 0 /end CHARACTERISTIC
/begin CHARACTERISTIC TP_U8ETCSCpInGrCntThr4SnglShft4TCS "" VALUE 0x8003A55B CalPrmWspcEng_UBYTE 0 Ti51 0 5.1 SYMBOL_LINK "CalPrmWspcEng01.TP_U8ETCSCpInGrCntThr4SnglShft4TCS" 0 /end CHARACTERISTIC
/begin CHARACTERISTIC TP_U8ETCSCpLatStabCntTh[0] "" VALUE 0x8003A55C CalPrmWspcEng_UBYTE 0 Ti51 0 5.1 SYMBOL_LINK "CalPrmWspcEng01.TP_U8ETCSCpLatStabCntTh[0]" 0 /end CHARACTERISTIC
/begin CHARACTERISTIC TP_U8ETCSCpLatStabCntTh[1] "" VALUE 0x8003A55D CalPrmWspcEng_UBYTE 0 Ti51 0 5.1 SYMBOL_LINK "CalPrmWspcEng01.TP_U8ETCSCpLatStabCntTh[1]" 0 /end CHARACTERISTIC
/begin CHARACTERISTIC TP_U8ETCSCpLatStabCntTh[2] "" VALUE 0x8003A55E CalPrmWspcEng_UBYTE 0 Ti51 0 5.1 SYMBOL_LINK "CalPrmWspcEng01.TP_U8ETCSCpLatStabCntTh[2]" 0 /end CHARACTERISTIC
/begin CHARACTERISTIC TP_U8ETCSCpLatStabStrTh[0] "" VALUE 0x8003A55F CalPrmWspcEng_UBYTE 0 A42 0 2.55 SYMBOL_LINK "CalPrmWspcEng01.TP_U8ETCSCpLatStabStrTh[0]" 0 /end CHARACTERISTIC
/begin CHARACTERISTIC TP_U8ETCSCpLatStabStrTh[1] "" VALUE 0x8003A560 CalPrmWspcEng_UBYTE 0 A42 0 2.55 SYMBOL_LINK "CalPrmWspcEng01.TP_U8ETCSCpLatStabStrTh[1]" 0 /end CHARACTERISTIC
/begin CHARACTERISTIC TP_U8ETCSCpLatStabStrTh[2] "" VALUE 0x8003A561 CalPrmWspcEng_UBYTE 0 A42 0 2.55 SYMBOL_LINK "CalPrmWspcEng01.TP_U8ETCSCpLatStabStrTh[2]" 0 /end CHARACTERISTIC
/begin CHARACTERISTIC TP_U8ETCSCpLdTrqAsymSpinFac "" VALUE 0x8003A562 CalPrmWspcEng_UBYTE 0 Perc6 0 255 SYMBOL_LINK "CalPrmWspcEng01.TP_U8ETCSCpLdTrqAsymSpinFac" 0 /end CHARACTERISTIC
/begin CHARACTERISTIC TP_U8ETCSCpLdTrqByAsymTransTme "" VALUE 0x8003A563 CalPrmWspcEng_UBYTE 0 Ti51 0 5.1 SYMBOL_LINK "CalPrmWspcEng01.TP_U8ETCSCpLdTrqByAsymTransTme" 0 /end CHARACTERISTIC
/begin CHARACTERISTIC TP_U8ETCSCpLdTrqByGrdTransTme "" VALUE 0x8003A564 CalPrmWspcEng_UBYTE 0 Ti51 0 5.1 SYMBOL_LINK "CalPrmWspcEng01.TP_U8ETCSCpLdTrqByGrdTransTme" 0 /end CHARACTERISTIC
/begin CHARACTERISTIC TP_U8ETCSCpLdTrqChngFac "" VALUE 0x8003A565 CalPrmWspcEng_UBYTE 0 Perc6 0 255 SYMBOL_LINK "CalPrmWspcEng01.TP_U8ETCSCpLdTrqChngFac" 0 /end CHARACTERISTIC
/begin CHARACTERISTIC TP_U8ETCSCpLowSpnTh "" VALUE 0x8003A568 CalPrmWspcEng_UBYTE 0 Spd12 0 31.875 SYMBOL_LINK "CalPrmWspcEng01.TP_U8ETCSCpLowSpnTh" 0 /end CHARACTERISTIC
/begin CHARACTERISTIC TP_U8ETCSCpMaxTrqFct4FunLamp "" VALUE 0x8003A572 CalPrmWspcEng_UBYTE 0 Perc6 0 255 SYMBOL_LINK "CalPrmWspcEng01.TP_U8ETCSCpMaxTrqFct4FunLamp" 0 /end CHARACTERISTIC
/begin CHARACTERISTIC TP_U8ETCSCpMinTarSpn "" VALUE 0x8003A573 CalPrmWspcEng_UBYTE 0 Spd12 0 31.875 SYMBOL_LINK "CalPrmWspcEng01.TP_U8ETCSCpMinTarSpn" 0 /end CHARACTERISTIC
/begin CHARACTERISTIC TP_U8ETCSCpMovWinLen "" VALUE 0x8003A574 CalPrmWspcEng_UBYTE 0 Gain 0 255 SYMBOL_LINK "CalPrmWspcEng01.TP_U8ETCSCpMovWinLen" 0 /end CHARACTERISTIC
/begin CHARACTERISTIC TP_U8ETCSCpNAlwAddTar4DepSnwSpd "" VALUE 0x8003A575 CalPrmWspcEng_UBYTE 0 Spd12 0 31.875 SYMBOL_LINK "CalPrmWspcEng01.TP_U8ETCSCpNAlwAddTar4DepSnwSpd" 0 /end CHARACTERISTIC
/begin CHARACTERISTIC TP_U8ETCSCpNegErrIgainSplt[0] "" VALUE 0x8003A586 CalPrmWspcEng_UBYTE 0 Fac31 0 255 SYMBOL_LINK "CalPrmWspcEng01.TP_U8ETCSCpNegErrIgainSplt[0]" 0 /end CHARACTERISTIC
/begin CHARACTERISTIC TP_U8ETCSCpNegErrIgainSplt[1] "" VALUE 0x8003A587 CalPrmWspcEng_UBYTE 0 Fac31 0 255 SYMBOL_LINK "CalPrmWspcEng01.TP_U8ETCSCpNegErrIgainSplt[1]" 0 /end CHARACTERISTIC
/begin CHARACTERISTIC TP_U8ETCSCpNegErrIgainSplt[2] "" VALUE 0x8003A588 CalPrmWspcEng_UBYTE 0 Fac31 0 255 SYMBOL_LINK "CalPrmWspcEng01.TP_U8ETCSCpNegErrIgainSplt[2]" 0 /end CHARACTERISTIC
/begin CHARACTERISTIC TP_U8ETCSCpNegErrIgainSplt[3] "" VALUE 0x8003A589 CalPrmWspcEng_UBYTE 0 Fac31 0 255 SYMBOL_LINK "CalPrmWspcEng01.TP_U8ETCSCpNegErrIgainSplt[3]" 0 /end CHARACTERISTIC
/begin CHARACTERISTIC TP_U8ETCSCpNegErrIgainSplt[4] "" VALUE 0x8003A58A CalPrmWspcEng_UBYTE 0 Fac31 0 255 SYMBOL_LINK "CalPrmWspcEng01.TP_U8ETCSCpNegErrIgainSplt[4]" 0 /end CHARACTERISTIC
/begin CHARACTERISTIC TP_U8ETCSCpNegErrIgain[0][0] "" VALUE 0x8003A576 CalPrmWspcEng_UBYTE 0 Fac31 0 255 SYMBOL_LINK "CalPrmWspcEng01.TP_U8ETCSCpNegErrIgain[0][0]" 0 /end CHARACTERISTIC
/begin CHARACTERISTIC TP_U8ETCSCpNegErrIgain[0][1] "" VALUE 0x8003A577 CalPrmWspcEng_UBYTE 0 Fac31 0 255 SYMBOL_LINK "CalPrmWspcEng01.TP_U8ETCSCpNegErrIgain[0][1]" 0 /end CHARACTERISTIC
/begin CHARACTERISTIC TP_U8ETCSCpNegErrIgain[0][2] "" VALUE 0x8003A578 CalPrmWspcEng_UBYTE 0 Fac31 0 255 SYMBOL_LINK "CalPrmWspcEng01.TP_U8ETCSCpNegErrIgain[0][2]" 0 /end CHARACTERISTIC
/begin CHARACTERISTIC TP_U8ETCSCpNegErrIgain[0][3] "" VALUE 0x8003A579 CalPrmWspcEng_UBYTE 0 Fac31 0 255 SYMBOL_LINK "CalPrmWspcEng01.TP_U8ETCSCpNegErrIgain[0][3]" 0 /end CHARACTERISTIC
/begin CHARACTERISTIC TP_U8ETCSCpNegErrIgain[0][4] "" VALUE 0x8003A57A CalPrmWspcEng_UBYTE 0 Fac31 0 255 SYMBOL_LINK "CalPrmWspcEng01.TP_U8ETCSCpNegErrIgain[0][4]" 0 /end CHARACTERISTIC
/begin CHARACTERISTIC TP_U8ETCSCpNegErrIgain[1][0] "" VALUE 0x8003A57B CalPrmWspcEng_UBYTE 0 Fac31 0 255 SYMBOL_LINK "CalPrmWspcEng01.TP_U8ETCSCpNegErrIgain[1][0]" 0 /end CHARACTERISTIC
/begin CHARACTERISTIC TP_U8ETCSCpNegErrIgain[1][1] "" VALUE 0x8003A57C CalPrmWspcEng_UBYTE 0 Fac31 0 255 SYMBOL_LINK "CalPrmWspcEng01.TP_U8ETCSCpNegErrIgain[1][1]" 0 /end CHARACTERISTIC
/begin CHARACTERISTIC TP_U8ETCSCpNegErrIgain[1][2] "" VALUE 0x8003A57D CalPrmWspcEng_UBYTE 0 Fac31 0 255 SYMBOL_LINK "CalPrmWspcEng01.TP_U8ETCSCpNegErrIgain[1][2]" 0 /end CHARACTERISTIC
/begin CHARACTERISTIC TP_U8ETCSCpNegErrIgain[1][3] "" VALUE 0x8003A57E CalPrmWspcEng_UBYTE 0 Fac31 0 255 SYMBOL_LINK "CalPrmWspcEng01.TP_U8ETCSCpNegErrIgain[1][3]" 0 /end CHARACTERISTIC
/begin CHARACTERISTIC TP_U8ETCSCpNegErrIgain[1][4] "" VALUE 0x8003A57F CalPrmWspcEng_UBYTE 0 Fac31 0 255 SYMBOL_LINK "CalPrmWspcEng01.TP_U8ETCSCpNegErrIgain[1][4]" 0 /end CHARACTERISTIC
/begin CHARACTERISTIC TP_U8ETCSCpNegErrIgain[2][0] "" VALUE 0x8003A580 CalPrmWspcEng_UBYTE 0 Fac31 0 255 SYMBOL_LINK "CalPrmWspcEng01.TP_U8ETCSCpNegErrIgain[2][0]" 0 /end CHARACTERISTIC
/begin CHARACTERISTIC TP_U8ETCSCpNegErrIgain[2][1] "" VALUE 0x8003A581 CalPrmWspcEng_UBYTE 0 Fac31 0 255 SYMBOL_LINK "CalPrmWspcEng01.TP_U8ETCSCpNegErrIgain[2][1]" 0 /end CHARACTERISTIC
/begin CHARACTERISTIC TP_U8ETCSCpNegErrIgain[2][2] "" VALUE 0x8003A582 CalPrmWspcEng_UBYTE 0 Fac31 0 255 SYMBOL_LINK "CalPrmWspcEng01.TP_U8ETCSCpNegErrIgain[2][2]" 0 /end CHARACTERISTIC
/begin CHARACTERISTIC TP_U8ETCSCpNegErrIgain[2][3] "" VALUE 0x8003A583 CalPrmWspcEng_UBYTE 0 Fac31 0 255 SYMBOL_LINK "CalPrmWspcEng01.TP_U8ETCSCpNegErrIgain[2][3]" 0 /end CHARACTERISTIC
/begin CHARACTERISTIC TP_U8ETCSCpNegErrIgain[2][4] "" VALUE 0x8003A584 CalPrmWspcEng_UBYTE 0 Fac31 0 255 SYMBOL_LINK "CalPrmWspcEng01.TP_U8ETCSCpNegErrIgain[2][4]" 0 /end CHARACTERISTIC
/begin CHARACTERISTIC TP_U8ETCSCpNegErrIgain_R "" VALUE 0x8003A585 CalPrmWspcEng_UBYTE 0 Fac31 0 255 SYMBOL_LINK "CalPrmWspcEng01.TP_U8ETCSCpNegErrIgain_R" 0 /end CHARACTERISTIC
/begin CHARACTERISTIC TP_U8ETCSCpNegErrPgainSplt[0] "" VALUE 0x8003A59B CalPrmWspcEng_UBYTE 0 Fac31 0 255 SYMBOL_LINK "CalPrmWspcEng01.TP_U8ETCSCpNegErrPgainSplt[0]" 0 /end CHARACTERISTIC
/begin CHARACTERISTIC TP_U8ETCSCpNegErrPgainSplt[1] "" VALUE 0x8003A59C CalPrmWspcEng_UBYTE 0 Fac31 0 255 SYMBOL_LINK "CalPrmWspcEng01.TP_U8ETCSCpNegErrPgainSplt[1]" 0 /end CHARACTERISTIC
/begin CHARACTERISTIC TP_U8ETCSCpNegErrPgainSplt[2] "" VALUE 0x8003A59D CalPrmWspcEng_UBYTE 0 Fac31 0 255 SYMBOL_LINK "CalPrmWspcEng01.TP_U8ETCSCpNegErrPgainSplt[2]" 0 /end CHARACTERISTIC
/begin CHARACTERISTIC TP_U8ETCSCpNegErrPgainSplt[3] "" VALUE 0x8003A59E CalPrmWspcEng_UBYTE 0 Fac31 0 255 SYMBOL_LINK "CalPrmWspcEng01.TP_U8ETCSCpNegErrPgainSplt[3]" 0 /end CHARACTERISTIC
/begin CHARACTERISTIC TP_U8ETCSCpNegErrPgainSplt[4] "" VALUE 0x8003A59F CalPrmWspcEng_UBYTE 0 Fac31 0 255 SYMBOL_LINK "CalPrmWspcEng01.TP_U8ETCSCpNegErrPgainSplt[4]" 0 /end CHARACTERISTIC
/begin CHARACTERISTIC TP_U8ETCSCpNegErrPgain[0][0] "" VALUE 0x8003A58B CalPrmWspcEng_UBYTE 0 Fac31 0 255 SYMBOL_LINK "CalPrmWspcEng01.TP_U8ETCSCpNegErrPgain[0][0]" 0 /end CHARACTERISTIC
/begin CHARACTERISTIC TP_U8ETCSCpNegErrPgain[0][1] "" VALUE 0x8003A58C CalPrmWspcEng_UBYTE 0 Fac31 0 255 SYMBOL_LINK "CalPrmWspcEng01.TP_U8ETCSCpNegErrPgain[0][1]" 0 /end CHARACTERISTIC
/begin CHARACTERISTIC TP_U8ETCSCpNegErrPgain[0][2] "" VALUE 0x8003A58D CalPrmWspcEng_UBYTE 0 Fac31 0 255 SYMBOL_LINK "CalPrmWspcEng01.TP_U8ETCSCpNegErrPgain[0][2]" 0 /end CHARACTERISTIC
/begin CHARACTERISTIC TP_U8ETCSCpNegErrPgain[0][3] "" VALUE 0x8003A58E CalPrmWspcEng_UBYTE 0 Fac31 0 255 SYMBOL_LINK "CalPrmWspcEng01.TP_U8ETCSCpNegErrPgain[0][3]" 0 /end CHARACTERISTIC
/begin CHARACTERISTIC TP_U8ETCSCpNegErrPgain[0][4] "" VALUE 0x8003A58F CalPrmWspcEng_UBYTE 0 Fac31 0 255 SYMBOL_LINK "CalPrmWspcEng01.TP_U8ETCSCpNegErrPgain[0][4]" 0 /end CHARACTERISTIC
/begin CHARACTERISTIC TP_U8ETCSCpNegErrPgain[1][0] "" VALUE 0x8003A590 CalPrmWspcEng_UBYTE 0 Fac31 0 255 SYMBOL_LINK "CalPrmWspcEng01.TP_U8ETCSCpNegErrPgain[1][0]" 0 /end CHARACTERISTIC
/begin CHARACTERISTIC TP_U8ETCSCpNegErrPgain[1][1] "" VALUE 0x8003A591 CalPrmWspcEng_UBYTE 0 Fac31 0 255 SYMBOL_LINK "CalPrmWspcEng01.TP_U8ETCSCpNegErrPgain[1][1]" 0 /end CHARACTERISTIC
/begin CHARACTERISTIC TP_U8ETCSCpNegErrPgain[1][2] "" VALUE 0x8003A592 CalPrmWspcEng_UBYTE 0 Fac31 0 255 SYMBOL_LINK "CalPrmWspcEng01.TP_U8ETCSCpNegErrPgain[1][2]" 0 /end CHARACTERISTIC
/begin CHARACTERISTIC TP_U8ETCSCpNegErrPgain[1][3] "" VALUE 0x8003A593 CalPrmWspcEng_UBYTE 0 Fac31 0 255 SYMBOL_LINK "CalPrmWspcEng01.TP_U8ETCSCpNegErrPgain[1][3]" 0 /end CHARACTERISTIC
/begin CHARACTERISTIC TP_U8ETCSCpNegErrPgain[1][4] "" VALUE 0x8003A594 CalPrmWspcEng_UBYTE 0 Fac31 0 255 SYMBOL_LINK "CalPrmWspcEng01.TP_U8ETCSCpNegErrPgain[1][4]" 0 /end CHARACTERISTIC
/begin CHARACTERISTIC TP_U8ETCSCpNegErrPgain[2][0] "" VALUE 0x8003A595 CalPrmWspcEng_UBYTE 0 Fac31 0 255 SYMBOL_LINK "CalPrmWspcEng01.TP_U8ETCSCpNegErrPgain[2][0]" 0 /end CHARACTERISTIC
/begin CHARACTERISTIC TP_U8ETCSCpNegErrPgain[2][1] "" VALUE 0x8003A596 CalPrmWspcEng_UBYTE 0 Fac31 0 255 SYMBOL_LINK "CalPrmWspcEng01.TP_U8ETCSCpNegErrPgain[2][1]" 0 /end CHARACTERISTIC
/begin CHARACTERISTIC TP_U8ETCSCpNegErrPgain[2][2] "" VALUE 0x8003A597 CalPrmWspcEng_UBYTE 0 Fac31 0 255 SYMBOL_LINK "CalPrmWspcEng01.TP_U8ETCSCpNegErrPgain[2][2]" 0 /end CHARACTERISTIC
/begin CHARACTERISTIC TP_U8ETCSCpNegErrPgain[2][3] "" VALUE 0x8003A598 CalPrmWspcEng_UBYTE 0 Fac31 0 255 SYMBOL_LINK "CalPrmWspcEng01.TP_U8ETCSCpNegErrPgain[2][3]" 0 /end CHARACTERISTIC
/begin CHARACTERISTIC TP_U8ETCSCpNegErrPgain[2][4] "" VALUE 0x8003A599 CalPrmWspcEng_UBYTE 0 Fac31 0 255 SYMBOL_LINK "CalPrmWspcEng01.TP_U8ETCSCpNegErrPgain[2][4]" 0 /end CHARACTERISTIC
/begin CHARACTERISTIC TP_U8ETCSCpNegErrPgain_R "" VALUE 0x8003A59A CalPrmWspcEng_UBYTE 0 Fac31 0 255 SYMBOL_LINK "CalPrmWspcEng01.TP_U8ETCSCpNegErrPgain_R" 0 /end CHARACTERISTIC
/begin CHARACTERISTIC TP_U8ETCSCpNoSpnTh "" VALUE 0x8003A5A0 CalPrmWspcEng_UBYTE 0 Spd12 0 31.875 SYMBOL_LINK "CalPrmWspcEng01.TP_U8ETCSCpNoSpnTh" 0 /end CHARACTERISTIC
/begin CHARACTERISTIC TP_U8ETCSCpOffsetFct4FunLamp "" VALUE 0x8003A5A1 CalPrmWspcEng_UBYTE 0 Fac31 0 255 SYMBOL_LINK "CalPrmWspcEng01.TP_U8ETCSCpOffsetFct4FunLamp" 0 /end CHARACTERISTIC
/begin CHARACTERISTIC TP_U8ETCSCpOvrStrLmtCrngEnbl "" VALUE 0x8003A5A2 CalPrmWspcEng_UBYTE 0 Gain 0 255 SYMBOL_LINK "CalPrmWspcEng01.TP_U8ETCSCpOvrStrLmtCrngEnbl" 0 /end CHARACTERISTIC
/begin CHARACTERISTIC TP_U8ETCSCpOvrStrTrgSpnDecEnbl "" VALUE 0x8003A5A3 CalPrmWspcEng_UBYTE 0 Gain 0 255 SYMBOL_LINK "CalPrmWspcEng01.TP_U8ETCSCpOvrStrTrgSpnDecEnbl" 0 /end CHARACTERISTIC
/begin CHARACTERISTIC TP_U8ETCSCpPgFacGrChgErrNeg[0] "" VALUE 0x8003A5A5 CalPrmWspcEng_UBYTE 0 Fac31 0 255 SYMBOL_LINK "CalPrmWspcEng01.TP_U8ETCSCpPgFacGrChgErrNeg[0]" 0 /end CHARACTERISTIC
/begin CHARACTERISTIC TP_U8ETCSCpPgFacGrChgErrNeg[1] "" VALUE 0x8003A5A6 CalPrmWspcEng_UBYTE 0 Fac31 0 255 SYMBOL_LINK "CalPrmWspcEng01.TP_U8ETCSCpPgFacGrChgErrNeg[1]" 0 /end CHARACTERISTIC
/begin CHARACTERISTIC TP_U8ETCSCpPgFacGrChgErrNeg[2] "" VALUE 0x8003A5A7 CalPrmWspcEng_UBYTE 0 Fac31 0 255 SYMBOL_LINK "CalPrmWspcEng01.TP_U8ETCSCpPgFacGrChgErrNeg[2]" 0 /end CHARACTERISTIC
/begin CHARACTERISTIC TP_U8ETCSCpPgFacGrChgErrNeg[3] "" VALUE 0x8003A5A8 CalPrmWspcEng_UBYTE 0 Fac31 0 255 SYMBOL_LINK "CalPrmWspcEng01.TP_U8ETCSCpPgFacGrChgErrNeg[3]" 0 /end CHARACTERISTIC
/begin CHARACTERISTIC TP_U8ETCSCpPgFacGrChgErrNeg[4] "" VALUE 0x8003A5A9 CalPrmWspcEng_UBYTE 0 Fac31 0 255 SYMBOL_LINK "CalPrmWspcEng01.TP_U8ETCSCpPgFacGrChgErrNeg[4]" 0 /end CHARACTERISTIC
/begin CHARACTERISTIC TP_U8ETCSCpPgFacGrChgErrPos[0] "" VALUE 0x8003A5AA CalPrmWspcEng_UBYTE 0 Fac31 0 255 SYMBOL_LINK "CalPrmWspcEng01.TP_U8ETCSCpPgFacGrChgErrPos[0]" 0 /end CHARACTERISTIC
/begin CHARACTERISTIC TP_U8ETCSCpPgFacGrChgErrPos[1] "" VALUE 0x8003A5AB CalPrmWspcEng_UBYTE 0 Fac31 0 255 SYMBOL_LINK "CalPrmWspcEng01.TP_U8ETCSCpPgFacGrChgErrPos[1]" 0 /end CHARACTERISTIC
/begin CHARACTERISTIC TP_U8ETCSCpPgFacGrChgErrPos[2] "" VALUE 0x8003A5AC CalPrmWspcEng_UBYTE 0 Fac31 0 255 SYMBOL_LINK "CalPrmWspcEng01.TP_U8ETCSCpPgFacGrChgErrPos[2]" 0 /end CHARACTERISTIC
/begin CHARACTERISTIC TP_U8ETCSCpPgFacGrChgErrPos[3] "" VALUE 0x8003A5AD CalPrmWspcEng_UBYTE 0 Fac31 0 255 SYMBOL_LINK "CalPrmWspcEng01.TP_U8ETCSCpPgFacGrChgErrPos[3]" 0 /end CHARACTERISTIC
/begin CHARACTERISTIC TP_U8ETCSCpPgFacGrChgErrPos[4] "" VALUE 0x8003A5AE CalPrmWspcEng_UBYTE 0 Fac31 0 255 SYMBOL_LINK "CalPrmWspcEng01.TP_U8ETCSCpPgFacGrChgErrPos[4]" 0 /end CHARACTERISTIC
/begin CHARACTERISTIC TP_U8ETCSCpPgFacInTrn[0][0] "" VALUE 0x8003A5AF CalPrmWspcEng_UBYTE 0 Fac31 0 255 SYMBOL_LINK "CalPrmWspcEng01.TP_U8ETCSCpPgFacInTrn[0][0]" 0 /end CHARACTERISTIC
/begin CHARACTERISTIC TP_U8ETCSCpPgFacInTrn[0][1] "" VALUE 0x8003A5B0 CalPrmWspcEng_UBYTE 0 Fac31 0 255 SYMBOL_LINK "CalPrmWspcEng01.TP_U8ETCSCpPgFacInTrn[0][1]" 0 /end CHARACTERISTIC
/begin CHARACTERISTIC TP_U8ETCSCpPgFacInTrn[0][2] "" VALUE 0x8003A5B1 CalPrmWspcEng_UBYTE 0 Fac31 0 255 SYMBOL_LINK "CalPrmWspcEng01.TP_U8ETCSCpPgFacInTrn[0][2]" 0 /end CHARACTERISTIC
/begin CHARACTERISTIC TP_U8ETCSCpPgFacInTrn[0][3] "" VALUE 0x8003A5B2 CalPrmWspcEng_UBYTE 0 Fac31 0 255 SYMBOL_LINK "CalPrmWspcEng01.TP_U8ETCSCpPgFacInTrn[0][3]" 0 /end CHARACTERISTIC
/begin CHARACTERISTIC TP_U8ETCSCpPgFacInTrn[0][4] "" VALUE 0x8003A5B3 CalPrmWspcEng_UBYTE 0 Fac31 0 255 SYMBOL_LINK "CalPrmWspcEng01.TP_U8ETCSCpPgFacInTrn[0][4]" 0 /end CHARACTERISTIC
/begin CHARACTERISTIC TP_U8ETCSCpPgFacInTrn[1][0] "" VALUE 0x8003A5B4 CalPrmWspcEng_UBYTE 0 Fac31 0 255 SYMBOL_LINK "CalPrmWspcEng01.TP_U8ETCSCpPgFacInTrn[1][0]" 0 /end CHARACTERISTIC
/begin CHARACTERISTIC TP_U8ETCSCpPgFacInTrn[1][1] "" VALUE 0x8003A5B5 CalPrmWspcEng_UBYTE 0 Fac31 0 255 SYMBOL_LINK "CalPrmWspcEng01.TP_U8ETCSCpPgFacInTrn[1][1]" 0 /end CHARACTERISTIC
/begin CHARACTERISTIC TP_U8ETCSCpPgFacInTrn[1][2] "" VALUE 0x8003A5B6 CalPrmWspcEng_UBYTE 0 Fac31 0 255 SYMBOL_LINK "CalPrmWspcEng01.TP_U8ETCSCpPgFacInTrn[1][2]" 0 /end CHARACTERISTIC
/begin CHARACTERISTIC TP_U8ETCSCpPgFacInTrn[1][3] "" VALUE 0x8003A5B7 CalPrmWspcEng_UBYTE 0 Fac31 0 255 SYMBOL_LINK "CalPrmWspcEng01.TP_U8ETCSCpPgFacInTrn[1][3]" 0 /end CHARACTERISTIC
/begin CHARACTERISTIC TP_U8ETCSCpPgFacInTrn[1][4] "" VALUE 0x8003A5B8 CalPrmWspcEng_UBYTE 0 Fac31 0 255 SYMBOL_LINK "CalPrmWspcEng01.TP_U8ETCSCpPgFacInTrn[1][4]" 0 /end CHARACTERISTIC
/begin CHARACTERISTIC TP_U8ETCSCpPgFacInTrn[2][0] "" VALUE 0x8003A5B9 CalPrmWspcEng_UBYTE 0 Fac31 0 255 SYMBOL_LINK "CalPrmWspcEng01.TP_U8ETCSCpPgFacInTrn[2][0]" 0 /end CHARACTERISTIC
/begin CHARACTERISTIC TP_U8ETCSCpPgFacInTrn[2][1] "" VALUE 0x8003A5BA CalPrmWspcEng_UBYTE 0 Fac31 0 255 SYMBOL_LINK "CalPrmWspcEng01.TP_U8ETCSCpPgFacInTrn[2][1]" 0 /end CHARACTERISTIC
/begin CHARACTERISTIC TP_U8ETCSCpPgFacInTrn[2][2] "" VALUE 0x8003A5BB CalPrmWspcEng_UBYTE 0 Fac31 0 255 SYMBOL_LINK "CalPrmWspcEng01.TP_U8ETCSCpPgFacInTrn[2][2]" 0 /end CHARACTERISTIC
/begin CHARACTERISTIC TP_U8ETCSCpPgFacInTrn[2][3] "" VALUE 0x8003A5BC CalPrmWspcEng_UBYTE 0 Fac31 0 255 SYMBOL_LINK "CalPrmWspcEng01.TP_U8ETCSCpPgFacInTrn[2][3]" 0 /end CHARACTERISTIC
/begin CHARACTERISTIC TP_U8ETCSCpPgFacInTrn[2][4] "" VALUE 0x8003A5BD CalPrmWspcEng_UBYTE 0 Fac31 0 255 SYMBOL_LINK "CalPrmWspcEng01.TP_U8ETCSCpPgFacInTrn[2][4]" 0 /end CHARACTERISTIC
/begin CHARACTERISTIC TP_U8ETCSCpPosErrIgainSplt[0] "" VALUE 0x8003A5CE CalPrmWspcEng_UBYTE 0 Fac31 0 255 SYMBOL_LINK "CalPrmWspcEng01.TP_U8ETCSCpPosErrIgainSplt[0]" 0 /end CHARACTERISTIC
/begin CHARACTERISTIC TP_U8ETCSCpPosErrIgainSplt[1] "" VALUE 0x8003A5CF CalPrmWspcEng_UBYTE 0 Fac31 0 255 SYMBOL_LINK "CalPrmWspcEng01.TP_U8ETCSCpPosErrIgainSplt[1]" 0 /end CHARACTERISTIC
/begin CHARACTERISTIC TP_U8ETCSCpPosErrIgainSplt[2] "" VALUE 0x8003A5D0 CalPrmWspcEng_UBYTE 0 Fac31 0 255 SYMBOL_LINK "CalPrmWspcEng01.TP_U8ETCSCpPosErrIgainSplt[2]" 0 /end CHARACTERISTIC
/begin CHARACTERISTIC TP_U8ETCSCpPosErrIgainSplt[3] "" VALUE 0x8003A5D1 CalPrmWspcEng_UBYTE 0 Fac31 0 255 SYMBOL_LINK "CalPrmWspcEng01.TP_U8ETCSCpPosErrIgainSplt[3]" 0 /end CHARACTERISTIC
/begin CHARACTERISTIC TP_U8ETCSCpPosErrIgainSplt[4] "" VALUE 0x8003A5D2 CalPrmWspcEng_UBYTE 0 Fac31 0 255 SYMBOL_LINK "CalPrmWspcEng01.TP_U8ETCSCpPosErrIgainSplt[4]" 0 /end CHARACTERISTIC
/begin CHARACTERISTIC TP_U8ETCSCpPosErrIgain[0][0] "" VALUE 0x8003A5BE CalPrmWspcEng_UBYTE 0 Fac31 0 255 SYMBOL_LINK "CalPrmWspcEng01.TP_U8ETCSCpPosErrIgain[0][0]" 0 /end CHARACTERISTIC
/begin CHARACTERISTIC TP_U8ETCSCpPosErrIgain[0][1] "" VALUE 0x8003A5BF CalPrmWspcEng_UBYTE 0 Fac31 0 255 SYMBOL_LINK "CalPrmWspcEng01.TP_U8ETCSCpPosErrIgain[0][1]" 0 /end CHARACTERISTIC
/begin CHARACTERISTIC TP_U8ETCSCpPosErrIgain[0][2] "" VALUE 0x8003A5C0 CalPrmWspcEng_UBYTE 0 Fac31 0 255 SYMBOL_LINK "CalPrmWspcEng01.TP_U8ETCSCpPosErrIgain[0][2]" 0 /end CHARACTERISTIC
/begin CHARACTERISTIC TP_U8ETCSCpPosErrIgain[0][3] "" VALUE 0x8003A5C1 CalPrmWspcEng_UBYTE 0 Fac31 0 255 SYMBOL_LINK "CalPrmWspcEng01.TP_U8ETCSCpPosErrIgain[0][3]" 0 /end CHARACTERISTIC
/begin CHARACTERISTIC TP_U8ETCSCpPosErrIgain[0][4] "" VALUE 0x8003A5C2 CalPrmWspcEng_UBYTE 0 Fac31 0 255 SYMBOL_LINK "CalPrmWspcEng01.TP_U8ETCSCpPosErrIgain[0][4]" 0 /end CHARACTERISTIC
/begin CHARACTERISTIC TP_U8ETCSCpPosErrIgain[1][0] "" VALUE 0x8003A5C3 CalPrmWspcEng_UBYTE 0 Fac31 0 255 SYMBOL_LINK "CalPrmWspcEng01.TP_U8ETCSCpPosErrIgain[1][0]" 0 /end CHARACTERISTIC
/begin CHARACTERISTIC TP_U8ETCSCpPosErrIgain[1][1] "" VALUE 0x8003A5C4 CalPrmWspcEng_UBYTE 0 Fac31 0 255 SYMBOL_LINK "CalPrmWspcEng01.TP_U8ETCSCpPosErrIgain[1][1]" 0 /end CHARACTERISTIC
/begin CHARACTERISTIC TP_U8ETCSCpPosErrIgain[1][2] "" VALUE 0x8003A5C5 CalPrmWspcEng_UBYTE 0 Fac31 0 255 SYMBOL_LINK "CalPrmWspcEng01.TP_U8ETCSCpPosErrIgain[1][2]" 0 /end CHARACTERISTIC
/begin CHARACTERISTIC TP_U8ETCSCpPosErrIgain[1][3] "" VALUE 0x8003A5C6 CalPrmWspcEng_UBYTE 0 Fac31 0 255 SYMBOL_LINK "CalPrmWspcEng01.TP_U8ETCSCpPosErrIgain[1][3]" 0 /end CHARACTERISTIC
/begin CHARACTERISTIC TP_U8ETCSCpPosErrIgain[1][4] "" VALUE 0x8003A5C7 CalPrmWspcEng_UBYTE 0 Fac31 0 255 SYMBOL_LINK "CalPrmWspcEng01.TP_U8ETCSCpPosErrIgain[1][4]" 0 /end CHARACTERISTIC
/begin CHARACTERISTIC TP_U8ETCSCpPosErrIgain[2][0] "" VALUE 0x8003A5C8 CalPrmWspcEng_UBYTE 0 Fac31 0 255 SYMBOL_LINK "CalPrmWspcEng01.TP_U8ETCSCpPosErrIgain[2][0]" 0 /end CHARACTERISTIC
/begin CHARACTERISTIC TP_U8ETCSCpPosErrIgain[2][1] "" VALUE 0x8003A5C9 CalPrmWspcEng_UBYTE 0 Fac31 0 255 SYMBOL_LINK "CalPrmWspcEng01.TP_U8ETCSCpPosErrIgain[2][1]" 0 /end CHARACTERISTIC
/begin CHARACTERISTIC TP_U8ETCSCpPosErrIgain[2][2] "" VALUE 0x8003A5CA CalPrmWspcEng_UBYTE 0 Fac31 0 255 SYMBOL_LINK "CalPrmWspcEng01.TP_U8ETCSCpPosErrIgain[2][2]" 0 /end CHARACTERISTIC
/begin CHARACTERISTIC TP_U8ETCSCpPosErrIgain[2][3] "" VALUE 0x8003A5CB CalPrmWspcEng_UBYTE 0 Fac31 0 255 SYMBOL_LINK "CalPrmWspcEng01.TP_U8ETCSCpPosErrIgain[2][3]" 0 /end CHARACTERISTIC
/begin CHARACTERISTIC TP_U8ETCSCpPosErrIgain[2][4] "" VALUE 0x8003A5CC CalPrmWspcEng_UBYTE 0 Fac31 0 255 SYMBOL_LINK "CalPrmWspcEng01.TP_U8ETCSCpPosErrIgain[2][4]" 0 /end CHARACTERISTIC
/begin CHARACTERISTIC TP_U8ETCSCpPosErrIgain_R "" VALUE 0x8003A5CD CalPrmWspcEng_UBYTE 0 Fac31 0 255 SYMBOL_LINK "CalPrmWspcEng01.TP_U8ETCSCpPosErrIgain_R" 0 /end CHARACTERISTIC
/begin CHARACTERISTIC TP_U8ETCSCpPosErrPgainSplt[0] "" VALUE 0x8003A5E3 CalPrmWspcEng_UBYTE 0 Fac31 0 255 SYMBOL_LINK "CalPrmWspcEng01.TP_U8ETCSCpPosErrPgainSplt[0]" 0 /end CHARACTERISTIC
/begin CHARACTERISTIC TP_U8ETCSCpPosErrPgainSplt[1] "" VALUE 0x8003A5E4 CalPrmWspcEng_UBYTE 0 Fac31 0 255 SYMBOL_LINK "CalPrmWspcEng01.TP_U8ETCSCpPosErrPgainSplt[1]" 0 /end CHARACTERISTIC
/begin CHARACTERISTIC TP_U8ETCSCpPosErrPgainSplt[2] "" VALUE 0x8003A5E5 CalPrmWspcEng_UBYTE 0 Fac31 0 255 SYMBOL_LINK "CalPrmWspcEng01.TP_U8ETCSCpPosErrPgainSplt[2]" 0 /end CHARACTERISTIC
/begin CHARACTERISTIC TP_U8ETCSCpPosErrPgainSplt[3] "" VALUE 0x8003A5E6 CalPrmWspcEng_UBYTE 0 Fac31 0 255 SYMBOL_LINK "CalPrmWspcEng01.TP_U8ETCSCpPosErrPgainSplt[3]" 0 /end CHARACTERISTIC
/begin CHARACTERISTIC TP_U8ETCSCpPosErrPgainSplt[4] "" VALUE 0x8003A5E7 CalPrmWspcEng_UBYTE 0 Fac31 0 255 SYMBOL_LINK "CalPrmWspcEng01.TP_U8ETCSCpPosErrPgainSplt[4]" 0 /end CHARACTERISTIC
/begin CHARACTERISTIC TP_U8ETCSCpPosErrPgain[0][0] "" VALUE 0x8003A5D3 CalPrmWspcEng_UBYTE 0 Fac31 0 255 SYMBOL_LINK "CalPrmWspcEng01.TP_U8ETCSCpPosErrPgain[0][0]" 0 /end CHARACTERISTIC
/begin CHARACTERISTIC TP_U8ETCSCpPosErrPgain[0][1] "" VALUE 0x8003A5D4 CalPrmWspcEng_UBYTE 0 Fac31 0 255 SYMBOL_LINK "CalPrmWspcEng01.TP_U8ETCSCpPosErrPgain[0][1]" 0 /end CHARACTERISTIC
/begin CHARACTERISTIC TP_U8ETCSCpPosErrPgain[0][2] "" VALUE 0x8003A5D5 CalPrmWspcEng_UBYTE 0 Fac31 0 255 SYMBOL_LINK "CalPrmWspcEng01.TP_U8ETCSCpPosErrPgain[0][2]" 0 /end CHARACTERISTIC
/begin CHARACTERISTIC TP_U8ETCSCpPosErrPgain[0][3] "" VALUE 0x8003A5D6 CalPrmWspcEng_UBYTE 0 Fac31 0 255 SYMBOL_LINK "CalPrmWspcEng01.TP_U8ETCSCpPosErrPgain[0][3]" 0 /end CHARACTERISTIC
/begin CHARACTERISTIC TP_U8ETCSCpPosErrPgain[0][4] "" VALUE 0x8003A5D7 CalPrmWspcEng_UBYTE 0 Fac31 0 255 SYMBOL_LINK "CalPrmWspcEng01.TP_U8ETCSCpPosErrPgain[0][4]" 0 /end CHARACTERISTIC
/begin CHARACTERISTIC TP_U8ETCSCpPosErrPgain[1][0] "" VALUE 0x8003A5D8 CalPrmWspcEng_UBYTE 0 Fac31 0 255 SYMBOL_LINK "CalPrmWspcEng01.TP_U8ETCSCpPosErrPgain[1][0]" 0 /end CHARACTERISTIC
/begin CHARACTERISTIC TP_U8ETCSCpPosErrPgain[1][1] "" VALUE 0x8003A5D9 CalPrmWspcEng_UBYTE 0 Fac31 0 255 SYMBOL_LINK "CalPrmWspcEng01.TP_U8ETCSCpPosErrPgain[1][1]" 0 /end CHARACTERISTIC
/begin CHARACTERISTIC TP_U8ETCSCpPosErrPgain[1][2] "" VALUE 0x8003A5DA CalPrmWspcEng_UBYTE 0 Fac31 0 255 SYMBOL_LINK "CalPrmWspcEng01.TP_U8ETCSCpPosErrPgain[1][2]" 0 /end CHARACTERISTIC
/begin CHARACTERISTIC TP_U8ETCSCpPosErrPgain[1][3] "" VALUE 0x8003A5DB CalPrmWspcEng_UBYTE 0 Fac31 0 255 SYMBOL_LINK "CalPrmWspcEng01.TP_U8ETCSCpPosErrPgain[1][3]" 0 /end CHARACTERISTIC
/begin CHARACTERISTIC TP_U8ETCSCpPosErrPgain[1][4] "" VALUE 0x8003A5DC CalPrmWspcEng_UBYTE 0 Fac31 0 255 SYMBOL_LINK "CalPrmWspcEng01.TP_U8ETCSCpPosErrPgain[1][4]" 0 /end CHARACTERISTIC
/begin CHARACTERISTIC TP_U8ETCSCpPosErrPgain[2][0] "" VALUE 0x8003A5DD CalPrmWspcEng_UBYTE 0 Fac31 0 255 SYMBOL_LINK "CalPrmWspcEng01.TP_U8ETCSCpPosErrPgain[2][0]" 0 /end CHARACTERISTIC
/begin CHARACTERISTIC TP_U8ETCSCpPosErrPgain[2][1] "" VALUE 0x8003A5DE CalPrmWspcEng_UBYTE 0 Fac31 0 255 SYMBOL_LINK "CalPrmWspcEng01.TP_U8ETCSCpPosErrPgain[2][1]" 0 /end CHARACTERISTIC
/begin CHARACTERISTIC TP_U8ETCSCpPosErrPgain[2][2] "" VALUE 0x8003A5DF CalPrmWspcEng_UBYTE 0 Fac31 0 255 SYMBOL_LINK "CalPrmWspcEng01.TP_U8ETCSCpPosErrPgain[2][2]" 0 /end CHARACTERISTIC
/begin CHARACTERISTIC TP_U8ETCSCpPosErrPgain[2][3] "" VALUE 0x8003A5E0 CalPrmWspcEng_UBYTE 0 Fac31 0 255 SYMBOL_LINK "CalPrmWspcEng01.TP_U8ETCSCpPosErrPgain[2][3]" 0 /end CHARACTERISTIC
/begin CHARACTERISTIC TP_U8ETCSCpPosErrPgain[2][4] "" VALUE 0x8003A5E1 CalPrmWspcEng_UBYTE 0 Fac31 0 255 SYMBOL_LINK "CalPrmWspcEng01.TP_U8ETCSCpPosErrPgain[2][4]" 0 /end CHARACTERISTIC
/begin CHARACTERISTIC TP_U8ETCSCpPosErrPgain_R "" VALUE 0x8003A5E2 CalPrmWspcEng_UBYTE 0 Fac31 0 255 SYMBOL_LINK "CalPrmWspcEng01.TP_U8ETCSCpPosErrPgain_R" 0 /end CHARACTERISTIC
/begin CHARACTERISTIC TP_U8ETCSCpStabCrngTime "" VALUE 0x8003A5F2 CalPrmWspcEng_UBYTE 0 Ti51 0 5.1 SYMBOL_LINK "CalPrmWspcEng01.TP_U8ETCSCpStabCrngTime" 0 /end CHARACTERISTIC
/begin CHARACTERISTIC TP_U8ETCSCpSymBrkCtlGain "" VALUE 0x8003A5F4 CalPrmWspcEng_UBYTE 0 Fac31 0 255 SYMBOL_LINK "CalPrmWspcEng01.TP_U8ETCSCpSymBrkCtlGain" 0 /end CHARACTERISTIC
/begin CHARACTERISTIC TP_U8ETCSCpSymBrkCtlIhbAxTh "" VALUE 0x8003A5F5 CalPrmWspcEng_UBYTE 0 A42 0 2.55 SYMBOL_LINK "CalPrmWspcEng01.TP_U8ETCSCpSymBrkCtlIhbAxTh" 0 /end CHARACTERISTIC
/begin CHARACTERISTIC TP_U8ETCSCpSymBrkCtlTh[0][0] "" VALUE 0x8003A5F6 CalPrmWspcEng_UBYTE 0 Spd12 0 31.875 SYMBOL_LINK "CalPrmWspcEng01.TP_U8ETCSCpSymBrkCtlTh[0][0]" 0 /end CHARACTERISTIC
/begin CHARACTERISTIC TP_U8ETCSCpSymBrkCtlTh[0][1] "" VALUE 0x8003A5F7 CalPrmWspcEng_UBYTE 0 Spd12 0 31.875 SYMBOL_LINK "CalPrmWspcEng01.TP_U8ETCSCpSymBrkCtlTh[0][1]" 0 /end CHARACTERISTIC
/begin CHARACTERISTIC TP_U8ETCSCpSymBrkCtlTh[0][2] "" VALUE 0x8003A5F8 CalPrmWspcEng_UBYTE 0 Spd12 0 31.875 SYMBOL_LINK "CalPrmWspcEng01.TP_U8ETCSCpSymBrkCtlTh[0][2]" 0 /end CHARACTERISTIC
/begin CHARACTERISTIC TP_U8ETCSCpSymBrkCtlTh[0][3] "" VALUE 0x8003A5F9 CalPrmWspcEng_UBYTE 0 Spd12 0 31.875 SYMBOL_LINK "CalPrmWspcEng01.TP_U8ETCSCpSymBrkCtlTh[0][3]" 0 /end CHARACTERISTIC
/begin CHARACTERISTIC TP_U8ETCSCpSymBrkCtlTh[0][4] "" VALUE 0x8003A5FA CalPrmWspcEng_UBYTE 0 Spd12 0 31.875 SYMBOL_LINK "CalPrmWspcEng01.TP_U8ETCSCpSymBrkCtlTh[0][4]" 0 /end CHARACTERISTIC
/begin CHARACTERISTIC TP_U8ETCSCpSymBrkCtlTh[1][0] "" VALUE 0x8003A5FB CalPrmWspcEng_UBYTE 0 Spd12 0 31.875 SYMBOL_LINK "CalPrmWspcEng01.TP_U8ETCSCpSymBrkCtlTh[1][0]" 0 /end CHARACTERISTIC
/begin CHARACTERISTIC TP_U8ETCSCpSymBrkCtlTh[1][1] "" VALUE 0x8003A5FC CalPrmWspcEng_UBYTE 0 Spd12 0 31.875 SYMBOL_LINK "CalPrmWspcEng01.TP_U8ETCSCpSymBrkCtlTh[1][1]" 0 /end CHARACTERISTIC
/begin CHARACTERISTIC TP_U8ETCSCpSymBrkCtlTh[1][2] "" VALUE 0x8003A5FD CalPrmWspcEng_UBYTE 0 Spd12 0 31.875 SYMBOL_LINK "CalPrmWspcEng01.TP_U8ETCSCpSymBrkCtlTh[1][2]" 0 /end CHARACTERISTIC
/begin CHARACTERISTIC TP_U8ETCSCpSymBrkCtlTh[1][3] "" VALUE 0x8003A5FE CalPrmWspcEng_UBYTE 0 Spd12 0 31.875 SYMBOL_LINK "CalPrmWspcEng01.TP_U8ETCSCpSymBrkCtlTh[1][3]" 0 /end CHARACTERISTIC
/begin CHARACTERISTIC TP_U8ETCSCpSymBrkCtlTh[1][4] "" VALUE 0x8003A5FF CalPrmWspcEng_UBYTE 0 Spd12 0 31.875 SYMBOL_LINK "CalPrmWspcEng01.TP_U8ETCSCpSymBrkCtlTh[1][4]" 0 /end CHARACTERISTIC
/begin CHARACTERISTIC TP_U8ETCSCpSymBrkTrqMax[0] "" VALUE 0x8003A600 CalPrmWspcEng_UWORD 0 Tq51 0 6553.5 SYMBOL_LINK "CalPrmWspcEng01.TP_U8ETCSCpSymBrkTrqMax[0]" 0 /end CHARACTERISTIC
/begin CHARACTERISTIC TP_U8ETCSCpSymBrkTrqMax[1] "" VALUE 0x8003A602 CalPrmWspcEng_UWORD 0 Tq51 0 6553.5 SYMBOL_LINK "CalPrmWspcEng01.TP_U8ETCSCpSymBrkTrqMax[1]" 0 /end CHARACTERISTIC
/begin CHARACTERISTIC TP_U8ETCSCpSymBrkTrqMax[2] "" VALUE 0x8003A604 CalPrmWspcEng_UWORD 0 Tq51 0 6553.5 SYMBOL_LINK "CalPrmWspcEng01.TP_U8ETCSCpSymBrkTrqMax[2]" 0 /end CHARACTERISTIC
/begin CHARACTERISTIC TP_U8ETCSCpSymBrkTrqMax[3] "" VALUE 0x8003A606 CalPrmWspcEng_UWORD 0 Tq51 0 6553.5 SYMBOL_LINK "CalPrmWspcEng01.TP_U8ETCSCpSymBrkTrqMax[3]" 0 /end CHARACTERISTIC
/begin CHARACTERISTIC TP_U8ETCSCpSymBrkTrqMax[4] "" VALUE 0x8003A608 CalPrmWspcEng_UWORD 0 Tq51 0 6553.5 SYMBOL_LINK "CalPrmWspcEng01.TP_U8ETCSCpSymBrkTrqMax[4]" 0 /end CHARACTERISTIC
/begin CHARACTERISTIC TP_U8ETCSCpSymSpnDifTh "" VALUE 0x8003A60B CalPrmWspcEng_UBYTE 0 Spd12 0 31.875 SYMBOL_LINK "CalPrmWspcEng01.TP_U8ETCSCpSymSpnDifTh" 0 /end CHARACTERISTIC
/begin CHARACTERISTIC TP_U8ETCSCpTEGInGrCntThr4ErSgnChng "" VALUE 0x8003A629 CalPrmWspcEng_UBYTE 0 Ti51 0 5.1 SYMBOL_LINK "CalPrmWspcEng01.TP_U8ETCSCpTEGInGrCntThr4ErSgnChng" 0 /end CHARACTERISTIC
/begin CHARACTERISTIC TP_U8ETCSCpTEGInGrCntThr4MultShft "" VALUE 0x8003A62A CalPrmWspcEng_UBYTE 0 Ti51 0 5.1 SYMBOL_LINK "CalPrmWspcEng01.TP_U8ETCSCpTEGInGrCntThr4MultShft" 0 /end CHARACTERISTIC
/begin CHARACTERISTIC TP_U8ETCSCpTEGInGrCntThr4SlpChng "" VALUE 0x8003A62B CalPrmWspcEng_UBYTE 0 Ti51 0 5.1 SYMBOL_LINK "CalPrmWspcEng01.TP_U8ETCSCpTEGInGrCntThr4SlpChng" 0 /end CHARACTERISTIC
/begin CHARACTERISTIC TP_U8ETCSCpTEGInGrCntThr4SnglShft "" VALUE 0x8003A62C CalPrmWspcEng_UBYTE 0 Ti51 0 5.1 SYMBOL_LINK "CalPrmWspcEng01.TP_U8ETCSCpTEGInGrCntThr4SnglShft" 0 /end CHARACTERISTIC
/begin CHARACTERISTIC TP_U8ETCSCpTEGOutGrCntThr "" VALUE 0x8003A62D CalPrmWspcEng_UBYTE 0 Ti51 0 5.1 SYMBOL_LINK "CalPrmWspcEng01.TP_U8ETCSCpTEGOutGrCntThr" 0 /end CHARACTERISTIC
/begin CHARACTERISTIC TP_U8ETCSCpTEGOutGrCntThr4Spin "" VALUE 0x8003A62E CalPrmWspcEng_UBYTE 0 Ti51 0 5.1 SYMBOL_LINK "CalPrmWspcEng01.TP_U8ETCSCpTEGOutGrCntThr4Spin" 0 /end CHARACTERISTIC
/begin CHARACTERISTIC TP_U8ETCSCpTEGSpdThrGr1st "" VALUE 0x8003A62F CalPrmWspcEng_UBYTE 0 Spd12 0 31.875 SYMBOL_LINK "CalPrmWspcEng01.TP_U8ETCSCpTEGSpdThrGr1st" 0 /end CHARACTERISTIC
/begin CHARACTERISTIC TP_U8ETCSCpTarNChngDltYawFac "" VALUE 0x8003A60D CalPrmWspcEng_UBYTE 0 Perc6 0 255 SYMBOL_LINK "CalPrmWspcEng01.TP_U8ETCSCpTarNChngDltYawFac" 0 /end CHARACTERISTIC
/begin CHARACTERISTIC TP_U8ETCSCpTarNChngDltYawHiBrkTrq "" VALUE 0x8003A60E CalPrmWspcEng_UBYTE 0 AgSpd31 0 2.55 SYMBOL_LINK "CalPrmWspcEng01.TP_U8ETCSCpTarNChngDltYawHiBrkTrq" 0 /end CHARACTERISTIC
/begin CHARACTERISTIC TP_U8ETCSCpTarNChngDltYawLwBrkTrq "" VALUE 0x8003A60F CalPrmWspcEng_UBYTE 0 AgSpd31 0 2.55 SYMBOL_LINK "CalPrmWspcEng01.TP_U8ETCSCpTarNChngDltYawLwBrkTrq" 0 /end CHARACTERISTIC
/begin CHARACTERISTIC TP_U8ETCSCpTarSpnAdd1stCycle[0] "" VALUE 0x8003A610 CalPrmWspcEng_UBYTE 0 Spd12 0 31.875 SYMBOL_LINK "CalPrmWspcEng01.TP_U8ETCSCpTarSpnAdd1stCycle[0]" 0 /end CHARACTERISTIC
/begin CHARACTERISTIC TP_U8ETCSCpTarSpnAdd1stCycle[1] "" VALUE 0x8003A611 CalPrmWspcEng_UBYTE 0 Spd12 0 31.875 SYMBOL_LINK "CalPrmWspcEng01.TP_U8ETCSCpTarSpnAdd1stCycle[1]" 0 /end CHARACTERISTIC
/begin CHARACTERISTIC TP_U8ETCSCpTarSpnAdd1stCycle[2] "" VALUE 0x8003A612 CalPrmWspcEng_UBYTE 0 Spd12 0 31.875 SYMBOL_LINK "CalPrmWspcEng01.TP_U8ETCSCpTarSpnAdd1stCycle[2]" 0 /end CHARACTERISTIC
/begin CHARACTERISTIC TP_U8ETCSCpTarSpnAdd1stCycle[3] "" VALUE 0x8003A613 CalPrmWspcEng_UBYTE 0 Spd12 0 31.875 SYMBOL_LINK "CalPrmWspcEng01.TP_U8ETCSCpTarSpnAdd1stCycle[3]" 0 /end CHARACTERISTIC
/begin CHARACTERISTIC TP_U8ETCSCpTarSpnAdd1stCycle[4] "" VALUE 0x8003A614 CalPrmWspcEng_UBYTE 0 Spd12 0 31.875 SYMBOL_LINK "CalPrmWspcEng01.TP_U8ETCSCpTarSpnAdd1stCycle[4]" 0 /end CHARACTERISTIC
/begin CHARACTERISTIC TP_U8ETCSCpTarSpnAdd4AbnmSizTire "" VALUE 0x8003A615 CalPrmWspcEng_UBYTE 0 Spd12 0 31.875 SYMBOL_LINK "CalPrmWspcEng01.TP_U8ETCSCpTarSpnAdd4AbnmSizTire" 0 /end CHARACTERISTIC
/begin CHARACTERISTIC TP_U8ETCSCpTarSpnAdd4AdHiRd "" VALUE 0x8003A616 CalPrmWspcEng_UBYTE 0 Spd12 0 31.875 SYMBOL_LINK "CalPrmWspcEng01.TP_U8ETCSCpTarSpnAdd4AdHiRd" 0 /end CHARACTERISTIC
/begin CHARACTERISTIC TP_U8ETCSCpTarSpnAdd4DepSnwHil "" VALUE 0x8003A617 CalPrmWspcEng_UBYTE 0 Spd12 0 31.875 SYMBOL_LINK "CalPrmWspcEng01.TP_U8ETCSCpTarSpnAdd4DepSnwHil" 0 /end CHARACTERISTIC
/begin CHARACTERISTIC TP_U8ETCSCpTarSpnAdd4DrvPrtnMd "" VALUE 0x8003A618 CalPrmWspcEng_UBYTE 0 Spd12 0 31.875 SYMBOL_LINK "CalPrmWspcEng01.TP_U8ETCSCpTarSpnAdd4DrvPrtnMd" 0 /end CHARACTERISTIC
/begin CHARACTERISTIC TP_U8ETCSCpTarSpnAdd4Hill "" VALUE 0x8003A619 CalPrmWspcEng_UBYTE 0 Spd12 0 31.875 SYMBOL_LINK "CalPrmWspcEng01.TP_U8ETCSCpTarSpnAdd4Hill" 0 /end CHARACTERISTIC
/begin CHARACTERISTIC TP_U8ETCSCpTarSpnAdd4LwWhlSpn "" VALUE 0x8003A61A CalPrmWspcEng_UBYTE 0 Spd12 0 31.875 SYMBOL_LINK "CalPrmWspcEng01.TP_U8ETCSCpTarSpnAdd4LwWhlSpn" 0 /end CHARACTERISTIC
/begin CHARACTERISTIC TP_U8ETCSCpTarSpnAdd4PreHiRd "" VALUE 0x8003A61B CalPrmWspcEng_UBYTE 0 Spd12 0 31.875 SYMBOL_LINK "CalPrmWspcEng01.TP_U8ETCSCpTarSpnAdd4PreHiRd" 0 /end CHARACTERISTIC
/begin CHARACTERISTIC TP_U8ETCSCpTarSpnAdd4Sp "" VALUE 0x8003A61C CalPrmWspcEng_UBYTE 0 Spd12 0 31.875 SYMBOL_LINK "CalPrmWspcEng01.TP_U8ETCSCpTarSpnAdd4Sp" 0 /end CHARACTERISTIC
/begin CHARACTERISTIC TP_U8ETCSCpTarSpnAdd4Track "" VALUE 0x8003A61D CalPrmWspcEng_UBYTE 0 Spd12 0 31.875 SYMBOL_LINK "CalPrmWspcEng01.TP_U8ETCSCpTarSpnAdd4Track" 0 /end CHARACTERISTIC
/begin CHARACTERISTIC TP_U8ETCSCpTarSpnAddLwSpd "" VALUE 0x8003A61E CalPrmWspcEng_UBYTE 0 Spd12 0 31.875 SYMBOL_LINK "CalPrmWspcEng01.TP_U8ETCSCpTarSpnAddLwSpd" 0 /end CHARACTERISTIC
/begin CHARACTERISTIC TP_U8ETCSCpTarSpnTransTme "" VALUE 0x8003A61F CalPrmWspcEng_UBYTE 0 Ti51 0 5.1 SYMBOL_LINK "CalPrmWspcEng01.TP_U8ETCSCpTarSpnTransTme" 0 /end CHARACTERISTIC
/begin CHARACTERISTIC TP_U8ETCSCpTarTransCplBrkTrq2Sp "" VALUE 0x8003A620 CalPrmWspcEng_UBYTE 0 Tq31 0 2550 SYMBOL_LINK "CalPrmWspcEng01.TP_U8ETCSCpTarTransCplBrkTrq2Sp" 0 /end CHARACTERISTIC
/begin CHARACTERISTIC TP_U8ETCSCpTarTransStBrkTrq2Sp "" VALUE 0x8003A622 CalPrmWspcEng_UBYTE 0 Tq31 0 2550 SYMBOL_LINK "CalPrmWspcEng01.TP_U8ETCSCpTarTransStBrkTrq2Sp" 0 /end CHARACTERISTIC
/begin CHARACTERISTIC TP_U8ETCSCpTarWhlSpin[0] "" VALUE 0x8003A624 CalPrmWspcEng_UBYTE 0 Spd12 0 31.875 SYMBOL_LINK "CalPrmWspcEng01.TP_U8ETCSCpTarWhlSpin[0]" 0 /end CHARACTERISTIC
/begin CHARACTERISTIC TP_U8ETCSCpTarWhlSpin[1] "" VALUE 0x8003A625 CalPrmWspcEng_UBYTE 0 Spd12 0 31.875 SYMBOL_LINK "CalPrmWspcEng01.TP_U8ETCSCpTarWhlSpin[1]" 0 /end CHARACTERISTIC
/begin CHARACTERISTIC TP_U8ETCSCpTarWhlSpin[2] "" VALUE 0x8003A626 CalPrmWspcEng_UBYTE 0 Spd12 0 31.875 SYMBOL_LINK "CalPrmWspcEng01.TP_U8ETCSCpTarWhlSpin[2]" 0 /end CHARACTERISTIC
/begin CHARACTERISTIC TP_U8ETCSCpTarWhlSpin[3] "" VALUE 0x8003A627 CalPrmWspcEng_UBYTE 0 Spd12 0 31.875 SYMBOL_LINK "CalPrmWspcEng01.TP_U8ETCSCpTarWhlSpin[3]" 0 /end CHARACTERISTIC
/begin CHARACTERISTIC TP_U8ETCSCpTarWhlSpin[4] "" VALUE 0x8003A628 CalPrmWspcEng_UBYTE 0 Spd12 0 31.875 SYMBOL_LINK "CalPrmWspcEng01.TP_U8ETCSCpTarWhlSpin[4]" 0 /end CHARACTERISTIC
/begin CHARACTERISTIC TP_U8ETCSCpTrqDel[0] "" VALUE 0x8003A633 CalPrmWspcEng_UBYTE 0 Gain 0 255 SYMBOL_LINK "CalPrmWspcEng01.TP_U8ETCSCpTrqDel[0]" 0 /end CHARACTERISTIC
/begin CHARACTERISTIC TP_U8ETCSCpTrqDel[1] "" VALUE 0x8003A634 CalPrmWspcEng_UBYTE 0 Gain 0 255 SYMBOL_LINK "CalPrmWspcEng01.TP_U8ETCSCpTrqDel[1]" 0 /end CHARACTERISTIC
/begin CHARACTERISTIC TP_U8ETCSCpTrqDel[2] "" VALUE 0x8003A635 CalPrmWspcEng_UBYTE 0 Gain 0 255 SYMBOL_LINK "CalPrmWspcEng01.TP_U8ETCSCpTrqDel[2]" 0 /end CHARACTERISTIC
/begin CHARACTERISTIC TP_U8ETCSCpTrqDel[3] "" VALUE 0x8003A636 CalPrmWspcEng_UBYTE 0 Gain 0 255 SYMBOL_LINK "CalPrmWspcEng01.TP_U8ETCSCpTrqDel[3]" 0 /end CHARACTERISTIC
/begin CHARACTERISTIC TP_U8ETCSCpTrqDel[4] "" VALUE 0x8003A637 CalPrmWspcEng_UBYTE 0 Gain 0 255 SYMBOL_LINK "CalPrmWspcEng01.TP_U8ETCSCpTrqDel[4]" 0 /end CHARACTERISTIC
/begin CHARACTERISTIC TP_U8ETCSCpWhlSpnTransVal "" VALUE 0x8003A638 CalPrmWspcEng_UBYTE 0 Spd12 0 31.875 SYMBOL_LINK "CalPrmWspcEng01.TP_U8ETCSCpWhlSpnTransVal" 0 /end CHARACTERISTIC
/begin CHARACTERISTIC TP_U8ETCSCpYawStabCntTh[0] "" VALUE 0x8003A63A CalPrmWspcEng_UBYTE 0 Ti51 0 5.1 SYMBOL_LINK "CalPrmWspcEng01.TP_U8ETCSCpYawStabCntTh[0]" 0 /end CHARACTERISTIC
/begin CHARACTERISTIC TP_U8ETCSCpYawStabCntTh[1] "" VALUE 0x8003A63B CalPrmWspcEng_UBYTE 0 Ti51 0 5.1 SYMBOL_LINK "CalPrmWspcEng01.TP_U8ETCSCpYawStabCntTh[1]" 0 /end CHARACTERISTIC
/begin CHARACTERISTIC TP_U8ETCSCpYawStabCntTh[2] "" VALUE 0x8003A63C CalPrmWspcEng_UBYTE 0 Ti51 0 5.1 SYMBOL_LINK "CalPrmWspcEng01.TP_U8ETCSCpYawStabCntTh[2]" 0 /end CHARACTERISTIC
/begin CHARACTERISTIC TP_U8ETCSCpYawStabCnvrgThFac "" VALUE 0x8003A63D CalPrmWspcEng_UBYTE 0 Perc6 0 255 SYMBOL_LINK "CalPrmWspcEng01.TP_U8ETCSCpYawStabCnvrgThFac" 0 /end CHARACTERISTIC
/begin CHARACTERISTIC TP_U8ETCSCpYawThFac[0][0] "" VALUE 0x8003A63E CalPrmWspcEng_UBYTE 0 Perc6 0 255 SYMBOL_LINK "CalPrmWspcEng01.TP_U8ETCSCpYawThFac[0][0]" 0 /end CHARACTERISTIC
/begin CHARACTERISTIC TP_U8ETCSCpYawThFac[0][1] "" VALUE 0x8003A63F CalPrmWspcEng_UBYTE 0 Perc6 0 255 SYMBOL_LINK "CalPrmWspcEng01.TP_U8ETCSCpYawThFac[0][1]" 0 /end CHARACTERISTIC
/begin CHARACTERISTIC TP_U8ETCSCpYawThFac[0][2] "" VALUE 0x8003A640 CalPrmWspcEng_UBYTE 0 Perc6 0 255 SYMBOL_LINK "CalPrmWspcEng01.TP_U8ETCSCpYawThFac[0][2]" 0 /end CHARACTERISTIC
/begin CHARACTERISTIC TP_U8ETCSCpYawThFac[0][3] "" VALUE 0x8003A641 CalPrmWspcEng_UBYTE 0 Perc6 0 255 SYMBOL_LINK "CalPrmWspcEng01.TP_U8ETCSCpYawThFac[0][3]" 0 /end CHARACTERISTIC
/begin CHARACTERISTIC TP_U8ETCSCpYawThFac[0][4] "" VALUE 0x8003A642 CalPrmWspcEng_UBYTE 0 Perc6 0 255 SYMBOL_LINK "CalPrmWspcEng01.TP_U8ETCSCpYawThFac[0][4]" 0 /end CHARACTERISTIC
/begin CHARACTERISTIC TP_U8ETCSCpYawThFac[1][0] "" VALUE 0x8003A643 CalPrmWspcEng_UBYTE 0 Perc6 0 255 SYMBOL_LINK "CalPrmWspcEng01.TP_U8ETCSCpYawThFac[1][0]" 0 /end CHARACTERISTIC
/begin CHARACTERISTIC TP_U8ETCSCpYawThFac[1][1] "" VALUE 0x8003A644 CalPrmWspcEng_UBYTE 0 Perc6 0 255 SYMBOL_LINK "CalPrmWspcEng01.TP_U8ETCSCpYawThFac[1][1]" 0 /end CHARACTERISTIC
/begin CHARACTERISTIC TP_U8ETCSCpYawThFac[1][2] "" VALUE 0x8003A645 CalPrmWspcEng_UBYTE 0 Perc6 0 255 SYMBOL_LINK "CalPrmWspcEng01.TP_U8ETCSCpYawThFac[1][2]" 0 /end CHARACTERISTIC
/begin CHARACTERISTIC TP_U8ETCSCpYawThFac[1][3] "" VALUE 0x8003A646 CalPrmWspcEng_UBYTE 0 Perc6 0 255 SYMBOL_LINK "CalPrmWspcEng01.TP_U8ETCSCpYawThFac[1][3]" 0 /end CHARACTERISTIC
/begin CHARACTERISTIC TP_U8ETCSCpYawThFac[1][4] "" VALUE 0x8003A647 CalPrmWspcEng_UBYTE 0 Perc6 0 255 SYMBOL_LINK "CalPrmWspcEng01.TP_U8ETCSCpYawThFac[1][4]" 0 /end CHARACTERISTIC
/begin CHARACTERISTIC TP_U8ETCSCpYawThFac[2][0] "" VALUE 0x8003A648 CalPrmWspcEng_UBYTE 0 Perc6 0 255 SYMBOL_LINK "CalPrmWspcEng01.TP_U8ETCSCpYawThFac[2][0]" 0 /end CHARACTERISTIC
/begin CHARACTERISTIC TP_U8ETCSCpYawThFac[2][1] "" VALUE 0x8003A649 CalPrmWspcEng_UBYTE 0 Perc6 0 255 SYMBOL_LINK "CalPrmWspcEng01.TP_U8ETCSCpYawThFac[2][1]" 0 /end CHARACTERISTIC
/begin CHARACTERISTIC TP_U8ETCSCpYawThFac[2][2] "" VALUE 0x8003A64A CalPrmWspcEng_UBYTE 0 Perc6 0 255 SYMBOL_LINK "CalPrmWspcEng01.TP_U8ETCSCpYawThFac[2][2]" 0 /end CHARACTERISTIC
/begin CHARACTERISTIC TP_U8ETCSCpYawThFac[2][3] "" VALUE 0x8003A64B CalPrmWspcEng_UBYTE 0 Perc6 0 255 SYMBOL_LINK "CalPrmWspcEng01.TP_U8ETCSCpYawThFac[2][3]" 0 /end CHARACTERISTIC
/begin CHARACTERISTIC TP_U8ETCSCpYawThFac[2][4] "" VALUE 0x8003A64C CalPrmWspcEng_UBYTE 0 Perc6 0 255 SYMBOL_LINK "CalPrmWspcEng01.TP_U8ETCSCpYawThFac[2][4]" 0 /end CHARACTERISTIC
/begin CHARACTERISTIC TP_U8TCSCpAsymSpnCtlFFmodeTimeUp "" VALUE 0x8003A26D CalPrmWspcEng_UBYTE 0 Ti21 0 2.55 SYMBOL_LINK "CalPrmWspcEng01.TP_U8TCSCpAsymSpnCtlFFmodeTimeUp" 0 /end CHARACTERISTIC
/begin CHARACTERISTIC TP_U8TCSCpIniMtrCtlModeTime "" VALUE 0x8003A311 CalPrmWspcEng_UBYTE 0 Ti21 0 2.55 SYMBOL_LINK "CalPrmWspcEng01.TP_U8TCSCpIniMtrCtlModeTime" 0 /end CHARACTERISTIC
/begin CHARACTERISTIC TP_U8TCSCpIniMtrCtlModeTimeInTurn "" VALUE 0x8003A312 CalPrmWspcEng_UBYTE 0 Ti21 0 2.55 SYMBOL_LINK "CalPrmWspcEng01.TP_U8TCSCpIniMtrCtlModeTimeInTurn" 0 /end CHARACTERISTIC
/begin CHARACTERISTIC TP_U8TCSCpIniPres "" VALUE 0x8003A313 CalPrmWspcEng_UBYTE 0 P34 0 25.5 SYMBOL_LINK "CalPrmWspcEng01.TP_U8TCSCpIniPres" 0 /end CHARACTERISTIC
/begin CHARACTERISTIC TP_U8TCSCpIniTCVCtlModeTime "" VALUE 0x8003A314 CalPrmWspcEng_UBYTE 0 Ti21 0 2.55 SYMBOL_LINK "CalPrmWspcEng01.TP_U8TCSCpIniTCVCtlModeTime" 0 /end CHARACTERISTIC
/begin CHARACTERISTIC TP_U8TCSCpIniTCVCtlModeTimeHill "" VALUE 0x8003A315 CalPrmWspcEng_UBYTE 0 Ti21 0 2.55 SYMBOL_LINK "CalPrmWspcEng01.TP_U8TCSCpIniTCVCtlModeTimeHill" 0 /end CHARACTERISTIC
/begin CHARACTERISTIC TP_U8TCSCpIniTCVCtlModeTimeHunt "" VALUE 0x8003A316 CalPrmWspcEng_UBYTE 0 Ti21 0 2.55 SYMBOL_LINK "CalPrmWspcEng01.TP_U8TCSCpIniTCVCtlModeTimeHunt" 0 /end CHARACTERISTIC
/begin CHARACTERISTIC TP_U8TCSCpIniTCVCtlModeTimeInTurn "" VALUE 0x8003A317 CalPrmWspcEng_UBYTE 0 Ti21 0 2.55 SYMBOL_LINK "CalPrmWspcEng01.TP_U8TCSCpIniTCVCtlModeTimeInTurn" 0 /end CHARACTERISTIC
/begin CHARACTERISTIC TP_U8TMCCpTurnIndex[0] "" VALUE 0x8003A64E CalPrmWspcEng_UBYTE 0 Gain 0 255 SYMBOL_LINK "CalPrmWspcEng01.TP_U8TMCCpTurnIndex[0]" 0 /end CHARACTERISTIC
/begin CHARACTERISTIC TP_U8TMCCpTurnIndex[1] "" VALUE 0x8003A64F CalPrmWspcEng_UBYTE 0 Gain 0 255 SYMBOL_LINK "CalPrmWspcEng01.TP_U8TMCCpTurnIndex[1]" 0 /end CHARACTERISTIC
/begin CHARACTERISTIC TP_U8TMCCpTurnIndex[2] "" VALUE 0x8003A650 CalPrmWspcEng_UBYTE 0 Gain 0 255 SYMBOL_LINK "CalPrmWspcEng01.TP_U8TMCCpTurnIndex[2]" 0 /end CHARACTERISTIC
/begin CHARACTERISTIC TP_U8TMCpAllowDnShftMinVehSpd[0] "" VALUE 0x8003A651 CalPrmWspcEng_UBYTE 0 Gain 0 255 SYMBOL_LINK "CalPrmWspcEng01.TP_U8TMCpAllowDnShftMinVehSpd[0]" 0 /end CHARACTERISTIC
/begin CHARACTERISTIC TP_U8TMCpAllowDnShftMinVehSpd[1] "" VALUE 0x8003A652 CalPrmWspcEng_UBYTE 0 Gain 0 255 SYMBOL_LINK "CalPrmWspcEng01.TP_U8TMCpAllowDnShftMinVehSpd[1]" 0 /end CHARACTERISTIC
/begin CHARACTERISTIC TP_U8TMCpAllowDnShftMinVehSpd[2] "" VALUE 0x8003A653 CalPrmWspcEng_UBYTE 0 Gain 0 255 SYMBOL_LINK "CalPrmWspcEng01.TP_U8TMCpAllowDnShftMinVehSpd[2]" 0 /end CHARACTERISTIC
/begin CHARACTERISTIC TP_U8TMCpAllowDnShftMinVehSpd[3] "" VALUE 0x8003A654 CalPrmWspcEng_UBYTE 0 Gain 0 255 SYMBOL_LINK "CalPrmWspcEng01.TP_U8TMCpAllowDnShftMinVehSpd[3]" 0 /end CHARACTERISTIC
/begin CHARACTERISTIC TP_U8TMCpAllowDnShftMinVehSpd[4] "" VALUE 0x8003A655 CalPrmWspcEng_UBYTE 0 Gain 0 255 SYMBOL_LINK "CalPrmWspcEng01.TP_U8TMCpAllowDnShftMinVehSpd[4]" 0 /end CHARACTERISTIC
/begin CHARACTERISTIC TP_U8TMCpAllowDnShftRPM[0] "" VALUE 0x8003A656 CalPrmWspcEng_UBYTE 0 Gain 0 255 SYMBOL_LINK "CalPrmWspcEng01.TP_U8TMCpAllowDnShftRPM[0]" 0 /end CHARACTERISTIC
/begin CHARACTERISTIC TP_U8TMCpAllowDnShftRPM[1] "" VALUE 0x8003A657 CalPrmWspcEng_UBYTE 0 Gain 0 255 SYMBOL_LINK "CalPrmWspcEng01.TP_U8TMCpAllowDnShftRPM[1]" 0 /end CHARACTERISTIC
/begin CHARACTERISTIC TP_U8TMCpAllowDnShftRPM[2] "" VALUE 0x8003A658 CalPrmWspcEng_UBYTE 0 Gain 0 255 SYMBOL_LINK "CalPrmWspcEng01.TP_U8TMCpAllowDnShftRPM[2]" 0 /end CHARACTERISTIC
/begin CHARACTERISTIC TP_U8TMCpAllowDnShftRPM[3] "" VALUE 0x8003A659 CalPrmWspcEng_UBYTE 0 Gain 0 255 SYMBOL_LINK "CalPrmWspcEng01.TP_U8TMCpAllowDnShftRPM[3]" 0 /end CHARACTERISTIC
/begin CHARACTERISTIC TP_U8TMCpAllowDnShftRPM[4] "" VALUE 0x8003A65A CalPrmWspcEng_UBYTE 0 Gain 0 255 SYMBOL_LINK "CalPrmWspcEng01.TP_U8TMCpAllowDnShftRPM[4]" 0 /end CHARACTERISTIC
/begin CHARACTERISTIC TP_U8TMCpAllowDnShftVehSpd[0] "" VALUE 0x8003A65B CalPrmWspcEng_UBYTE 0 Gain 0 255 SYMBOL_LINK "CalPrmWspcEng01.TP_U8TMCpAllowDnShftVehSpd[0]" 0 /end CHARACTERISTIC
/begin CHARACTERISTIC TP_U8TMCpAllowDnShftVehSpd[1] "" VALUE 0x8003A65C CalPrmWspcEng_UBYTE 0 Gain 0 255 SYMBOL_LINK "CalPrmWspcEng01.TP_U8TMCpAllowDnShftVehSpd[1]" 0 /end CHARACTERISTIC
/begin CHARACTERISTIC TP_U8TMCpAllowDnShftVehSpd[2] "" VALUE 0x8003A65D CalPrmWspcEng_UBYTE 0 Gain 0 255 SYMBOL_LINK "CalPrmWspcEng01.TP_U8TMCpAllowDnShftVehSpd[2]" 0 /end CHARACTERISTIC
/begin CHARACTERISTIC TP_U8TMCpAllowDnShftVehSpd[3] "" VALUE 0x8003A65E CalPrmWspcEng_UBYTE 0 Gain 0 255 SYMBOL_LINK "CalPrmWspcEng01.TP_U8TMCpAllowDnShftVehSpd[3]" 0 /end CHARACTERISTIC
/begin CHARACTERISTIC TP_U8TMCpAllowDnShftVehSpd[4] "" VALUE 0x8003A65F CalPrmWspcEng_UBYTE 0 Gain 0 255 SYMBOL_LINK "CalPrmWspcEng01.TP_U8TMCpAllowDnShftVehSpd[4]" 0 /end CHARACTERISTIC
/begin CHARACTERISTIC TP_U8TMCpAllowUpShftMaxVehSpd[0] "" VALUE 0x8003A660 CalPrmWspcEng_UBYTE 0 Gain 0 255 SYMBOL_LINK "CalPrmWspcEng01.TP_U8TMCpAllowUpShftMaxVehSpd[0]" 0 /end CHARACTERISTIC
/begin CHARACTERISTIC TP_U8TMCpAllowUpShftMaxVehSpd[1] "" VALUE 0x8003A661 CalPrmWspcEng_UBYTE 0 Gain 0 255 SYMBOL_LINK "CalPrmWspcEng01.TP_U8TMCpAllowUpShftMaxVehSpd[1]" 0 /end CHARACTERISTIC
/begin CHARACTERISTIC TP_U8TMCpAllowUpShftMaxVehSpd[2] "" VALUE 0x8003A662 CalPrmWspcEng_UBYTE 0 Gain 0 255 SYMBOL_LINK "CalPrmWspcEng01.TP_U8TMCpAllowUpShftMaxVehSpd[2]" 0 /end CHARACTERISTIC
/begin CHARACTERISTIC TP_U8TMCpAllowUpShftMaxVehSpd[3] "" VALUE 0x8003A663 CalPrmWspcEng_UBYTE 0 Gain 0 255 SYMBOL_LINK "CalPrmWspcEng01.TP_U8TMCpAllowUpShftMaxVehSpd[3]" 0 /end CHARACTERISTIC
/begin CHARACTERISTIC TP_U8TMCpAllowUpShftMaxVehSpd[4] "" VALUE 0x8003A664 CalPrmWspcEng_UBYTE 0 Gain 0 255 SYMBOL_LINK "CalPrmWspcEng01.TP_U8TMCpAllowUpShftMaxVehSpd[4]" 0 /end CHARACTERISTIC
/begin CHARACTERISTIC TP_U8TMCpAllowUpShftRPM[0] "" VALUE 0x8003A665 CalPrmWspcEng_UBYTE 0 Gain 0 255 SYMBOL_LINK "CalPrmWspcEng01.TP_U8TMCpAllowUpShftRPM[0]" 0 /end CHARACTERISTIC
/begin CHARACTERISTIC TP_U8TMCpAllowUpShftRPM[1] "" VALUE 0x8003A666 CalPrmWspcEng_UBYTE 0 Gain 0 255 SYMBOL_LINK "CalPrmWspcEng01.TP_U8TMCpAllowUpShftRPM[1]" 0 /end CHARACTERISTIC
/begin CHARACTERISTIC TP_U8TMCpAllowUpShftRPM[2] "" VALUE 0x8003A667 CalPrmWspcEng_UBYTE 0 Gain 0 255 SYMBOL_LINK "CalPrmWspcEng01.TP_U8TMCpAllowUpShftRPM[2]" 0 /end CHARACTERISTIC
/begin CHARACTERISTIC TP_U8TMCpAllowUpShftRPM[3] "" VALUE 0x8003A668 CalPrmWspcEng_UBYTE 0 Gain 0 255 SYMBOL_LINK "CalPrmWspcEng01.TP_U8TMCpAllowUpShftRPM[3]" 0 /end CHARACTERISTIC
/begin CHARACTERISTIC TP_U8TMCpAllowUpShftRPM[4] "" VALUE 0x8003A669 CalPrmWspcEng_UBYTE 0 Gain 0 255 SYMBOL_LINK "CalPrmWspcEng01.TP_U8TMCpAllowUpShftRPM[4]" 0 /end CHARACTERISTIC
/begin CHARACTERISTIC TP_U8TMCpAllowUpShftVehSpd[0] "" VALUE 0x8003A66A CalPrmWspcEng_UBYTE 0 Gain 0 255 SYMBOL_LINK "CalPrmWspcEng01.TP_U8TMCpAllowUpShftVehSpd[0]" 0 /end CHARACTERISTIC
/begin CHARACTERISTIC TP_U8TMCpAllowUpShftVehSpd[1] "" VALUE 0x8003A66B CalPrmWspcEng_UBYTE 0 Gain 0 255 SYMBOL_LINK "CalPrmWspcEng01.TP_U8TMCpAllowUpShftVehSpd[1]" 0 /end CHARACTERISTIC
/begin CHARACTERISTIC TP_U8TMCpAllowUpShftVehSpd[2] "" VALUE 0x8003A66C CalPrmWspcEng_UBYTE 0 Gain 0 255 SYMBOL_LINK "CalPrmWspcEng01.TP_U8TMCpAllowUpShftVehSpd[2]" 0 /end CHARACTERISTIC
/begin CHARACTERISTIC TP_U8TMCpAllowUpShftVehSpd[3] "" VALUE 0x8003A66D CalPrmWspcEng_UBYTE 0 Gain 0 255 SYMBOL_LINK "CalPrmWspcEng01.TP_U8TMCpAllowUpShftVehSpd[3]" 0 /end CHARACTERISTIC
/begin CHARACTERISTIC TP_U8TMCpAllowUpShftVehSpd[4] "" VALUE 0x8003A66E CalPrmWspcEng_UBYTE 0 Gain 0 255 SYMBOL_LINK "CalPrmWspcEng01.TP_U8TMCpAllowUpShftVehSpd[4]" 0 /end CHARACTERISTIC
/begin CHARACTERISTIC TP_U8TMCpGearShiftTime "" VALUE 0x8003A66F CalPrmWspcEng_UBYTE 0 Ti51 0 5.1 SYMBOL_LINK "CalPrmWspcEng01.TP_U8TMCpGearShiftTime" 0 /end CHARACTERISTIC
/begin CHARACTERISTIC TP_U8TMCpMaxGear "" VALUE 0x8003A670 CalPrmWspcEng_UBYTE 0 Fac31 0 255 SYMBOL_LINK "CalPrmWspcEng01.TP_U8TMCpMaxGear" 0 /end CHARACTERISTIC
/begin CHARACTERISTIC TP_U8TMCpMinGear "" VALUE 0x8003A671 CalPrmWspcEng_UBYTE 0 Fac31 0 255 SYMBOL_LINK "CalPrmWspcEng01.TP_U8TMCpMinGear" 0 /end CHARACTERISTIC
/begin CHARACTERISTIC TP_U8TMCpShftChgRPMHys "" VALUE 0x8003A672 CalPrmWspcEng_UBYTE 0 N13 0 25500 SYMBOL_LINK "CalPrmWspcEng01.TP_U8TMCpShftChgRPMHys" 0 /end CHARACTERISTIC
/begin CHARACTERISTIC TP_U8TMCpShftChgRPMInTrn[0] "" VALUE 0x8003A673 CalPrmWspcEng_UBYTE 0 Gain 0 255 SYMBOL_LINK "CalPrmWspcEng01.TP_U8TMCpShftChgRPMInTrn[0]" 0 /end CHARACTERISTIC
/begin CHARACTERISTIC TP_U8TMCpShftChgRPMInTrn[1] "" VALUE 0x8003A674 CalPrmWspcEng_UBYTE 0 Gain 0 255 SYMBOL_LINK "CalPrmWspcEng01.TP_U8TMCpShftChgRPMInTrn[1]" 0 /end CHARACTERISTIC
/begin CHARACTERISTIC TP_U8TMCpShftChgRPMInTrn[2] "" VALUE 0x8003A675 CalPrmWspcEng_UBYTE 0 Gain 0 255 SYMBOL_LINK "CalPrmWspcEng01.TP_U8TMCpShftChgRPMInTrn[2]" 0 /end CHARACTERISTIC
/begin CHARACTERISTIC TP_U8TMCpShftChgVehSpdHys "" VALUE 0x8003A676 CalPrmWspcEng_UBYTE 0 Spd41 0 255 SYMBOL_LINK "CalPrmWspcEng01.TP_U8TMCpShftChgVehSpdHys" 0 /end CHARACTERISTIC
/begin CHARACTERISTIC TP_U8TMCpShftChgVehSpdInHill "" VALUE 0x8003A677 CalPrmWspcEng_UBYTE 0 Spd41 0 255 SYMBOL_LINK "CalPrmWspcEng01.TP_U8TMCpShftChgVehSpdInHill" 0 /end CHARACTERISTIC
/begin CHARACTERISTIC TP_U8TMCpShftChgVehSpdInTrn[0] "" VALUE 0x8003A678 CalPrmWspcEng_UBYTE 0 Gain 0 255 SYMBOL_LINK "CalPrmWspcEng01.TP_U8TMCpShftChgVehSpdInTrn[0]" 0 /end CHARACTERISTIC
/begin CHARACTERISTIC TP_U8TMCpShftChgVehSpdInTrn[1] "" VALUE 0x8003A679 CalPrmWspcEng_UBYTE 0 Gain 0 255 SYMBOL_LINK "CalPrmWspcEng01.TP_U8TMCpShftChgVehSpdInTrn[1]" 0 /end CHARACTERISTIC
/begin CHARACTERISTIC TP_U8TMCpShftChgVehSpdInTrn[2] "" VALUE 0x8003A67A CalPrmWspcEng_UBYTE 0 Gain 0 255 SYMBOL_LINK "CalPrmWspcEng01.TP_U8TMCpShftChgVehSpdInTrn[2]" 0 /end CHARACTERISTIC
/begin CHARACTERISTIC TP_U8TransEff_1 "This calibration parameter represents transmission efficiency. This value can be obtained from vehicle specification or through the vehicle test which is designed for it." VALUE 0x8003A022 CalPrmCmnEng_UBYTE 0 Perc6 0 255 SYMBOL_LINK "CalPrmCmnEng01.TP_U8TransEff_1" 0 /end CHARACTERISTIC
/begin CHARACTERISTIC TP_U8TransEff_2 "This calibration parameter represents transmission efficiency. This value can be obtained from vehicle specification or through the vehicle test which is designed for it." VALUE 0x8003A023 CalPrmCmnEng_UBYTE 0 Perc6 0 255 SYMBOL_LINK "CalPrmCmnEng01.TP_U8TransEff_2" 0 /end CHARACTERISTIC
/begin CHARACTERISTIC TP_U8TransEff_3 "This calibration parameter represents transmission efficiency. This value can be obtained from vehicle specification or through the vehicle test which is designed for it." VALUE 0x8003A024 CalPrmCmnEng_UBYTE 0 Perc6 0 255 SYMBOL_LINK "CalPrmCmnEng01.TP_U8TransEff_3" 0 /end CHARACTERISTIC
/begin CHARACTERISTIC TP_U8TransEff_4 "This calibration parameter represents transmission efficiency. This value can be obtained from vehicle specification or through the vehicle test which is designed for it." VALUE 0x8003A025 CalPrmCmnEng_UBYTE 0 Perc6 0 255 SYMBOL_LINK "CalPrmCmnEng01.TP_U8TransEff_4" 0 /end CHARACTERISTIC
/begin CHARACTERISTIC TP_U8TransEff_5 "This calibration parameter represents transmission efficiency. This value can be obtained from vehicle specification or through the vehicle test which is designed for it." VALUE 0x8003A026 CalPrmCmnEng_UBYTE 0 Perc6 0 255 SYMBOL_LINK "CalPrmCmnEng01.TP_U8TransEff_5" 0 /end CHARACTERISTIC
/begin CHARACTERISTIC TP_U8TransEff_6 "This calibration parameter represents transmission efficiency. This value can be obtained from vehicle specification or through the vehicle test which is designed for it." VALUE 0x8003A027 CalPrmCmnEng_UBYTE 0 Perc6 0 255 SYMBOL_LINK "CalPrmCmnEng01.TP_U8TransEff_6" 0 /end CHARACTERISTIC
/begin CHARACTERISTIC TP_U8TransEff_7 "This calibration parameter represents transmission efficiency. This value can be obtained from vehicle specification or through the vehicle test which is designed for it." VALUE 0x8003A028 CalPrmCmnEng_UBYTE 0 Perc6 0 255 SYMBOL_LINK "CalPrmCmnEng01.TP_U8TransEff_7" 0 /end CHARACTERISTIC
/begin CHARACTERISTIC TP_U8TransEff_8 "This calibration parameter represents transmission efficiency. This value can be obtained from vehicle specification or through the vehicle test which is designed for it." VALUE 0x8003A029 CalPrmCmnEng_UBYTE 0 Perc6 0 255 SYMBOL_LINK "CalPrmCmnEng01.TP_U8TransEff_8" 0 /end CHARACTERISTIC
/begin CHARACTERISTIC TP_U8TransEff_R "This calibration parameter represents transmission efficiency. This value can be obtained from vehicle specification or through the vehicle test which is designed for it." VALUE 0x8003A02A CalPrmCmnEng_UBYTE 0 Perc6 0 255 SYMBOL_LINK "CalPrmCmnEng01.TP_U8TransEff_R" 0 /end CHARACTERISTIC
/begin CHARACTERISTIC TP_U8_EDC_PHASE1_D_GAIN_ESC_S1 "" VALUE 0x8003A104 CalPrmWslcEng_UBYTE 0 Gain 0 255 SYMBOL_LINK "CalPrmWslcEng01.TP_U8_EDC_PHASE1_D_GAIN_ESC_S1" 0 /end CHARACTERISTIC
/begin CHARACTERISTIC TP_U8_EDC_PHASE1_D_GAIN_ESC_S2 "" VALUE 0x8003A105 CalPrmWslcEng_UBYTE 0 Gain 0 255 SYMBOL_LINK "CalPrmWslcEng01.TP_U8_EDC_PHASE1_D_GAIN_ESC_S2" 0 /end CHARACTERISTIC
/begin CHARACTERISTIC TP_U8_EDC_PHASE1_D_GAIN_ESC_S3 "" VALUE 0x8003A106 CalPrmWslcEng_UBYTE 0 Gain 0 255 SYMBOL_LINK "CalPrmWslcEng01.TP_U8_EDC_PHASE1_D_GAIN_ESC_S3" 0 /end CHARACTERISTIC
/begin CHARACTERISTIC TP_U8_EDC_PHASE1_D_GAIN_ESC_S4 "" VALUE 0x8003A107 CalPrmWslcEng_UBYTE 0 Gain 0 255 SYMBOL_LINK "CalPrmWslcEng01.TP_U8_EDC_PHASE1_D_GAIN_ESC_S4" 0 /end CHARACTERISTIC
/begin CHARACTERISTIC TP_U8_EDC_PHASE1_P_GAIN_ESC_S1 "" VALUE 0x8003A108 CalPrmWslcEng_UBYTE 0 Gain 0 255 SYMBOL_LINK "CalPrmWslcEng01.TP_U8_EDC_PHASE1_P_GAIN_ESC_S1" 0 /end CHARACTERISTIC
/begin CHARACTERISTIC TP_U8_EDC_PHASE1_P_GAIN_ESC_S2 "" VALUE 0x8003A109 CalPrmWslcEng_UBYTE 0 Gain 0 255 SYMBOL_LINK "CalPrmWslcEng01.TP_U8_EDC_PHASE1_P_GAIN_ESC_S2" 0 /end CHARACTERISTIC
/begin CHARACTERISTIC TP_U8_EDC_PHASE1_P_GAIN_ESC_S3 "" VALUE 0x8003A10A CalPrmWslcEng_UBYTE 0 Gain 0 255 SYMBOL_LINK "CalPrmWslcEng01.TP_U8_EDC_PHASE1_P_GAIN_ESC_S3" 0 /end CHARACTERISTIC
/begin CHARACTERISTIC TP_U8_EDC_PHASE1_P_GAIN_ESC_S4 "" VALUE 0x8003A10B CalPrmWslcEng_UBYTE 0 Gain 0 255 SYMBOL_LINK "CalPrmWslcEng01.TP_U8_EDC_PHASE1_P_GAIN_ESC_S4" 0 /end CHARACTERISTIC
/begin CHARACTERISTIC TP_U8_EDC_PHASE2_D_GAIN_ESC_S1 "" VALUE 0x8003A10C CalPrmWslcEng_UBYTE 0 Gain 0 255 SYMBOL_LINK "CalPrmWslcEng01.TP_U8_EDC_PHASE2_D_GAIN_ESC_S1" 0 /end CHARACTERISTIC
/begin CHARACTERISTIC TP_U8_EDC_PHASE2_D_GAIN_ESC_S2 "" VALUE 0x8003A10D CalPrmWslcEng_UBYTE 0 Gain 0 255 SYMBOL_LINK "CalPrmWslcEng01.TP_U8_EDC_PHASE2_D_GAIN_ESC_S2" 0 /end CHARACTERISTIC
/begin CHARACTERISTIC TP_U8_EDC_PHASE2_D_GAIN_ESC_S3 "" VALUE 0x8003A10E CalPrmWslcEng_UBYTE 0 Gain 0 255 SYMBOL_LINK "CalPrmWslcEng01.TP_U8_EDC_PHASE2_D_GAIN_ESC_S3" 0 /end CHARACTERISTIC
/begin CHARACTERISTIC TP_U8_EDC_PHASE2_D_GAIN_ESC_S4 "" VALUE 0x8003A10F CalPrmWslcEng_UBYTE 0 Gain 0 255 SYMBOL_LINK "CalPrmWslcEng01.TP_U8_EDC_PHASE2_D_GAIN_ESC_S4" 0 /end CHARACTERISTIC
/begin CHARACTERISTIC TP_U8_EDC_PHASE2_P_GAIN_ESC_S1 "" VALUE 0x8003A110 CalPrmWslcEng_UBYTE 0 Gain 0 255 SYMBOL_LINK "CalPrmWslcEng01.TP_U8_EDC_PHASE2_P_GAIN_ESC_S1" 0 /end CHARACTERISTIC
/begin CHARACTERISTIC TP_U8_EDC_PHASE2_P_GAIN_ESC_S2 "" VALUE 0x8003A111 CalPrmWslcEng_UBYTE 0 Gain 0 255 SYMBOL_LINK "CalPrmWslcEng01.TP_U8_EDC_PHASE2_P_GAIN_ESC_S2" 0 /end CHARACTERISTIC
/begin CHARACTERISTIC TP_U8_EDC_PHASE2_P_GAIN_ESC_S3 "" VALUE 0x8003A112 CalPrmWslcEng_UBYTE 0 Gain 0 255 SYMBOL_LINK "CalPrmWslcEng01.TP_U8_EDC_PHASE2_P_GAIN_ESC_S3" 0 /end CHARACTERISTIC
/begin CHARACTERISTIC TP_U8_EDC_PHASE2_P_GAIN_ESC_S4 "" VALUE 0x8003A113 CalPrmWslcEng_UBYTE 0 Gain 0 255 SYMBOL_LINK "CalPrmWslcEng01.TP_U8_EDC_PHASE2_P_GAIN_ESC_S4" 0 /end CHARACTERISTIC
/begin CHARACTERISTIC TP_U8_EDC_PHASE3_D_GAIN_ESC_S1 "" VALUE 0x8003A114 CalPrmWslcEng_UBYTE 0 Gain 0 255 SYMBOL_LINK "CalPrmWslcEng01.TP_U8_EDC_PHASE3_D_GAIN_ESC_S1" 0 /end CHARACTERISTIC
/begin CHARACTERISTIC TP_U8_EDC_PHASE3_D_GAIN_ESC_S2 "" VALUE 0x8003A115 CalPrmWslcEng_UBYTE 0 Gain 0 255 SYMBOL_LINK "CalPrmWslcEng01.TP_U8_EDC_PHASE3_D_GAIN_ESC_S2" 0 /end CHARACTERISTIC
/begin CHARACTERISTIC TP_U8_EDC_PHASE3_D_GAIN_ESC_S3 "" VALUE 0x8003A116 CalPrmWslcEng_UBYTE 0 Gain 0 255 SYMBOL_LINK "CalPrmWslcEng01.TP_U8_EDC_PHASE3_D_GAIN_ESC_S3" 0 /end CHARACTERISTIC
/begin CHARACTERISTIC TP_U8_EDC_PHASE3_D_GAIN_ESC_S4 "" VALUE 0x8003A117 CalPrmWslcEng_UBYTE 0 Gain 0 255 SYMBOL_LINK "CalPrmWslcEng01.TP_U8_EDC_PHASE3_D_GAIN_ESC_S4" 0 /end CHARACTERISTIC
/begin CHARACTERISTIC TP_U8_EDC_PHASE3_P_GAIN_ESC_S1 "" VALUE 0x8003A118 CalPrmWslcEng_UBYTE 0 Gain 0 255 SYMBOL_LINK "CalPrmWslcEng01.TP_U8_EDC_PHASE3_P_GAIN_ESC_S1" 0 /end CHARACTERISTIC
/begin CHARACTERISTIC TP_U8_EDC_PHASE3_P_GAIN_ESC_S2 "" VALUE 0x8003A119 CalPrmWslcEng_UBYTE 0 Gain 0 255 SYMBOL_LINK "CalPrmWslcEng01.TP_U8_EDC_PHASE3_P_GAIN_ESC_S2" 0 /end CHARACTERISTIC
/begin CHARACTERISTIC TP_U8_EDC_PHASE3_P_GAIN_ESC_S3 "" VALUE 0x8003A11A CalPrmWslcEng_UBYTE 0 Gain 0 255 SYMBOL_LINK "CalPrmWslcEng01.TP_U8_EDC_PHASE3_P_GAIN_ESC_S3" 0 /end CHARACTERISTIC
/begin CHARACTERISTIC TP_U8_EDC_PHASE3_P_GAIN_ESC_S4 "" VALUE 0x8003A11B CalPrmWslcEng_UBYTE 0 Gain 0 255 SYMBOL_LINK "CalPrmWslcEng01.TP_U8_EDC_PHASE3_P_GAIN_ESC_S4" 0 /end CHARACTERISTIC
/begin CHARACTERISTIC TP_U8_EDC_PHASE4_D_GAIN_ESC_S1 "" VALUE 0x8003A11C CalPrmWslcEng_UBYTE 0 Gain 0 255 SYMBOL_LINK "CalPrmWslcEng01.TP_U8_EDC_PHASE4_D_GAIN_ESC_S1" 0 /end CHARACTERISTIC
/begin CHARACTERISTIC TP_U8_EDC_PHASE4_D_GAIN_ESC_S2 "" VALUE 0x8003A11D CalPrmWslcEng_UBYTE 0 Gain 0 255 SYMBOL_LINK "CalPrmWslcEng01.TP_U8_EDC_PHASE4_D_GAIN_ESC_S2" 0 /end CHARACTERISTIC
/begin CHARACTERISTIC TP_U8_EDC_PHASE4_D_GAIN_ESC_S3 "" VALUE 0x8003A11E CalPrmWslcEng_UBYTE 0 Gain 0 255 SYMBOL_LINK "CalPrmWslcEng01.TP_U8_EDC_PHASE4_D_GAIN_ESC_S3" 0 /end CHARACTERISTIC
/begin CHARACTERISTIC TP_U8_EDC_PHASE4_D_GAIN_ESC_S4 "" VALUE 0x8003A11F CalPrmWslcEng_UBYTE 0 Gain 0 255 SYMBOL_LINK "CalPrmWslcEng01.TP_U8_EDC_PHASE4_D_GAIN_ESC_S4" 0 /end CHARACTERISTIC
/begin CHARACTERISTIC TP_U8_EDC_PHASE4_P_GAIN_ESC_S1 "" VALUE 0x8003A120 CalPrmWslcEng_UBYTE 0 Gain 0 255 SYMBOL_LINK "CalPrmWslcEng01.TP_U8_EDC_PHASE4_P_GAIN_ESC_S1" 0 /end CHARACTERISTIC
/begin CHARACTERISTIC TP_U8_EDC_PHASE4_P_GAIN_ESC_S2 "" VALUE 0x8003A121 CalPrmWslcEng_UBYTE 0 Gain 0 255 SYMBOL_LINK "CalPrmWslcEng01.TP_U8_EDC_PHASE4_P_GAIN_ESC_S2" 0 /end CHARACTERISTIC
/begin CHARACTERISTIC TP_U8_EDC_PHASE4_P_GAIN_ESC_S3 "" VALUE 0x8003A122 CalPrmWslcEng_UBYTE 0 Gain 0 255 SYMBOL_LINK "CalPrmWslcEng01.TP_U8_EDC_PHASE4_P_GAIN_ESC_S3" 0 /end CHARACTERISTIC
/begin CHARACTERISTIC TP_U8_EDC_PHASE4_P_GAIN_ESC_S4 "" VALUE 0x8003A123 CalPrmWslcEng_UBYTE 0 Gain 0 255 SYMBOL_LINK "CalPrmWslcEng01.TP_U8_EDC_PHASE4_P_GAIN_ESC_S4" 0 /end CHARACTERISTIC
/begin CHARACTERISTIC TQTvbbUint8InhibitionFlag "" VALUE 0x80020D5A CalPrmLatDynsCoorrBrk_UBYTE 0 Gain 0 255 SYMBOL_LINK "CalPrmLatDynsCoorrBrk01.TQTvbbUint8InhibitionFlag" 0 /end CHARACTERISTIC
/begin CHARACTERISTIC U16DftCompDutyMotU1 "Target motot voltage for determine compensation motor duty when target motor voltage change in motor off  (1 point of 2 interpolation)" VALUE 0x8002149A CalPrmBrkTqCtrlrBrk_UWORD 0 U11 0 65.535 SYMBOL_LINK "CalPrmBrkTqCtrlrBrk01.U16DftCompDutyMotU1" 0 /end CHARACTERISTIC
/begin CHARACTERISTIC U16DftCompDutyMotU2 "Target motot voltage for determine compensation motor duty when target motor voltage change in motor off  (2 point of 2 interpolation)" VALUE 0x8002149C CalPrmBrkTqCtrlrBrk_UWORD 0 U11 0 65.535 SYMBOL_LINK "CalPrmBrkTqCtrlrBrk01.U16DftCompDutyMotU2" 0 /end CHARACTERISTIC
/begin CHARACTERISTIC U16TcVlvCurTestIniCur "Initial TC valve current when TC current test" VALUE 0x800214BC CalPrmBrkTqCtrlrBrk_UWORD 0 Amp2 0 65.535 SYMBOL_LINK "CalPrmBrkTqCtrlrBrk01.U16TcVlvCurTestIniCur" 0 /end CHARACTERISTIC
/begin CHARACTERISTIC U16TcVlvCurTestMotU "Motor target voltage when TC current test" VALUE 0x800214CA CalPrmBrkTqCtrlrBrk_UWORD 0 U11 0 65.535 SYMBOL_LINK "CalPrmBrkTqCtrlrBrk01.U16TcVlvCurTestMotU" 0 /end CHARACTERISTIC
/begin CHARACTERISTIC U16TcmfHldDumpMotUP1 "Target brake pressure for determine target motor voltage in TCMF hold/dump control (1 point of 3 interpolation)" VALUE 0x80021478 CalPrmBrkTqCtrlrBrk_UWORD 0 P32 0 655.35 SYMBOL_LINK "CalPrmBrkTqCtrlrBrk01.U16TcmfHldDumpMotUP1" 0 /end CHARACTERISTIC
/begin CHARACTERISTIC U16TcmfHldDumpMotUP2 "Target brake pressure for determine target motor voltage in TCMF hold/dump control (2 point of 3 interpolation)" VALUE 0x8002147A CalPrmBrkTqCtrlrBrk_UWORD 0 P32 0 655.35 SYMBOL_LINK "CalPrmBrkTqCtrlrBrk01.U16TcmfHldDumpMotUP2" 0 /end CHARACTERISTIC
/begin CHARACTERISTIC U16TcmfHldDumpMotUP3 "Target brake pressure for determine target motor voltage in TCMF hold/dump control (3 point of 3 interpolation)" VALUE 0x8002147C CalPrmBrkTqCtrlrBrk_UWORD 0 P32 0 655.35 SYMBOL_LINK "CalPrmBrkTqCtrlrBrk01.U16TcmfHldDumpMotUP3" 0 /end CHARACTERISTIC
/begin CHARACTERISTIC U16TcmfHldDumpPMotU1 "Target motot voltage in TCMF hold/dump control at target brake pressure 1point" VALUE 0x8002147E CalPrmBrkTqCtrlrBrk_UWORD 0 U11 0 65.535 SYMBOL_LINK "CalPrmBrkTqCtrlrBrk01.U16TcmfHldDumpPMotU1" 0 /end CHARACTERISTIC
/begin CHARACTERISTIC U16TcmfHldDumpPMotU2 "Target motot voltage in TCMF hold/dump control at target brake pressure 2point" VALUE 0x80021480 CalPrmBrkTqCtrlrBrk_UWORD 0 U11 0 65.535 SYMBOL_LINK "CalPrmBrkTqCtrlrBrk01.U16TcmfHldDumpPMotU2" 0 /end CHARACTERISTIC
/begin CHARACTERISTIC U16TcmfHldDumpPMotU3 "Target motot voltage in TCMF hold/dump control at target brake pressure 3point" VALUE 0x80021482 CalPrmBrkTqCtrlrBrk_UWORD 0 U11 0 65.535 SYMBOL_LINK "CalPrmBrkTqCtrlrBrk01.U16TcmfHldDumpPMotU3" 0 /end CHARACTERISTIC
/begin CHARACTERISTIC U16TcmfIniHldPeakCur "TC valve current max when AVH/HSA pattern control" VALUE 0x8002132E CalPrmBrkTqCtrlrBrk_UWORD 0 Amp2 0 65.535 SYMBOL_LINK "CalPrmBrkTqCtrlrBrk01.U16TcmfIniHldPeakCur" 0 /end CHARACTERISTIC
/begin CHARACTERISTIC U16TcmfIniHldStrtCur "Initial TC valve current when AVH/HSA pattern control" VALUE 0x8002132C CalPrmBrkTqCtrlrBrk_UWORD 0 Amp2 0 65.535 SYMBOL_LINK "CalPrmBrkTqCtrlrBrk01.U16TcmfIniHldStrtCur" 0 /end CHARACTERISTIC
/begin CHARACTERISTIC U16TireCircumferenceFrnt "Front tire circumference" VALUE 0x80020018 CalPrmCmnBrk_UWORD 0 Gain 0 65535 SYMBOL_LINK "CalPrmCmnBrk01.U16TireCircumferenceFrnt" 0 /end CHARACTERISTIC
/begin CHARACTERISTIC U16TireCircumferenceRe "Rear tire circumference" VALUE 0x8002001A CalPrmCmnBrk_UWORD 0 Gain 0 65535 SYMBOL_LINK "CalPrmCmnBrk01.U16TireCircumferenceRe" 0 /end CHARACTERISTIC
/begin CHARACTERISTIC U16TqToPGainFrnt "Front gain to convert brake torque to pressure (2 X friction coefficient of brake pad X caliper position area X effective radius X g)" VALUE 0x80020010 CalPrmCmnBrk_UWORD 0 Gain 0 65535 SYMBOL_LINK "CalPrmCmnBrk01.U16TqToPGainFrnt" 0 /end CHARACTERISTIC
/begin CHARACTERISTIC U16TqToPGainRe "Rear gain to convert brake torque to pressure (2 X friction coefficient of brake pad X caliper position area X effective radius X g)" VALUE 0x80020012 CalPrmCmnBrk_UWORD 0 Gain 0 65535 SYMBOL_LINK "CalPrmCmnBrk01.U16TqToPGainRe" 0 /end CHARACTERISTIC
/begin CHARACTERISTIC U16TrackWidthFrnt "Front track width" VALUE 0x80020014 CalPrmCmnBrk_UWORD 0 Gain 0 65535 SYMBOL_LINK "CalPrmCmnBrk01.U16TrackWidthFrnt" 0 /end CHARACTERISTIC
/begin CHARACTERISTIC U16TrackWidthRe "Rear track width" VALUE 0x80020016 CalPrmCmnBrk_UWORD 0 Gain 0 65535 SYMBOL_LINK "CalPrmCmnBrk01.U16TrackWidthRe" 0 /end CHARACTERISTIC
/begin CHARACTERISTIC U16WhlTiStampResl "Wheel distance pulse time stamp resolution" VALUE 0x8002001E CalPrmCmnBrk_UWORD 0 Gain 0 65535 SYMBOL_LINK "CalPrmCmnBrk01.U16WhlTiStampResl" 0 /end CHARACTERISTIC
/begin CHARACTERISTIC U16_VLC_DISK_TEMP_ERROR_RESET_THRES "VLC Common calibration of reset detection high disk temperature threshold." VALUE 0x8003A8AC CalPrmVehLgtCoorrEng_UWORD 0 Fac31 0 65535 SYMBOL_LINK "CalPrmVehLgtCoorrEng01.U16_VLC_DISK_TEMP_ERROR_RESET_THRES" 0 /end CHARACTERISTIC
/begin CHARACTERISTIC U16_VLC_DISK_TEMP_ERROR_SET_THRES "VLC Common calibration of set detection high disk temperature threshold." VALUE 0x8003A8AE CalPrmVehLgtCoorrEng_UWORD 0 Fac31 0 65535 SYMBOL_LINK "CalPrmVehLgtCoorrEng01.U16_VLC_DISK_TEMP_ERROR_SET_THRES" 0 /end CHARACTERISTIC
/begin CHARACTERISTIC U16_VLC_Gear_1 "VLC Common calibration of gear ratio D1" VALUE 0x8003A8B0 CalPrmVehLgtCoorrEng_UWORD 0 Fac31 0 65535 SYMBOL_LINK "CalPrmVehLgtCoorrEng01.U16_VLC_Gear_1" 0 /end CHARACTERISTIC
/begin CHARACTERISTIC U16_VLC_Gear_10 "VLC Common calibration of gear ratio D10" VALUE 0x8003A8C2 CalPrmVehLgtCoorrEng_UWORD 0 Fac31 0 65535 SYMBOL_LINK "CalPrmVehLgtCoorrEng01.U16_VLC_Gear_10" 0 /end CHARACTERISTIC
/begin CHARACTERISTIC U16_VLC_Gear_2 "VLC Common calibration of gear ratio D2" VALUE 0x8003A8B2 CalPrmVehLgtCoorrEng_UWORD 0 Fac31 0 65535 SYMBOL_LINK "CalPrmVehLgtCoorrEng01.U16_VLC_Gear_2" 0 /end CHARACTERISTIC
/begin CHARACTERISTIC U16_VLC_Gear_3 "VLC Common calibration of gear ratio D3" VALUE 0x8003A8B4 CalPrmVehLgtCoorrEng_UWORD 0 Fac31 0 65535 SYMBOL_LINK "CalPrmVehLgtCoorrEng01.U16_VLC_Gear_3" 0 /end CHARACTERISTIC
/begin CHARACTERISTIC U16_VLC_Gear_4 "VLC Common calibration of gear ratio D4" VALUE 0x8003A8B6 CalPrmVehLgtCoorrEng_UWORD 0 Fac31 0 65535 SYMBOL_LINK "CalPrmVehLgtCoorrEng01.U16_VLC_Gear_4" 0 /end CHARACTERISTIC
/begin CHARACTERISTIC U16_VLC_Gear_5 "VLC Common calibration of gear ratio D5" VALUE 0x8003A8B8 CalPrmVehLgtCoorrEng_UWORD 0 Fac31 0 65535 SYMBOL_LINK "CalPrmVehLgtCoorrEng01.U16_VLC_Gear_5" 0 /end CHARACTERISTIC
/begin CHARACTERISTIC U16_VLC_Gear_6 "VLC Common calibration of gear ratio D6" VALUE 0x8003A8BA CalPrmVehLgtCoorrEng_UWORD 0 Fac31 0 65535 SYMBOL_LINK "CalPrmVehLgtCoorrEng01.U16_VLC_Gear_6" 0 /end CHARACTERISTIC
/begin CHARACTERISTIC U16_VLC_Gear_7 "VLC Common calibration of gear ratio D7" VALUE 0x8003A8BC CalPrmVehLgtCoorrEng_UWORD 0 Fac31 0 65535 SYMBOL_LINK "CalPrmVehLgtCoorrEng01.U16_VLC_Gear_7" 0 /end CHARACTERISTIC
/begin CHARACTERISTIC U16_VLC_Gear_8 "VLC Common calibration of gear ratio D8" VALUE 0x8003A8BE CalPrmVehLgtCoorrEng_UWORD 0 Fac31 0 65535 SYMBOL_LINK "CalPrmVehLgtCoorrEng01.U16_VLC_Gear_8" 0 /end CHARACTERISTIC
/begin CHARACTERISTIC U16_VLC_Gear_9 "VLC Common calibration of gear ratio D9" VALUE 0x8003A8C0 CalPrmVehLgtCoorrEng_UWORD 0 Fac31 0 65535 SYMBOL_LINK "CalPrmVehLgtCoorrEng01.U16_VLC_Gear_9" 0 /end CHARACTERISTIC
/begin CHARACTERISTIC U16_VLC_Gear_R "VLC Common calibration of gear ratio R" VALUE 0x8003A8C4 CalPrmVehLgtCoorrEng_UWORD 0 Fac31 0 65535 SYMBOL_LINK "CalPrmVehLgtCoorrEng01.U16_VLC_Gear_R" 0 /end CHARACTERISTIC
/begin CHARACTERISTIC U8DftCompDecMotUDuty1 "Decrease motor duty at target motot voltage when target motor voltage change in motor off 1 point" VALUE 0x800214A0 CalPrmBrkTqCtrlrBrk_UBYTE 0 Perc2 0 127.5 SYMBOL_LINK "CalPrmBrkTqCtrlrBrk01.U8DftCompDecMotUDuty1" 0 /end CHARACTERISTIC
/begin CHARACTERISTIC U8DftCompDecMotUDuty2 "Decrease motor duty at target motot voltage when target motor voltage change in motor off 2 point" VALUE 0x800214A1 CalPrmBrkTqCtrlrBrk_UBYTE 0 Perc2 0 127.5 SYMBOL_LINK "CalPrmBrkTqCtrlrBrk01.U8DftCompDecMotUDuty2" 0 /end CHARACTERISTIC
/begin CHARACTERISTIC U8DftCompIncMotUDuty1 "Increase motor duty at target motot voltage when target motor voltage change in motor off 1 point" VALUE 0x8002149E CalPrmBrkTqCtrlrBrk_UBYTE 0 Perc2 0 127.5 SYMBOL_LINK "CalPrmBrkTqCtrlrBrk01.U8DftCompIncMotUDuty1" 0 /end CHARACTERISTIC
/begin CHARACTERISTIC U8DftCompIncMotUDuty2 "Increase motor duty at target motot voltage when target motor voltage change in motor off 2 point" VALUE 0x8002149F CalPrmBrkTqCtrlrBrk_UBYTE 0 Perc2 0 127.5 SYMBOL_LINK "CalPrmBrkTqCtrlrBrk01.U8DftCompIncMotUDuty2" 0 /end CHARACTERISTIC
/begin CHARACTERISTIC U8TcmfIniHldFirstTi "TC valve current rise time from U16TcmfIniHldStrtCur to U16TcmfIniHldPeakCur when AVH/HSA pattern control" VALUE 0x80021330 CalPrmBrkTqCtrlrBrk_UBYTE 0 Ti41 0 1.275 SYMBOL_LINK "CalPrmBrkTqCtrlrBrk01.U8TcmfIniHldFirstTi" 0 /end CHARACTERISTIC
/begin CHARACTERISTIC U8TcmfIniHldSecTi "TC valve current dump time from U16TcmfIniHldPeakCur to target TC valve current when AVH/HSA pattern control" VALUE 0x80021331 CalPrmBrkTqCtrlrBrk_UBYTE 0 Ti41 0 1.275 SYMBOL_LINK "CalPrmBrkTqCtrlrBrk01.U8TcmfIniHldSecTi" 0 /end CHARACTERISTIC
/begin CHARACTERISTIC U8TcmfIniRisePGrdtTiRe01 "TCMF initial rise time at rear target pressure gradient 1 point (U16TcmfIniRiseMotUPGrdtRe01)" VALUE 0x80021313 CalPrmBrkTqCtrlrBrk_UBYTE 0 Ti41 0 1.275 SYMBOL_LINK "CalPrmBrkTqCtrlrBrk01.U8TcmfIniRisePGrdtTiRe01" 0 /end CHARACTERISTIC
/begin CHARACTERISTIC U8TcmfIniRisePGrdtTiRe02 "TCMF initial rise time at rear target pressure gradient 2 point (U16TcmfIniRiseMotUPGrdtRe02)" VALUE 0x80021314 CalPrmBrkTqCtrlrBrk_UBYTE 0 Ti41 0 1.275 SYMBOL_LINK "CalPrmBrkTqCtrlrBrk01.U8TcmfIniRisePGrdtTiRe02" 0 /end CHARACTERISTIC
/begin CHARACTERISTIC U8TcmfIniRisePGrdtTiRe03 "TCMF initial rise time at rear target pressure gradient 3 point (U16TcmfIniRiseMotUPGrdtRe03)" VALUE 0x80021315 CalPrmBrkTqCtrlrBrk_UBYTE 0 Ti41 0 1.275 SYMBOL_LINK "CalPrmBrkTqCtrlrBrk01.U8TcmfIniRisePGrdtTiRe03" 0 /end CHARACTERISTIC
/begin CHARACTERISTIC U8TcmfIniRisePGrdtTiRe04 "TCMF initial rise time at rear target pressure gradient 4 point (U16TcmfIniRiseMotUPGrdtRe04)" VALUE 0x80021316 CalPrmBrkTqCtrlrBrk_UBYTE 0 Ti41 0 1.275 SYMBOL_LINK "CalPrmBrkTqCtrlrBrk01.U8TcmfIniRisePGrdtTiRe04" 0 /end CHARACTERISTIC
/begin CHARACTERISTIC U8TcmfIniRisePGrdtTiRe05 "TCMF initial rise time at rear target pressure gradient 5 point (U16TcmfIniRiseMotUPGrdtRe05)" VALUE 0x80021317 CalPrmBrkTqCtrlrBrk_UBYTE 0 Ti41 0 1.275 SYMBOL_LINK "CalPrmBrkTqCtrlrBrk01.U8TcmfIniRisePGrdtTiRe05" 0 /end CHARACTERISTIC
/begin CHARACTERISTIC U8TcmfIniRisePGrdtTiRe06 "TCMF initial rise time at rear target pressure gradient 6 point (U16TcmfIniRiseMotUPGrdtRe06)" VALUE 0x80021318 CalPrmBrkTqCtrlrBrk_UBYTE 0 Ti41 0 1.275 SYMBOL_LINK "CalPrmBrkTqCtrlrBrk01.U8TcmfIniRisePGrdtTiRe06" 0 /end CHARACTERISTIC
/begin CHARACTERISTIC U8TcmfIniRisePGrdtTiRe07 "TCMF initial rise time at rear target pressure gradient 7 point (U16TcmfIniRiseMotUPGrdtRe07)" VALUE 0x80021319 CalPrmBrkTqCtrlrBrk_UBYTE 0 Ti41 0 1.275 SYMBOL_LINK "CalPrmBrkTqCtrlrBrk01.U8TcmfIniRisePGrdtTiRe07" 0 /end CHARACTERISTIC
/begin CHARACTERISTIC U8TcmfIniRisePGrdtTiRe08 "TCMF initial rise time at rear target pressure gradient 8 point (U16TcmfIniRiseMotUPGrdtRe08)" VALUE 0x8002131A CalPrmBrkTqCtrlrBrk_UBYTE 0 Ti41 0 1.275 SYMBOL_LINK "CalPrmBrkTqCtrlrBrk01.U8TcmfIniRisePGrdtTiRe08" 0 /end CHARACTERISTIC
/begin CHARACTERISTIC U8TcmfIniRisePGrdtTiRe09 "TCMF initial rise time at rear target pressure gradient 9 point (U16TcmfIniRiseMotUPGrdtRe09)" VALUE 0x8002131B CalPrmBrkTqCtrlrBrk_UBYTE 0 Ti41 0 1.275 SYMBOL_LINK "CalPrmBrkTqCtrlrBrk01.U8TcmfIniRisePGrdtTiRe09" 0 /end CHARACTERISTIC
/begin CHARACTERISTIC U8TcmfIniRisePGrdtTiRe10 "TCMF initial rise time at rear target pressure gradient 10 point (U16TcmfIniRiseMotUPGrdtRe10)" VALUE 0x8002131C CalPrmBrkTqCtrlrBrk_UBYTE 0 Ti41 0 1.275 SYMBOL_LINK "CalPrmBrkTqCtrlrBrk01.U8TcmfIniRisePGrdtTiRe10" 0 /end CHARACTERISTIC
/begin CHARACTERISTIC U8TcmfIniRisePGrdtTiRe11 "TCMF initial rise time at rear target pressure gradient 11 point (U16TcmfIniRiseMotUPGrdtRe11)" VALUE 0x8002131D CalPrmBrkTqCtrlrBrk_UBYTE 0 Ti41 0 1.275 SYMBOL_LINK "CalPrmBrkTqCtrlrBrk01.U8TcmfIniRisePGrdtTiRe11" 0 /end CHARACTERISTIC
/begin CHARACTERISTIC U8TcmfIniRisePGrdtTiRe12 "TCMF initial rise time at rear target pressure gradient 12 point (U16TcmfIniRiseMotUPGrdtRe12)" VALUE 0x8002131E CalPrmBrkTqCtrlrBrk_UBYTE 0 Ti41 0 1.275 SYMBOL_LINK "CalPrmBrkTqCtrlrBrk01.U8TcmfIniRisePGrdtTiRe12" 0 /end CHARACTERISTIC
/begin CHARACTERISTIC U8TcmfIniRisePGrdtTiRe13 "TCMF initial rise time at rear target pressure gradient 13 point (U16TcmfIniRiseMotUPGrdtRe13)" VALUE 0x8002131F CalPrmBrkTqCtrlrBrk_UBYTE 0 Ti41 0 1.275 SYMBOL_LINK "CalPrmBrkTqCtrlrBrk01.U8TcmfIniRisePGrdtTiRe13" 0 /end CHARACTERISTIC
/begin CHARACTERISTIC U8TcmfIniRisePGrdtTiRe14 "TCMF initial rise time at rear target pressure gradient 14 point (U16TcmfIniRiseMotUPGrdtRe14)" VALUE 0x80021320 CalPrmBrkTqCtrlrBrk_UBYTE 0 Ti41 0 1.275 SYMBOL_LINK "CalPrmBrkTqCtrlrBrk01.U8TcmfIniRisePGrdtTiRe14" 0 /end CHARACTERISTIC
/begin CHARACTERISTIC U8WhlTeethFrnt "Front wheel teeth number" VALUE 0x8002001C CalPrmCmnBrk_UBYTE 0 Gain 0 255 SYMBOL_LINK "CalPrmCmnBrk01.U8WhlTeethFrnt" 0 /end CHARACTERISTIC
/begin CHARACTERISTIC U8WhlTeethRe "Rear wheel teeth number" VALUE 0x8002001D CalPrmCmnBrk_UBYTE 0 Gain 0 255 SYMBOL_LINK "CalPrmCmnBrk01.U8WhlTeethRe" 0 /end CHARACTERISTIC
/begin CHARACTERISTIC U8_VLC_BRKLAMPOFF_PRESS "VLC Common calibration of brake light off threshold" VALUE 0x8003A8C8 CalPrmVehLgtCoorrEng_UBYTE 0 P34 0 25.5 SYMBOL_LINK "CalPrmVehLgtCoorrEng01.U8_VLC_BRKLAMPOFF_PRESS" 0 /end CHARACTERISTIC
/begin CHARACTERISTIC U8_VLC_BRKLAMPON_PRESS "VLC Common calibration of brake light on threshold" VALUE 0x8003A8C9 CalPrmVehLgtCoorrEng_UBYTE 0 P34 0 25.5 SYMBOL_LINK "CalPrmVehLgtCoorrEng01.U8_VLC_BRKLAMPON_PRESS" 0 /end CHARACTERISTIC
/begin CHARACTERISTIC U8_VLC_MASS "VLC Common calibration of vehicle mass" VALUE 0x8003A8C6 CalPrmVehLgtCoorrEng_UBYTE 0 Fac31 0 255 SYMBOL_LINK "CalPrmVehLgtCoorrEng01.U8_VLC_MASS" 0 /end CHARACTERISTIC
/begin CHARACTERISTIC U8_VLC_SLOPE_MAX_THD "VLC Common calibration of maximum hill road detection threshold." VALUE 0x8003A8CA CalPrmVehLgtCoorrEng_UBYTE 0 A41 0 0.255 SYMBOL_LINK "CalPrmVehLgtCoorrEng01.U8_VLC_SLOPE_MAX_THD" 0 /end CHARACTERISTIC
/begin CHARACTERISTIC U8_VLC_SLOPE_THD "VLC Common calibration of minimum hill road detection threshold." VALUE 0x8003A8CB CalPrmVehLgtCoorrEng_UBYTE 0 A41 0 0.255 SYMBOL_LINK "CalPrmVehLgtCoorrEng01.U8_VLC_SLOPE_THD" 0 /end CHARACTERISTIC
/begin CHARACTERISTIC U8_VLC_TIRE_R "VLC Common calibration of tire radius" VALUE 0x8003A8C7 CalPrmVehLgtCoorrEng_UBYTE 0 Fac31 0 255 SYMBOL_LINK "CalPrmVehLgtCoorrEng01.U8_VLC_TIRE_R" 0 /end CHARACTERISTIC
/begin COMPU_METHOD A41 "" LINEAR "%.15" "g" COEFFS_LINEAR 0.001 0 /end COMPU_METHOD
/begin COMPU_METHOD A42 "" LINEAR "%.15" "g" COEFFS_LINEAR 0.01 0 /end COMPU_METHOD
/begin COMPU_METHOD A48 "" LINEAR "%.15" "g" COEFFS_LINEAR 0.0001 0 /end COMPU_METHOD
/begin COMPU_METHOD AgSpd31 "" LINEAR "%.15" "DegPerSec" COEFFS_LINEAR 0.01 0 /end COMPU_METHOD
/begin COMPU_METHOD Amp2 "" LINEAR "%.15" "A" COEFFS_LINEAR 0.001 0 /end COMPU_METHOD
/begin COMPU_METHOD BrkCalVariantCriterion.Selector.Conversion "" TAB_VERB "%.0" "" COMPU_TAB_REF BrkCalVariantCriterion.Selector.Conversion /end COMPU_METHOD
/begin COMPU_METHOD EngCalVariantCriterion.Selector.Conversion "" TAB_VERB "%.0" "" COMPU_TAB_REF EngCalVariantCriterion.Selector.Conversion /end COMPU_METHOD
/begin COMPU_METHOD Fac31 "" LINEAR "%.15" "NA" COEFFS_LINEAR 1 0 /end COMPU_METHOD
/begin COMPU_METHOD Fac91 "" LINEAR "%.15" "NA" COEFFS_LINEAR 0.1 0 /end COMPU_METHOD
/begin COMPU_METHOD Gain "" LINEAR "%.15" "NA" COEFFS_LINEAR 1 0 /end COMPU_METHOD
/begin COMPU_METHOD InvldVld2 "" LINEAR "%.15" "NA" COEFFS_LINEAR 1 0 STATUS_STRING_REF VldTable /end COMPU_METHOD
/begin COMPU_METHOD IsgSts1 "" LINEAR "%.15" "NA" COEFFS_LINEAR 1 0 STATUS_STRING_REF IsgTable /end COMPU_METHOD
/begin COMPU_METHOD LampReq1 "" LINEAR "%.15" "NA" COEFFS_LINEAR 1 0 STATUS_STRING_REF LampTable /end COMPU_METHOD
/begin COMPU_METHOD Len41 "" LINEAR "%.15" "m" COEFFS_LINEAR 0.0001 0 /end COMPU_METHOD
/begin COMPU_METHOD Len51 "" LINEAR "%.15" "m" COEFFS_LINEAR 0.001 0 /end COMPU_METHOD
/begin COMPU_METHOD Len71 "" LINEAR "%.15" "m" COEFFS_LINEAR 1E-05 0 /end COMPU_METHOD
/begin COMPU_METHOD M1 "" LINEAR "%.15" "kg" COEFFS_LINEAR 1 0 /end COMPU_METHOD
/begin COMPU_METHOD MiniTireDetnSt1 "" LINEAR "%.15" "NA" COEFFS_LINEAR 1 0 STATUS_STRING_REF InstTable /end COMPU_METHOD
/begin COMPU_METHOD MotModNotWslc "" LINEAR "%.15" "NA" COEFFS_LINEAR 1 0 STATUS_STRING_REF MotModNotWslcTable /end COMPU_METHOD
/begin COMPU_METHOD MotModWslc "" LINEAR "%.15" "NA" COEFFS_LINEAR 1 0 STATUS_STRING_REF MotModWslcTable /end COMPU_METHOD
/begin COMPU_METHOD MotTqCurCoeff1 "" LINEAR "%.15" "NmPerA" COEFFS_LINEAR 0.001 0 /end COMPU_METHOD
/begin COMPU_METHOD MotVolRpmCoeff1 "" LINEAR "%.15" "VPerRPM" COEFFS_LINEAR 0.0001 0 /end COMPU_METHOD
/begin COMPU_METHOD MsgReq1 "" LINEAR "%.15" "NA" COEFFS_LINEAR 1 0 STATUS_STRING_REF MsgTable /end COMPU_METHOD
/begin COMPU_METHOD N10 "" LINEAR "%.15" "RPM" COEFFS_LINEAR 1 0 /end COMPU_METHOD
/begin COMPU_METHOD N13 "" LINEAR "%.15" "RPM" COEFFS_LINEAR 100 0 /end COMPU_METHOD
/begin COMPU_METHOD NcVlvMod "" LINEAR "%.15" "NA" COEFFS_LINEAR 1 0 STATUS_STRING_REF NcVlvModTable /end COMPU_METHOD
/begin COMPU_METHOD No1VlvMod "" LINEAR "%.15" "NA" COEFFS_LINEAR 1 0 STATUS_STRING_REF No1VlvModTable /end COMPU_METHOD
/begin COMPU_METHOD OnOff1 "" LINEAR "%.15" "NA" COEFFS_LINEAR 1 0 STATUS_STRING_REF OnOffTable /end COMPU_METHOD
/begin COMPU_METHOD P32 "" LINEAR "%.15" "bar" COEFFS_LINEAR 0.01 0 /end COMPU_METHOD
/begin COMPU_METHOD P34 "" LINEAR "%.15" "bar" COEFFS_LINEAR 0.1 0 /end COMPU_METHOD
/begin COMPU_METHOD Perc2 "" LINEAR "%.15" "Percentage" COEFFS_LINEAR 0.5 0 /end COMPU_METHOD
/begin COMPU_METHOD Perc3 "" LINEAR "%.15" "Percentage" COEFFS_LINEAR 10 0 /end COMPU_METHOD
/begin COMPU_METHOD Perc6 "" LINEAR "%.15" "Percentage" COEFFS_LINEAR 1 0 /end COMPU_METHOD
/begin COMPU_METHOD Perc9 "" LINEAR "%.15" "Percentage" COEFFS_LINEAR 0.1 0 /end COMPU_METHOD
/begin COMPU_METHOD Spd12 "" LINEAR "%.15" "kph" COEFFS_LINEAR 0.125 0 /end COMPU_METHOD
/begin COMPU_METHOD Spd41 "" LINEAR "%.15" "kph" COEFFS_LINEAR 1 0 /end COMPU_METHOD
/begin COMPU_METHOD Ti21 "" LINEAR "%.15" "sec" COEFFS_LINEAR 0.01 0 /end COMPU_METHOD
/begin COMPU_METHOD Ti41 "" LINEAR "%.15" "sec" COEFFS_LINEAR 0.005 0 /end COMPU_METHOD
/begin COMPU_METHOD Ti51 "" LINEAR "%.15" "sec" COEFFS_LINEAR 0.02 0 /end COMPU_METHOD
/begin COMPU_METHOD Tq2 "" LINEAR "%.15" "Nm" COEFFS_LINEAR 1 0 /end COMPU_METHOD
/begin COMPU_METHOD Tq31 "" LINEAR "%.15" "Nm" COEFFS_LINEAR 10 0 /end COMPU_METHOD
/begin COMPU_METHOD Tq51 "" LINEAR "%.15" "Nm" COEFFS_LINEAR 0.1 0 /end COMPU_METHOD
/begin COMPU_METHOD U11 "" LINEAR "%.15" "V" COEFFS_LINEAR 0.001 0 /end COMPU_METHOD
/begin COMPU_VTAB BrkCalVariantCriterion.Selector.Conversion "" TAB_VERB 8 1 "BrkCalVrntCtaDft01" 2 "BrkCalVrntCtaDft02" 3 "BrkCalVrntCtaDft03" 4 "BrkCalVrntCtaDft04" 5 "BrkCalVrntCtaDft05" 6 "BrkCalVrntCtaDft06" 7 "BrkCalVrntCtaDft07" 8 "BrkCalVrntCtaDft08" /end COMPU_VTAB
/begin COMPU_VTAB EngCalVariantCriterion.Selector.Conversion "" TAB_VERB 24 1 "EngCalVrntCtaDft01" 2 "EngCalVrntCtaDft02" 3 "EngCalVrntCtaDft03" 4 "EngCalVrntCtaDft04" 5 "EngCalVrntCtaDft05" 6 "EngCalVrntCtaDft06" 7 "EngCalVrntCtaDft07" 8 "EngCalVrntCtaDft08" 9 "EngCalVrntCtaDft09" 10 "EngCalVrntCtaDft10" 11 "EngCalVrntCtaDft11" 12 "EngCalVrntCtaDft12" 13 "EngCalVrntCtaDft13" 14 "EngCalVrntCtaDft14" 15 "EngCalVrntCtaDft15" 16 "EngCalVrntCtaDft16" 17 "EngCalVrntCtaDft17" 18 "EngCalVrntCtaDft18" 19 "EngCalVrntCtaDft19" 20 "EngCalVrntCtaDft20" 21 "EngCalVrntCtaDft21" 22 "EngCalVrntCtaDft22" 23 "EngCalVrntCtaDft23" 24 "EngCalVrntCtaDft24" /end COMPU_VTAB
/begin COMPU_VTAB InstTable "" TAB_VERB 3 0 "Unknown" 1 "Uninstall" 2 "Install" DEFAULT_VALUE "" /end COMPU_VTAB
/begin COMPU_VTAB IsgTable "" TAB_VERB 8 0 "IsgNoActv" 1 "IsgActv" 2 "AutStrtByEcu" 3 "IsgProhb" 4 "FltInIsg" 5 "IsgInhbBySys" 6 "IsgDeactvt" 7 "NoBrkForIsg" DEFAULT_VALUE "" /end COMPU_VTAB
/begin COMPU_VTAB LampTable "" TAB_VERB 7 0 "Off" 1 "YellowOn" 2 "GreenOn" 3 "WhiteOn" 4 "YellowBlinking" 5 "GreenBlinking" 6 "WhiteBlinking" DEFAULT_VALUE "" /end COMPU_VTAB
/begin COMPU_VTAB MotModNotWslcTable "" TAB_VERB 6 0 "Not control" 1 "TCMF initial rise control" 2 "TCMF rise control" 3 "TCMF rise pattern control" 4 "TCMF hold or dump control" 5 "Not TCMF control" DEFAULT_VALUE "" /end COMPU_VTAB
/begin COMPU_VTAB MotModWslcTable "" TAB_VERB 5 0 "Not control" 1 "ABS initial control" 2 "ABS control initial finished" 3 "ABS control finished" 4 "Not ABS control finished (EBD or CBC or SLS)" DEFAULT_VALUE "" /end COMPU_VTAB
/begin COMPU_VTAB MsgTable "" TAB_VERB 6 0 "None" 1 "ReadyToRlease" 2 "CloseBltDoorHoodTr" 3 "AutomaticallyEpbClamped" 4 "PressBrk" 5 "CloseDoorHoodTr" DEFAULT_VALUE "" /end COMPU_VTAB
/begin COMPU_VTAB NcVlvModTable "" TAB_VERB 4 0 "Not control" 1 "TCMF control" 2 "On-Off control" 3 "WSLC control" DEFAULT_VALUE "" /end COMPU_VTAB
/begin COMPU_VTAB No1VlvModTable "" TAB_VERB 7 0 "Not control" 1 "TCMF control" 2 "LFC rise control" 3 "Pulse-up rise control" 4 "Hold or Dump control" 5 "WSLC only control" 6 "WSLC with ESC combination control" DEFAULT_VALUE "" /end COMPU_VTAB
/begin COMPU_VTAB OnOff1 "" TAB_VERB 2 0 "off" 1 "on" DEFAULT_VALUE "" /end COMPU_VTAB
/begin COMPU_VTAB OnOffTable "" TAB_VERB 2 0 "Off" 1 "On" DEFAULT_VALUE "" /end COMPU_VTAB
/begin COMPU_VTAB VldTable "" TAB_VERB 2 0 "Valid" 1 "InValid" DEFAULT_VALUE "" /end COMPU_VTAB
/begin RECORD_LAYOUT CalPrmAwdCtrlrEng_SWORD FNC_VALUES 1 SWORD COLUMN_DIR DIRECT ALIGNMENT_BYTE 1 ALIGNMENT_WORD 1 ALIGNMENT_LONG 1 ALIGNMENT_FLOAT32_IEEE 1 ALIGNMENT_FLOAT64_IEEE 1 ALIGNMENT_INT64 1 /end RECORD_LAYOUT
/begin RECORD_LAYOUT CalPrmBrkTqCtrlrBrk_UBYTE FNC_VALUES 1 UBYTE COLUMN_DIR DIRECT ALIGNMENT_BYTE 1 ALIGNMENT_WORD 1 ALIGNMENT_LONG 1 ALIGNMENT_FLOAT32_IEEE 1 ALIGNMENT_FLOAT64_IEEE 1 ALIGNMENT_INT64 1 /end RECORD_LAYOUT
/begin RECORD_LAYOUT CalPrmBrkTqCtrlrBrk_UWORD FNC_VALUES 1 UWORD COLUMN_DIR DIRECT ALIGNMENT_BYTE 1 ALIGNMENT_WORD 1 ALIGNMENT_LONG 1 ALIGNMENT_FLOAT32_IEEE 1 ALIGNMENT_FLOAT64_IEEE 1 ALIGNMENT_INT64 1 /end RECORD_LAYOUT
/begin RECORD_LAYOUT CalPrmCmnBrk_UBYTE FNC_VALUES 1 UBYTE COLUMN_DIR DIRECT ALIGNMENT_BYTE 1 ALIGNMENT_WORD 1 ALIGNMENT_LONG 1 ALIGNMENT_FLOAT32_IEEE 1 ALIGNMENT_FLOAT64_IEEE 1 ALIGNMENT_INT64 1 /end RECORD_LAYOUT
/begin RECORD_LAYOUT CalPrmCmnBrk_UWORD FNC_VALUES 1 UWORD COLUMN_DIR DIRECT ALIGNMENT_BYTE 1 ALIGNMENT_WORD 1 ALIGNMENT_LONG 1 ALIGNMENT_FLOAT32_IEEE 1 ALIGNMENT_FLOAT64_IEEE 1 ALIGNMENT_INT64 1 /end RECORD_LAYOUT
/begin RECORD_LAYOUT CalPrmCmnEng_SWORD FNC_VALUES 1 SWORD COLUMN_DIR DIRECT ALIGNMENT_BYTE 1 ALIGNMENT_WORD 1 ALIGNMENT_LONG 1 ALIGNMENT_FLOAT32_IEEE 1 ALIGNMENT_FLOAT64_IEEE 1 ALIGNMENT_INT64 1 /end RECORD_LAYOUT
/begin RECORD_LAYOUT CalPrmCmnEng_UBYTE FNC_VALUES 1 UBYTE COLUMN_DIR DIRECT ALIGNMENT_BYTE 1 ALIGNMENT_WORD 1 ALIGNMENT_LONG 1 ALIGNMENT_FLOAT32_IEEE 1 ALIGNMENT_FLOAT64_IEEE 1 ALIGNMENT_INT64 1 /end RECORD_LAYOUT
/begin RECORD_LAYOUT CalPrmLatDynsCoorrBrk_UBYTE FNC_VALUES 1 UBYTE COLUMN_DIR DIRECT ALIGNMENT_BYTE 1 ALIGNMENT_WORD 1 ALIGNMENT_LONG 1 ALIGNMENT_FLOAT32_IEEE 1 ALIGNMENT_FLOAT64_IEEE 1 ALIGNMENT_INT64 1 /end RECORD_LAYOUT
/begin RECORD_LAYOUT CalPrmSsmBrk_SWORD FNC_VALUES 1 SWORD COLUMN_DIR DIRECT ALIGNMENT_BYTE 1 ALIGNMENT_WORD 1 ALIGNMENT_LONG 1 ALIGNMENT_FLOAT32_IEEE 1 ALIGNMENT_FLOAT64_IEEE 1 ALIGNMENT_INT64 1 /end RECORD_LAYOUT
/begin RECORD_LAYOUT CalPrmSsmBrk_UBYTE FNC_VALUES 1 UBYTE COLUMN_DIR DIRECT ALIGNMENT_BYTE 1 ALIGNMENT_WORD 1 ALIGNMENT_LONG 1 ALIGNMENT_FLOAT32_IEEE 1 ALIGNMENT_FLOAT64_IEEE 1 ALIGNMENT_INT64 1 /end RECORD_LAYOUT
/begin RECORD_LAYOUT CalPrmSsmBrk_UWORD FNC_VALUES 1 UWORD COLUMN_DIR DIRECT ALIGNMENT_BYTE 1 ALIGNMENT_WORD 1 ALIGNMENT_LONG 1 ALIGNMENT_FLOAT32_IEEE 1 ALIGNMENT_FLOAT64_IEEE 1 ALIGNMENT_INT64 1 /end RECORD_LAYOUT
/begin RECORD_LAYOUT CalPrmVehLgtCoorrEng_SWORD FNC_VALUES 1 SWORD COLUMN_DIR DIRECT ALIGNMENT_BYTE 1 ALIGNMENT_WORD 1 ALIGNMENT_LONG 1 ALIGNMENT_FLOAT32_IEEE 1 ALIGNMENT_FLOAT64_IEEE 1 ALIGNMENT_INT64 1 /end RECORD_LAYOUT
/begin RECORD_LAYOUT CalPrmVehLgtCoorrEng_UBYTE FNC_VALUES 1 UBYTE COLUMN_DIR DIRECT ALIGNMENT_BYTE 1 ALIGNMENT_WORD 1 ALIGNMENT_LONG 1 ALIGNMENT_FLOAT32_IEEE 1 ALIGNMENT_FLOAT64_IEEE 1 ALIGNMENT_INT64 1 /end RECORD_LAYOUT
/begin RECORD_LAYOUT CalPrmVehLgtCoorrEng_UWORD FNC_VALUES 1 UWORD COLUMN_DIR DIRECT ALIGNMENT_BYTE 1 ALIGNMENT_WORD 1 ALIGNMENT_LONG 1 ALIGNMENT_FLOAT32_IEEE 1 ALIGNMENT_FLOAT64_IEEE 1 ALIGNMENT_INT64 1 /end RECORD_LAYOUT
/begin RECORD_LAYOUT CalPrmWslcEng_SBYTE FNC_VALUES 1 SBYTE COLUMN_DIR DIRECT ALIGNMENT_BYTE 1 ALIGNMENT_WORD 1 ALIGNMENT_LONG 1 ALIGNMENT_FLOAT32_IEEE 1 ALIGNMENT_FLOAT64_IEEE 1 ALIGNMENT_INT64 1 /end RECORD_LAYOUT
/begin RECORD_LAYOUT CalPrmWslcEng_SWORD FNC_VALUES 1 SWORD COLUMN_DIR DIRECT ALIGNMENT_BYTE 1 ALIGNMENT_WORD 1 ALIGNMENT_LONG 1 ALIGNMENT_FLOAT32_IEEE 1 ALIGNMENT_FLOAT64_IEEE 1 ALIGNMENT_INT64 1 /end RECORD_LAYOUT
/begin RECORD_LAYOUT CalPrmWslcEng_UBYTE FNC_VALUES 1 UBYTE COLUMN_DIR DIRECT ALIGNMENT_BYTE 1 ALIGNMENT_WORD 1 ALIGNMENT_LONG 1 ALIGNMENT_FLOAT32_IEEE 1 ALIGNMENT_FLOAT64_IEEE 1 ALIGNMENT_INT64 1 /end RECORD_LAYOUT
/begin RECORD_LAYOUT CalPrmWspcEng_SBYTE FNC_VALUES 1 SBYTE COLUMN_DIR DIRECT ALIGNMENT_BYTE 1 ALIGNMENT_WORD 1 ALIGNMENT_LONG 1 ALIGNMENT_FLOAT32_IEEE 1 ALIGNMENT_FLOAT64_IEEE 1 ALIGNMENT_INT64 1 /end RECORD_LAYOUT
/begin RECORD_LAYOUT CalPrmWspcEng_SWORD FNC_VALUES 1 SWORD COLUMN_DIR DIRECT ALIGNMENT_BYTE 1 ALIGNMENT_WORD 1 ALIGNMENT_LONG 1 ALIGNMENT_FLOAT32_IEEE 1 ALIGNMENT_FLOAT64_IEEE 1 ALIGNMENT_INT64 1 /end RECORD_LAYOUT
/begin RECORD_LAYOUT CalPrmWspcEng_UBYTE FNC_VALUES 1 UBYTE COLUMN_DIR DIRECT ALIGNMENT_BYTE 1 ALIGNMENT_WORD 1 ALIGNMENT_LONG 1 ALIGNMENT_FLOAT32_IEEE 1 ALIGNMENT_FLOAT64_IEEE 1 ALIGNMENT_INT64 1 /end RECORD_LAYOUT
/begin RECORD_LAYOUT CalPrmWspcEng_UWORD FNC_VALUES 1 UWORD COLUMN_DIR DIRECT ALIGNMENT_BYTE 1 ALIGNMENT_WORD 1 ALIGNMENT_LONG 1 ALIGNMENT_FLOAT32_IEEE 1 ALIGNMENT_FLOAT64_IEEE 1 ALIGNMENT_INT64 1 /end RECORD_LAYOUT
/begin RECORD_LAYOUT CalVrntCta_UBYTE FNC_VALUES 1 UBYTE COLUMN_DIR DIRECT ALIGNMENT_BYTE 1 ALIGNMENT_WORD 1 ALIGNMENT_LONG 1 ALIGNMENT_FLOAT32_IEEE 1 ALIGNMENT_FLOAT64_IEEE 1 ALIGNMENT_INT64 1 /end RECORD_LAYOUT
/begin GROUP C.TOD_TorqueMap ""
 /begin REF_CHARACTERISTIC TP_S16_TOD_TORQ_CST_OVER1 TP_S16_TOD_TORQ_CST_OVER2 TP_S16_TOD_TORQ_CST_STABL TP_S16_TOD_TORQ_CST_UNDER1 TP_S16_TOD_TORQ_CST_UNDER2 TP_S16_TOD_TORQ_HOT_OVER1 TP_S16_TOD_TORQ_HOT_OVER2 TP_S16_TOD_TORQ_HOT_STABL TP_S16_TOD_TORQ_HOT_UNDER1 TP_S16_TOD_TORQ_HOT_UNDER2 TP_S16_TOD_TORQ_WOT_OVER1 TP_S16_TOD_TORQ_WOT_OVER2 TP_S16_TOD_TORQ_WOT_STABL TP_S16_TOD_TORQ_WOT_UNDER1 TP_S16_TOD_TORQ_WOT_UNDER2 /end REF_CHARACTERISTIC
/end GROUP
/begin GROUP C.TVBB_Control "" /begin REF_CHARACTERISTIC TQTvbbUint8InhibitionFlag /end REF_CHARACTERISTIC /begin SUB_GROUP b.TVBB_Enter_Exit c.TVBB_Tar_Tq /end SUB_GROUP /end GROUP
/begin GROUP C.TarMotUChgMotOff ""
 /begin REF_CHARACTERISTIC U16DftCompDutyMotU1 U16DftCompDutyMotU2 U8DftCompDecMotUDuty1 U8DftCompDecMotUDuty2 U8DftCompIncMotUDuty1 U8DftCompIncMotUDuty2 /end REF_CHARACTERISTIC
/end GROUP
/begin GROUP C.TcVlvCurTest "" /begin REF_CHARACTERISTIC U16TcVlvCurTestIniCur U16TcVlvCurTestMotU /end REF_CHARACTERISTIC /begin SUB_GROUP A.TcVlvCurUpDwnTest B.TcVlvCurReleafTest /end SUB_GROUP /end GROUP
/begin GROUP C.TcmfHldDumpMotU ""
 /begin REF_CHARACTERISTIC U16TcmfHldDumpMotUP1 U16TcmfHldDumpMotUP2 U16TcmfHldDumpMotUP3 U16TcmfHldDumpPMotU1 U16TcmfHldDumpPMotU2 U16TcmfHldDumpPMotU3 /end REF_CHARACTERISTIC
/end GROUP
/begin GROUP C.TcmfIniHld ""
 /begin REF_CHARACTERISTIC U16TcmfIniHldPeakCur U16TcmfIniHldStrtCur U8TcmfIniHldFirstTi U8TcmfIniHldSecTi /end REF_CHARACTERISTIC
/end GROUP
/begin GROUP C.TcmfIniRiseTiRe ""
 /begin REF_CHARACTERISTIC U8TcmfIniRisePGrdtTiRe01 U8TcmfIniRisePGrdtTiRe02 U8TcmfIniRisePGrdtTiRe03 U8TcmfIniRisePGrdtTiRe04 U8TcmfIniRisePGrdtTiRe05 U8TcmfIniRisePGrdtTiRe06 U8TcmfIniRisePGrdtTiRe07 U8TcmfIniRisePGrdtTiRe08 U8TcmfIniRisePGrdtTiRe09 U8TcmfIniRisePGrdtTiRe10 U8TcmfIniRisePGrdtTiRe11 U8TcmfIniRisePGrdtTiRe12 U8TcmfIniRisePGrdtTiRe13 U8TcmfIniRisePGrdtTiRe14 /end REF_CHARACTERISTIC
/end GROUP
/begin GROUP C_EDC_ENG_STATUS_DETECTION ""
 /begin REF_CHARACTERISTIC TP_S16_AT_Eng_Status_Threshold TP_S8_MT_Eng_Status_Threshold /end REF_CHARACTERISTIC
/end GROUP
/begin GROUP C_EDC_ESC_Entry ""
 /begin REF_CHARACTERISTIC TP_S8_EDC_ENTRY_THR0_ESC_S1 TP_S8_EDC_ENTRY_THR0_ESC_S2 TP_S8_EDC_ENTRY_THR0_ESC_S3 TP_S8_EDC_ENTRY_THR0_ESC_S4 TP_S8_EDC_ENTRY_THR1_ESC_S1 TP_S8_EDC_ENTRY_THR1_ESC_S2 TP_S8_EDC_ENTRY_THR1_ESC_S3 TP_S8_EDC_ENTRY_THR1_ESC_S4 TP_S8_EDC_ENTRY_THR2_ESC_S1 TP_S8_EDC_ENTRY_THR2_ESC_S2 TP_S8_EDC_ENTRY_THR2_ESC_S3 TP_S8_EDC_ENTRY_THR2_ESC_S4 /end REF_CHARACTERISTIC
/end GROUP
/begin GROUP C_EDC_ESC_PD_GAIN ""
 /begin REF_CHARACTERISTIC TP_U8_EDC_PHASE1_D_GAIN_ESC_S1 TP_U8_EDC_PHASE1_D_GAIN_ESC_S2 TP_U8_EDC_PHASE1_D_GAIN_ESC_S3 TP_U8_EDC_PHASE1_D_GAIN_ESC_S4 TP_U8_EDC_PHASE1_P_GAIN_ESC_S1 TP_U8_EDC_PHASE1_P_GAIN_ESC_S2 TP_U8_EDC_PHASE1_P_GAIN_ESC_S3 TP_U8_EDC_PHASE1_P_GAIN_ESC_S4 TP_U8_EDC_PHASE2_D_GAIN_ESC_S1 TP_U8_EDC_PHASE2_D_GAIN_ESC_S2 TP_U8_EDC_PHASE2_D_GAIN_ESC_S3 TP_U8_EDC_PHASE2_D_GAIN_ESC_S4 TP_U8_EDC_PHASE2_P_GAIN_ESC_S1 TP_U8_EDC_PHASE2_P_GAIN_ESC_S2 TP_U8_EDC_PHASE2_P_GAIN_ESC_S3 TP_U8_EDC_PHASE2_P_GAIN_ESC_S4 TP_U8_EDC_PHASE3_D_GAIN_ESC_S1 TP_U8_EDC_PHASE3_D_GAIN_ESC_S2 TP_U8_EDC_PHASE3_D_GAIN_ESC_S3 TP_U8_EDC_PHASE3_D_GAIN_ESC_S4 TP_U8_EDC_PHASE3_P_GAIN_ESC_S1 TP_U8_EDC_PHASE3_P_GAIN_ESC_S2 TP_U8_EDC_PHASE3_P_GAIN_ESC_S3 TP_U8_EDC_PHASE3_P_GAIN_ESC_S4 TP_U8_EDC_PHASE4_D_GAIN_ESC_S1 TP_U8_EDC_PHASE4_D_GAIN_ESC_S2 TP_U8_EDC_PHASE4_D_GAIN_ESC_S3 TP_U8_EDC_PHASE4_D_GAIN_ESC_S4 TP_U8_EDC_PHASE4_P_GAIN_ESC_S1 TP_U8_EDC_PHASE4_P_GAIN_ESC_S2 TP_U8_EDC_PHASE4_P_GAIN_ESC_S3 TP_U8_EDC_PHASE4_P_GAIN_ESC_S4 /end REF_CHARACTERISTIC
/end GROUP
/begin GROUP C_EDC_ESC_Target ""
 /begin REF_CHARACTERISTIC TP_S8_EDC_TARGET_DELTA_V_ESC_S1 TP_S8_EDC_TARGET_DELTA_V_ESC_S2 TP_S8_EDC_TARGET_DELTA_V_ESC_S3 TP_S8_EDC_TARGET_DELTA_V_ESC_S4 /end REF_CHARACTERISTIC
/end GROUP
/begin GROUP C_EDC_EXIT_THRESHOLD ""
 /begin REF_CHARACTERISTIC TP_S8_EDC_EXIT_RELLAM_THR TP_S8_EDC_EXIT_RELLAM_THR_3G0 TP_S8_EDC_EXIT_SPEED_THR TP_S8_EDC_EXIT_SPEED_THR_3G0 /end REF_CHARACTERISTIC
/end GROUP
/begin GROUP C_EPB_Ctrl ""
 /begin SUB_GROUP Ca_STA Cb_STR Cc_Automatic_Apply Cd_Automatic_Release Ce_Autonomouse_Apply Cf_Crazy_Mode Cg_Degraded_Apply Ch_Degraded_Release Ci_Intelligent_Apply Cj_Dynamic_Brake Ck_AutoAdjust Cl_Service_Release Cm_Pre_Release Cn_PtoX Co_RollerBench /end SUB_GROUP
/end GROUP
/begin GROUP C_Initial_Control ""
 /begin REF_CHARACTERISTIC TP_U8TCSCpAsymSpnCtlFFmodeTimeUp TP_U8TCSCpIniMtrCtlModeTime TP_U8TCSCpIniMtrCtlModeTimeInTurn TP_U8TCSCpIniPres TP_U8TCSCpIniTCVCtlModeTime TP_U8TCSCpIniTCVCtlModeTimeHill TP_U8TCSCpIniTCVCtlModeTimeHunt TP_U8TCSCpIniTCVCtlModeTimeInTurn /end REF_CHARACTERISTIC
/end GROUP
/begin GROUP C_WpeTcVlvPrm ""
 /begin SUB_GROUP a_WpeTcDumpFront b_WpeTcDumpRear c_WpeTcHoldDuty d_WpeTcHoldPres e_WpeTcRelsCompFront f_WpeTcRelsCompRear /end SUB_GROUP
/end GROUP
/begin GROUP Ca_STA "" /begin REF_CHARACTERISTIC SSM_K_EPB_Maunal_Apply_Feature_En /end REF_CHARACTERISTIC /end GROUP
/begin GROUP CalVrntCta "" /begin REF_CHARACTERISTIC BrkCalVrntCtaDft EngCalVrntCtaDft /end REF_CHARACTERISTIC /end GROUP
/begin GROUP Cal_AxSenAvail "" /begin REF_CHARACTERISTIC TP_U8ETCSCpAxSenAvail /end REF_CHARACTERISTIC /end GROUP
/begin GROUP Cal_Cornering ""
 /begin REF_CHARACTERISTIC TP_S16ETCSCpAftTrnResetSpnCnt TP_U16ETCSCpStrCnvrgWhAngGrdThr TP_U16ETCSCpStrCnvrgWhAngThr TP_U8ETCSCpAy[0] TP_U8ETCSCpAy[1] TP_U8ETCSCpAy[2] TP_U8ETCSCpCnt4Tar1stIncInTrn TP_U8ETCSCpCnt4TarMaxDecInTrn TP_U8ETCSCpCrnExDctCnt TP_U8ETCSCpDltYawStbDctCnt TP_U8ETCSCpLatStabCntTh[0] TP_U8ETCSCpLatStabCntTh[1] TP_U8ETCSCpLatStabCntTh[2] TP_U8ETCSCpLatStabStrTh[0] TP_U8ETCSCpLatStabStrTh[1] TP_U8ETCSCpLatStabStrTh[2] TP_U8ETCSCpOvrStrLmtCrngEnbl TP_U8ETCSCpOvrStrTrgSpnDecEnbl TP_U8ETCSCpStabCrngTime TP_U8ETCSCpTarNChngDltYawFac TP_U8ETCSCpTarNChngDltYawHiBrkTrq TP_U8ETCSCpTarNChngDltYawLwBrkTrq TP_U8ETCSCpYawStabCntTh[0] TP_U8ETCSCpYawStabCntTh[1] TP_U8ETCSCpYawStabCntTh[2] TP_U8ETCSCpYawStabCnvrgThFac TP_U8ETCSCpYawThFac[0][0] TP_U8ETCSCpYawThFac[0][1] TP_U8ETCSCpYawThFac[0][2] TP_U8ETCSCpYawThFac[0][3] TP_U8ETCSCpYawThFac[0][4] TP_U8ETCSCpYawThFac[1][0] TP_U8ETCSCpYawThFac[1][1] TP_U8ETCSCpYawThFac[1][2] TP_U8ETCSCpYawThFac[1][3] TP_U8ETCSCpYawThFac[1][4] TP_U8ETCSCpYawThFac[2][0] TP_U8ETCSCpYawThFac[2][1] TP_U8ETCSCpYawThFac[2][2] TP_U8ETCSCpYawThFac[2][3] TP_U8ETCSCpYawThFac[2][4] /end REF_CHARACTERISTIC
/end GROUP
/begin GROUP Cal_DecTarWhlSpn ""
 /begin REF_CHARACTERISTIC TP_S8ETCSCpLmtCrngTarSpn[0][0] TP_S8ETCSCpLmtCrngTarSpn[0][1] TP_S8ETCSCpLmtCrngTarSpn[0][2] TP_S8ETCSCpLmtCrngTarSpn[0][3] TP_S8ETCSCpLmtCrngTarSpn[0][4] TP_S8ETCSCpLmtCrngTarSpn[1][0] TP_S8ETCSCpLmtCrngTarSpn[1][1] TP_S8ETCSCpLmtCrngTarSpn[1][2] TP_S8ETCSCpLmtCrngTarSpn[1][3] TP_S8ETCSCpLmtCrngTarSpn[1][4] TP_S8ETCSCpLmtCrngTarSpn[2][0] TP_S8ETCSCpLmtCrngTarSpn[2][1] TP_S8ETCSCpLmtCrngTarSpn[2][2] TP_S8ETCSCpLmtCrngTarSpn[2][3] TP_S8ETCSCpLmtCrngTarSpn[2][4] TP_S8ETCSCpTarSpnDec4Vib TP_U8ETCSCpDltYawOffset4MinTrgtSpn /end REF_CHARACTERISTIC
/end GROUP
/begin GROUP Cal_EngMdl ""
 /begin REF_CHARACTERISTIC TP_S16ETCSCpEngSpd[0] TP_S16ETCSCpEngSpd[1] TP_S16ETCSCpEngSpd[2] TP_S16ETCSCpEngSpd[3] TP_S16ETCSCpEngSpd[4] TP_U8ETCSCpEngTrqFltGainCmdDec TP_U8ETCSCpEngTrqFltGainCmdInc TP_U8ETCSCpTrqDel[0] TP_U8ETCSCpTrqDel[1] TP_U8ETCSCpTrqDel[2] TP_U8ETCSCpTrqDel[3] TP_U8ETCSCpTrqDel[4] /end REF_CHARACTERISTIC
/end GROUP
/begin GROUP Cal_GearEst ""
 /begin REF_CHARACTERISTIC TP_S16ETCSCpTEGWheelSpinThr TP_U16ETCSCpTEGTimeAcclPdlThr TP_U8ETCSCpGrRtErrThr_ABS TP_U8ETCSCpGrRtErrThr_Cstng TP_U8ETCSCpGrRtErrThr_Shftng TP_U8ETCSCpGrRtErrThr_Smth TP_U8ETCSCpGrRtErrThr_Spin_HghLmt TP_U8ETCSCpGrRtErrThr_Spin_LowLmt TP_U8ETCSCpGrRtErrThr_Trctn TP_U8ETCSCpInGrCntThr4MultShft4TCS TP_U8ETCSCpInGrCntThr4SnglShft4TCS TP_U8ETCSCpTEGInGrCntThr4ErSgnChng TP_U8ETCSCpTEGInGrCntThr4MultShft TP_U8ETCSCpTEGInGrCntThr4SlpChng TP_U8ETCSCpTEGInGrCntThr4SnglShft TP_U8ETCSCpTEGOutGrCntThr TP_U8ETCSCpTEGOutGrCntThr4Spin TP_U8ETCSCpTEGSpdThrGr1st /end REF_CHARACTERISTIC
/end GROUP
/begin GROUP Cal_HomoTarWhlSpn ""
 /begin REF_CHARACTERISTIC TP_U8ETCSCpMinTarSpn TP_U8ETCSCpTarSpnTransTme TP_U8ETCSCpTarWhlSpin[0] TP_U8ETCSCpTarWhlSpin[1] TP_U8ETCSCpTarWhlSpin[2] TP_U8ETCSCpTarWhlSpin[3] TP_U8ETCSCpTarWhlSpin[4] /end REF_CHARACTERISTIC
/end GROUP
/begin GROUP Cal_IncTarWhlSpn ""
 /begin REF_CHARACTERISTIC TP_S16ETCSCpCircumferenceOfTire TP_S16ETCSCpTrgtEngSpdStlDetd TP_S16ETCSCpTrgtOffStEngSpdStlDetd TP_S8ETCSCpTarSpnInc4Vib TP_U8ETCSCpAddBstTarWhlSpn[0] TP_U8ETCSCpAddBstTarWhlSpn[1] TP_U8ETCSCpAddBstTarWhlSpn[2] TP_U8ETCSCpAlwAddTar4DepSnwSpd TP_U8ETCSCpNAlwAddTar4DepSnwSpd TP_U8ETCSCpTarSpnAdd1stCycle[0] TP_U8ETCSCpTarSpnAdd1stCycle[1] TP_U8ETCSCpTarSpnAdd1stCycle[2] TP_U8ETCSCpTarSpnAdd1stCycle[3] TP_U8ETCSCpTarSpnAdd1stCycle[4] TP_U8ETCSCpTarSpnAdd4AbnmSizTire TP_U8ETCSCpTarSpnAdd4AdHiRd TP_U8ETCSCpTarSpnAdd4DepSnwHil TP_U8ETCSCpTarSpnAdd4DrvPrtnMd TP_U8ETCSCpTarSpnAdd4Hill TP_U8ETCSCpTarSpnAdd4LwWhlSpn TP_U8ETCSCpTarSpnAdd4PreHiRd TP_U8ETCSCpTarSpnAdd4Sp TP_U8ETCSCpTarSpnAdd4Track TP_U8ETCSCpTarSpnAddLwSpd /end REF_CHARACTERISTIC
/end GROUP
/begin GROUP Cal_LoadTrq "" /begin REF_CHARACTERISTIC TP_U8ETCSCpGrdLdTrqChngFac TP_U8ETCSCpLdTrqByGrdTransTme /end REF_CHARACTERISTIC /end GROUP
/begin GROUP Cal_SplitTarWhlSpn ""
 /begin REF_CHARACTERISTIC TP_U8ETCSCpAddTarWhlSpnLwToSp TP_U8ETCSCpAddTarWhlSpnSp TP_U8ETCSCpTarTransCplBrkTrq2Sp TP_U8ETCSCpTarTransStBrkTrq2Sp /end REF_CHARACTERISTIC
/end GROUP
/begin GROUP Cal_StrtOfCtl "" /begin REF_CHARACTERISTIC TP_U8ETCSCpCtlActTmThInLmtCnrg /end REF_CHARACTERISTIC /end GROUP
/begin GROUP Cal_SymBrkCtl ""
 /begin REF_CHARACTERISTIC TP_U8ETCSCpSymBrkCtlTh[0][0] TP_U8ETCSCpSymBrkCtlTh[0][1] TP_U8ETCSCpSymBrkCtlTh[0][2] TP_U8ETCSCpSymBrkCtlTh[0][3] TP_U8ETCSCpSymBrkCtlTh[0][4] TP_U8ETCSCpSymBrkCtlTh[1][0] TP_U8ETCSCpSymBrkCtlTh[1][1] TP_U8ETCSCpSymBrkCtlTh[1][2] TP_U8ETCSCpSymBrkCtlTh[1][3] TP_U8ETCSCpSymBrkCtlTh[1][4] /end REF_CHARACTERISTIC
/end GROUP
/begin GROUP Cal_TarWhlSpn "" /begin REF_CHARACTERISTIC TP_U8ETCSCpWhlSpnTransVal /end REF_CHARACTERISTIC
 /begin SUB_GROUP Cal_DecTarWhlSpn Cal_HomoTarWhlSpn Cal_IncTarWhlSpn Cal_SplitTarWhlSpn /end SUB_GROUP
/end GROUP
/begin GROUP Cal_TotalGearRatio ""
 /begin REF_CHARACTERISTIC TP_S16ETCSCpTrnfrCsGrRtoHgMd TP_S16ETCSCpTrnfrCsGrRtoLwMd TP_U8ETCSCpGrHoldingTme TP_U8ETCSCpGrTransTme /end REF_CHARACTERISTIC
/end GROUP
/begin GROUP Cal_VehPara ""
 /begin REF_CHARACTERISTIC TP_S16ETCSCpTireRadi TP_S16ETCSCpTtlVehMass TP_U8ETCSCpMovWinLen /end REF_CHARACTERISTIC
/end GROUP
/begin GROUP Cal_VehSpdBrkPnts ""
 /begin REF_CHARACTERISTIC TP_S16ETCSCpSpd[0] TP_S16ETCSCpSpd[1] TP_S16ETCSCpSpd[2] TP_S16ETCSCpSpd[3] TP_S16ETCSCpSpd[4] /end REF_CHARACTERISTIC
/end GROUP
/begin GROUP Cb_STR "" /begin REF_CHARACTERISTIC SSM_K_EPB_Maunal_Release_Feature_En /end REF_CHARACTERISTIC /end GROUP
/begin GROUP CbcCalPrm "" /begin SUB_GROUP a_CBC_Ref_Speed b_CBC b_CBC_Abs /end SUB_GROUP /end GROUP
/begin GROUP Cc_Automatic_Apply ""
 /begin REF_CHARACTERISTIC SSM_K_EPB_AVH_TimeOut_Suspect_Time_Th SSM_K_EPB_Automatic_Apply_Key_Out_Inibit_Time /end REF_CHARACTERISTIC
 /begin SUB_GROUP AA_AutoSwitch AA_DoorBelt AA_HilStop AA_MT_SWFail KOA /end SUB_GROUP
/end GROUP
/begin GROUP Cd_Automatic_Release ""
 /begin REF_CHARACTERISTIC SSM_K_EPB_Auto_Release_Door_Close_Act SSM_K_EPB_Auto_Release_MT_IN_Gear_Act SSM_K_EPB_Automatic_Release_Feature_En /end REF_CHARACTERISTIC
/end GROUP
/begin GROUP Ce_Autonomouse_Apply ""
 /begin REF_CHARACTERISTIC SSM_K_EPB_Autonomous_Apply_Driven_Spd_Th SSM_K_EPB_Autonomous_Apply_ESC_Feature_En SSM_K_EPB_Autonomous_Apply_ETRS_Feature_En SSM_K_EPB_Autonomous_Apply_VICM_Feature_En /end REF_CHARACTERISTIC
/end GROUP
/begin GROUP Cf_Crazy_Mode ""
 /begin REF_CHARACTERISTIC SSM_K_EPB_Crazy_Mode_Feature_En SSM_K_EPB_Crazy_Mode_Hold_Time SSM_K_EPB_Crazy_Mode_Max_Cnt /end REF_CHARACTERISTIC
/end GROUP
/begin GROUP Cg_Degraded_Apply ""
 /begin REF_CHARACTERISTIC SSM_K_EPB_Degraded_Apply_Feature_En SSM_K_EPB_Degraded_Apply_Time_Periode SSM_K_EPB_Degraded_Apply_Time_TH /end REF_CHARACTERISTIC
/end GROUP
/begin GROUP Ch_Degraded_Release ""
 /begin REF_CHARACTERISTIC SSM_K_EPB_Degrad_Release_SWOFF_Time_Th SSM_K_EPB_Degraded_Release_Feature_En SSM_K_EPB_Degraded_Release_Time_Th /end REF_CHARACTERISTIC
/end GROUP
/begin GROUP Ci_Intelligent_Apply ""
 /begin REF_CHARACTERISTIC SSM_K_EPB_Intelligent_Apply_Belt_Feature_En SSM_K_EPB_Intelligent_Apply_Feature_En SSM_K_EPB_Intelligent_Apply_Switch_Feature_En SSM_K_EPB_Intelligent_Apply_Switch_Hold_On_Act SSM_K_EPB_Intelligent_Apply_Switch_Re_On_Act SSM_K_EPB_Intelligent_Apply_Switch_Time_Th /end REF_CHARACTERISTIC
/end GROUP
/begin GROUP Cj_Dynamic_Brake ""
 /begin REF_CHARACTERISTIC SSM_K_EPB_DPB_REQ_OVERRIDE_TIME SSM_K_EPB_Dynamic_Brake_Decel_Rate_ESC SSM_K_EPB_Dynamic_Brake_Decel_Rate_ESC_No_Brk SSM_K_EPB_Dynamic_Brake_EPB_Feature_En SSM_K_EPB_Dynamic_Brake_ESC_Feature_En /end REF_CHARACTERISTIC
/end GROUP
/begin GROUP Ck_AutoAdjust ""
 /begin REF_CHARACTERISTIC SSM_K_AutoAdjust_Apply_Feature_En SSM_K_AutoAdjust_Apply_OdoMeter /end REF_CHARACTERISTIC
/end GROUP
/begin GROUP Cl_Service_Release ""
 /begin REF_CHARACTERISTIC SSM_K_EPB_Service_Release_DectTime SSM_K_EPB_Service_Release_Feature_En SSM_K_EPB_Service_Release_Switch_On_Time /end REF_CHARACTERISTIC
/end GROUP
/begin GROUP Clutch_Pedal ""
 /begin REF_CHARACTERISTIC SSM_K_ClutchSwitch_From_ClutchSensor SSM_K_Clutch_Engage_LongG_Avr_Max SSM_K_Clutch_Engage_LongG_Avr_Min SSM_K_Clutch_Engage_Study_LongG_Th1 SSM_K_Clutch_Engage_Study_LongG_Th2 SSM_K_Clutch_Engage_Study_LongG_Th3 SSM_K_Clutch_Engage_Study_LongG_Th4 SSM_K_EPB_ClutchEngageStudy_Feature_En SSM_K_EPB_Clutch_Engage_Detect_Speed SSM_K_EPB_Clutch_Engage_Rpm_Comp_Max SSM_K_EPB_Clutch_Engage_Study_Comp SSM_K_EPB_Clutch_Pedal_Back SSM_K_EPB_Clutch_Pedal_Friction_Th SSM_K_EPB_Clutch_Pedal_Max_Th SSM_K_EPB_Clutch_Pedal_Min_Th SSM_K_EPB_Clutch_Pedal_Z0_Th SSM_K_EPB_Clutch_Pedal_Z1_Th SSM_K_EPB_Clutch_Pedal_Z2_Th SSM_K_EPB_Clutch_Pedal_Z3_Th SSM_K_EPB_Clutch_Pedal_ZU_Th /end REF_CHARACTERISTIC
/end GROUP
/begin GROUP Cm_Pre_Release "" /begin REF_CHARACTERISTIC SSM_K_EPB_Pre_Release_Feature_En /end REF_CHARACTERISTIC /end GROUP
/begin GROUP Cmn_BrkCal ""
 /begin REF_CHARACTERISTIC U16TireCircumferenceFrnt U16TireCircumferenceRe U16TqToPGainFrnt U16TqToPGainRe U16TrackWidthFrnt U16TrackWidthRe U16WhlTiStampResl U8WhlTeethFrnt U8WhlTeethRe /end REF_CHARACTERISTIC
 /begin SUB_GROUP Esc_Model /end SUB_GROUP
/end GROUP
/begin GROUP Cmn_EngCal ""
 /begin REF_CHARACTERISTIC TP_S16TotalGearRatio_1 TP_S16TotalGearRatio_2 TP_S16TotalGearRatio_3 TP_S16TotalGearRatio_4 TP_S16TotalGearRatio_5 TP_S16TotalGearRatio_6 TP_S16TotalGearRatio_7 TP_S16TotalGearRatio_8 TP_S16TotalGearRatio_R TP_U8TransEff_1 TP_U8TransEff_2 TP_U8TransEff_3 TP_U8TransEff_4 TP_U8TransEff_5 TP_U8TransEff_6 TP_U8TransEff_7 TP_U8TransEff_8 TP_U8TransEff_R /end REF_CHARACTERISTIC
/end GROUP
/begin GROUP Cn_PtoX ""
 /begin REF_CHARACTERISTIC SSM_K_EPB_DectGear_D_Position_Th SSM_K_EPB_DectGear_N_Position_Th SSM_K_EPB_DectGear_P_Position_Th SSM_K_EPB_DectGear_R_Position_Th SSM_K_EPB_P2X_Gear_Change_Time_Th SSM_K_EPB_PtoX_D_BrakeOnTime SSM_K_EPB_PtoX_N_BrakeOnTime SSM_K_EPB_PtoX_P_BrakeOnTime SSM_K_EPB_PtoX_R_BrakeOnTime SSM_K_EPB_PtoX_Release_DtoD_On_Act SSM_K_EPB_PtoX_Release_DtoX_On_Act SSM_K_EPB_PtoX_Release_Feature_En SSM_K_EPB_PtoX_Release_HillStop_Act SSM_K_EPB_PtoX_Release_NtoX_On_Act SSM_K_EPB_PtoX_Release_PtoX_On_Act SSM_K_EPB_PtoX_Release_RtoR_On_Act SSM_K_EPB_PtoX_Release_RtoX_On_Act /end REF_CHARACTERISTIC
/end GROUP
/begin GROUP Co_RollerBench ""
 /begin REF_CHARACTERISTIC SSM_K_EPB_Rollbench_Front_SPD_TH_H SSM_K_EPB_Rollbench_Front_SPD_TH_L SSM_K_EPB_Rollbench_Rear_SPD_TH_H SSM_K_EPB_Rollbench_Rear_SPD_TH_L SSM_K_RollBench_Apply_Feature_En /end REF_CHARACTERISTIC
/end GROUP
/begin GROUP ComEngCalPrm ""
 /begin REF_CHARACTERISTIC S16_VLC_BRAKE_CONTROL_MIN_TORQUE S16_VLC_MAX_ENGINE_DRAG_TORQUE_COMP U16_VLC_DISK_TEMP_ERROR_RESET_THRES U16_VLC_DISK_TEMP_ERROR_SET_THRES U16_VLC_Gear_1 U16_VLC_Gear_10 U16_VLC_Gear_2 U16_VLC_Gear_3 U16_VLC_Gear_4 U16_VLC_Gear_5 U16_VLC_Gear_6 U16_VLC_Gear_7 U16_VLC_Gear_8 U16_VLC_Gear_9 U16_VLC_Gear_R U8_VLC_BRKLAMPOFF_PRESS U8_VLC_BRKLAMPON_PRESS U8_VLC_MASS U8_VLC_SLOPE_MAX_THD U8_VLC_SLOPE_THD U8_VLC_TIRE_R /end REF_CHARACTERISTIC
/end GROUP
/begin GROUP Ctl_AftLimCornrg "" /begin REF_CHARACTERISTIC TP_S16ETCSCpAftTrnMaxCnt /end REF_CHARACTERISTIC /end GROUP
/begin GROUP Ctl_BaseTorq_Yawgain ""
 /begin REF_CHARACTERISTIC TP_S16ETCSCpLmtCrngTarTrq[0] TP_S16ETCSCpLmtCrngTarTrq[1] TP_S16ETCSCpLmtCrngTarTrq[2] TP_U8ETCSCpDelYawLowTrqGain[0] TP_U8ETCSCpDelYawLowTrqGain[1] TP_U8ETCSCpDelYawLowTrqGain[2] /end REF_CHARACTERISTIC
/end GROUP
/begin GROUP Ctl_Cnvrg_FastInc_Yawgain ""
 /begin REF_CHARACTERISTIC TP_U8ETCSCpDelYawFstIncGain[0][0] TP_U8ETCSCpDelYawFstIncGain[0][1] TP_U8ETCSCpDelYawFstIncGain[0][2] TP_U8ETCSCpDelYawFstIncGain[0][3] TP_U8ETCSCpDelYawFstIncGain[0][4] TP_U8ETCSCpDelYawFstIncGain[1][0] TP_U8ETCSCpDelYawFstIncGain[1][1] TP_U8ETCSCpDelYawFstIncGain[1][2] TP_U8ETCSCpDelYawFstIncGain[1][3] TP_U8ETCSCpDelYawFstIncGain[1][4] TP_U8ETCSCpDelYawFstIncGain[2][0] TP_U8ETCSCpDelYawFstIncGain[2][1] TP_U8ETCSCpDelYawFstIncGain[2][2] TP_U8ETCSCpDelYawFstIncGain[2][3] TP_U8ETCSCpDelYawFstIncGain[2][4] /end REF_CHARACTERISTIC
/end GROUP
/begin GROUP Ctl_Cnvrg_SlowInc_Yawgain ""
 /begin REF_CHARACTERISTIC TP_U8ETCSCpDelYawSlwIncGain[0][0] TP_U8ETCSCpDelYawSlwIncGain[0][1] TP_U8ETCSCpDelYawSlwIncGain[0][2] TP_U8ETCSCpDelYawSlwIncGain[0][3] TP_U8ETCSCpDelYawSlwIncGain[0][4] TP_U8ETCSCpDelYawSlwIncGain[1][0] TP_U8ETCSCpDelYawSlwIncGain[1][1] TP_U8ETCSCpDelYawSlwIncGain[1][2] TP_U8ETCSCpDelYawSlwIncGain[1][3] TP_U8ETCSCpDelYawSlwIncGain[1][4] TP_U8ETCSCpDelYawSlwIncGain[2][0] TP_U8ETCSCpDelYawSlwIncGain[2][1] TP_U8ETCSCpDelYawSlwIncGain[2][2] TP_U8ETCSCpDelYawSlwIncGain[2][3] TP_U8ETCSCpDelYawSlwIncGain[2][4] /end REF_CHARACTERISTIC
/end GROUP
/begin GROUP Ctl_DeltaYaw ""
 /begin SUB_GROUP Ctl_AftLimCornrg Ctl_BaseTorq_Yawgain Ctl_Cnvrg_FastInc_Yawgain Ctl_Cnvrg_SlowInc_Yawgain Ctl_Divrg_Yawgain Ctl_TorqDropCornrg /end SUB_GROUP
/end GROUP
/begin GROUP Ctl_Divrg_Yawgain ""
 /begin REF_CHARACTERISTIC TP_U8ETCSCpDelYawDivrgGain[0][0] TP_U8ETCSCpDelYawDivrgGain[0][1] TP_U8ETCSCpDelYawDivrgGain[0][2] TP_U8ETCSCpDelYawDivrgGain[0][3] TP_U8ETCSCpDelYawDivrgGain[0][4] TP_U8ETCSCpDelYawDivrgGain[1][0] TP_U8ETCSCpDelYawDivrgGain[1][1] TP_U8ETCSCpDelYawDivrgGain[1][2] TP_U8ETCSCpDelYawDivrgGain[1][3] TP_U8ETCSCpDelYawDivrgGain[1][4] TP_U8ETCSCpDelYawDivrgGain[2][0] TP_U8ETCSCpDelYawDivrgGain[2][1] TP_U8ETCSCpDelYawDivrgGain[2][2] TP_U8ETCSCpDelYawDivrgGain[2][3] TP_U8ETCSCpDelYawDivrgGain[2][4] /end REF_CHARACTERISTIC
/end GROUP
/begin GROUP Ctl_FctLamp ""
 /begin REF_CHARACTERISTIC TP_S16ETCSCpFuncLampOffBrkTrq[0] TP_S16ETCSCpFuncLampOffBrkTrq[1] TP_S16ETCSCpMaxEngTrq TP_U8ETCSCpFunLampOffCnt TP_U8ETCSCpMaxTrqFct4FunLamp TP_U8ETCSCpOffsetFct4FunLamp /end REF_CHARACTERISTIC
/end GROUP
/begin GROUP Ctl_GainTransTm "" /begin REF_CHARACTERISTIC TP_S16ETCSCpTransTmAftDrvVib TP_U8ETCSCpGainFacTransTme /end REF_CHARACTERISTIC /end GROUP
/begin GROUP Ctl_IEffect "" /begin SUB_GROUP Ctl_Ifactor Ctl_Igain /end SUB_GROUP /end GROUP
/begin GROUP Ctl_Ifactor ""
 /begin SUB_GROUP Ctl_Ifactor_AftLimCornrg Ctl_Ifactor_BigEngSpd Ctl_Ifactor_BigSpn Ctl_Ifactor_Cornering Ctl_Ifactor_GearChng Ctl_Ifactor_Vib /end SUB_GROUP
/end GROUP
/begin GROUP Ctl_Ifactor_AftLimCornrg ""
 /begin REF_CHARACTERISTIC TP_U8ETCSCpIgainFacAftrTrn[0][0] TP_U8ETCSCpIgainFacAftrTrn[0][1] TP_U8ETCSCpIgainFacAftrTrn[0][2] TP_U8ETCSCpIgainFacAftrTrn[0][3] TP_U8ETCSCpIgainFacAftrTrn[0][4] TP_U8ETCSCpIgainFacAftrTrn[1][0] TP_U8ETCSCpIgainFacAftrTrn[1][1] TP_U8ETCSCpIgainFacAftrTrn[1][2] TP_U8ETCSCpIgainFacAftrTrn[1][3] TP_U8ETCSCpIgainFacAftrTrn[1][4] TP_U8ETCSCpIgainFacAftrTrn[2][0] TP_U8ETCSCpIgainFacAftrTrn[2][1] TP_U8ETCSCpIgainFacAftrTrn[2][2] TP_U8ETCSCpIgainFacAftrTrn[2][3] TP_U8ETCSCpIgainFacAftrTrn[2][4] /end REF_CHARACTERISTIC
/end GROUP
/begin GROUP Ctl_Ifactor_BigEngSpd ""
 /begin REF_CHARACTERISTIC TP_U8ETCSCpBigEngSpdIgFac[0][0] TP_U8ETCSCpBigEngSpdIgFac[0][1] TP_U8ETCSCpBigEngSpdIgFac[0][2] TP_U8ETCSCpBigEngSpdIgFac[1][0] TP_U8ETCSCpBigEngSpdIgFac[1][1] TP_U8ETCSCpBigEngSpdIgFac[1][2] TP_U8ETCSCpBigEngSpdIgFac[2][0] TP_U8ETCSCpBigEngSpdIgFac[2][1] TP_U8ETCSCpBigEngSpdIgFac[2][2] /end REF_CHARACTERISTIC
/end GROUP
/begin GROUP Ctl_Ifactor_BigSpn ""
 /begin REF_CHARACTERISTIC TP_U8ETCSCpBigSpnIgFac[0][0] TP_U8ETCSCpBigSpnIgFac[0][1] TP_U8ETCSCpBigSpnIgFac[0][2] TP_U8ETCSCpBigSpnIgFac[1][0] TP_U8ETCSCpBigSpnIgFac[1][1] TP_U8ETCSCpBigSpnIgFac[1][2] /end REF_CHARACTERISTIC
/end GROUP
/begin GROUP Ctl_Ifactor_Cornering ""
 /begin REF_CHARACTERISTIC TP_U8ETCSCpIGainLmtFac[0][0] TP_U8ETCSCpIGainLmtFac[0][1] TP_U8ETCSCpIGainLmtFac[0][2] TP_U8ETCSCpIGainLmtFac[1][0] TP_U8ETCSCpIGainLmtFac[1][1] TP_U8ETCSCpIGainLmtFac[1][2] TP_U8ETCSCpIGainLmtFac[2][0] TP_U8ETCSCpIGainLmtFac[2][1] TP_U8ETCSCpIGainLmtFac[2][2] TP_U8ETCSCpIgFacInTrn[0][0] TP_U8ETCSCpIgFacInTrn[0][1] TP_U8ETCSCpIgFacInTrn[0][2] TP_U8ETCSCpIgFacInTrn[0][3] TP_U8ETCSCpIgFacInTrn[0][4] TP_U8ETCSCpIgFacInTrn[1][0] TP_U8ETCSCpIgFacInTrn[1][1] TP_U8ETCSCpIgFacInTrn[1][2] TP_U8ETCSCpIgFacInTrn[1][3] TP_U8ETCSCpIgFacInTrn[1][4] TP_U8ETCSCpIgFacInTrn[2][0] TP_U8ETCSCpIgFacInTrn[2][1] TP_U8ETCSCpIgFacInTrn[2][2] TP_U8ETCSCpIgFacInTrn[2][3] TP_U8ETCSCpIgFacInTrn[2][4] /end REF_CHARACTERISTIC
/end GROUP
/begin GROUP Ctl_Ifactor_GearChng ""
 /begin REF_CHARACTERISTIC TP_U8ETCSCpIgFacGrChgErrNeg[0] TP_U8ETCSCpIgFacGrChgErrNeg[1] TP_U8ETCSCpIgFacGrChgErrNeg[2] TP_U8ETCSCpIgFacGrChgErrNeg[3] TP_U8ETCSCpIgFacGrChgErrNeg[4] TP_U8ETCSCpIgFacGrChgErrPos[0] TP_U8ETCSCpIgFacGrChgErrPos[1] TP_U8ETCSCpIgFacGrChgErrPos[2] TP_U8ETCSCpIgFacGrChgErrPos[3] TP_U8ETCSCpIgFacGrChgErrPos[4] /end REF_CHARACTERISTIC
/end GROUP
/begin GROUP Ctl_Ifactor_Vib ""
 /begin REF_CHARACTERISTIC TP_U8ETCSCpIGainIncFacAsymVib TP_U8ETCSCpIGainIncFacHldVib TP_U8ETCSCpIGainIncFacVib /end REF_CHARACTERISTIC
/end GROUP
/begin GROUP Ctl_Igain "" /begin SUB_GROUP Ctl_Igain_Homo Ctl_Igain_Split /end SUB_GROUP /end GROUP
/begin GROUP Ctl_Igain_Homo ""
 /begin REF_CHARACTERISTIC TP_U8ETCSCpNegErrIgain[0][0] TP_U8ETCSCpNegErrIgain[0][1] TP_U8ETCSCpNegErrIgain[0][2] TP_U8ETCSCpNegErrIgain[0][3] TP_U8ETCSCpNegErrIgain[0][4] TP_U8ETCSCpNegErrIgain[1][0] TP_U8ETCSCpNegErrIgain[1][1] TP_U8ETCSCpNegErrIgain[1][2] TP_U8ETCSCpNegErrIgain[1][3] TP_U8ETCSCpNegErrIgain[1][4] TP_U8ETCSCpNegErrIgain[2][0] TP_U8ETCSCpNegErrIgain[2][1] TP_U8ETCSCpNegErrIgain[2][2] TP_U8ETCSCpNegErrIgain[2][3] TP_U8ETCSCpNegErrIgain[2][4] TP_U8ETCSCpNegErrIgain_R TP_U8ETCSCpPosErrIgain[0][0] TP_U8ETCSCpPosErrIgain[0][1] TP_U8ETCSCpPosErrIgain[0][2] TP_U8ETCSCpPosErrIgain[0][3] TP_U8ETCSCpPosErrIgain[0][4] TP_U8ETCSCpPosErrIgain[1][0] TP_U8ETCSCpPosErrIgain[1][1] TP_U8ETCSCpPosErrIgain[1][2] TP_U8ETCSCpPosErrIgain[1][3] TP_U8ETCSCpPosErrIgain[1][4] TP_U8ETCSCpPosErrIgain[2][0] TP_U8ETCSCpPosErrIgain[2][1] TP_U8ETCSCpPosErrIgain[2][2] TP_U8ETCSCpPosErrIgain[2][3] TP_U8ETCSCpPosErrIgain[2][4] TP_U8ETCSCpPosErrIgain_R /end REF_CHARACTERISTIC
/end GROUP
/begin GROUP Ctl_Igain_Split ""
 /begin REF_CHARACTERISTIC TP_U8ETCSCpNegErrIgainSplt[0] TP_U8ETCSCpNegErrIgainSplt[1] TP_U8ETCSCpNegErrIgainSplt[2] TP_U8ETCSCpNegErrIgainSplt[3] TP_U8ETCSCpNegErrIgainSplt[4] TP_U8ETCSCpPosErrIgainSplt[0] TP_U8ETCSCpPosErrIgainSplt[1] TP_U8ETCSCpPosErrIgainSplt[2] TP_U8ETCSCpPosErrIgainSplt[3] TP_U8ETCSCpPosErrIgainSplt[4] /end REF_CHARACTERISTIC
/end GROUP
/begin GROUP Ctl_MinCtlCmd "" /begin REF_CHARACTERISTIC TP_S16ETCSCpEngCmdTransTrq TP_S16ETCSCpMinCrdnCmdTrq /end REF_CHARACTERISTIC /end GROUP
/begin GROUP Ctl_PEffect "" /begin SUB_GROUP Ctl_Pfactor Ctl_Pgain /end SUB_GROUP /end GROUP
/begin GROUP Ctl_Pfactor "" /begin SUB_GROUP Ctl_Pfactor_Cornering Ctl_Pfactor_GearChng /end SUB_GROUP /end GROUP
/begin GROUP Ctl_Pfactor_Cornering ""
 /begin REF_CHARACTERISTIC TP_U8ETCSCpPgFacInTrn[0][0] TP_U8ETCSCpPgFacInTrn[0][1] TP_U8ETCSCpPgFacInTrn[0][2] TP_U8ETCSCpPgFacInTrn[0][3] TP_U8ETCSCpPgFacInTrn[0][4] TP_U8ETCSCpPgFacInTrn[1][0] TP_U8ETCSCpPgFacInTrn[1][1] TP_U8ETCSCpPgFacInTrn[1][2] TP_U8ETCSCpPgFacInTrn[1][3] TP_U8ETCSCpPgFacInTrn[1][4] TP_U8ETCSCpPgFacInTrn[2][0] TP_U8ETCSCpPgFacInTrn[2][1] TP_U8ETCSCpPgFacInTrn[2][2] TP_U8ETCSCpPgFacInTrn[2][3] TP_U8ETCSCpPgFacInTrn[2][4] /end REF_CHARACTERISTIC
/end GROUP
/begin GROUP Ctl_Pfactor_GearChng ""
 /begin REF_CHARACTERISTIC TP_U8ETCSCpPgFacGrChgErrNeg[0] TP_U8ETCSCpPgFacGrChgErrNeg[1] TP_U8ETCSCpPgFacGrChgErrNeg[2] TP_U8ETCSCpPgFacGrChgErrNeg[3] TP_U8ETCSCpPgFacGrChgErrNeg[4] TP_U8ETCSCpPgFacGrChgErrPos[0] TP_U8ETCSCpPgFacGrChgErrPos[1] TP_U8ETCSCpPgFacGrChgErrPos[2] TP_U8ETCSCpPgFacGrChgErrPos[3] TP_U8ETCSCpPgFacGrChgErrPos[4] /end REF_CHARACTERISTIC
/end GROUP
/begin GROUP Ctl_Pgain "" /begin REF_CHARACTERISTIC TP_S8ETCSCpPgTransTmDrvVib /end REF_CHARACTERISTIC /begin SUB_GROUP Ctl_Pgain_Homo Ctl_Pgain_Split /end SUB_GROUP /end GROUP
/begin GROUP Ctl_Pgain_Homo ""
 /begin REF_CHARACTERISTIC TP_U8ETCSCpNegErrPgain[0][0] TP_U8ETCSCpNegErrPgain[0][1] TP_U8ETCSCpNegErrPgain[0][2] TP_U8ETCSCpNegErrPgain[0][3] TP_U8ETCSCpNegErrPgain[0][4] TP_U8ETCSCpNegErrPgain[1][0] TP_U8ETCSCpNegErrPgain[1][1] TP_U8ETCSCpNegErrPgain[1][2] TP_U8ETCSCpNegErrPgain[1][3] TP_U8ETCSCpNegErrPgain[1][4] TP_U8ETCSCpNegErrPgain[2][0] TP_U8ETCSCpNegErrPgain[2][1] TP_U8ETCSCpNegErrPgain[2][2] TP_U8ETCSCpNegErrPgain[2][3] TP_U8ETCSCpNegErrPgain[2][4] TP_U8ETCSCpNegErrPgain_R TP_U8ETCSCpPosErrPgain[0][0] TP_U8ETCSCpPosErrPgain[0][1] TP_U8ETCSCpPosErrPgain[0][2] TP_U8ETCSCpPosErrPgain[0][3] TP_U8ETCSCpPosErrPgain[0][4] TP_U8ETCSCpPosErrPgain[1][0] TP_U8ETCSCpPosErrPgain[1][1] TP_U8ETCSCpPosErrPgain[1][2] TP_U8ETCSCpPosErrPgain[1][3] TP_U8ETCSCpPosErrPgain[1][4] TP_U8ETCSCpPosErrPgain[2][0] TP_U8ETCSCpPosErrPgain[2][1] TP_U8ETCSCpPosErrPgain[2][2] TP_U8ETCSCpPosErrPgain[2][3] TP_U8ETCSCpPosErrPgain[2][4] TP_U8ETCSCpPosErrPgain_R /end REF_CHARACTERISTIC
/end GROUP
/begin GROUP Ctl_Pgain_Split ""
 /begin REF_CHARACTERISTIC TP_U8ETCSCpNegErrPgainSplt[0] TP_U8ETCSCpNegErrPgainSplt[1] TP_U8ETCSCpNegErrPgainSplt[2] TP_U8ETCSCpNegErrPgainSplt[3] TP_U8ETCSCpNegErrPgainSplt[4] TP_U8ETCSCpPosErrPgainSplt[0] TP_U8ETCSCpPosErrPgainSplt[1] TP_U8ETCSCpPosErrPgainSplt[2] TP_U8ETCSCpPosErrPgainSplt[3] TP_U8ETCSCpPosErrPgainSplt[4] /end REF_CHARACTERISTIC
/end GROUP
/begin GROUP Ctl_SplitPattern ""
 /begin REF_CHARACTERISTIC TP_S16ETCSCpLdTrqAsymSpinCplCnt TP_S16ETCSCpLdTrqAsymSpinMaxCnt TP_S16ETCSCpLdTrqAsymSpinMinCnt TP_S16ETCSCpLdTrqByAsymSpin TP_S16ETCSCpLdTrqByAsymSpinHill TP_S16ETCSCpLdTrqCntLwToSplt TP_S16ETCSCpSplitDecCrdnTrq TP_S16ETCSCpSplitDecTrqCplSpnErr TP_S16ETCSCpSplitDecTrqStrSpnErr TP_S16ETCSCpSpltPatFasIncTrqRate TP_S16ETCSCpSpltPatSlwDecTrqRate TP_S16ETCSCpSpltPatSlwIncTrqRate TP_S16ETCSCpSpltToLwTrqDrp[0][0] TP_S16ETCSCpSpltToLwTrqDrp[0][1] TP_S16ETCSCpSpltToLwTrqDrp[0][2] TP_S16ETCSCpSpltToLwTrqDrp[1][0] TP_S16ETCSCpSpltToLwTrqDrp[1][1] TP_S16ETCSCpSpltToLwTrqDrp[1][2] TP_S16ETCSCpSpltToLwTrqDrp[2][0] TP_S16ETCSCpSpltToLwTrqDrp[2][1] TP_S16ETCSCpSpltToLwTrqDrp[2][2] TP_U8ETCSCpHighBigSpnTh TP_U8ETCSCpHighSpnTh TP_U8ETCSCpLdTrqAsymSpinFac TP_U8ETCSCpLdTrqByAsymTransTme TP_U8ETCSCpLdTrqChngFac TP_U8ETCSCpLowSpnTh TP_U8ETCSCpNoSpnTh TP_U8ETCSCpSymSpnDifTh /end REF_CHARACTERISTIC
/end GROUP
/begin GROUP Ctl_SymBrkCtl ""
 /begin REF_CHARACTERISTIC TP_U8ETCSCpSymBrkCtlGain TP_U8ETCSCpSymBrkCtlIhbAxTh TP_U8ETCSCpSymBrkTrqMax[0] TP_U8ETCSCpSymBrkTrqMax[1] TP_U8ETCSCpSymBrkTrqMax[2] TP_U8ETCSCpSymBrkTrqMax[3] TP_U8ETCSCpSymBrkTrqMax[4] /end REF_CHARACTERISTIC
/end GROUP
/begin GROUP Ctl_TorqDropCornrg ""
 /begin REF_CHARACTERISTIC TP_S16ETCSCpCdrnTrqDrpLmtCr[0][0] TP_S16ETCSCpCdrnTrqDrpLmtCr[0][1] TP_S16ETCSCpCdrnTrqDrpLmtCr[0][2] TP_S16ETCSCpCdrnTrqDrpLmtCr[1][0] TP_S16ETCSCpCdrnTrqDrpLmtCr[1][1] TP_S16ETCSCpCdrnTrqDrpLmtCr[1][2] TP_S16ETCSCpCdrnTrqDrpLmtCr[2][0] TP_S16ETCSCpCdrnTrqDrpLmtCr[2][1] TP_S16ETCSCpCdrnTrqDrpLmtCr[2][2] /end REF_CHARACTERISTIC
/end GROUP
/begin GROUP Ctl_TrsmCrtl ""
 /begin REF_CHARACTERISTIC TP_U8TMCCpTurnIndex[0] TP_U8TMCCpTurnIndex[1] TP_U8TMCCpTurnIndex[2] TP_U8TMCpAllowDnShftMinVehSpd[0] TP_U8TMCpAllowDnShftMinVehSpd[1] TP_U8TMCpAllowDnShftMinVehSpd[2] TP_U8TMCpAllowDnShftMinVehSpd[3] TP_U8TMCpAllowDnShftMinVehSpd[4] TP_U8TMCpAllowDnShftRPM[0] TP_U8TMCpAllowDnShftRPM[1] TP_U8TMCpAllowDnShftRPM[2] TP_U8TMCpAllowDnShftRPM[3] TP_U8TMCpAllowDnShftRPM[4] TP_U8TMCpAllowDnShftVehSpd[0] TP_U8TMCpAllowDnShftVehSpd[1] TP_U8TMCpAllowDnShftVehSpd[2] TP_U8TMCpAllowDnShftVehSpd[3] TP_U8TMCpAllowDnShftVehSpd[4] TP_U8TMCpAllowUpShftMaxVehSpd[0] TP_U8TMCpAllowUpShftMaxVehSpd[1] TP_U8TMCpAllowUpShftMaxVehSpd[2] TP_U8TMCpAllowUpShftMaxVehSpd[3] TP_U8TMCpAllowUpShftMaxVehSpd[4] TP_U8TMCpAllowUpShftRPM[0] TP_U8TMCpAllowUpShftRPM[1] TP_U8TMCpAllowUpShftRPM[2] TP_U8TMCpAllowUpShftRPM[3] TP_U8TMCpAllowUpShftRPM[4] TP_U8TMCpAllowUpShftVehSpd[0] TP_U8TMCpAllowUpShftVehSpd[1] TP_U8TMCpAllowUpShftVehSpd[2] TP_U8TMCpAllowUpShftVehSpd[3] TP_U8TMCpAllowUpShftVehSpd[4] TP_U8TMCpGearShiftTime TP_U8TMCpMaxGear TP_U8TMCpMinGear TP_U8TMCpShftChgRPMHys TP_U8TMCpShftChgRPMInTrn[0] TP_U8TMCpShftChgRPMInTrn[1] TP_U8TMCpShftChgRPMInTrn[2] TP_U8TMCpShftChgVehSpdHys TP_U8TMCpShftChgVehSpdInHill TP_U8TMCpShftChgVehSpdInTrn[0] TP_U8TMCpShftChgVehSpdInTrn[1] TP_U8TMCpShftChgVehSpdInTrn[2] /end REF_CHARACTERISTIC
/end GROUP
/end MODULE
/end PROJECT
