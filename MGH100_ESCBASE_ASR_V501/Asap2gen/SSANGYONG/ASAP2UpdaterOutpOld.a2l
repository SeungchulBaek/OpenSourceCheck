ASAP2_VERSION 1 60
/begin PROJECT Master ""
/begin MODULE CPP ""
/begin MOD_COMMON "" BYTE_ORDER MSB_LAST ALIGNMENT_BYTE 1 ALIGNMENT_WORD 1 ALIGNMENT_LONG 1 ALIGNMENT_FLOAT32_IEEE 1 ALIGNMENT_FLOAT64_IEEE 1 ALIGNMENT_INT64 1 /end MOD_COMMON
/begin VARIANT_CODING
 /begin VAR_CHARACTERISTIC TP_U8_LFC_built_cnt_F_Low_Ref BrkCalVariantCriterion
  /begin VAR_ADDRESS 0x800202C0 0x800236C0 0x80026AC0 0x80029EC0 0x8002D2C0 0x800306C0 0x80033AC0 0x80036EC0 /end VAR_ADDRESS
 /end VAR_CHARACTERISTIC
 /begin VAR_CHARACTERISTIC TP_U8_LFC_built_cnt_F_Med_Ref BrkCalVariantCriterion
  /begin VAR_ADDRESS 0x800202C1 0x800236C1 0x80026AC1 0x80029EC1 0x8002D2C1 0x800306C1 0x80033AC1 0x80036EC1 /end VAR_ADDRESS
 /end VAR_CHARACTERISTIC
 /begin VAR_CHARACTERISTIC TP_U8_LFC_built_cnt_F_Rough_Ref BrkCalVariantCriterion
  /begin VAR_ADDRESS 0x800202C2 0x800236C2 0x80026AC2 0x80029EC2 0x8002D2C2 0x800306C2 0x80033AC2 0x80036EC2 /end VAR_ADDRESS
 /end VAR_CHARACTERISTIC
 /begin VAR_CHARACTERISTIC TP_U8_LFC_built_cnt_F_SpHigh_Ref BrkCalVariantCriterion
  /begin VAR_ADDRESS 0x800202C3 0x800236C3 0x80026AC3 0x80029EC3 0x8002D2C3 0x800306C3 0x80033AC3 0x80036EC3 /end VAR_ADDRESS
 /end VAR_CHARACTERISTIC
 /begin VAR_CHARACTERISTIC TP_U8_LFC_built_cnt_R_High_Ref BrkCalVariantCriterion
  /begin VAR_ADDRESS 0x800202C4 0x800236C4 0x80026AC4 0x80029EC4 0x8002D2C4 0x800306C4 0x80033AC4 0x80036EC4 /end VAR_ADDRESS
 /end VAR_CHARACTERISTIC
 /begin VAR_CHARACTERISTIC TP_U8_LFC_built_cnt_R_Low_Ref BrkCalVariantCriterion
  /begin VAR_ADDRESS 0x800202C5 0x800236C5 0x80026AC5 0x80029EC5 0x8002D2C5 0x800306C5 0x80033AC5 0x80036EC5 /end VAR_ADDRESS
 /end VAR_CHARACTERISTIC
 /begin VAR_CHARACTERISTIC TP_U8_LFC_built_cnt_R_Med_Ref BrkCalVariantCriterion
  /begin VAR_ADDRESS 0x800202C6 0x800236C6 0x80026AC6 0x80029EC6 0x8002D2C6 0x800306C6 0x80033AC6 0x80036EC6 /end VAR_ADDRESS
 /end VAR_CHARACTERISTIC
 /begin VAR_CHARACTERISTIC TP_U8_LFC_built_cnt_R_Rough_Ref BrkCalVariantCriterion
  /begin VAR_ADDRESS 0x800202C7 0x800236C7 0x80026AC7 0x80029EC7 0x8002D2C7 0x800306C7 0x80033AC7 0x80036EC7 /end VAR_ADDRESS
 /end VAR_CHARACTERISTIC
 /begin VAR_CHARACTERISTIC TP_U8_LIMIT_CNT_FOR_BMP_DCT BrkCalVariantCriterion
  /begin VAR_ADDRESS 0x80020625 0x80023A25 0x80026E25 0x8002A225 0x8002D625 0x80030A25 0x80033E25 0x80037225 /end VAR_ADDRESS
 /end VAR_CHARACTERISTIC
 /begin VAR_CHARACTERISTIC TP_U8_LIMIT_CNT_SPLT_FOR_BMP_DCT BrkCalVariantCriterion
  /begin VAR_ADDRESS 0x80020626 0x80023A26 0x80026E26 0x8002A226 0x8002D626 0x80030A26 0x80033E26 0x80037226 /end VAR_ADDRESS
 /end VAR_CHARACTERISTIC
 /begin VAR_CHARACTERISTIC TP_U8_LIMIT_DMP_CNT_FOR_BMP_DCT BrkCalVariantCriterion
  /begin VAR_ADDRESS 0x80020627 0x80023A27 0x80026E27 0x8002A227 0x8002D627 0x80030A27 0x80033E27 0x80037227 /end VAR_ADDRESS
 /end VAR_CHARACTERISTIC
 /begin VAR_CHARACTERISTIC TP_U8_LOW_MU BrkCalVariantCriterion
  /begin VAR_ADDRESS 0x80020569 0x80023969 0x80026D69 0x8002A169 0x8002D569 0x80030969 0x80033D69 0x80037169 /end VAR_ADDRESS
 /end VAR_CHARACTERISTIC
 /begin VAR_CHARACTERISTIC TP_U8_Low_Mu_Dump_Rise_Factor BrkCalVariantCriterion
  /begin VAR_ADDRESS 0x8002059D 0x8002399D 0x80026D9D 0x8002A19D 0x8002D59D 0x8003099D 0x80033D9D 0x8003719D /end VAR_ADDRESS
 /end VAR_CHARACTERISTIC
 /begin VAR_CHARACTERISTIC TP_U8_MAXIMUM_dP_RISESCAN_F BrkCalVariantCriterion
  /begin VAR_ADDRESS 0x80020491 0x80023891 0x80026C91 0x8002A091 0x8002D491 0x80030891 0x80033C91 0x80037091 /end VAR_ADDRESS
 /end VAR_CHARACTERISTIC
 /begin VAR_CHARACTERISTIC TP_U8_MAXIMUM_dP_RISESCAN_R BrkCalVariantCriterion
  /begin VAR_ADDRESS 0x80020492 0x80023892 0x80026C92 0x8002A092 0x8002D492 0x80030892 0x80033C92 0x80037092 /end VAR_ADDRESS
 /end VAR_CHARACTERISTIC
 /begin VAR_CHARACTERISTIC TP_U8_MAX_VCA_SUSTAIN_SCAN EngCalVariantCriterion
  /begin VAR_ADDRESS 0x8003A257 0x8003B057 0x8003BE57 0x8003CC57 0x8003DA57 0x8003E857 0x8003F657 0x80040457 0x80041257 0x80042057 0x80042E57 0x80043C57 0x80044A57 0x80045857 0x80046657 0x80047457 0x80048257 0x80049057 0x80049E57 0x8004AC57 0x8004BA57 0x8004C857 0x8004D657 0x8004E457 /end VAR_ADDRESS
 /end VAR_CHARACTERISTIC
 /begin VAR_CHARACTERISTIC TP_U8_MINIMUM_dP_RISESCAN_F BrkCalVariantCriterion
  /begin VAR_ADDRESS 0x80020493 0x80023893 0x80026C93 0x8002A093 0x8002D493 0x80030893 0x80033C93 0x80037093 /end VAR_ADDRESS
 /end VAR_CHARACTERISTIC
 /begin VAR_CHARACTERISTIC TP_U8_MINIMUM_dP_RISESCAN_R BrkCalVariantCriterion
  /begin VAR_ADDRESS 0x80020494 0x80023894 0x80026C94 0x8002A094 0x8002D494 0x80030894 0x80033C94 0x80037094 /end VAR_ADDRESS
 /end VAR_CHARACTERISTIC
 /begin VAR_CHARACTERISTIC TP_U8_MIN_DP_RISE_FOR_BUMP_OR_WA BrkCalVariantCriterion
  /begin VAR_ADDRESS 0x800205DD 0x800239DD 0x80026DDD 0x8002A1DD 0x8002D5DD 0x800309DD 0x80033DDD 0x800371DD /end VAR_ADDRESS
 /end VAR_CHARACTERISTIC
 /begin VAR_CHARACTERISTIC TP_U8_MIN_INIT_dP_RISE_AT_LOW_MP_F BrkCalVariantCriterion
  /begin VAR_ADDRESS 0x800205DE 0x800239DE 0x80026DDE 0x8002A1DE 0x8002D5DE 0x800309DE 0x80033DDE 0x800371DE /end VAR_ADDRESS
 /end VAR_CHARACTERISTIC
 /begin VAR_CHARACTERISTIC TP_U8_MIN_INIT_dP_RISE_AT_LOW_MP_R BrkCalVariantCriterion
  /begin VAR_ADDRESS 0x800205DF 0x800239DF 0x80026DDF 0x8002A1DF 0x8002D5DF 0x800309DF 0x80033DDF 0x800371DF /end VAR_ADDRESS
 /end VAR_CHARACTERISTIC
 /begin VAR_CHARACTERISTIC TP_U8_MIN_dP_RISE_AT_LOW_MP_F BrkCalVariantCriterion
  /begin VAR_ADDRESS 0x80020497 0x80023897 0x80026C97 0x8002A097 0x8002D497 0x80030897 0x80033C97 0x80037097 /end VAR_ADDRESS
 /end VAR_CHARACTERISTIC
 /begin VAR_CHARACTERISTIC TP_U8_MIN_dP_RISE_AT_LOW_MP_R BrkCalVariantCriterion
  /begin VAR_ADDRESS 0x80020498 0x80023898 0x80026C98 0x8002A098 0x8002D498 0x80030898 0x80033C98 0x80037098 /end VAR_ADDRESS
 /end VAR_CHARACTERISTIC
 /begin VAR_CHARACTERISTIC TP_U8_MIN_dP_RISE_Bw_15kph_F BrkCalVariantCriterion
  /begin VAR_ADDRESS 0x80020495 0x80023895 0x80026C95 0x8002A095 0x8002D495 0x80030895 0x80033C95 0x80037095 /end VAR_ADDRESS
 /end VAR_CHARACTERISTIC
 /begin VAR_CHARACTERISTIC TP_U8_MIN_dP_RISE_Bw_15kph_R BrkCalVariantCriterion
  /begin VAR_ADDRESS 0x80020496 0x80023896 0x80026C96 0x8002A096 0x8002D496 0x80030896 0x80033C96 0x80037096 /end VAR_ADDRESS
 /end VAR_CHARACTERISTIC
 /begin VAR_CHARACTERISTIC TP_U8_Max_hold_scan_ref BrkCalVariantCriterion
  /begin VAR_ADDRESS 0x800205D4 0x800239D4 0x80026DD4 0x8002A1D4 0x8002D5D4 0x800309D4 0x80033DD4 0x800371D4 /end VAR_ADDRESS
 /end VAR_CHARACTERISTIC
 /begin VAR_CHARACTERISTIC TP_U8_PULSE_HIGH_MU BrkCalVariantCriterion
  /begin VAR_ADDRESS 0x80020216 0x80023616 0x80026A16 0x80029E16 0x8002D216 0x80030616 0x80033A16 0x80036E16 /end VAR_ADDRESS
 /end VAR_CHARACTERISTIC
 /begin VAR_CHARACTERISTIC TP_U8_PULSE_LOW_MED_MU BrkCalVariantCriterion
  /begin VAR_ADDRESS 0x80020217 0x80023617 0x80026A17 0x80029E17 0x8002D217 0x80030617 0x80033A17 0x80036E17 /end VAR_ADDRESS
 /end VAR_CHARACTERISTIC
 /begin VAR_CHARACTERISTIC TP_U8_PULSE_LOW_MU BrkCalVariantCriterion
  /begin VAR_ADDRESS 0x80020218 0x80023618 0x80026A18 0x80029E18 0x8002D218 0x80030618 0x80033A18 0x80036E18 /end VAR_ADDRESS
 /end VAR_CHARACTERISTIC
 /begin VAR_CHARACTERISTIC TP_U8_PULSE_MEDIUM_MU BrkCalVariantCriterion
  /begin VAR_ADDRESS 0x80020219 0x80023619 0x80026A19 0x80029E19 0x8002D219 0x80030619 0x80033A19 0x80036E19 /end VAR_ADDRESS
 /end VAR_CHARACTERISTIC
 /begin VAR_CHARACTERISTIC TP_U8_PULSE_MED_HIGH_MU BrkCalVariantCriterion
  /begin VAR_ADDRESS 0x8002021A 0x8002361A 0x80026A1A 0x80029E1A 0x8002D21A 0x8003061A 0x80033A1A 0x80036E1A /end VAR_ADDRESS
 /end VAR_CHARACTERISTIC
 /begin VAR_CHARACTERISTIC TP_U8_PULSE_UNDER_LOW_MED_MU BrkCalVariantCriterion
  /begin VAR_ADDRESS 0x8002021B 0x8002361B 0x80026A1B 0x80029E1B 0x8002D21B 0x8003061B 0x80033A1B 0x80036E1B /end VAR_ADDRESS
 /end VAR_CHARACTERISTIC
 /begin VAR_CHARACTERISTIC TP_U8_ROUGH_SPEED_LEVEL1 BrkCalVariantCriterion
  /begin VAR_ADDRESS 0x800204CA 0x800238CA 0x80026CCA 0x8002A0CA 0x8002D4CA 0x800308CA 0x80033CCA 0x800370CA /end VAR_ADDRESS
 /end VAR_CHARACTERISTIC
 /begin VAR_CHARACTERISTIC TP_U8_ROUGH_SPEED_LEVEL2 BrkCalVariantCriterion
  /begin VAR_ADDRESS 0x800204CB 0x800238CB 0x80026CCB 0x8002A0CB 0x8002D4CB 0x800308CB 0x80033CCB 0x800370CB /end VAR_ADDRESS
 /end VAR_CHARACTERISTIC
 /begin VAR_CHARACTERISTIC TP_U8_ROUGH_THRES_GAIN_LEVEL2 BrkCalVariantCriterion
  /begin VAR_ADDRESS 0x800204CC 0x800238CC 0x80026CCC 0x8002A0CC 0x8002D4CC 0x800308CC 0x80033CCC 0x800370CC /end VAR_ADDRESS
 /end VAR_CHARACTERISTIC
 /begin VAR_CHARACTERISTIC TP_U8_ROUGH_THRES_GAIN_LEVEL2_R BrkCalVariantCriterion
  /begin VAR_ADDRESS 0x800204CD 0x800238CD 0x80026CCD 0x8002A0CD 0x8002D4CD 0x800308CD 0x80033CCD 0x800370CD /end VAR_ADDRESS
 /end VAR_CHARACTERISTIC
 /begin VAR_CHARACTERISTIC TP_U8_SPEED_TH_VCA EngCalVariantCriterion
  /begin VAR_ADDRESS 0x8003A258 0x8003B058 0x8003BE58 0x8003CC58 0x8003DA58 0x8003E858 0x8003F658 0x80040458 0x80041258 0x80042058 0x80042E58 0x80043C58 0x80044A58 0x80045858 0x80046658 0x80047458 0x80048258 0x80049058 0x80049E58 0x8004AC58 0x8004BA58 0x8004C858 0x8004D658 0x8004E458 /end VAR_ADDRESS
 /end VAR_CHARACTERISTIC
 /begin VAR_CHARACTERISTIC TP_U8_SPIN_TH_VCA EngCalVariantCriterion
  /begin VAR_ADDRESS 0x8003A259 0x8003B059 0x8003BE59 0x8003CC59 0x8003DA59 0x8003E859 0x8003F659 0x80040459 0x80041259 0x80042059 0x80042E59 0x80043C59 0x80044A59 0x80045859 0x80046659 0x80047459 0x80048259 0x80049059 0x80049E59 0x8004AC59 0x8004BA59 0x8004C859 0x8004D659 0x8004E459 /end VAR_ADDRESS
 /end VAR_CHARACTERISTIC
 /begin VAR_CHARACTERISTIC TP_U8_SP_LOW_FRT_DUMPTIM_AFZ BrkCalVariantCriterion
  /begin VAR_ADDRESS 0x800205EA 0x800239EA 0x80026DEA 0x8002A1EA 0x8002D5EA 0x800309EA 0x80033DEA 0x800371EA /end VAR_ADDRESS
 /end VAR_CHARACTERISTIC
 /begin VAR_CHARACTERISTIC TP_U8_SP_LOW_RER_DUMPTIM_AFZ BrkCalVariantCriterion
  /begin VAR_ADDRESS 0x800205EB 0x800239EB 0x80026DEB 0x8002A1EB 0x8002D5EB 0x800309EB 0x80033DEB 0x800371EB /end VAR_ADDRESS
 /end VAR_CHARACTERISTIC
 /begin VAR_CHARACTERISTIC TP_U8_STABDUMP_SCANTIME_F BrkCalVariantCriterion
  /begin VAR_ADDRESS 0x800205E9 0x800239E9 0x80026DE9 0x8002A1E9 0x8002D5E9 0x800309E9 0x80033DE9 0x800371E9 /end VAR_ADDRESS
 /end VAR_CHARACTERISTIC
 /begin VAR_CHARACTERISTIC TP_U8_STB_DMP_MAX_HIGH_BothOverInF BrkCalVariantCriterion
  /begin VAR_ADDRESS 0x80020526 0x80023926 0x80026D26 0x8002A126 0x8002D526 0x80030926 0x80033D26 0x80037126 /end VAR_ADDRESS
 /end VAR_CHARACTERISTIC
 /begin VAR_CHARACTERISTIC TP_U8_STB_DMP_MAX_HIGH_BothOverInR BrkCalVariantCriterion
  /begin VAR_ADDRESS 0x8002052A 0x8002392A 0x80026D2A 0x8002A12A 0x8002D52A 0x8003092A 0x80033D2A 0x8003712A /end VAR_ADDRESS
 /end VAR_CHARACTERISTIC
 /begin VAR_CHARACTERISTIC TP_U8_STB_DMP_MAX_HIGH_OverInF BrkCalVariantCriterion
  /begin VAR_ADDRESS 0x8002051E 0x8002391E 0x80026D1E 0x8002A11E 0x8002D51E 0x8003091E 0x80033D1E 0x8003711E /end VAR_ADDRESS
 /end VAR_CHARACTERISTIC
 /begin VAR_CHARACTERISTIC TP_U8_STB_DMP_MAX_HIGH_OverInR BrkCalVariantCriterion
  /begin VAR_ADDRESS 0x80020522 0x80023922 0x80026D22 0x8002A122 0x8002D522 0x80030922 0x80033D22 0x80037122 /end VAR_ADDRESS
 /end VAR_CHARACTERISTIC
 /begin VAR_CHARACTERISTIC TP_U8_STB_DMP_MAX_HIGH_UnderOutF BrkCalVariantCriterion
  /begin VAR_ADDRESS 0x8002052E 0x8002392E 0x80026D2E 0x8002A12E 0x8002D52E 0x8003092E 0x80033D2E 0x8003712E /end VAR_ADDRESS
 /end VAR_CHARACTERISTIC
 /begin VAR_CHARACTERISTIC TP_U8_STB_DMP_MAX_LOW_BothOverInF BrkCalVariantCriterion
  /begin VAR_ADDRESS 0x80020527 0x80023927 0x80026D27 0x8002A127 0x8002D527 0x80030927 0x80033D27 0x80037127 /end VAR_ADDRESS
 /end VAR_CHARACTERISTIC
 /begin VAR_CHARACTERISTIC TP_U8_STB_DMP_MAX_LOW_BothOverInR BrkCalVariantCriterion
  /begin VAR_ADDRESS 0x8002052B 0x8002392B 0x80026D2B 0x8002A12B 0x8002D52B 0x8003092B 0x80033D2B 0x8003712B /end VAR_ADDRESS
 /end VAR_CHARACTERISTIC
 /begin VAR_CHARACTERISTIC TP_U8_STB_DMP_MAX_LOW_OverInF BrkCalVariantCriterion
  /begin VAR_ADDRESS 0x8002051F 0x8002391F 0x80026D1F 0x8002A11F 0x8002D51F 0x8003091F 0x80033D1F 0x8003711F /end VAR_ADDRESS
 /end VAR_CHARACTERISTIC
 /begin VAR_CHARACTERISTIC TP_U8_STB_DMP_MAX_LOW_OverInR BrkCalVariantCriterion
  /begin VAR_ADDRESS 0x80020523 0x80023923 0x80026D23 0x8002A123 0x8002D523 0x80030923 0x80033D23 0x80037123 /end VAR_ADDRESS
 /end VAR_CHARACTERISTIC
 /begin VAR_CHARACTERISTIC TP_U8_STB_DMP_MAX_LOW_UnderOutF BrkCalVariantCriterion
  /begin VAR_ADDRESS 0x8002052F 0x8002392F 0x80026D2F 0x8002A12F 0x8002D52F 0x8003092F 0x80033D2F 0x8003712F /end VAR_ADDRESS
 /end VAR_CHARACTERISTIC
 /begin VAR_CHARACTERISTIC TP_U8_STB_DMP_MAX_MED_BothOverInF BrkCalVariantCriterion
  /begin VAR_ADDRESS 0x80020528 0x80023928 0x80026D28 0x8002A128 0x8002D528 0x80030928 0x80033D28 0x80037128 /end VAR_ADDRESS
 /end VAR_CHARACTERISTIC
 /begin VAR_CHARACTERISTIC TP_U8_STB_DMP_MAX_MED_BothOverInR BrkCalVariantCriterion
  /begin VAR_ADDRESS 0x8002052C 0x8002392C 0x80026D2C 0x8002A12C 0x8002D52C 0x8003092C 0x80033D2C 0x8003712C /end VAR_ADDRESS
 /end VAR_CHARACTERISTIC
 /begin VAR_CHARACTERISTIC TP_U8_STB_DMP_MAX_MED_OverInF BrkCalVariantCriterion
  /begin VAR_ADDRESS 0x80020520 0x80023920 0x80026D20 0x8002A120 0x8002D520 0x80030920 0x80033D20 0x80037120 /end VAR_ADDRESS
 /end VAR_CHARACTERISTIC
 /begin VAR_CHARACTERISTIC TP_U8_STB_DMP_MAX_MED_OverInR BrkCalVariantCriterion
  /begin VAR_ADDRESS 0x80020524 0x80023924 0x80026D24 0x8002A124 0x8002D524 0x80030924 0x80033D24 0x80037124 /end VAR_ADDRESS
 /end VAR_CHARACTERISTIC
 /begin VAR_CHARACTERISTIC TP_U8_STB_DMP_MAX_MED_UnderOutF BrkCalVariantCriterion
  /begin VAR_ADDRESS 0x80020530 0x80023930 0x80026D30 0x8002A130 0x8002D530 0x80030930 0x80033D30 0x80037130 /end VAR_ADDRESS
 /end VAR_CHARACTERISTIC
 /begin VAR_CHARACTERISTIC TP_U8_STB_DMP_MAX_SP_BothOverInF BrkCalVariantCriterion
  /begin VAR_ADDRESS 0x80020529 0x80023929 0x80026D29 0x8002A129 0x8002D529 0x80030929 0x80033D29 0x80037129 /end VAR_ADDRESS
 /end VAR_CHARACTERISTIC
 /begin VAR_CHARACTERISTIC TP_U8_STB_DMP_MAX_SP_BothOverInR BrkCalVariantCriterion
  /begin VAR_ADDRESS 0x8002052D 0x8002392D 0x80026D2D 0x8002A12D 0x8002D52D 0x8003092D 0x80033D2D 0x8003712D /end VAR_ADDRESS
 /end VAR_CHARACTERISTIC
 /begin VAR_CHARACTERISTIC TP_U8_STB_DMP_MAX_SP_OverInF BrkCalVariantCriterion
  /begin VAR_ADDRESS 0x80020521 0x80023921 0x80026D21 0x8002A121 0x8002D521 0x80030921 0x80033D21 0x80037121 /end VAR_ADDRESS
 /end VAR_CHARACTERISTIC
 /begin VAR_CHARACTERISTIC TP_U8_STB_DMP_MAX_SP_OverInR BrkCalVariantCriterion
  /begin VAR_ADDRESS 0x80020525 0x80023925 0x80026D25 0x8002A125 0x8002D525 0x80030925 0x80033D25 0x80037125 /end VAR_ADDRESS
 /end VAR_CHARACTERISTIC
 /begin VAR_CHARACTERISTIC TP_U8_STB_DMP_MAX_SP_UnderOutF BrkCalVariantCriterion
  /begin VAR_ADDRESS 0x80020531 0x80023931 0x80026D31 0x8002A131 0x8002D531 0x80030931 0x80033D31 0x80037131 /end VAR_ADDRESS
 /end VAR_CHARACTERISTIC
 /begin VAR_CHARACTERISTIC TP_U8_TCS_MOVING_WINDOW_LENGTH EngCalVariantCriterion
  /begin VAR_ADDRESS 0x8003A25A 0x8003B05A 0x8003BE5A 0x8003CC5A 0x8003DA5A 0x8003E85A 0x8003F65A 0x8004045A 0x8004125A 0x8004205A 0x80042E5A 0x80043C5A 0x80044A5A 0x8004585A 0x8004665A 0x8004745A 0x8004825A 0x8004905A 0x80049E5A 0x8004AC5A 0x8004BA5A 0x8004C85A 0x8004D65A 0x8004E45A /end VAR_ADDRESS
 /end VAR_CHARACTERISTIC
 /begin VAR_CHARACTERISTIC TP_U8_TCS_VCA_REENGAGE_ALLOW_TIME EngCalVariantCriterion
  /begin VAR_ADDRESS 0x8003A25B 0x8003B05B 0x8003BE5B 0x8003CC5B 0x8003DA5B 0x8003E85B 0x8003F65B 0x8004045B 0x8004125B 0x8004205B 0x80042E5B 0x80043C5B 0x80044A5B 0x8004585B 0x8004665B 0x8004745B 0x8004825B 0x8004905B 0x80049E5B 0x8004AC5B 0x8004BA5B 0x8004C85B 0x8004D65B 0x8004E45B /end VAR_ADDRESS
 /end VAR_CHARACTERISTIC
 /begin VAR_CHARACTERISTIC TP_U8_TCS_VIB_AMPLITUDE_ENTER EngCalVariantCriterion
  /begin VAR_ADDRESS 0x8003A25C 0x8003B05C 0x8003BE5C 0x8003CC5C 0x8003DA5C 0x8003E85C 0x8003F65C 0x8004045C 0x8004125C 0x8004205C 0x80042E5C 0x80043C5C 0x80044A5C 0x8004585C 0x8004665C 0x8004745C 0x8004825C 0x8004905C 0x80049E5C 0x8004AC5C 0x8004BA5C 0x8004C85C 0x8004D65C 0x8004E45C /end VAR_ADDRESS
 /end VAR_CHARACTERISTIC
 /begin VAR_CHARACTERISTIC TP_U8_TCS_VIB_AMPLITUDE_OUT EngCalVariantCriterion
  /begin VAR_ADDRESS 0x8003A25D 0x8003B05D 0x8003BE5D 0x8003CC5D 0x8003DA5D 0x8003E85D 0x8003F65D 0x8004045D 0x8004125D 0x8004205D 0x80042E5D 0x80043C5D 0x80044A5D 0x8004585D 0x8004665D 0x8004745D 0x8004825D 0x8004905D 0x80049E5D 0x8004AC5D 0x8004BA5D 0x8004C85D 0x8004D65D 0x8004E45D /end VAR_ADDRESS
 /end VAR_CHARACTERISTIC
 /begin VAR_CHARACTERISTIC TP_U8_TCS_VIB_BRK_CTL_PERIOD EngCalVariantCriterion
  /begin VAR_ADDRESS 0x8003A25E 0x8003B05E 0x8003BE5E 0x8003CC5E 0x8003DA5E 0x8003E85E 0x8003F65E 0x8004045E 0x8004125E 0x8004205E 0x80042E5E 0x80043C5E 0x80044A5E 0x8004585E 0x8004665E 0x8004745E 0x8004825E 0x8004905E 0x80049E5E 0x8004AC5E 0x8004BA5E 0x8004C85E 0x8004D65E 0x8004E45E /end VAR_ADDRESS
 /end VAR_CHARACTERISTIC
 /begin VAR_CHARACTERISTIC TP_U8_TCS_VIB_CNT_SCAN EngCalVariantCriterion
  /begin VAR_ADDRESS 0x8003A25F 0x8003B05F 0x8003BE5F 0x8003CC5F 0x8003DA5F 0x8003E85F 0x8003F65F 0x8004045F 0x8004125F 0x8004205F 0x80042E5F 0x80043C5F 0x80044A5F 0x8004585F 0x8004665F 0x8004745F 0x8004825F 0x8004905F 0x80049E5F 0x8004AC5F 0x8004BA5F 0x8004C85F 0x8004D65F 0x8004E45F /end VAR_ADDRESS
 /end VAR_CHARACTERISTIC
 /begin VAR_CHARACTERISTIC TP_U8_TCS_VIB_FLAG_ENTER_CYCLE EngCalVariantCriterion
  /begin VAR_ADDRESS 0x8003A260 0x8003B060 0x8003BE60 0x8003CC60 0x8003DA60 0x8003E860 0x8003F660 0x80040460 0x80041260 0x80042060 0x80042E60 0x80043C60 0x80044A60 0x80045860 0x80046660 0x80047460 0x80048260 0x80049060 0x80049E60 0x8004AC60 0x8004BA60 0x8004C860 0x8004D660 0x8004E460 /end VAR_ADDRESS
 /end VAR_CHARACTERISTIC
 /begin VAR_CHARACTERISTIC TP_U8_TCS_VIB_FLAG_OUT_CYCLE EngCalVariantCriterion
  /begin VAR_ADDRESS 0x8003A261 0x8003B061 0x8003BE61 0x8003CC61 0x8003DA61 0x8003E861 0x8003F661 0x80040461 0x80041261 0x80042061 0x80042E61 0x80043C61 0x80044A61 0x80045861 0x80046661 0x80047461 0x80048261 0x80049061 0x80049E61 0x8004AC61 0x8004BA61 0x8004C861 0x8004D661 0x8004E461 /end VAR_ADDRESS
 /end VAR_CHARACTERISTIC
 /begin VAR_CHARACTERISTIC TP_U8_TCS_VIB_FREQUENCY_ENTER EngCalVariantCriterion
  /begin VAR_ADDRESS 0x8003A262 0x8003B062 0x8003BE62 0x8003CC62 0x8003DA62 0x8003E862 0x8003F662 0x80040462 0x80041262 0x80042062 0x80042E62 0x80043C62 0x80044A62 0x80045862 0x80046662 0x80047462 0x80048262 0x80049062 0x80049E62 0x8004AC62 0x8004BA62 0x8004C862 0x8004D662 0x8004E462 /end VAR_ADDRESS
 /end VAR_CHARACTERISTIC
 /begin VAR_CHARACTERISTIC TP_U8_TCS_VIB_FREQUENCY_OUT EngCalVariantCriterion
  /begin VAR_ADDRESS 0x8003A263 0x8003B063 0x8003BE63 0x8003CC63 0x8003DA63 0x8003E863 0x8003F663 0x80040463 0x80041263 0x80042063 0x80042E63 0x80043C63 0x80044A63 0x80045863 0x80046663 0x80047463 0x80048263 0x80049063 0x80049E63 0x8004AC63 0x8004BA63 0x8004C863 0x8004D663 0x8004E463 /end VAR_ADDRESS
 /end VAR_CHARACTERISTIC
 /begin VAR_CHARACTERISTIC TP_U8_TCS_VIB_FREQUENCY_THR EngCalVariantCriterion
  /begin VAR_ADDRESS 0x8003A264 0x8003B064 0x8003BE64 0x8003CC64 0x8003DA64 0x8003E864 0x8003F664 0x80040464 0x80041264 0x80042064 0x80042E64 0x80043C64 0x80044A64 0x80045864 0x80046664 0x80047464 0x80048264 0x80049064 0x80049E64 0x8004AC64 0x8004BA64 0x8004C864 0x8004D664 0x8004E464 /end VAR_ADDRESS
 /end VAR_CHARACTERISTIC
 /begin VAR_CHARACTERISTIC TP_U8_TCS_VIB_OVERFLOW_SCAN EngCalVariantCriterion
  /begin VAR_ADDRESS 0x8003A265 0x8003B065 0x8003BE65 0x8003CC65 0x8003DA65 0x8003E865 0x8003F665 0x80040465 0x80041265 0x80042065 0x80042E65 0x80043C65 0x80044A65 0x80045865 0x80046665 0x80047465 0x80048265 0x80049065 0x80049E65 0x8004AC65 0x8004BA65 0x8004C865 0x8004D665 0x8004E465 /end VAR_ADDRESS
 /end VAR_CHARACTERISTIC
 /begin VAR_CHARACTERISTIC TP_U8_TCS_VIB_REFERENCE_VREF_ENTER EngCalVariantCriterion
  /begin VAR_ADDRESS 0x8003A266 0x8003B066 0x8003BE66 0x8003CC66 0x8003DA66 0x8003E866 0x8003F666 0x80040466 0x80041266 0x80042066 0x80042E66 0x80043C66 0x80044A66 0x80045866 0x80046666 0x80047466 0x80048266 0x80049066 0x80049E66 0x8004AC66 0x8004BA66 0x8004C866 0x8004D666 0x8004E466 /end VAR_ADDRESS
 /end VAR_CHARACTERISTIC
 /begin VAR_CHARACTERISTIC TP_U8_TCS_VIB_REFERENCE_VREF_OUT EngCalVariantCriterion
  /begin VAR_ADDRESS 0x8003A267 0x8003B067 0x8003BE67 0x8003CC67 0x8003DA67 0x8003E867 0x8003F667 0x80040467 0x80041267 0x80042067 0x80042E67 0x80043C67 0x80044A67 0x80045867 0x80046667 0x80047467 0x80048267 0x80049067 0x80049E67 0x8004AC67 0x8004BA67 0x8004C867 0x8004D667 0x8004E467 /end VAR_ADDRESS
 /end VAR_CHARACTERISTIC
 /begin VAR_CHARACTERISTIC TP_U8_TCS_VIB_TIMESHIFT_SCAN_TCMF EngCalVariantCriterion
  /begin VAR_ADDRESS 0x8003A268 0x8003B068 0x8003BE68 0x8003CC68 0x8003DA68 0x8003E868 0x8003F668 0x80040468 0x80041268 0x80042068 0x80042E68 0x80043C68 0x80044A68 0x80045868 0x80046668 0x80047468 0x80048268 0x80049068 0x80049E68 0x8004AC68 0x8004BA68 0x8004C868 0x8004D668 0x8004E468 /end VAR_ADDRESS
 /end VAR_CHARACTERISTIC
 /begin VAR_CHARACTERISTIC TP_U8_TOD_MODE_CST_OVER1 EngCalVariantCriterion
  /begin VAR_ADDRESS 0x8003A6CA 0x8003B4CA 0x8003C2CA 0x8003D0CA 0x8003DECA 0x8003ECCA 0x8003FACA 0x800408CA 0x800416CA 0x800424CA 0x800432CA 0x800440CA 0x80044ECA 0x80045CCA 0x80046ACA 0x800478CA 0x800486CA 0x800494CA 0x8004A2CA 0x8004B0CA 0x8004BECA 0x8004CCCA 0x8004DACA 0x8004E8CA /end VAR_ADDRESS
 /end VAR_CHARACTERISTIC
 /begin VAR_CHARACTERISTIC TP_U8_TOD_MODE_CST_OVER2 EngCalVariantCriterion
  /begin VAR_ADDRESS 0x8003A6CB 0x8003B4CB 0x8003C2CB 0x8003D0CB 0x8003DECB 0x8003ECCB 0x8003FACB 0x800408CB 0x800416CB 0x800424CB 0x800432CB 0x800440CB 0x80044ECB 0x80045CCB 0x80046ACB 0x800478CB 0x800486CB 0x800494CB 0x8004A2CB 0x8004B0CB 0x8004BECB 0x8004CCCB 0x8004DACB 0x8004E8CB /end VAR_ADDRESS
 /end VAR_CHARACTERISTIC
 /begin VAR_CHARACTERISTIC TP_U8_TOD_MODE_CST_STABL EngCalVariantCriterion
  /begin VAR_ADDRESS 0x8003A6CC 0x8003B4CC 0x8003C2CC 0x8003D0CC 0x8003DECC 0x8003ECCC 0x8003FACC 0x800408CC 0x800416CC 0x800424CC 0x800432CC 0x800440CC 0x80044ECC 0x80045CCC 0x80046ACC 0x800478CC 0x800486CC 0x800494CC 0x8004A2CC 0x8004B0CC 0x8004BECC 0x8004CCCC 0x8004DACC 0x8004E8CC /end VAR_ADDRESS
 /end VAR_CHARACTERISTIC
 /begin VAR_CHARACTERISTIC TP_U8_TOD_MODE_CST_UNDER1 EngCalVariantCriterion
  /begin VAR_ADDRESS 0x8003A6CD 0x8003B4CD 0x8003C2CD 0x8003D0CD 0x8003DECD 0x8003ECCD 0x8003FACD 0x800408CD 0x800416CD 0x800424CD 0x800432CD 0x800440CD 0x80044ECD 0x80045CCD 0x80046ACD 0x800478CD 0x800486CD 0x800494CD 0x8004A2CD 0x8004B0CD 0x8004BECD 0x8004CCCD 0x8004DACD 0x8004E8CD /end VAR_ADDRESS
 /end VAR_CHARACTERISTIC
 /begin VAR_CHARACTERISTIC TP_U8_TOD_MODE_CST_UNDER2 EngCalVariantCriterion
  /begin VAR_ADDRESS 0x8003A6CE 0x8003B4CE 0x8003C2CE 0x8003D0CE 0x8003DECE 0x8003ECCE 0x8003FACE 0x800408CE 0x800416CE 0x800424CE 0x800432CE 0x800440CE 0x80044ECE 0x80045CCE 0x80046ACE 0x800478CE 0x800486CE 0x800494CE 0x8004A2CE 0x8004B0CE 0x8004BECE 0x8004CCCE 0x8004DACE 0x8004E8CE /end VAR_ADDRESS
 /end VAR_CHARACTERISTIC
 /begin VAR_CHARACTERISTIC TP_U8_TOD_MODE_HOT_OVER1 EngCalVariantCriterion
  /begin VAR_ADDRESS 0x8003A6CF 0x8003B4CF 0x8003C2CF 0x8003D0CF 0x8003DECF 0x8003ECCF 0x8003FACF 0x800408CF 0x800416CF 0x800424CF 0x800432CF 0x800440CF 0x80044ECF 0x80045CCF 0x80046ACF 0x800478CF 0x800486CF 0x800494CF 0x8004A2CF 0x8004B0CF 0x8004BECF 0x8004CCCF 0x8004DACF 0x8004E8CF /end VAR_ADDRESS
 /end VAR_CHARACTERISTIC
 /begin VAR_CHARACTERISTIC TP_U8_TOD_MODE_HOT_OVER2 EngCalVariantCriterion
  /begin VAR_ADDRESS 0x8003A6D0 0x8003B4D0 0x8003C2D0 0x8003D0D0 0x8003DED0 0x8003ECD0 0x8003FAD0 0x800408D0 0x800416D0 0x800424D0 0x800432D0 0x800440D0 0x80044ED0 0x80045CD0 0x80046AD0 0x800478D0 0x800486D0 0x800494D0 0x8004A2D0 0x8004B0D0 0x8004BED0 0x8004CCD0 0x8004DAD0 0x8004E8D0 /end VAR_ADDRESS
 /end VAR_CHARACTERISTIC
 /begin VAR_CHARACTERISTIC TP_U8_TOD_MODE_HOT_STABL EngCalVariantCriterion
  /begin VAR_ADDRESS 0x8003A6D1 0x8003B4D1 0x8003C2D1 0x8003D0D1 0x8003DED1 0x8003ECD1 0x8003FAD1 0x800408D1 0x800416D1 0x800424D1 0x800432D1 0x800440D1 0x80044ED1 0x80045CD1 0x80046AD1 0x800478D1 0x800486D1 0x800494D1 0x8004A2D1 0x8004B0D1 0x8004BED1 0x8004CCD1 0x8004DAD1 0x8004E8D1 /end VAR_ADDRESS
 /end VAR_CHARACTERISTIC
 /begin VAR_CHARACTERISTIC TP_U8_TOD_MODE_HOT_UNDER1 EngCalVariantCriterion
  /begin VAR_ADDRESS 0x8003A6D2 0x8003B4D2 0x8003C2D2 0x8003D0D2 0x8003DED2 0x8003ECD2 0x8003FAD2 0x800408D2 0x800416D2 0x800424D2 0x800432D2 0x800440D2 0x80044ED2 0x80045CD2 0x80046AD2 0x800478D2 0x800486D2 0x800494D2 0x8004A2D2 0x8004B0D2 0x8004BED2 0x8004CCD2 0x8004DAD2 0x8004E8D2 /end VAR_ADDRESS
 /end VAR_CHARACTERISTIC
 /begin VAR_CHARACTERISTIC TP_U8_TOD_MODE_HOT_UNDER2 EngCalVariantCriterion
  /begin VAR_ADDRESS 0x8003A6D3 0x8003B4D3 0x8003C2D3 0x8003D0D3 0x8003DED3 0x8003ECD3 0x8003FAD3 0x800408D3 0x800416D3 0x800424D3 0x800432D3 0x800440D3 0x80044ED3 0x80045CD3 0x80046AD3 0x800478D3 0x800486D3 0x800494D3 0x8004A2D3 0x8004B0D3 0x8004BED3 0x8004CCD3 0x8004DAD3 0x8004E8D3 /end VAR_ADDRESS
 /end VAR_CHARACTERISTIC
 /begin VAR_CHARACTERISTIC TP_U8_TOD_MODE_WOT_OVER1 EngCalVariantCriterion
  /begin VAR_ADDRESS 0x8003A6D4 0x8003B4D4 0x8003C2D4 0x8003D0D4 0x8003DED4 0x8003ECD4 0x8003FAD4 0x800408D4 0x800416D4 0x800424D4 0x800432D4 0x800440D4 0x80044ED4 0x80045CD4 0x80046AD4 0x800478D4 0x800486D4 0x800494D4 0x8004A2D4 0x8004B0D4 0x8004BED4 0x8004CCD4 0x8004DAD4 0x8004E8D4 /end VAR_ADDRESS
 /end VAR_CHARACTERISTIC
 /begin VAR_CHARACTERISTIC TP_U8_TOD_MODE_WOT_OVER2 EngCalVariantCriterion
  /begin VAR_ADDRESS 0x8003A6D5 0x8003B4D5 0x8003C2D5 0x8003D0D5 0x8003DED5 0x8003ECD5 0x8003FAD5 0x800408D5 0x800416D5 0x800424D5 0x800432D5 0x800440D5 0x80044ED5 0x80045CD5 0x80046AD5 0x800478D5 0x800486D5 0x800494D5 0x8004A2D5 0x8004B0D5 0x8004BED5 0x8004CCD5 0x8004DAD5 0x8004E8D5 /end VAR_ADDRESS
 /end VAR_CHARACTERISTIC
 /begin VAR_CHARACTERISTIC TP_U8_TOD_MODE_WOT_STABL EngCalVariantCriterion
  /begin VAR_ADDRESS 0x8003A6D6 0x8003B4D6 0x8003C2D6 0x8003D0D6 0x8003DED6 0x8003ECD6 0x8003FAD6 0x800408D6 0x800416D6 0x800424D6 0x800432D6 0x800440D6 0x80044ED6 0x80045CD6 0x80046AD6 0x800478D6 0x800486D6 0x800494D6 0x8004A2D6 0x8004B0D6 0x8004BED6 0x8004CCD6 0x8004DAD6 0x8004E8D6 /end VAR_ADDRESS
 /end VAR_CHARACTERISTIC
 /begin VAR_CHARACTERISTIC TP_U8_TOD_MODE_WOT_UNDER1 EngCalVariantCriterion
  /begin VAR_ADDRESS 0x8003A6D7 0x8003B4D7 0x8003C2D7 0x8003D0D7 0x8003DED7 0x8003ECD7 0x8003FAD7 0x800408D7 0x800416D7 0x800424D7 0x800432D7 0x800440D7 0x80044ED7 0x80045CD7 0x80046AD7 0x800478D7 0x800486D7 0x800494D7 0x8004A2D7 0x8004B0D7 0x8004BED7 0x8004CCD7 0x8004DAD7 0x8004E8D7 /end VAR_ADDRESS
 /end VAR_CHARACTERISTIC
 /begin VAR_CHARACTERISTIC TP_U8_TOD_MODE_WOT_UNDER2 EngCalVariantCriterion
  /begin VAR_ADDRESS 0x8003A6D8 0x8003B4D8 0x8003C2D8 0x8003D0D8 0x8003DED8 0x8003ECD8 0x8003FAD8 0x800408D8 0x800416D8 0x800424D8 0x800432D8 0x800440D8 0x80044ED8 0x80045CD8 0x80046AD8 0x800478D8 0x800486D8 0x800494D8 0x8004A2D8 0x8004B0D8 0x8004BED8 0x8004CCD8 0x8004DAD8 0x8004E8D8 /end VAR_ADDRESS
 /end VAR_CHARACTERISTIC
 /begin VAR_CHARACTERISTIC TP_U8_TOD_MTP_THR EngCalVariantCriterion
  /begin VAR_ADDRESS 0x8003A6D9 0x8003B4D9 0x8003C2D9 0x8003D0D9 0x8003DED9 0x8003ECD9 0x8003FAD9 0x800408D9 0x800416D9 0x800424D9 0x800432D9 0x800440D9 0x80044ED9 0x80045CD9 0x80046AD9 0x800478D9 0x800486D9 0x800494D9 0x8004A2D9 0x8004B0D9 0x8004BED9 0x8004CCD9 0x8004DAD9 0x8004E8D9 /end VAR_ADDRESS
 /end VAR_CHARACTERISTIC
 /begin VAR_CHARACTERISTIC TP_U8_TOD_OVER_THR_G1 EngCalVariantCriterion
  /begin VAR_ADDRESS 0x8003A6DA 0x8003B4DA 0x8003C2DA 0x8003D0DA 0x8003DEDA 0x8003ECDA 0x8003FADA 0x800408DA 0x800416DA 0x800424DA 0x800432DA 0x800440DA 0x80044EDA 0x80045CDA 0x80046ADA 0x800478DA 0x800486DA 0x800494DA 0x8004A2DA 0x8004B0DA 0x8004BEDA 0x8004CCDA 0x8004DADA 0x8004E8DA /end VAR_ADDRESS
 /end VAR_CHARACTERISTIC
 /begin VAR_CHARACTERISTIC TP_U8_TOD_OVER_THR_G2 EngCalVariantCriterion
  /begin VAR_ADDRESS 0x8003A6DB 0x8003B4DB 0x8003C2DB 0x8003D0DB 0x8003DEDB 0x8003ECDB 0x8003FADB 0x800408DB 0x800416DB 0x800424DB 0x800432DB 0x800440DB 0x80044EDB 0x80045CDB 0x80046ADB 0x800478DB 0x800486DB 0x800494DB 0x8004A2DB 0x8004B0DB 0x8004BEDB 0x8004CCDB 0x8004DADB 0x8004E8DB /end VAR_ADDRESS
 /end VAR_CHARACTERISTIC
 /begin VAR_CHARACTERISTIC TP_U8_TOD_UNDER_THR_G1 EngCalVariantCriterion
  /begin VAR_ADDRESS 0x8003A6DC 0x8003B4DC 0x8003C2DC 0x8003D0DC 0x8003DEDC 0x8003ECDC 0x8003FADC 0x800408DC 0x800416DC 0x800424DC 0x800432DC 0x800440DC 0x80044EDC 0x80045CDC 0x80046ADC 0x800478DC 0x800486DC 0x800494DC 0x8004A2DC 0x8004B0DC 0x8004BEDC 0x8004CCDC 0x8004DADC 0x8004E8DC /end VAR_ADDRESS
 /end VAR_CHARACTERISTIC
 /begin VAR_CHARACTERISTIC TP_U8_TOD_UNDER_THR_G2 EngCalVariantCriterion
  /begin VAR_ADDRESS 0x8003A6DD 0x8003B4DD 0x8003C2DD 0x8003D0DD 0x8003DEDD 0x8003ECDD 0x8003FADD 0x800408DD 0x800416DD 0x800424DD 0x800432DD 0x800440DD 0x80044EDD 0x80045CDD 0x80046ADD 0x800478DD 0x800486DD 0x800494DD 0x8004A2DD 0x8004B0DD 0x8004BEDD 0x8004CCDD 0x8004DADD 0x8004E8DD /end VAR_ADDRESS
 /end VAR_CHARACTERISTIC
 /begin VAR_CHARACTERISTIC TP_U8_TORQ_HOLD_LV_IN_EDC_S1 EngCalVariantCriterion
  /begin VAR_ADDRESS 0x8003A130 0x8003AF30 0x8003BD30 0x8003CB30 0x8003D930 0x8003E730 0x8003F530 0x80040330 0x80041130 0x80041F30 0x80042D30 0x80043B30 0x80044930 0x80045730 0x80046530 0x80047330 0x80048130 0x80048F30 0x80049D30 0x8004AB30 0x8004B930 0x8004C730 0x8004D530 0x8004E330 /end VAR_ADDRESS
 /end VAR_CHARACTERISTIC
 /begin VAR_CHARACTERISTIC TP_U8_TORQ_HOLD_LV_IN_EDC_S2 EngCalVariantCriterion
  /begin VAR_ADDRESS 0x8003A131 0x8003AF31 0x8003BD31 0x8003CB31 0x8003D931 0x8003E731 0x8003F531 0x80040331 0x80041131 0x80041F31 0x80042D31 0x80043B31 0x80044931 0x80045731 0x80046531 0x80047331 0x80048131 0x80048F31 0x80049D31 0x8004AB31 0x8004B931 0x8004C731 0x8004D531 0x8004E331 /end VAR_ADDRESS
 /end VAR_CHARACTERISTIC
 /begin VAR_CHARACTERISTIC TP_U8_TORQ_HOLD_LV_IN_EDC_S3 EngCalVariantCriterion
  /begin VAR_ADDRESS 0x8003A132 0x8003AF32 0x8003BD32 0x8003CB32 0x8003D932 0x8003E732 0x8003F532 0x80040332 0x80041132 0x80041F32 0x80042D32 0x80043B32 0x80044932 0x80045732 0x80046532 0x80047332 0x80048132 0x80048F32 0x80049D32 0x8004AB32 0x8004B932 0x8004C732 0x8004D532 0x8004E332 /end VAR_ADDRESS
 /end VAR_CHARACTERISTIC
 /begin VAR_CHARACTERISTIC TP_U8_TORQ_HOLD_LV_IN_EDC_S4 EngCalVariantCriterion
  /begin VAR_ADDRESS 0x8003A133 0x8003AF33 0x8003BD33 0x8003CB33 0x8003D933 0x8003E733 0x8003F533 0x80040333 0x80041133 0x80041F33 0x80042D33 0x80043B33 0x80044933 0x80045733 0x80046533 0x80047333 0x80048133 0x80048F33 0x80049D33 0x8004AB33 0x8004B933 0x8004C733 0x8004D533 0x8004E333 /end VAR_ADDRESS
 /end VAR_CHARACTERISTIC
 /begin VAR_CHARACTERISTIC TP_U8_TORQ_UP_LIMIT_ABS EngCalVariantCriterion
  /begin VAR_ADDRESS 0x8003A134 0x8003AF34 0x8003BD34 0x8003CB34 0x8003D934 0x8003E734 0x8003F534 0x80040334 0x80041134 0x80041F34 0x80042D34 0x80043B34 0x80044934 0x80045734 0x80046534 0x80047334 0x80048134 0x80048F34 0x80049D34 0x8004AB34 0x8004B934 0x8004C734 0x8004D534 0x8004E334 /end VAR_ADDRESS
 /end VAR_CHARACTERISTIC
 /begin VAR_CHARACTERISTIC TP_U8_TORQ_UP_LIMIT_ABS_HIGH_MU EngCalVariantCriterion
  /begin VAR_ADDRESS 0x8003A135 0x8003AF35 0x8003BD35 0x8003CB35 0x8003D935 0x8003E735 0x8003F535 0x80040335 0x80041135 0x80041F35 0x80042D35 0x80043B35 0x80044935 0x80045735 0x80046535 0x80047335 0x80048135 0x80048F35 0x80049D35 0x8004AB35 0x8004B935 0x8004C735 0x8004D535 0x8004E335 /end VAR_ADDRESS
 /end VAR_CHARACTERISTIC
 /begin VAR_CHARACTERISTIC TP_U8_TORQ_UP_LIMIT_ESC EngCalVariantCriterion
  /begin VAR_ADDRESS 0x8003A136 0x8003AF36 0x8003BD36 0x8003CB36 0x8003D936 0x8003E736 0x8003F536 0x80040336 0x80041136 0x80041F36 0x80042D36 0x80043B36 0x80044936 0x80045736 0x80046536 0x80047336 0x80048136 0x80048F36 0x80049D36 0x8004AB36 0x8004B936 0x8004C736 0x8004D536 0x8004E336 /end VAR_ADDRESS
 /end VAR_CHARACTERISTIC
 /begin VAR_CHARACTERISTIC TP_U8_TORQ_UP_LIMIT_SOLO EngCalVariantCriterion
  /begin VAR_ADDRESS 0x8003A137 0x8003AF37 0x8003BD37 0x8003CB37 0x8003D937 0x8003E737 0x8003F537 0x80040337 0x80041137 0x80041F37 0x80042D37 0x80043B37 0x80044937 0x80045737 0x80046537 0x80047337 0x80048137 0x80048F37 0x80049D37 0x8004AB37 0x8004B937 0x8004C737 0x8004D537 0x8004E337 /end VAR_ADDRESS
 /end VAR_CHARACTERISTIC
 /begin VAR_CHARACTERISTIC TP_U8_UNSTABLE_RISE_REF_DUMP_1st_F BrkCalVariantCriterion
  /begin VAR_ADDRESS 0x8002041A 0x8002381A 0x80026C1A 0x8002A01A 0x8002D41A 0x8003081A 0x80033C1A 0x8003701A /end VAR_ADDRESS
 /end VAR_CHARACTERISTIC
 /begin VAR_CHARACTERISTIC TP_U8_UNSTABLE_RISE_REF_DUMP_1st_R BrkCalVariantCriterion
  /begin VAR_ADDRESS 0x8002041B 0x8002381B 0x80026C1B 0x8002A01B 0x8002D41B 0x8003081B 0x80033C1B 0x8003701B /end VAR_ADDRESS
 /end VAR_CHARACTERISTIC
 /begin VAR_CHARACTERISTIC TP_U8_UnstableTim_for_IncDumptime BrkCalVariantCriterion
  /begin VAR_ADDRESS 0x800204B7 0x800238B7 0x80026CB7 0x8002A0B7 0x8002D4B7 0x800308B7 0x80033CB7 0x800370B7 /end VAR_ADDRESS
 /end VAR_CHARACTERISTIC
 /begin VAR_CHARACTERISTIC TP_U8_Usage_Level_of_ESC_Sen BrkCalVariantCriterion
  /begin VAR_ADDRESS 0x800204D2 0x800238D2 0x80026CD2 0x8002A0D2 0x8002D4D2 0x800308D2 0x80033CD2 0x800370D2 /end VAR_ADDRESS
 /end VAR_CHARACTERISTIC
 /begin VAR_CHARACTERISTIC TP_U8_VEL_GAP_MOVING_WINDOW_LENGTH EngCalVariantCriterion
  /begin VAR_ADDRESS 0x8003A149 0x8003AF49 0x8003BD49 0x8003CB49 0x8003D949 0x8003E749 0x8003F549 0x80040349 0x80041149 0x80041F49 0x80042D49 0x80043B49 0x80044949 0x80045749 0x80046549 0x80047349 0x80048149 0x80048F49 0x80049D49 0x8004AB49 0x8004B949 0x8004C749 0x8004D549 0x8004E349 /end VAR_ADDRESS
 /end VAR_CHARACTERISTIC
 /begin VAR_CHARACTERISTIC TP_U8_VREF_DECREASE_LIMIT_OF_VCA EngCalVariantCriterion
  /begin VAR_ADDRESS 0x8003A269 0x8003B069 0x8003BE69 0x8003CC69 0x8003DA69 0x8003E869 0x8003F669 0x80040469 0x80041269 0x80042069 0x80042E69 0x80043C69 0x80044A69 0x80045869 0x80046669 0x80047469 0x80048269 0x80049069 0x80049E69 0x8004AC69 0x8004BA69 0x8004C869 0x8004D669 0x8004E469 /end VAR_ADDRESS
 /end VAR_CHARACTERISTIC
 /begin VAR_CHARACTERISTIC TP_U8_YDF_DUMPHOLD_T_AT_DEC_L1 BrkCalVariantCriterion
  /begin VAR_ADDRESS 0x8002050C 0x8002390C 0x80026D0C 0x8002A10C 0x8002D50C 0x8003090C 0x80033D0C 0x8003710C /end VAR_ADDRESS
 /end VAR_CHARACTERISTIC
 /begin VAR_CHARACTERISTIC TP_U8_YDF_DUMPHOLD_T_AT_DEC_L2 BrkCalVariantCriterion
  /begin VAR_ADDRESS 0x8002050D 0x8002390D 0x80026D0D 0x8002A10D 0x8002D50D 0x8003090D 0x80033D0D 0x8003710D /end VAR_ADDRESS
 /end VAR_CHARACTERISTIC
 /begin VAR_CHARACTERISTIC TP_U8_YDF_DUMPHOLD_T_AT_DEC_L3 BrkCalVariantCriterion
  /begin VAR_ADDRESS 0x8002050E 0x8002390E 0x80026D0E 0x8002A10E 0x8002D50E 0x8003090E 0x80033D0E 0x8003710E /end VAR_ADDRESS
 /end VAR_CHARACTERISTIC
 /begin VAR_CHARACTERISTIC TP_U8_YDF_DUMPHOLD_T_MAX BrkCalVariantCriterion
  /begin VAR_ADDRESS 0x8002050F 0x8002390F 0x80026D0F 0x8002A10F 0x8002D50F 0x8003090F 0x80033D0F 0x8003710F /end VAR_ADDRESS
 /end VAR_CHARACTERISTIC
 /begin VAR_CHARACTERISTIC TP_U8_YDF_RISEHOLD_T_AT_INC_L1 BrkCalVariantCriterion
  /begin VAR_ADDRESS 0x80020516 0x80023916 0x80026D16 0x8002A116 0x8002D516 0x80030916 0x80033D16 0x80037116 /end VAR_ADDRESS
 /end VAR_CHARACTERISTIC
 /begin VAR_CHARACTERISTIC TP_U8_YDF_RISEHOLD_T_AT_INC_L2 BrkCalVariantCriterion
  /begin VAR_ADDRESS 0x80020517 0x80023917 0x80026D17 0x8002A117 0x8002D517 0x80030917 0x80033D17 0x80037117 /end VAR_ADDRESS
 /end VAR_CHARACTERISTIC
 /begin VAR_CHARACTERISTIC TP_U8_YDF_RISEHOLD_T_AT_TARGETDYAW BrkCalVariantCriterion
  /begin VAR_ADDRESS 0x80020518 0x80023918 0x80026D18 0x8002A118 0x8002D518 0x80030918 0x80033D18 0x80037118 /end VAR_ADDRESS
 /end VAR_CHARACTERISTIC
 /begin VAR_CHARACTERISTIC TP_U8_YDF_RISEHOLD_T_MAX BrkCalVariantCriterion
  /begin VAR_ADDRESS 0x80020519 0x80023919 0x80026D19 0x8002A119 0x8002D519 0x80030919 0x80033D19 0x80037119 /end VAR_ADDRESS
 /end VAR_CHARACTERISTIC
 /begin VAR_CHARACTERISTIC TP_U8_dPTim_Dump_Ref_Ab_HMu_1_F BrkCalVariantCriterion
  /begin VAR_ADDRESS 0x8002043A 0x8002383A 0x80026C3A 0x8002A03A 0x8002D43A 0x8003083A 0x80033C3A 0x8003703A /end VAR_ADDRESS
 /end VAR_CHARACTERISTIC
 /begin VAR_CHARACTERISTIC TP_U8_dPTim_Dump_Ref_Ab_HMu_1_R BrkCalVariantCriterion
  /begin VAR_ADDRESS 0x80020441 0x80023841 0x80026C41 0x8002A041 0x8002D441 0x80030841 0x80033C41 0x80037041 /end VAR_ADDRESS
 /end VAR_CHARACTERISTIC
 /begin VAR_CHARACTERISTIC TP_U8_dPTim_Dump_Ref_Ab_HMu_2_F BrkCalVariantCriterion
  /begin VAR_ADDRESS 0x8002043B 0x8002383B 0x80026C3B 0x8002A03B 0x8002D43B 0x8003083B 0x80033C3B 0x8003703B /end VAR_ADDRESS
 /end VAR_CHARACTERISTIC
 /begin VAR_CHARACTERISTIC TP_U8_dPTim_Dump_Ref_Ab_HMu_2_R BrkCalVariantCriterion
  /begin VAR_ADDRESS 0x80020442 0x80023842 0x80026C42 0x8002A042 0x8002D442 0x80030842 0x80033C42 0x80037042 /end VAR_ADDRESS
 /end VAR_CHARACTERISTIC
 /begin VAR_CHARACTERISTIC TP_U8_dPTim_Dump_Ref_Ab_HMu_3_F BrkCalVariantCriterion
  /begin VAR_ADDRESS 0x8002043C 0x8002383C 0x80026C3C 0x8002A03C 0x8002D43C 0x8003083C 0x80033C3C 0x8003703C /end VAR_ADDRESS
 /end VAR_CHARACTERISTIC
 /begin VAR_CHARACTERISTIC TP_U8_dPTim_Dump_Ref_Ab_HMu_3_R BrkCalVariantCriterion
  /begin VAR_ADDRESS 0x80020443 0x80023843 0x80026C43 0x8002A043 0x8002D443 0x80030843 0x80033C43 0x80037043 /end VAR_ADDRESS
 /end VAR_CHARACTERISTIC
 /begin VAR_CHARACTERISTIC TP_U8_dPTim_Dump_Ref_Bw_LMu_1_F BrkCalVariantCriterion
  /begin VAR_ADDRESS 0x80020480 0x80023880 0x80026C80 0x8002A080 0x8002D480 0x80030880 0x80033C80 0x80037080 /end VAR_ADDRESS
 /end VAR_CHARACTERISTIC
 /begin VAR_CHARACTERISTIC TP_U8_dPTim_Dump_Ref_Bw_LMu_1_R BrkCalVariantCriterion
  /begin VAR_ADDRESS 0x80020487 0x80023887 0x80026C87 0x8002A087 0x8002D487 0x80030887 0x80033C87 0x80037087 /end VAR_ADDRESS
 /end VAR_CHARACTERISTIC
 /begin VAR_CHARACTERISTIC TP_U8_dPTim_Dump_Ref_Bw_LMu_2_F BrkCalVariantCriterion
  /begin VAR_ADDRESS 0x80020481 0x80023881 0x80026C81 0x8002A081 0x8002D481 0x80030881 0x80033C81 0x80037081 /end VAR_ADDRESS
 /end VAR_CHARACTERISTIC
 /begin VAR_CHARACTERISTIC TP_U8_dPTim_Dump_Ref_Bw_LMu_2_R BrkCalVariantCriterion
  /begin VAR_ADDRESS 0x80020488 0x80023888 0x80026C88 0x8002A088 0x8002D488 0x80030888 0x80033C88 0x80037088 /end VAR_ADDRESS
 /end VAR_CHARACTERISTIC
 /begin VAR_CHARACTERISTIC TP_U8_dPTim_Dump_Ref_Bw_LMu_3_F BrkCalVariantCriterion
  /begin VAR_ADDRESS 0x80020482 0x80023882 0x80026C82 0x8002A082 0x8002D482 0x80030882 0x80033C82 0x80037082 /end VAR_ADDRESS
 /end VAR_CHARACTERISTIC
 /begin VAR_CHARACTERISTIC TP_U8_dPTim_Dump_Ref_Bw_LMu_3_R BrkCalVariantCriterion
  /begin VAR_ADDRESS 0x80020489 0x80023889 0x80026C89 0x8002A089 0x8002D489 0x80030889 0x80033C89 0x80037089 /end VAR_ADDRESS
 /end VAR_CHARACTERISTIC
 /begin VAR_CHARACTERISTIC TP_U8_dPTim_Dump_Ref_LMMu_MMu_1_F BrkCalVariantCriterion
  /begin VAR_ADDRESS 0x80020464 0x80023864 0x80026C64 0x8002A064 0x8002D464 0x80030864 0x80033C64 0x80037064 /end VAR_ADDRESS
 /end VAR_CHARACTERISTIC
 /begin VAR_CHARACTERISTIC TP_U8_dPTim_Dump_Ref_LMMu_MMu_1_R BrkCalVariantCriterion
  /begin VAR_ADDRESS 0x8002046B 0x8002386B 0x80026C6B 0x8002A06B 0x8002D46B 0x8003086B 0x80033C6B 0x8003706B /end VAR_ADDRESS
 /end VAR_CHARACTERISTIC
 /begin VAR_CHARACTERISTIC TP_U8_dPTim_Dump_Ref_LMMu_MMu_2_F BrkCalVariantCriterion
  /begin VAR_ADDRESS 0x80020465 0x80023865 0x80026C65 0x8002A065 0x8002D465 0x80030865 0x80033C65 0x80037065 /end VAR_ADDRESS
 /end VAR_CHARACTERISTIC
 /begin VAR_CHARACTERISTIC TP_U8_dPTim_Dump_Ref_LMMu_MMu_2_R BrkCalVariantCriterion
  /begin VAR_ADDRESS 0x8002046C 0x8002386C 0x80026C6C 0x8002A06C 0x8002D46C 0x8003086C 0x80033C6C 0x8003706C /end VAR_ADDRESS
 /end VAR_CHARACTERISTIC
 /begin VAR_CHARACTERISTIC TP_U8_dPTim_Dump_Ref_LMMu_MMu_3_F BrkCalVariantCriterion
  /begin VAR_ADDRESS 0x80020466 0x80023866 0x80026C66 0x8002A066 0x8002D466 0x80030866 0x80033C66 0x80037066 /end VAR_ADDRESS
 /end VAR_CHARACTERISTIC
 /begin VAR_CHARACTERISTIC TP_U8_dPTim_Dump_Ref_LMMu_MMu_3_R BrkCalVariantCriterion
  /begin VAR_ADDRESS 0x8002046D 0x8002386D 0x80026C6D 0x8002A06D 0x8002D46D 0x8003086D 0x80033C6D 0x8003706D /end VAR_ADDRESS
 /end VAR_CHARACTERISTIC
 /begin VAR_CHARACTERISTIC TP_U8_dPTim_Dump_Ref_LMu_LMMu_1_F BrkCalVariantCriterion
  /begin VAR_ADDRESS 0x80020472 0x80023872 0x80026C72 0x8002A072 0x8002D472 0x80030872 0x80033C72 0x80037072 /end VAR_ADDRESS
 /end VAR_CHARACTERISTIC
 /begin VAR_CHARACTERISTIC TP_U8_dPTim_Dump_Ref_LMu_LMMu_1_R BrkCalVariantCriterion
  /begin VAR_ADDRESS 0x80020479 0x80023879 0x80026C79 0x8002A079 0x8002D479 0x80030879 0x80033C79 0x80037079 /end VAR_ADDRESS
 /end VAR_CHARACTERISTIC
 /begin VAR_CHARACTERISTIC TP_U8_dPTim_Dump_Ref_LMu_LMMu_2_F BrkCalVariantCriterion
  /begin VAR_ADDRESS 0x80020473 0x80023873 0x80026C73 0x8002A073 0x8002D473 0x80030873 0x80033C73 0x80037073 /end VAR_ADDRESS
 /end VAR_CHARACTERISTIC
 /begin VAR_CHARACTERISTIC TP_U8_dPTim_Dump_Ref_LMu_LMMu_2_R BrkCalVariantCriterion
  /begin VAR_ADDRESS 0x8002047A 0x8002387A 0x80026C7A 0x8002A07A 0x8002D47A 0x8003087A 0x80033C7A 0x8003707A /end VAR_ADDRESS
 /end VAR_CHARACTERISTIC
 /begin VAR_CHARACTERISTIC TP_U8_dPTim_Dump_Ref_LMu_LMMu_3_F BrkCalVariantCriterion
  /begin VAR_ADDRESS 0x80020474 0x80023874 0x80026C74 0x8002A074 0x8002D474 0x80030874 0x80033C74 0x80037074 /end VAR_ADDRESS
 /end VAR_CHARACTERISTIC
 /begin VAR_CHARACTERISTIC TP_U8_dPTim_Dump_Ref_LMu_LMMu_3_R BrkCalVariantCriterion
  /begin VAR_ADDRESS 0x8002047B 0x8002387B 0x80026C7B 0x8002A07B 0x8002D47B 0x8003087B 0x80033C7B 0x8003707B /end VAR_ADDRESS
 /end VAR_CHARACTERISTIC
 /begin VAR_CHARACTERISTIC TP_U8_dPTim_Dump_Ref_MHMu_HMu_1_F BrkCalVariantCriterion
  /begin VAR_ADDRESS 0x80020448 0x80023848 0x80026C48 0x8002A048 0x8002D448 0x80030848 0x80033C48 0x80037048 /end VAR_ADDRESS
 /end VAR_CHARACTERISTIC
 /begin VAR_CHARACTERISTIC TP_U8_dPTim_Dump_Ref_MHMu_HMu_1_R BrkCalVariantCriterion
  /begin VAR_ADDRESS 0x8002044F 0x8002384F 0x80026C4F 0x8002A04F 0x8002D44F 0x8003084F 0x80033C4F 0x8003704F /end VAR_ADDRESS
 /end VAR_CHARACTERISTIC
 /begin VAR_CHARACTERISTIC TP_U8_dPTim_Dump_Ref_MHMu_HMu_2_F BrkCalVariantCriterion
  /begin VAR_ADDRESS 0x80020449 0x80023849 0x80026C49 0x8002A049 0x8002D449 0x80030849 0x80033C49 0x80037049 /end VAR_ADDRESS
 /end VAR_CHARACTERISTIC
 /begin VAR_CHARACTERISTIC TP_U8_dPTim_Dump_Ref_MHMu_HMu_2_R BrkCalVariantCriterion
  /begin VAR_ADDRESS 0x80020450 0x80023850 0x80026C50 0x8002A050 0x8002D450 0x80030850 0x80033C50 0x80037050 /end VAR_ADDRESS
 /end VAR_CHARACTERISTIC
 /begin VAR_CHARACTERISTIC TP_U8_dPTim_Dump_Ref_MHMu_HMu_3_F BrkCalVariantCriterion
  /begin VAR_ADDRESS 0x8002044A 0x8002384A 0x80026C4A 0x8002A04A 0x8002D44A 0x8003084A 0x80033C4A 0x8003704A /end VAR_ADDRESS
 /end VAR_CHARACTERISTIC
 /begin VAR_CHARACTERISTIC TP_U8_dPTim_Dump_Ref_MHMu_HMu_3_R BrkCalVariantCriterion
  /begin VAR_ADDRESS 0x80020451 0x80023851 0x80026C51 0x8002A051 0x8002D451 0x80030851 0x80033C51 0x80037051 /end VAR_ADDRESS
 /end VAR_CHARACTERISTIC
 /begin VAR_CHARACTERISTIC TP_U8_dPTim_Dump_Ref_MMu_MHMu_1_F BrkCalVariantCriterion
  /begin VAR_ADDRESS 0x80020456 0x80023856 0x80026C56 0x8002A056 0x8002D456 0x80030856 0x80033C56 0x80037056 /end VAR_ADDRESS
 /end VAR_CHARACTERISTIC
 /begin VAR_CHARACTERISTIC TP_U8_dPTim_Dump_Ref_MMu_MHMu_1_R BrkCalVariantCriterion
  /begin VAR_ADDRESS 0x8002045D 0x8002385D 0x80026C5D 0x8002A05D 0x8002D45D 0x8003085D 0x80033C5D 0x8003705D /end VAR_ADDRESS
 /end VAR_CHARACTERISTIC
 /begin VAR_CHARACTERISTIC TP_U8_dPTim_Dump_Ref_MMu_MHMu_2_F BrkCalVariantCriterion
  /begin VAR_ADDRESS 0x80020457 0x80023857 0x80026C57 0x8002A057 0x8002D457 0x80030857 0x80033C57 0x80037057 /end VAR_ADDRESS
 /end VAR_CHARACTERISTIC
 /begin VAR_CHARACTERISTIC TP_U8_dPTim_Dump_Ref_MMu_MHMu_2_R BrkCalVariantCriterion
  /begin VAR_ADDRESS 0x8002045E 0x8002385E 0x80026C5E 0x8002A05E 0x8002D45E 0x8003085E 0x80033C5E 0x8003705E /end VAR_ADDRESS
 /end VAR_CHARACTERISTIC
 /begin VAR_CHARACTERISTIC TP_U8_dPTim_Dump_Ref_MMu_MHMu_3_F BrkCalVariantCriterion
  /begin VAR_ADDRESS 0x80020458 0x80023858 0x80026C58 0x8002A058 0x8002D458 0x80030858 0x80033C58 0x80037058 /end VAR_ADDRESS
 /end VAR_CHARACTERISTIC
 /begin VAR_CHARACTERISTIC TP_U8_dPTim_Dump_Ref_MMu_MHMu_3_R BrkCalVariantCriterion
  /begin VAR_ADDRESS 0x8002045F 0x8002385F 0x80026C5F 0x8002A05F 0x8002D45F 0x8003085F 0x80033C5F 0x8003705F /end VAR_ADDRESS
 /end VAR_CHARACTERISTIC
 /begin VAR_CHARACTERISTIC TP_U8_dPTim_Dump_Ref_SPHMu_1_F BrkCalVariantCriterion
  /begin VAR_ADDRESS 0x8002048E 0x8002388E 0x80026C8E 0x8002A08E 0x8002D48E 0x8003088E 0x80033C8E 0x8003708E /end VAR_ADDRESS
 /end VAR_CHARACTERISTIC
 /begin VAR_CHARACTERISTIC TP_U8_dPTim_Dump_Ref_SPHMu_2_F BrkCalVariantCriterion
  /begin VAR_ADDRESS 0x8002048F 0x8002388F 0x80026C8F 0x8002A08F 0x8002D48F 0x8003088F 0x80033C8F 0x8003708F /end VAR_ADDRESS
 /end VAR_CHARACTERISTIC
 /begin VAR_CHARACTERISTIC TP_U8_dPTim_Dump_Ref_SPHMu_3_F BrkCalVariantCriterion
  /begin VAR_ADDRESS 0x80020490 0x80023890 0x80026C90 0x8002A090 0x8002D490 0x80030890 0x80033C90 0x80037090 /end VAR_ADDRESS
 /end VAR_CHARACTERISTIC
 /begin VAR_CHARACTERISTIC TP_U8_dPTim_by_Dump_Ab_HMu_1_F BrkCalVariantCriterion
  /begin VAR_ADDRESS 0x80020436 0x80023836 0x80026C36 0x8002A036 0x8002D436 0x80030836 0x80033C36 0x80037036 /end VAR_ADDRESS
 /end VAR_CHARACTERISTIC
 /begin VAR_CHARACTERISTIC TP_U8_dPTim_by_Dump_Ab_HMu_1_R BrkCalVariantCriterion
  /begin VAR_ADDRESS 0x8002043D 0x8002383D 0x80026C3D 0x8002A03D 0x8002D43D 0x8003083D 0x80033C3D 0x8003703D /end VAR_ADDRESS
 /end VAR_CHARACTERISTIC
 /begin VAR_CHARACTERISTIC TP_U8_dPTim_by_Dump_Ab_HMu_2_F BrkCalVariantCriterion
  /begin VAR_ADDRESS 0x80020437 0x80023837 0x80026C37 0x8002A037 0x8002D437 0x80030837 0x80033C37 0x80037037 /end VAR_ADDRESS
 /end VAR_CHARACTERISTIC
 /begin VAR_CHARACTERISTIC TP_U8_dPTim_by_Dump_Ab_HMu_2_R BrkCalVariantCriterion
  /begin VAR_ADDRESS 0x8002043E 0x8002383E 0x80026C3E 0x8002A03E 0x8002D43E 0x8003083E 0x80033C3E 0x8003703E /end VAR_ADDRESS
 /end VAR_CHARACTERISTIC
 /begin VAR_CHARACTERISTIC TP_U8_dPTim_by_Dump_Ab_HMu_3_F BrkCalVariantCriterion
  /begin VAR_ADDRESS 0x80020438 0x80023838 0x80026C38 0x8002A038 0x8002D438 0x80030838 0x80033C38 0x80037038 /end VAR_ADDRESS
 /end VAR_CHARACTERISTIC
 /begin VAR_CHARACTERISTIC TP_U8_dPTim_by_Dump_Ab_HMu_3_R BrkCalVariantCriterion
  /begin VAR_ADDRESS 0x8002043F 0x8002383F 0x80026C3F 0x8002A03F 0x8002D43F 0x8003083F 0x80033C3F 0x8003703F /end VAR_ADDRESS
 /end VAR_CHARACTERISTIC
 /begin VAR_CHARACTERISTIC TP_U8_dPTim_by_Dump_Ab_HMu_Max_F BrkCalVariantCriterion
  /begin VAR_ADDRESS 0x80020439 0x80023839 0x80026C39 0x8002A039 0x8002D439 0x80030839 0x80033C39 0x80037039 /end VAR_ADDRESS
 /end VAR_CHARACTERISTIC
 /begin VAR_CHARACTERISTIC TP_U8_dPTim_by_Dump_Ab_HMu_Max_R BrkCalVariantCriterion
  /begin VAR_ADDRESS 0x80020440 0x80023840 0x80026C40 0x8002A040 0x8002D440 0x80030840 0x80033C40 0x80037040 /end VAR_ADDRESS
 /end VAR_CHARACTERISTIC
 /begin VAR_CHARACTERISTIC TP_U8_dPTim_by_Dump_Bw_LMu_1_F BrkCalVariantCriterion
  /begin VAR_ADDRESS 0x8002047C 0x8002387C 0x80026C7C 0x8002A07C 0x8002D47C 0x8003087C 0x80033C7C 0x8003707C /end VAR_ADDRESS
 /end VAR_CHARACTERISTIC
 /begin VAR_CHARACTERISTIC TP_U8_dPTim_by_Dump_Bw_LMu_1_R BrkCalVariantCriterion
  /begin VAR_ADDRESS 0x80020483 0x80023883 0x80026C83 0x8002A083 0x8002D483 0x80030883 0x80033C83 0x80037083 /end VAR_ADDRESS
 /end VAR_CHARACTERISTIC
 /begin VAR_CHARACTERISTIC TP_U8_dPTim_by_Dump_Bw_LMu_2_F BrkCalVariantCriterion
  /begin VAR_ADDRESS 0x8002047D 0x8002387D 0x80026C7D 0x8002A07D 0x8002D47D 0x8003087D 0x80033C7D 0x8003707D /end VAR_ADDRESS
 /end VAR_CHARACTERISTIC
 /begin VAR_CHARACTERISTIC TP_U8_dPTim_by_Dump_Bw_LMu_2_R BrkCalVariantCriterion
  /begin VAR_ADDRESS 0x80020484 0x80023884 0x80026C84 0x8002A084 0x8002D484 0x80030884 0x80033C84 0x80037084 /end VAR_ADDRESS
 /end VAR_CHARACTERISTIC
 /begin VAR_CHARACTERISTIC TP_U8_dPTim_by_Dump_Bw_LMu_3_F BrkCalVariantCriterion
  /begin VAR_ADDRESS 0x8002047E 0x8002387E 0x80026C7E 0x8002A07E 0x8002D47E 0x8003087E 0x80033C7E 0x8003707E /end VAR_ADDRESS
 /end VAR_CHARACTERISTIC
 /begin VAR_CHARACTERISTIC TP_U8_dPTim_by_Dump_Bw_LMu_3_R BrkCalVariantCriterion
  /begin VAR_ADDRESS 0x80020485 0x80023885 0x80026C85 0x8002A085 0x8002D485 0x80030885 0x80033C85 0x80037085 /end VAR_ADDRESS
 /end VAR_CHARACTERISTIC
 /begin VAR_CHARACTERISTIC TP_U8_dPTim_by_Dump_Bw_LMu_Max_F BrkCalVariantCriterion
  /begin VAR_ADDRESS 0x8002047F 0x8002387F 0x80026C7F 0x8002A07F 0x8002D47F 0x8003087F 0x80033C7F 0x8003707F /end VAR_ADDRESS
 /end VAR_CHARACTERISTIC
 /begin VAR_CHARACTERISTIC TP_U8_dPTim_by_Dump_Bw_LMu_Max_R BrkCalVariantCriterion
  /begin VAR_ADDRESS 0x80020486 0x80023886 0x80026C86 0x8002A086 0x8002D486 0x80030886 0x80033C86 0x80037086 /end VAR_ADDRESS
 /end VAR_CHARACTERISTIC
 /begin VAR_CHARACTERISTIC TP_U8_dPTim_by_Dump_LMMu_MMu_1_F BrkCalVariantCriterion
  /begin VAR_ADDRESS 0x80020460 0x80023860 0x80026C60 0x8002A060 0x8002D460 0x80030860 0x80033C60 0x80037060 /end VAR_ADDRESS
 /end VAR_CHARACTERISTIC
 /begin VAR_CHARACTERISTIC TP_U8_dPTim_by_Dump_LMMu_MMu_1_R BrkCalVariantCriterion
  /begin VAR_ADDRESS 0x80020467 0x80023867 0x80026C67 0x8002A067 0x8002D467 0x80030867 0x80033C67 0x80037067 /end VAR_ADDRESS
 /end VAR_CHARACTERISTIC
 /begin VAR_CHARACTERISTIC TP_U8_dPTim_by_Dump_LMMu_MMu_2_F BrkCalVariantCriterion
  /begin VAR_ADDRESS 0x80020461 0x80023861 0x80026C61 0x8002A061 0x8002D461 0x80030861 0x80033C61 0x80037061 /end VAR_ADDRESS
 /end VAR_CHARACTERISTIC
 /begin VAR_CHARACTERISTIC TP_U8_dPTim_by_Dump_LMMu_MMu_2_R BrkCalVariantCriterion
  /begin VAR_ADDRESS 0x80020468 0x80023868 0x80026C68 0x8002A068 0x8002D468 0x80030868 0x80033C68 0x80037068 /end VAR_ADDRESS
 /end VAR_CHARACTERISTIC
 /begin VAR_CHARACTERISTIC TP_U8_dPTim_by_Dump_LMMu_MMu_3_F BrkCalVariantCriterion
  /begin VAR_ADDRESS 0x80020462 0x80023862 0x80026C62 0x8002A062 0x8002D462 0x80030862 0x80033C62 0x80037062 /end VAR_ADDRESS
 /end VAR_CHARACTERISTIC
 /begin VAR_CHARACTERISTIC TP_U8_dPTim_by_Dump_LMMu_MMu_3_R BrkCalVariantCriterion
  /begin VAR_ADDRESS 0x80020469 0x80023869 0x80026C69 0x8002A069 0x8002D469 0x80030869 0x80033C69 0x80037069 /end VAR_ADDRESS
 /end VAR_CHARACTERISTIC
 /begin VAR_CHARACTERISTIC TP_U8_dPTim_by_Dump_LMMu_MMu_Max_F BrkCalVariantCriterion
  /begin VAR_ADDRESS 0x80020463 0x80023863 0x80026C63 0x8002A063 0x8002D463 0x80030863 0x80033C63 0x80037063 /end VAR_ADDRESS
 /end VAR_CHARACTERISTIC
 /begin VAR_CHARACTERISTIC TP_U8_dPTim_by_Dump_LMMu_MMu_Max_R BrkCalVariantCriterion
  /begin VAR_ADDRESS 0x8002046A 0x8002386A 0x80026C6A 0x8002A06A 0x8002D46A 0x8003086A 0x80033C6A 0x8003706A /end VAR_ADDRESS
 /end VAR_CHARACTERISTIC
 /begin VAR_CHARACTERISTIC TP_U8_dPTim_by_Dump_LMu_LMMu_1_F BrkCalVariantCriterion
  /begin VAR_ADDRESS 0x8002046E 0x8002386E 0x80026C6E 0x8002A06E 0x8002D46E 0x8003086E 0x80033C6E 0x8003706E /end VAR_ADDRESS
 /end VAR_CHARACTERISTIC
 /begin VAR_CHARACTERISTIC TP_U8_dPTim_by_Dump_LMu_LMMu_1_R BrkCalVariantCriterion
  /begin VAR_ADDRESS 0x80020475 0x80023875 0x80026C75 0x8002A075 0x8002D475 0x80030875 0x80033C75 0x80037075 /end VAR_ADDRESS
 /end VAR_CHARACTERISTIC
 /begin VAR_CHARACTERISTIC TP_U8_dPTim_by_Dump_LMu_LMMu_2_F BrkCalVariantCriterion
  /begin VAR_ADDRESS 0x8002046F 0x8002386F 0x80026C6F 0x8002A06F 0x8002D46F 0x8003086F 0x80033C6F 0x8003706F /end VAR_ADDRESS
 /end VAR_CHARACTERISTIC
 /begin VAR_CHARACTERISTIC TP_U8_dPTim_by_Dump_LMu_LMMu_2_R BrkCalVariantCriterion
  /begin VAR_ADDRESS 0x80020476 0x80023876 0x80026C76 0x8002A076 0x8002D476 0x80030876 0x80033C76 0x80037076 /end VAR_ADDRESS
 /end VAR_CHARACTERISTIC
 /begin VAR_CHARACTERISTIC TP_U8_dPTim_by_Dump_LMu_LMMu_3_F BrkCalVariantCriterion
  /begin VAR_ADDRESS 0x80020470 0x80023870 0x80026C70 0x8002A070 0x8002D470 0x80030870 0x80033C70 0x80037070 /end VAR_ADDRESS
 /end VAR_CHARACTERISTIC
 /begin VAR_CHARACTERISTIC TP_U8_dPTim_by_Dump_LMu_LMMu_3_R BrkCalVariantCriterion
  /begin VAR_ADDRESS 0x80020477 0x80023877 0x80026C77 0x8002A077 0x8002D477 0x80030877 0x80033C77 0x80037077 /end VAR_ADDRESS
 /end VAR_CHARACTERISTIC
 /begin VAR_CHARACTERISTIC TP_U8_dPTim_by_Dump_LMu_LMMu_Max_F BrkCalVariantCriterion
  /begin VAR_ADDRESS 0x80020471 0x80023871 0x80026C71 0x8002A071 0x8002D471 0x80030871 0x80033C71 0x80037071 /end VAR_ADDRESS
 /end VAR_CHARACTERISTIC
 /begin VAR_CHARACTERISTIC TP_U8_dPTim_by_Dump_LMu_LMMu_Max_R BrkCalVariantCriterion
  /begin VAR_ADDRESS 0x80020478 0x80023878 0x80026C78 0x8002A078 0x8002D478 0x80030878 0x80033C78 0x80037078 /end VAR_ADDRESS
 /end VAR_CHARACTERISTIC
 /begin VAR_CHARACTERISTIC TP_U8_dPTim_by_Dump_MHMu_HMu_1_F BrkCalVariantCriterion
  /begin VAR_ADDRESS 0x80020444 0x80023844 0x80026C44 0x8002A044 0x8002D444 0x80030844 0x80033C44 0x80037044 /end VAR_ADDRESS
 /end VAR_CHARACTERISTIC
 /begin VAR_CHARACTERISTIC TP_U8_dPTim_by_Dump_MHMu_HMu_1_R BrkCalVariantCriterion
  /begin VAR_ADDRESS 0x8002044B 0x8002384B 0x80026C4B 0x8002A04B 0x8002D44B 0x8003084B 0x80033C4B 0x8003704B /end VAR_ADDRESS
 /end VAR_CHARACTERISTIC
 /begin VAR_CHARACTERISTIC TP_U8_dPTim_by_Dump_MHMu_HMu_2_F BrkCalVariantCriterion
  /begin VAR_ADDRESS 0x80020445 0x80023845 0x80026C45 0x8002A045 0x8002D445 0x80030845 0x80033C45 0x80037045 /end VAR_ADDRESS
 /end VAR_CHARACTERISTIC
 /begin VAR_CHARACTERISTIC TP_U8_dPTim_by_Dump_MHMu_HMu_2_R BrkCalVariantCriterion
  /begin VAR_ADDRESS 0x8002044C 0x8002384C 0x80026C4C 0x8002A04C 0x8002D44C 0x8003084C 0x80033C4C 0x8003704C /end VAR_ADDRESS
 /end VAR_CHARACTERISTIC
 /begin VAR_CHARACTERISTIC TP_U8_dPTim_by_Dump_MHMu_HMu_3_F BrkCalVariantCriterion
  /begin VAR_ADDRESS 0x80020446 0x80023846 0x80026C46 0x8002A046 0x8002D446 0x80030846 0x80033C46 0x80037046 /end VAR_ADDRESS
 /end VAR_CHARACTERISTIC
 /begin VAR_CHARACTERISTIC TP_U8_dPTim_by_Dump_MHMu_HMu_3_R BrkCalVariantCriterion
  /begin VAR_ADDRESS 0x8002044D 0x8002384D 0x80026C4D 0x8002A04D 0x8002D44D 0x8003084D 0x80033C4D 0x8003704D /end VAR_ADDRESS
 /end VAR_CHARACTERISTIC
 /begin VAR_CHARACTERISTIC TP_U8_dPTim_by_Dump_MHMu_HMu_Max_F BrkCalVariantCriterion
  /begin VAR_ADDRESS 0x80020447 0x80023847 0x80026C47 0x8002A047 0x8002D447 0x80030847 0x80033C47 0x80037047 /end VAR_ADDRESS
 /end VAR_CHARACTERISTIC
 /begin VAR_CHARACTERISTIC TP_U8_dPTim_by_Dump_MHMu_HMu_Max_R BrkCalVariantCriterion
  /begin VAR_ADDRESS 0x8002044E 0x8002384E 0x80026C4E 0x8002A04E 0x8002D44E 0x8003084E 0x80033C4E 0x8003704E /end VAR_ADDRESS
 /end VAR_CHARACTERISTIC
 /begin VAR_CHARACTERISTIC TP_U8_dPTim_by_Dump_MMu_MHMu_1_F BrkCalVariantCriterion
  /begin VAR_ADDRESS 0x80020452 0x80023852 0x80026C52 0x8002A052 0x8002D452 0x80030852 0x80033C52 0x80037052 /end VAR_ADDRESS
 /end VAR_CHARACTERISTIC
 /begin VAR_CHARACTERISTIC TP_U8_dPTim_by_Dump_MMu_MHMu_1_R BrkCalVariantCriterion
  /begin VAR_ADDRESS 0x80020459 0x80023859 0x80026C59 0x8002A059 0x8002D459 0x80030859 0x80033C59 0x80037059 /end VAR_ADDRESS
 /end VAR_CHARACTERISTIC
 /begin VAR_CHARACTERISTIC TP_U8_dPTim_by_Dump_MMu_MHMu_2_F BrkCalVariantCriterion
  /begin VAR_ADDRESS 0x80020453 0x80023853 0x80026C53 0x8002A053 0x8002D453 0x80030853 0x80033C53 0x80037053 /end VAR_ADDRESS
 /end VAR_CHARACTERISTIC
 /begin VAR_CHARACTERISTIC TP_U8_dPTim_by_Dump_MMu_MHMu_2_R BrkCalVariantCriterion
  /begin VAR_ADDRESS 0x8002045A 0x8002385A 0x80026C5A 0x8002A05A 0x8002D45A 0x8003085A 0x80033C5A 0x8003705A /end VAR_ADDRESS
 /end VAR_CHARACTERISTIC
 /begin VAR_CHARACTERISTIC TP_U8_dPTim_by_Dump_MMu_MHMu_3_F BrkCalVariantCriterion
  /begin VAR_ADDRESS 0x80020454 0x80023854 0x80026C54 0x8002A054 0x8002D454 0x80030854 0x80033C54 0x80037054 /end VAR_ADDRESS
 /end VAR_CHARACTERISTIC
 /begin VAR_CHARACTERISTIC TP_U8_dPTim_by_Dump_MMu_MHMu_3_R BrkCalVariantCriterion
  /begin VAR_ADDRESS 0x8002045B 0x8002385B 0x80026C5B 0x8002A05B 0x8002D45B 0x8003085B 0x80033C5B 0x8003705B /end VAR_ADDRESS
 /end VAR_CHARACTERISTIC
 /begin VAR_CHARACTERISTIC TP_U8_dPTim_by_Dump_MMu_MHMu_Max_F BrkCalVariantCriterion
  /begin VAR_ADDRESS 0x80020455 0x80023855 0x80026C55 0x8002A055 0x8002D455 0x80030855 0x80033C55 0x80037055 /end VAR_ADDRESS
 /end VAR_CHARACTERISTIC
 /begin VAR_CHARACTERISTIC TP_U8_dPTim_by_Dump_MMu_MHMu_Max_R BrkCalVariantCriterion
  /begin VAR_ADDRESS 0x8002045C 0x8002385C 0x80026C5C 0x8002A05C 0x8002D45C 0x8003085C 0x80033C5C 0x8003705C /end VAR_ADDRESS
 /end VAR_CHARACTERISTIC
 /begin VAR_CHARACTERISTIC TP_U8_dPTim_by_Dump_SPHMu_1_F BrkCalVariantCriterion
  /begin VAR_ADDRESS 0x8002048A 0x8002388A 0x80026C8A 0x8002A08A 0x8002D48A 0x8003088A 0x80033C8A 0x8003708A /end VAR_ADDRESS
 /end VAR_CHARACTERISTIC
 /begin VAR_CHARACTERISTIC TP_U8_dPTim_by_Dump_SPHMu_2_F BrkCalVariantCriterion
  /begin VAR_ADDRESS 0x8002048B 0x8002388B 0x80026C8B 0x8002A08B 0x8002D48B 0x8003088B 0x80033C8B 0x8003708B /end VAR_ADDRESS
 /end VAR_CHARACTERISTIC
 /begin VAR_CHARACTERISTIC TP_U8_dPTim_by_Dump_SPHMu_3_F BrkCalVariantCriterion
  /begin VAR_ADDRESS 0x8002048C 0x8002388C 0x80026C8C 0x8002A08C 0x8002D48C 0x8003088C 0x80033C8C 0x8003708C /end VAR_ADDRESS
 /end VAR_CHARACTERISTIC
 /begin VAR_CHARACTERISTIC TP_U8_dPTim_by_Dump_SPHMu_Max_F BrkCalVariantCriterion
  /begin VAR_ADDRESS 0x8002048D 0x8002388D 0x80026C8D 0x8002A08D 0x8002D48D 0x8003088D 0x80033C8D 0x8003708D /end VAR_ADDRESS
 /end VAR_CHARACTERISTIC
 /begin VAR_CHARACTERISTIC TP_U8_dP_Dump_cnt_Ref_Ab_HMu_F BrkCalVariantCriterion
  /begin VAR_ADDRESS 0x8002041D 0x8002381D 0x80026C1D 0x8002A01D 0x8002D41D 0x8003081D 0x80033C1D 0x8003701D /end VAR_ADDRESS
 /end VAR_CHARACTERISTIC
 /begin VAR_CHARACTERISTIC TP_U8_dP_Dump_cnt_Ref_Ab_HMu_R BrkCalVariantCriterion
  /begin VAR_ADDRESS 0x8002041F 0x8002381F 0x80026C1F 0x8002A01F 0x8002D41F 0x8003081F 0x80033C1F 0x8003701F /end VAR_ADDRESS
 /end VAR_CHARACTERISTIC
 /begin VAR_CHARACTERISTIC TP_U8_dP_Dump_cnt_Ref_Bw_LMu_F BrkCalVariantCriterion
  /begin VAR_ADDRESS 0x80020431 0x80023831 0x80026C31 0x8002A031 0x8002D431 0x80030831 0x80033C31 0x80037031 /end VAR_ADDRESS
 /end VAR_CHARACTERISTIC
 /begin VAR_CHARACTERISTIC TP_U8_dP_Dump_cnt_Ref_Bw_LMu_R BrkCalVariantCriterion
  /begin VAR_ADDRESS 0x80020433 0x80023833 0x80026C33 0x8002A033 0x8002D433 0x80030833 0x80033C33 0x80037033 /end VAR_ADDRESS
 /end VAR_CHARACTERISTIC
 /begin VAR_CHARACTERISTIC TP_U8_dP_Dump_cnt_Ref_LMMu_MMu_F BrkCalVariantCriterion
  /begin VAR_ADDRESS 0x80020429 0x80023829 0x80026C29 0x8002A029 0x8002D429 0x80030829 0x80033C29 0x80037029 /end VAR_ADDRESS
 /end VAR_CHARACTERISTIC
 /begin VAR_CHARACTERISTIC TP_U8_dP_Dump_cnt_Ref_LMMu_MMu_R BrkCalVariantCriterion
  /begin VAR_ADDRESS 0x8002042B 0x8002382B 0x80026C2B 0x8002A02B 0x8002D42B 0x8003082B 0x80033C2B 0x8003702B /end VAR_ADDRESS
 /end VAR_CHARACTERISTIC
 /begin VAR_CHARACTERISTIC TP_U8_dP_Dump_cnt_Ref_LMu_LMMu_F BrkCalVariantCriterion
  /begin VAR_ADDRESS 0x8002042D 0x8002382D 0x80026C2D 0x8002A02D 0x8002D42D 0x8003082D 0x80033C2D 0x8003702D /end VAR_ADDRESS
 /end VAR_CHARACTERISTIC
 /begin VAR_CHARACTERISTIC TP_U8_dP_Dump_cnt_Ref_LMu_LMMu_R BrkCalVariantCriterion
  /begin VAR_ADDRESS 0x8002042F 0x8002382F 0x80026C2F 0x8002A02F 0x8002D42F 0x8003082F 0x80033C2F 0x8003702F /end VAR_ADDRESS
 /end VAR_CHARACTERISTIC
 /begin VAR_CHARACTERISTIC TP_U8_dP_Dump_cnt_Ref_MHMu_HMu_F BrkCalVariantCriterion
  /begin VAR_ADDRESS 0x80020421 0x80023821 0x80026C21 0x8002A021 0x8002D421 0x80030821 0x80033C21 0x80037021 /end VAR_ADDRESS
 /end VAR_CHARACTERISTIC
 /begin VAR_CHARACTERISTIC TP_U8_dP_Dump_cnt_Ref_MHMu_HMu_R BrkCalVariantCriterion
  /begin VAR_ADDRESS 0x80020423 0x80023823 0x80026C23 0x8002A023 0x8002D423 0x80030823 0x80033C23 0x80037023 /end VAR_ADDRESS
 /end VAR_CHARACTERISTIC
 /begin VAR_CHARACTERISTIC TP_U8_dP_Dump_cnt_Ref_MMu_MHMu_F BrkCalVariantCriterion
  /begin VAR_ADDRESS 0x80020425 0x80023825 0x80026C25 0x8002A025 0x8002D425 0x80030825 0x80033C25 0x80037025 /end VAR_ADDRESS
 /end VAR_CHARACTERISTIC
 /begin VAR_CHARACTERISTIC TP_U8_dP_Dump_cnt_Ref_MMu_MHMu_R BrkCalVariantCriterion
  /begin VAR_ADDRESS 0x80020427 0x80023827 0x80026C27 0x8002A027 0x8002D427 0x80030827 0x80033C27 0x80037027 /end VAR_ADDRESS
 /end VAR_CHARACTERISTIC
 /begin VAR_CHARACTERISTIC TP_U8_dP_Dump_cnt_Ref_SpHMu_F BrkCalVariantCriterion
  /begin VAR_ADDRESS 0x80020435 0x80023835 0x80026C35 0x8002A035 0x8002D435 0x80030835 0x80033C35 0x80037035 /end VAR_ADDRESS
 /end VAR_CHARACTERISTIC
 /begin VAR_CHARACTERISTIC TP_U8_dP_HMu_Dct_AradRef_1st_F BrkCalVariantCriterion
  /begin VAR_ADDRESS 0x800205E0 0x800239E0 0x80026DE0 0x8002A1E0 0x8002D5E0 0x800309E0 0x80033DE0 0x800371E0 /end VAR_ADDRESS
 /end VAR_CHARACTERISTIC
 /begin VAR_CHARACTERISTIC TP_U8_dP_HMu_Dct_AradRef_1st_R BrkCalVariantCriterion
  /begin VAR_ADDRESS 0x800205E4 0x800239E4 0x80026DE4 0x8002A1E4 0x8002D5E4 0x800309E4 0x80033DE4 0x800371E4 /end VAR_ADDRESS
 /end VAR_CHARACTERISTIC
 /begin VAR_CHARACTERISTIC TP_U8_dP_HMu_Dct_DumpRef_1st_F BrkCalVariantCriterion
  /begin VAR_ADDRESS 0x800205E1 0x800239E1 0x80026DE1 0x8002A1E1 0x8002D5E1 0x800309E1 0x80033DE1 0x800371E1 /end VAR_ADDRESS
 /end VAR_CHARACTERISTIC
 /begin VAR_CHARACTERISTIC TP_U8_dP_HMu_Dct_DumpRef_1st_R BrkCalVariantCriterion
  /begin VAR_ADDRESS 0x800205E5 0x800239E5 0x80026DE5 0x8002A1E5 0x8002D5E5 0x800309E5 0x80033DE5 0x800371E5 /end VAR_ADDRESS
 /end VAR_CHARACTERISTIC
 /begin VAR_CHARACTERISTIC TP_U8_dP_LMu_Dct_AradRef_1st_F BrkCalVariantCriterion
  /begin VAR_ADDRESS 0x800205E2 0x800239E2 0x80026DE2 0x8002A1E2 0x8002D5E2 0x800309E2 0x80033DE2 0x800371E2 /end VAR_ADDRESS
 /end VAR_CHARACTERISTIC
 /begin VAR_CHARACTERISTIC TP_U8_dP_LMu_Dct_AradRef_1st_R BrkCalVariantCriterion
  /begin VAR_ADDRESS 0x800205E6 0x800239E6 0x80026DE6 0x8002A1E6 0x8002D5E6 0x800309E6 0x80033DE6 0x800371E6 /end VAR_ADDRESS
 /end VAR_CHARACTERISTIC
 /begin VAR_CHARACTERISTIC TP_U8_dP_LMu_Dct_DumpRef_1st_F BrkCalVariantCriterion
  /begin VAR_ADDRESS 0x800205E3 0x800239E3 0x80026DE3 0x8002A1E3 0x8002D5E3 0x800309E3 0x80033DE3 0x800371E3 /end VAR_ADDRESS
 /end VAR_CHARACTERISTIC
 /begin VAR_CHARACTERISTIC TP_U8_dP_LMu_Dct_DumpRef_1st_R BrkCalVariantCriterion
  /begin VAR_ADDRESS 0x800205E7 0x800239E7 0x80026DE7 0x8002A1E7 0x8002D5E7 0x800309E7 0x80033DE7 0x800371E7 /end VAR_ADDRESS
 /end VAR_CHARACTERISTIC
 /begin VAR_CHARACTERISTIC TP_U8_dV_BF_AFZOK_100kph_F BrkCalVariantCriterion
  /begin VAR_ADDRESS 0x80020224 0x80023624 0x80026A24 0x80029E24 0x8002D224 0x80030624 0x80033A24 0x80036E24 /end VAR_ADDRESS
 /end VAR_CHARACTERISTIC
 /begin VAR_CHARACTERISTIC TP_U8_dV_BF_AFZOK_100kph_R BrkCalVariantCriterion
  /begin VAR_ADDRESS 0x8002022E 0x8002362E 0x80026A2E 0x80029E2E 0x8002D22E 0x8003062E 0x80033A2E 0x80036E2E /end VAR_ADDRESS
 /end VAR_CHARACTERISTIC
 /begin VAR_CHARACTERISTIC TP_U8_dV_BF_AFZOK_10kph_F BrkCalVariantCriterion
  /begin VAR_ADDRESS 0x8002021F 0x8002361F 0x80026A1F 0x80029E1F 0x8002D21F 0x8003061F 0x80033A1F 0x80036E1F /end VAR_ADDRESS
 /end VAR_CHARACTERISTIC
 /begin VAR_CHARACTERISTIC TP_U8_dV_BF_AFZOK_10kph_R BrkCalVariantCriterion
  /begin VAR_ADDRESS 0x80020229 0x80023629 0x80026A29 0x80029E29 0x8002D229 0x80030629 0x80033A29 0x80036E29 /end VAR_ADDRESS
 /end VAR_CHARACTERISTIC
 /begin VAR_CHARACTERISTIC TP_U8_dV_BF_AFZOK_120kph_F BrkCalVariantCriterion
  /begin VAR_ADDRESS 0x80020225 0x80023625 0x80026A25 0x80029E25 0x8002D225 0x80030625 0x80033A25 0x80036E25 /end VAR_ADDRESS
 /end VAR_CHARACTERISTIC
 /begin VAR_CHARACTERISTIC TP_U8_dV_BF_AFZOK_120kph_R BrkCalVariantCriterion
  /begin VAR_ADDRESS 0x8002022F 0x8002362F 0x80026A2F 0x80029E2F 0x8002D22F 0x8003062F 0x80033A2F 0x80036E2F /end VAR_ADDRESS
 /end VAR_CHARACTERISTIC
 /begin VAR_CHARACTERISTIC TP_U8_dV_BF_AFZOK_140kph_F BrkCalVariantCriterion
  /begin VAR_ADDRESS 0x80020226 0x80023626 0x80026A26 0x80029E26 0x8002D226 0x80030626 0x80033A26 0x80036E26 /end VAR_ADDRESS
 /end VAR_CHARACTERISTIC
 /begin VAR_CHARACTERISTIC TP_U8_dV_BF_AFZOK_140kph_R BrkCalVariantCriterion
  /begin VAR_ADDRESS 0x80020230 0x80023630 0x80026A30 0x80029E30 0x8002D230 0x80030630 0x80033A30 0x80036E30 /end VAR_ADDRESS
 /end VAR_CHARACTERISTIC
 /begin VAR_CHARACTERISTIC TP_U8_dV_BF_AFZOK_160kph_F BrkCalVariantCriterion
  /begin VAR_ADDRESS 0x80020227 0x80023627 0x80026A27 0x80029E27 0x8002D227 0x80030627 0x80033A27 0x80036E27 /end VAR_ADDRESS
 /end VAR_CHARACTERISTIC
 /begin VAR_CHARACTERISTIC TP_U8_dV_BF_AFZOK_160kph_R BrkCalVariantCriterion
  /begin VAR_ADDRESS 0x80020231 0x80023631 0x80026A31 0x80029E31 0x8002D231 0x80030631 0x80033A31 0x80036E31 /end VAR_ADDRESS
 /end VAR_CHARACTERISTIC
 /begin VAR_CHARACTERISTIC TP_U8_dV_BF_AFZOK_20kph_F BrkCalVariantCriterion
  /begin VAR_ADDRESS 0x80020220 0x80023620 0x80026A20 0x80029E20 0x8002D220 0x80030620 0x80033A20 0x80036E20 /end VAR_ADDRESS
 /end VAR_CHARACTERISTIC
 /begin VAR_CHARACTERISTIC TP_U8_dV_BF_AFZOK_20kph_R BrkCalVariantCriterion
  /begin VAR_ADDRESS 0x8002022A 0x8002362A 0x80026A2A 0x80029E2A 0x8002D22A 0x8003062A 0x80033A2A 0x80036E2A /end VAR_ADDRESS
 /end VAR_CHARACTERISTIC
 /begin VAR_CHARACTERISTIC TP_U8_dV_BF_AFZOK_40kph_F BrkCalVariantCriterion
  /begin VAR_ADDRESS 0x80020221 0x80023621 0x80026A21 0x80029E21 0x8002D221 0x80030621 0x80033A21 0x80036E21 /end VAR_ADDRESS
 /end VAR_CHARACTERISTIC
 /begin VAR_CHARACTERISTIC TP_U8_dV_BF_AFZOK_40kph_R BrkCalVariantCriterion
  /begin VAR_ADDRESS 0x8002022B 0x8002362B 0x80026A2B 0x80029E2B 0x8002D22B 0x8003062B 0x80033A2B 0x80036E2B /end VAR_ADDRESS
 /end VAR_CHARACTERISTIC
 /begin VAR_CHARACTERISTIC TP_U8_dV_BF_AFZOK_60kph_F BrkCalVariantCriterion
  /begin VAR_ADDRESS 0x80020222 0x80023622 0x80026A22 0x80029E22 0x8002D222 0x80030622 0x80033A22 0x80036E22 /end VAR_ADDRESS
 /end VAR_CHARACTERISTIC
 /begin VAR_CHARACTERISTIC TP_U8_dV_BF_AFZOK_60kph_R BrkCalVariantCriterion
  /begin VAR_ADDRESS 0x8002022C 0x8002362C 0x80026A2C 0x80029E2C 0x8002D22C 0x8003062C 0x80033A2C 0x80036E2C /end VAR_ADDRESS
 /end VAR_CHARACTERISTIC
 /begin VAR_CHARACTERISTIC TP_U8_dV_BF_AFZOK_80kph_F BrkCalVariantCriterion
  /begin VAR_ADDRESS 0x80020223 0x80023623 0x80026A23 0x80029E23 0x8002D223 0x80030623 0x80033A23 0x80036E23 /end VAR_ADDRESS
 /end VAR_CHARACTERISTIC
 /begin VAR_CHARACTERISTIC TP_U8_dV_BF_AFZOK_80kph_R BrkCalVariantCriterion
  /begin VAR_ADDRESS 0x8002022D 0x8002362D 0x80026A2D 0x80029E2D 0x8002D22D 0x8003062D 0x80033A2D 0x80036E2D /end VAR_ADDRESS
 /end VAR_CHARACTERISTIC
 /begin VAR_CHARACTERISTIC TP_U8_dV_HMu_100kph_F BrkCalVariantCriterion
  /begin VAR_ADDRESS 0x80020238 0x80023638 0x80026A38 0x80029E38 0x8002D238 0x80030638 0x80033A38 0x80036E38 /end VAR_ADDRESS
 /end VAR_CHARACTERISTIC
 /begin VAR_CHARACTERISTIC TP_U8_dV_HMu_100kph_R BrkCalVariantCriterion
  /begin VAR_ADDRESS 0x80020242 0x80023642 0x80026A42 0x80029E42 0x8002D242 0x80030642 0x80033A42 0x80036E42 /end VAR_ADDRESS
 /end VAR_CHARACTERISTIC
 /begin VAR_CHARACTERISTIC TP_U8_dV_HMu_10kph_F BrkCalVariantCriterion
  /begin VAR_ADDRESS 0x80020233 0x80023633 0x80026A33 0x80029E33 0x8002D233 0x80030633 0x80033A33 0x80036E33 /end VAR_ADDRESS
 /end VAR_CHARACTERISTIC
 /begin VAR_CHARACTERISTIC TP_U8_dV_HMu_10kph_R BrkCalVariantCriterion
  /begin VAR_ADDRESS 0x8002023D 0x8002363D 0x80026A3D 0x80029E3D 0x8002D23D 0x8003063D 0x80033A3D 0x80036E3D /end VAR_ADDRESS
 /end VAR_CHARACTERISTIC
 /begin VAR_CHARACTERISTIC TP_U8_dV_HMu_120kph_F BrkCalVariantCriterion
  /begin VAR_ADDRESS 0x80020239 0x80023639 0x80026A39 0x80029E39 0x8002D239 0x80030639 0x80033A39 0x80036E39 /end VAR_ADDRESS
 /end VAR_CHARACTERISTIC
 /begin VAR_CHARACTERISTIC TP_U8_dV_HMu_120kph_R BrkCalVariantCriterion
  /begin VAR_ADDRESS 0x80020243 0x80023643 0x80026A43 0x80029E43 0x8002D243 0x80030643 0x80033A43 0x80036E43 /end VAR_ADDRESS
 /end VAR_CHARACTERISTIC
 /begin VAR_CHARACTERISTIC TP_U8_dV_HMu_140kph_F BrkCalVariantCriterion
  /begin VAR_ADDRESS 0x8002023A 0x8002363A 0x80026A3A 0x80029E3A 0x8002D23A 0x8003063A 0x80033A3A 0x80036E3A /end VAR_ADDRESS
 /end VAR_CHARACTERISTIC
 /begin VAR_CHARACTERISTIC TP_U8_dV_HMu_140kph_R BrkCalVariantCriterion
  /begin VAR_ADDRESS 0x80020244 0x80023644 0x80026A44 0x80029E44 0x8002D244 0x80030644 0x80033A44 0x80036E44 /end VAR_ADDRESS
 /end VAR_CHARACTERISTIC
 /begin VAR_CHARACTERISTIC TP_U8_dV_HMu_160kph_F BrkCalVariantCriterion
  /begin VAR_ADDRESS 0x8002023B 0x8002363B 0x80026A3B 0x80029E3B 0x8002D23B 0x8003063B 0x80033A3B 0x80036E3B /end VAR_ADDRESS
 /end VAR_CHARACTERISTIC
 /begin VAR_CHARACTERISTIC TP_U8_dV_HMu_160kph_R BrkCalVariantCriterion
  /begin VAR_ADDRESS 0x80020245 0x80023645 0x80026A45 0x80029E45 0x8002D245 0x80030645 0x80033A45 0x80036E45 /end VAR_ADDRESS
 /end VAR_CHARACTERISTIC
 /begin VAR_CHARACTERISTIC TP_U8_dV_HMu_20kph_F BrkCalVariantCriterion
  /begin VAR_ADDRESS 0x80020234 0x80023634 0x80026A34 0x80029E34 0x8002D234 0x80030634 0x80033A34 0x80036E34 /end VAR_ADDRESS
 /end VAR_CHARACTERISTIC
 /begin VAR_CHARACTERISTIC TP_U8_dV_HMu_20kph_R BrkCalVariantCriterion
  /begin VAR_ADDRESS 0x8002023E 0x8002363E 0x80026A3E 0x80029E3E 0x8002D23E 0x8003063E 0x80033A3E 0x80036E3E /end VAR_ADDRESS
 /end VAR_CHARACTERISTIC
 /begin VAR_CHARACTERISTIC TP_U8_dV_HMu_40kph_F BrkCalVariantCriterion
  /begin VAR_ADDRESS 0x80020235 0x80023635 0x80026A35 0x80029E35 0x8002D235 0x80030635 0x80033A35 0x80036E35 /end VAR_ADDRESS
 /end VAR_CHARACTERISTIC
 /begin VAR_CHARACTERISTIC TP_U8_dV_HMu_40kph_R BrkCalVariantCriterion
  /begin VAR_ADDRESS 0x8002023F 0x8002363F 0x80026A3F 0x80029E3F 0x8002D23F 0x8003063F 0x80033A3F 0x80036E3F /end VAR_ADDRESS
 /end VAR_CHARACTERISTIC
 /begin VAR_CHARACTERISTIC TP_U8_dV_HMu_60kph_F BrkCalVariantCriterion
  /begin VAR_ADDRESS 0x80020236 0x80023636 0x80026A36 0x80029E36 0x8002D236 0x80030636 0x80033A36 0x80036E36 /end VAR_ADDRESS
 /end VAR_CHARACTERISTIC
 /begin VAR_CHARACTERISTIC TP_U8_dV_HMu_60kph_R BrkCalVariantCriterion
  /begin VAR_ADDRESS 0x80020240 0x80023640 0x80026A40 0x80029E40 0x8002D240 0x80030640 0x80033A40 0x80036E40 /end VAR_ADDRESS
 /end VAR_CHARACTERISTIC
 /begin VAR_CHARACTERISTIC TP_U8_dV_HMu_80kph_F BrkCalVariantCriterion
  /begin VAR_ADDRESS 0x80020237 0x80023637 0x80026A37 0x80029E37 0x8002D237 0x80030637 0x80033A37 0x80036E37 /end VAR_ADDRESS
 /end VAR_CHARACTERISTIC
 /begin VAR_CHARACTERISTIC TP_U8_dV_HMu_80kph_R BrkCalVariantCriterion
  /begin VAR_ADDRESS 0x80020241 0x80023641 0x80026A41 0x80029E41 0x8002D241 0x80030641 0x80033A41 0x80036E41 /end VAR_ADDRESS
 /end VAR_CHARACTERISTIC
 /begin VAR_CHARACTERISTIC TP_U8_dV_Higher_Limit_F BrkCalVariantCriterion
  /begin VAR_ADDRESS 0x8002021D 0x8002361D 0x80026A1D 0x80029E1D 0x8002D21D 0x8003061D 0x80033A1D 0x80036E1D /end VAR_ADDRESS
 /end VAR_CHARACTERISTIC
 /begin VAR_CHARACTERISTIC TP_U8_dV_Higher_Limit_R BrkCalVariantCriterion
  /begin VAR_ADDRESS 0x8002021E 0x8002361E 0x80026A1E 0x80029E1E 0x8002D21E 0x8003061E 0x80033A1E 0x80036E1E /end VAR_ADDRESS
 /end VAR_CHARACTERISTIC
 /begin VAR_CHARACTERISTIC TP_U8_dV_LMMu_100kph_F BrkCalVariantCriterion
  /begin VAR_ADDRESS 0x80020260 0x80023660 0x80026A60 0x80029E60 0x8002D260 0x80030660 0x80033A60 0x80036E60 /end VAR_ADDRESS
 /end VAR_CHARACTERISTIC
 /begin VAR_CHARACTERISTIC TP_U8_dV_LMMu_100kph_R BrkCalVariantCriterion
  /begin VAR_ADDRESS 0x8002026A 0x8002366A 0x80026A6A 0x80029E6A 0x8002D26A 0x8003066A 0x80033A6A 0x80036E6A /end VAR_ADDRESS
 /end VAR_CHARACTERISTIC
 /begin VAR_CHARACTERISTIC TP_U8_dV_LMMu_10kph_F BrkCalVariantCriterion
  /begin VAR_ADDRESS 0x8002025B 0x8002365B 0x80026A5B 0x80029E5B 0x8002D25B 0x8003065B 0x80033A5B 0x80036E5B /end VAR_ADDRESS
 /end VAR_CHARACTERISTIC
 /begin VAR_CHARACTERISTIC TP_U8_dV_LMMu_10kph_R BrkCalVariantCriterion
  /begin VAR_ADDRESS 0x80020265 0x80023665 0x80026A65 0x80029E65 0x8002D265 0x80030665 0x80033A65 0x80036E65 /end VAR_ADDRESS
 /end VAR_CHARACTERISTIC
 /begin VAR_CHARACTERISTIC TP_U8_dV_LMMu_120kph_F BrkCalVariantCriterion
  /begin VAR_ADDRESS 0x80020261 0x80023661 0x80026A61 0x80029E61 0x8002D261 0x80030661 0x80033A61 0x80036E61 /end VAR_ADDRESS
 /end VAR_CHARACTERISTIC
 /begin VAR_CHARACTERISTIC TP_U8_dV_LMMu_120kph_R BrkCalVariantCriterion
  /begin VAR_ADDRESS 0x8002026B 0x8002366B 0x80026A6B 0x80029E6B 0x8002D26B 0x8003066B 0x80033A6B 0x80036E6B /end VAR_ADDRESS
 /end VAR_CHARACTERISTIC
 /begin VAR_CHARACTERISTIC TP_U8_dV_LMMu_140kph_F BrkCalVariantCriterion
  /begin VAR_ADDRESS 0x80020262 0x80023662 0x80026A62 0x80029E62 0x8002D262 0x80030662 0x80033A62 0x80036E62 /end VAR_ADDRESS
 /end VAR_CHARACTERISTIC
 /begin VAR_CHARACTERISTIC TP_U8_dV_LMMu_140kph_R BrkCalVariantCriterion
  /begin VAR_ADDRESS 0x8002026C 0x8002366C 0x80026A6C 0x80029E6C 0x8002D26C 0x8003066C 0x80033A6C 0x80036E6C /end VAR_ADDRESS
 /end VAR_CHARACTERISTIC
 /begin VAR_CHARACTERISTIC TP_U8_dV_LMMu_160kph_F BrkCalVariantCriterion
  /begin VAR_ADDRESS 0x80020263 0x80023663 0x80026A63 0x80029E63 0x8002D263 0x80030663 0x80033A63 0x80036E63 /end VAR_ADDRESS
 /end VAR_CHARACTERISTIC
 /begin VAR_CHARACTERISTIC TP_U8_dV_LMMu_160kph_R BrkCalVariantCriterion
  /begin VAR_ADDRESS 0x8002026D 0x8002366D 0x80026A6D 0x80029E6D 0x8002D26D 0x8003066D 0x80033A6D 0x80036E6D /end VAR_ADDRESS
 /end VAR_CHARACTERISTIC
 /begin VAR_CHARACTERISTIC TP_U8_dV_LMMu_20kph_F BrkCalVariantCriterion
  /begin VAR_ADDRESS 0x8002025C 0x8002365C 0x80026A5C 0x80029E5C 0x8002D25C 0x8003065C 0x80033A5C 0x80036E5C /end VAR_ADDRESS
 /end VAR_CHARACTERISTIC
 /begin VAR_CHARACTERISTIC TP_U8_dV_LMMu_20kph_R BrkCalVariantCriterion
  /begin VAR_ADDRESS 0x80020266 0x80023666 0x80026A66 0x80029E66 0x8002D266 0x80030666 0x80033A66 0x80036E66 /end VAR_ADDRESS
 /end VAR_CHARACTERISTIC
 /begin VAR_CHARACTERISTIC TP_U8_dV_LMMu_40kph_F BrkCalVariantCriterion
  /begin VAR_ADDRESS 0x8002025D 0x8002365D 0x80026A5D 0x80029E5D 0x8002D25D 0x8003065D 0x80033A5D 0x80036E5D /end VAR_ADDRESS
 /end VAR_CHARACTERISTIC
 /begin VAR_CHARACTERISTIC TP_U8_dV_LMMu_40kph_R BrkCalVariantCriterion
  /begin VAR_ADDRESS 0x80020267 0x80023667 0x80026A67 0x80029E67 0x8002D267 0x80030667 0x80033A67 0x80036E67 /end VAR_ADDRESS
 /end VAR_CHARACTERISTIC
 /begin VAR_CHARACTERISTIC TP_U8_dV_LMMu_60kph_F BrkCalVariantCriterion
  /begin VAR_ADDRESS 0x8002025E 0x8002365E 0x80026A5E 0x80029E5E 0x8002D25E 0x8003065E 0x80033A5E 0x80036E5E /end VAR_ADDRESS
 /end VAR_CHARACTERISTIC
 /begin VAR_CHARACTERISTIC TP_U8_dV_LMMu_60kph_R BrkCalVariantCriterion
  /begin VAR_ADDRESS 0x80020268 0x80023668 0x80026A68 0x80029E68 0x8002D268 0x80030668 0x80033A68 0x80036E68 /end VAR_ADDRESS
 /end VAR_CHARACTERISTIC
 /begin VAR_CHARACTERISTIC TP_U8_dV_LMMu_80kph_F BrkCalVariantCriterion
  /begin VAR_ADDRESS 0x8002025F 0x8002365F 0x80026A5F 0x80029E5F 0x8002D25F 0x8003065F 0x80033A5F 0x80036E5F /end VAR_ADDRESS
 /end VAR_CHARACTERISTIC
 /begin VAR_CHARACTERISTIC TP_U8_dV_LMMu_80kph_R BrkCalVariantCriterion
  /begin VAR_ADDRESS 0x80020269 0x80023669 0x80026A69 0x80029E69 0x8002D269 0x80030669 0x80033A69 0x80036E69 /end VAR_ADDRESS
 /end VAR_CHARACTERISTIC
 /begin VAR_CHARACTERISTIC TP_U8_dV_LMu_100kph_F BrkCalVariantCriterion
  /begin VAR_ADDRESS 0x80020274 0x80023674 0x80026A74 0x80029E74 0x8002D274 0x80030674 0x80033A74 0x80036E74 /end VAR_ADDRESS
 /end VAR_CHARACTERISTIC
 /begin VAR_CHARACTERISTIC TP_U8_dV_LMu_100kph_R BrkCalVariantCriterion
  /begin VAR_ADDRESS 0x8002027E 0x8002367E 0x80026A7E 0x80029E7E 0x8002D27E 0x8003067E 0x80033A7E 0x80036E7E /end VAR_ADDRESS
 /end VAR_CHARACTERISTIC
 /begin VAR_CHARACTERISTIC TP_U8_dV_LMu_10kph_F BrkCalVariantCriterion
  /begin VAR_ADDRESS 0x8002026F 0x8002366F 0x80026A6F 0x80029E6F 0x8002D26F 0x8003066F 0x80033A6F 0x80036E6F /end VAR_ADDRESS
 /end VAR_CHARACTERISTIC
 /begin VAR_CHARACTERISTIC TP_U8_dV_LMu_10kph_R BrkCalVariantCriterion
  /begin VAR_ADDRESS 0x80020279 0x80023679 0x80026A79 0x80029E79 0x8002D279 0x80030679 0x80033A79 0x80036E79 /end VAR_ADDRESS
 /end VAR_CHARACTERISTIC
 /begin VAR_CHARACTERISTIC TP_U8_dV_LMu_120kph_F BrkCalVariantCriterion
  /begin VAR_ADDRESS 0x80020275 0x80023675 0x80026A75 0x80029E75 0x8002D275 0x80030675 0x80033A75 0x80036E75 /end VAR_ADDRESS
 /end VAR_CHARACTERISTIC
 /begin VAR_CHARACTERISTIC TP_U8_dV_LMu_120kph_R BrkCalVariantCriterion
  /begin VAR_ADDRESS 0x8002027F 0x8002367F 0x80026A7F 0x80029E7F 0x8002D27F 0x8003067F 0x80033A7F 0x80036E7F /end VAR_ADDRESS
 /end VAR_CHARACTERISTIC
 /begin VAR_CHARACTERISTIC TP_U8_dV_LMu_140kph_F BrkCalVariantCriterion
  /begin VAR_ADDRESS 0x80020276 0x80023676 0x80026A76 0x80029E76 0x8002D276 0x80030676 0x80033A76 0x80036E76 /end VAR_ADDRESS
 /end VAR_CHARACTERISTIC
 /begin VAR_CHARACTERISTIC TP_U8_dV_LMu_140kph_R BrkCalVariantCriterion
  /begin VAR_ADDRESS 0x80020280 0x80023680 0x80026A80 0x80029E80 0x8002D280 0x80030680 0x80033A80 0x80036E80 /end VAR_ADDRESS
 /end VAR_CHARACTERISTIC
 /begin VAR_CHARACTERISTIC TP_U8_dV_LMu_160kph_F BrkCalVariantCriterion
  /begin VAR_ADDRESS 0x80020277 0x80023677 0x80026A77 0x80029E77 0x8002D277 0x80030677 0x80033A77 0x80036E77 /end VAR_ADDRESS
 /end VAR_CHARACTERISTIC
 /begin VAR_CHARACTERISTIC TP_U8_dV_LMu_160kph_R BrkCalVariantCriterion
  /begin VAR_ADDRESS 0x80020281 0x80023681 0x80026A81 0x80029E81 0x8002D281 0x80030681 0x80033A81 0x80036E81 /end VAR_ADDRESS
 /end VAR_CHARACTERISTIC
 /begin VAR_CHARACTERISTIC TP_U8_dV_LMu_20kph_F BrkCalVariantCriterion
  /begin VAR_ADDRESS 0x80020270 0x80023670 0x80026A70 0x80029E70 0x8002D270 0x80030670 0x80033A70 0x80036E70 /end VAR_ADDRESS
 /end VAR_CHARACTERISTIC
 /begin VAR_CHARACTERISTIC TP_U8_dV_LMu_20kph_R BrkCalVariantCriterion
  /begin VAR_ADDRESS 0x8002027A 0x8002367A 0x80026A7A 0x80029E7A 0x8002D27A 0x8003067A 0x80033A7A 0x80036E7A /end VAR_ADDRESS
 /end VAR_CHARACTERISTIC
 /begin VAR_CHARACTERISTIC TP_U8_dV_LMu_40kph_F BrkCalVariantCriterion
  /begin VAR_ADDRESS 0x80020271 0x80023671 0x80026A71 0x80029E71 0x8002D271 0x80030671 0x80033A71 0x80036E71 /end VAR_ADDRESS
 /end VAR_CHARACTERISTIC
 /begin VAR_CHARACTERISTIC TP_U8_dV_LMu_40kph_R BrkCalVariantCriterion
  /begin VAR_ADDRESS 0x8002027B 0x8002367B 0x80026A7B 0x80029E7B 0x8002D27B 0x8003067B 0x80033A7B 0x80036E7B /end VAR_ADDRESS
 /end VAR_CHARACTERISTIC
 /begin VAR_CHARACTERISTIC TP_U8_dV_LMu_60kph_F BrkCalVariantCriterion
  /begin VAR_ADDRESS 0x80020272 0x80023672 0x80026A72 0x80029E72 0x8002D272 0x80030672 0x80033A72 0x80036E72 /end VAR_ADDRESS
 /end VAR_CHARACTERISTIC
 /begin VAR_CHARACTERISTIC TP_U8_dV_LMu_60kph_R BrkCalVariantCriterion
  /begin VAR_ADDRESS 0x8002027C 0x8002367C 0x80026A7C 0x80029E7C 0x8002D27C 0x8003067C 0x80033A7C 0x80036E7C /end VAR_ADDRESS
 /end VAR_CHARACTERISTIC
 /begin VAR_CHARACTERISTIC TP_U8_dV_LMu_80kph_F BrkCalVariantCriterion
  /begin VAR_ADDRESS 0x80020273 0x80023673 0x80026A73 0x80029E73 0x8002D273 0x80030673 0x80033A73 0x80036E73 /end VAR_ADDRESS
 /end VAR_CHARACTERISTIC
 /begin VAR_CHARACTERISTIC TP_U8_dV_LMu_80kph_R BrkCalVariantCriterion
  /begin VAR_ADDRESS 0x8002027D 0x8002367D 0x80026A7D 0x80029E7D 0x8002D27D 0x8003067D 0x80033A7D 0x80036E7D /end VAR_ADDRESS
 /end VAR_CHARACTERISTIC
 /begin VAR_CHARACTERISTIC TP_U8_dV_MMu_100kph_F BrkCalVariantCriterion
  /begin VAR_ADDRESS 0x8002024C 0x8002364C 0x80026A4C 0x80029E4C 0x8002D24C 0x8003064C 0x80033A4C 0x80036E4C /end VAR_ADDRESS
 /end VAR_CHARACTERISTIC
 /begin VAR_CHARACTERISTIC TP_U8_dV_MMu_100kph_R BrkCalVariantCriterion
  /begin VAR_ADDRESS 0x80020256 0x80023656 0x80026A56 0x80029E56 0x8002D256 0x80030656 0x80033A56 0x80036E56 /end VAR_ADDRESS
 /end VAR_CHARACTERISTIC
 /begin VAR_CHARACTERISTIC TP_U8_dV_MMu_10kph_F BrkCalVariantCriterion
  /begin VAR_ADDRESS 0x80020247 0x80023647 0x80026A47 0x80029E47 0x8002D247 0x80030647 0x80033A47 0x80036E47 /end VAR_ADDRESS
 /end VAR_CHARACTERISTIC
 /begin VAR_CHARACTERISTIC TP_U8_dV_MMu_10kph_R BrkCalVariantCriterion
  /begin VAR_ADDRESS 0x80020251 0x80023651 0x80026A51 0x80029E51 0x8002D251 0x80030651 0x80033A51 0x80036E51 /end VAR_ADDRESS
 /end VAR_CHARACTERISTIC
 /begin VAR_CHARACTERISTIC TP_U8_dV_MMu_120kph_F BrkCalVariantCriterion
  /begin VAR_ADDRESS 0x8002024D 0x8002364D 0x80026A4D 0x80029E4D 0x8002D24D 0x8003064D 0x80033A4D 0x80036E4D /end VAR_ADDRESS
 /end VAR_CHARACTERISTIC
 /begin VAR_CHARACTERISTIC TP_U8_dV_MMu_120kph_R BrkCalVariantCriterion
  /begin VAR_ADDRESS 0x80020257 0x80023657 0x80026A57 0x80029E57 0x8002D257 0x80030657 0x80033A57 0x80036E57 /end VAR_ADDRESS
 /end VAR_CHARACTERISTIC
 /begin VAR_CHARACTERISTIC TP_U8_dV_MMu_140kph_F BrkCalVariantCriterion
  /begin VAR_ADDRESS 0x8002024E 0x8002364E 0x80026A4E 0x80029E4E 0x8002D24E 0x8003064E 0x80033A4E 0x80036E4E /end VAR_ADDRESS
 /end VAR_CHARACTERISTIC
 /begin VAR_CHARACTERISTIC TP_U8_dV_MMu_140kph_R BrkCalVariantCriterion
  /begin VAR_ADDRESS 0x80020258 0x80023658 0x80026A58 0x80029E58 0x8002D258 0x80030658 0x80033A58 0x80036E58 /end VAR_ADDRESS
 /end VAR_CHARACTERISTIC
 /begin VAR_CHARACTERISTIC TP_U8_dV_MMu_160kph_F BrkCalVariantCriterion
  /begin VAR_ADDRESS 0x8002024F 0x8002364F 0x80026A4F 0x80029E4F 0x8002D24F 0x8003064F 0x80033A4F 0x80036E4F /end VAR_ADDRESS
 /end VAR_CHARACTERISTIC
 /begin VAR_CHARACTERISTIC TP_U8_dV_MMu_160kph_R BrkCalVariantCriterion
  /begin VAR_ADDRESS 0x80020259 0x80023659 0x80026A59 0x80029E59 0x8002D259 0x80030659 0x80033A59 0x80036E59 /end VAR_ADDRESS
 /end VAR_CHARACTERISTIC
 /begin VAR_CHARACTERISTIC TP_U8_dV_MMu_20kph_F BrkCalVariantCriterion
  /begin VAR_ADDRESS 0x80020248 0x80023648 0x80026A48 0x80029E48 0x8002D248 0x80030648 0x80033A48 0x80036E48 /end VAR_ADDRESS
 /end VAR_CHARACTERISTIC
 /begin VAR_CHARACTERISTIC TP_U8_dV_MMu_20kph_R BrkCalVariantCriterion
  /begin VAR_ADDRESS 0x80020252 0x80023652 0x80026A52 0x80029E52 0x8002D252 0x80030652 0x80033A52 0x80036E52 /end VAR_ADDRESS
 /end VAR_CHARACTERISTIC
 /begin VAR_CHARACTERISTIC TP_U8_dV_MMu_40kph_F BrkCalVariantCriterion
  /begin VAR_ADDRESS 0x80020249 0x80023649 0x80026A49 0x80029E49 0x8002D249 0x80030649 0x80033A49 0x80036E49 /end VAR_ADDRESS
 /end VAR_CHARACTERISTIC
 /begin VAR_CHARACTERISTIC TP_U8_dV_MMu_40kph_R BrkCalVariantCriterion
  /begin VAR_ADDRESS 0x80020253 0x80023653 0x80026A53 0x80029E53 0x8002D253 0x80030653 0x80033A53 0x80036E53 /end VAR_ADDRESS
 /end VAR_CHARACTERISTIC
 /begin VAR_CHARACTERISTIC TP_U8_dV_MMu_60kph_F BrkCalVariantCriterion
  /begin VAR_ADDRESS 0x8002024A 0x8002364A 0x80026A4A 0x80029E4A 0x8002D24A 0x8003064A 0x80033A4A 0x80036E4A /end VAR_ADDRESS
 /end VAR_CHARACTERISTIC
 /begin VAR_CHARACTERISTIC TP_U8_dV_MMu_60kph_R BrkCalVariantCriterion
  /begin VAR_ADDRESS 0x80020254 0x80023654 0x80026A54 0x80029E54 0x8002D254 0x80030654 0x80033A54 0x80036E54 /end VAR_ADDRESS
 /end VAR_CHARACTERISTIC
 /begin VAR_CHARACTERISTIC TP_U8_dV_MMu_80kph_F BrkCalVariantCriterion
  /begin VAR_ADDRESS 0x8002024B 0x8002364B 0x80026A4B 0x80029E4B 0x8002D24B 0x8003064B 0x80033A4B 0x80036E4B /end VAR_ADDRESS
 /end VAR_CHARACTERISTIC
 /begin VAR_CHARACTERISTIC TP_U8_dV_MMu_80kph_R BrkCalVariantCriterion
  /begin VAR_ADDRESS 0x80020255 0x80023655 0x80026A55 0x80029E55 0x8002D255 0x80030655 0x80033A55 0x80036E55 /end VAR_ADDRESS
 /end VAR_CHARACTERISTIC
 /begin VAR_CHARACTERISTIC TP_U8_dV_Pro_High_Vel_HMu_F BrkCalVariantCriterion
  /begin VAR_ADDRESS 0x8002023C 0x8002363C 0x80026A3C 0x80029E3C 0x8002D23C 0x8003063C 0x80033A3C 0x80036E3C /end VAR_ADDRESS
 /end VAR_CHARACTERISTIC
 /begin VAR_CHARACTERISTIC TP_U8_dV_Pro_High_Vel_HMu_R BrkCalVariantCriterion
  /begin VAR_ADDRESS 0x80020246 0x80023646 0x80026A46 0x80029E46 0x8002D246 0x80030646 0x80033A46 0x80036E46 /end VAR_ADDRESS
 /end VAR_CHARACTERISTIC
 /begin VAR_CHARACTERISTIC TP_U8_dV_Pro_High_Vel_LMMu_F BrkCalVariantCriterion
  /begin VAR_ADDRESS 0x80020264 0x80023664 0x80026A64 0x80029E64 0x8002D264 0x80030664 0x80033A64 0x80036E64 /end VAR_ADDRESS
 /end VAR_CHARACTERISTIC
 /begin VAR_CHARACTERISTIC TP_U8_dV_Pro_High_Vel_LMMu_R BrkCalVariantCriterion
  /begin VAR_ADDRESS 0x8002026E 0x8002366E 0x80026A6E 0x80029E6E 0x8002D26E 0x8003066E 0x80033A6E 0x80036E6E /end VAR_ADDRESS
 /end VAR_CHARACTERISTIC
 /begin VAR_CHARACTERISTIC TP_U8_dV_Pro_High_Vel_LMu_F BrkCalVariantCriterion
  /begin VAR_ADDRESS 0x80020278 0x80023678 0x80026A78 0x80029E78 0x8002D278 0x80030678 0x80033A78 0x80036E78 /end VAR_ADDRESS
 /end VAR_CHARACTERISTIC
 /begin VAR_CHARACTERISTIC TP_U8_dV_Pro_High_Vel_LMu_R BrkCalVariantCriterion
  /begin VAR_ADDRESS 0x80020282 0x80023682 0x80026A82 0x80029E82 0x8002D282 0x80030682 0x80033A82 0x80036E82 /end VAR_ADDRESS
 /end VAR_CHARACTERISTIC
 /begin VAR_CHARACTERISTIC TP_U8_dV_Pro_High_Vel_MMu_F BrkCalVariantCriterion
  /begin VAR_ADDRESS 0x80020250 0x80023650 0x80026A50 0x80029E50 0x8002D250 0x80030650 0x80033A50 0x80036E50 /end VAR_ADDRESS
 /end VAR_CHARACTERISTIC
 /begin VAR_CHARACTERISTIC TP_U8_dV_Pro_High_Vel_MMu_R BrkCalVariantCriterion
  /begin VAR_ADDRESS 0x8002025A 0x8002365A 0x80026A5A 0x80029E5A 0x8002D25A 0x8003065A 0x80033A5A 0x80036E5A /end VAR_ADDRESS
 /end VAR_CHARACTERISTIC
 /begin VAR_CHARACTERISTIC TP_U8_dV_Pro_High_Vel_SpMu_F BrkCalVariantCriterion
  /begin VAR_ADDRESS 0x80020285 0x80023685 0x80026A85 0x80029E85 0x8002D285 0x80030685 0x80033A85 0x80036E85 /end VAR_ADDRESS
 /end VAR_CHARACTERISTIC
 /begin VAR_CHARACTERISTIC TP_U8_dV_SpMu_100kph_F BrkCalVariantCriterion
  /begin VAR_ADDRESS 0x80020286 0x80023686 0x80026A86 0x80029E86 0x8002D286 0x80030686 0x80033A86 0x80036E86 /end VAR_ADDRESS
 /end VAR_CHARACTERISTIC
 /begin VAR_CHARACTERISTIC TP_U8_dV_SpMu_10kph_F BrkCalVariantCriterion
  /begin VAR_ADDRESS 0x80020287 0x80023687 0x80026A87 0x80029E87 0x8002D287 0x80030687 0x80033A87 0x80036E87 /end VAR_ADDRESS
 /end VAR_CHARACTERISTIC
 /begin VAR_CHARACTERISTIC TP_U8_dV_SpMu_20kph_F BrkCalVariantCriterion
  /begin VAR_ADDRESS 0x80020288 0x80023688 0x80026A88 0x80029E88 0x8002D288 0x80030688 0x80033A88 0x80036E88 /end VAR_ADDRESS
 /end VAR_CHARACTERISTIC
 /begin VAR_CHARACTERISTIC TP_U8_dV_SpMu_40kph_F BrkCalVariantCriterion
  /begin VAR_ADDRESS 0x80020289 0x80023689 0x80026A89 0x80029E89 0x8002D289 0x80030689 0x80033A89 0x80036E89 /end VAR_ADDRESS
 /end VAR_CHARACTERISTIC
 /begin VAR_CHARACTERISTIC TP_U8_dV_SpMu_60kph_F BrkCalVariantCriterion
  /begin VAR_ADDRESS 0x8002028A 0x8002368A 0x80026A8A 0x80029E8A 0x8002D28A 0x8003068A 0x80033A8A 0x80036E8A /end VAR_ADDRESS
 /end VAR_CHARACTERISTIC
 /begin VAR_CHARACTERISTIC TP_U8_dV_SpMu_80kph_F BrkCalVariantCriterion
  /begin VAR_ADDRESS 0x8002028B 0x8002368B 0x80026A8B 0x80029E8B 0x8002D28B 0x8003068B 0x80033A8B 0x80036E8B /end VAR_ADDRESS
 /end VAR_CHARACTERISTIC
 /begin VAR_CHARACTERISTIC TP_U8_nth_Dumpscantime_EBD_R BrkCalVariantCriterion
  /begin VAR_ADDRESS 0x800206DD 0x80023ADD 0x80026EDD 0x8002A2DD 0x8002D6DD 0x80030ADD 0x80033EDD 0x800372DD /end VAR_ADDRESS
 /end VAR_CHARACTERISTIC
 /begin VAR_CHARACTERISTIC TP_U8_nth_Dumpscantime_LMMu_F BrkCalVariantCriterion
  /begin VAR_ADDRESS 0x800204AC 0x800238AC 0x80026CAC 0x8002A0AC 0x8002D4AC 0x800308AC 0x80033CAC 0x800370AC /end VAR_ADDRESS
 /end VAR_CHARACTERISTIC
 /begin VAR_CHARACTERISTIC TP_U8_nth_Dumpscantime_LMMu_R BrkCalVariantCriterion
  /begin VAR_ADDRESS 0x800204B1 0x800238B1 0x80026CB1 0x8002A0B1 0x8002D4B1 0x800308B1 0x80033CB1 0x800370B1 /end VAR_ADDRESS
 /end VAR_CHARACTERISTIC
 /begin VAR_CHARACTERISTIC TP_U8_nth_Dumpscantime_LMu_F BrkCalVariantCriterion
  /begin VAR_ADDRESS 0x800204B6 0x800238B6 0x80026CB6 0x8002A0B6 0x8002D4B6 0x800308B6 0x80033CB6 0x800370B6 /end VAR_ADDRESS
 /end VAR_CHARACTERISTIC
 /begin VAR_CHARACTERISTIC TP_U8_nth_Dumpscantime_LMu_R BrkCalVariantCriterion
  /begin VAR_ADDRESS 0x800204BC 0x800238BC 0x80026CBC 0x8002A0BC 0x8002D4BC 0x800308BC 0x80033CBC 0x800370BC /end VAR_ADDRESS
 /end VAR_CHARACTERISTIC
 /begin VAR_CHARACTERISTIC TP_U8_nth_Dumpscantime_MMu_F BrkCalVariantCriterion
  /begin VAR_ADDRESS 0x800204A5 0x800238A5 0x80026CA5 0x8002A0A5 0x8002D4A5 0x800308A5 0x80033CA5 0x800370A5 /end VAR_ADDRESS
 /end VAR_CHARACTERISTIC
 /begin VAR_CHARACTERISTIC TP_U8_nth_Dumpscantime_MMu_R BrkCalVariantCriterion
  /begin VAR_ADDRESS 0x800204A8 0x800238A8 0x80026CA8 0x8002A0A8 0x8002D4A8 0x800308A8 0x80033CA8 0x800370A8 /end VAR_ADDRESS
 /end VAR_CHARACTERISTIC
 /begin VAR_CHARACTERISTIC TP_ZS16BTCSCpReserved01 EngCalVariantCriterion
  /begin VAR_ADDRESS 0x8003A360 0x8003B160 0x8003BF60 0x8003CD60 0x8003DB60 0x8003E960 0x8003F760 0x80040560 0x80041360 0x80042160 0x80042F60 0x80043D60 0x80044B60 0x80045960 0x80046760 0x80047560 0x80048360 0x80049160 0x80049F60 0x8004AD60 0x8004BB60 0x8004C960 0x8004D760 0x8004E560 /end VAR_ADDRESS
 /end VAR_CHARACTERISTIC
 /begin VAR_CHARACTERISTIC TP_ZS16BTCSCpReserved02 EngCalVariantCriterion
  /begin VAR_ADDRESS 0x8003A362 0x8003B162 0x8003BF62 0x8003CD62 0x8003DB62 0x8003E962 0x8003F762 0x80040562 0x80041362 0x80042162 0x80042F62 0x80043D62 0x80044B62 0x80045962 0x80046762 0x80047562 0x80048362 0x80049162 0x80049F62 0x8004AD62 0x8004BB62 0x8004C962 0x8004D762 0x8004E562 /end VAR_ADDRESS
 /end VAR_CHARACTERISTIC
 /begin VAR_CHARACTERISTIC TP_ZS16BTCSCpReserved03 EngCalVariantCriterion
  /begin VAR_ADDRESS 0x8003A364 0x8003B164 0x8003BF64 0x8003CD64 0x8003DB64 0x8003E964 0x8003F764 0x80040564 0x80041364 0x80042164 0x80042F64 0x80043D64 0x80044B64 0x80045964 0x80046764 0x80047564 0x80048364 0x80049164 0x80049F64 0x8004AD64 0x8004BB64 0x8004C964 0x8004D764 0x8004E564 /end VAR_ADDRESS
 /end VAR_CHARACTERISTIC
 /begin VAR_CHARACTERISTIC TP_ZS16BTCSCpReserved04 EngCalVariantCriterion
  /begin VAR_ADDRESS 0x8003A366 0x8003B166 0x8003BF66 0x8003CD66 0x8003DB66 0x8003E966 0x8003F766 0x80040566 0x80041366 0x80042166 0x80042F66 0x80043D66 0x80044B66 0x80045966 0x80046766 0x80047566 0x80048366 0x80049166 0x80049F66 0x8004AD66 0x8004BB66 0x8004C966 0x8004D766 0x8004E566 /end VAR_ADDRESS
 /end VAR_CHARACTERISTIC
 /begin VAR_CHARACTERISTIC TP_ZS16BTCSCpReserved05 EngCalVariantCriterion
  /begin VAR_ADDRESS 0x8003A368 0x8003B168 0x8003BF68 0x8003CD68 0x8003DB68 0x8003E968 0x8003F768 0x80040568 0x80041368 0x80042168 0x80042F68 0x80043D68 0x80044B68 0x80045968 0x80046768 0x80047568 0x80048368 0x80049168 0x80049F68 0x8004AD68 0x8004BB68 0x8004C968 0x8004D768 0x8004E568 /end VAR_ADDRESS
 /end VAR_CHARACTERISTIC
 /begin VAR_CHARACTERISTIC TP_ZS16BTCSCpReserved06 EngCalVariantCriterion
  /begin VAR_ADDRESS 0x8003A36A 0x8003B16A 0x8003BF6A 0x8003CD6A 0x8003DB6A 0x8003E96A 0x8003F76A 0x8004056A 0x8004136A 0x8004216A 0x80042F6A 0x80043D6A 0x80044B6A 0x8004596A 0x8004676A 0x8004756A 0x8004836A 0x8004916A 0x80049F6A 0x8004AD6A 0x8004BB6A 0x8004C96A 0x8004D76A 0x8004E56A /end VAR_ADDRESS
 /end VAR_CHARACTERISTIC
 /begin VAR_CHARACTERISTIC TP_ZS16BTCSCpReserved07 EngCalVariantCriterion
  /begin VAR_ADDRESS 0x8003A36C 0x8003B16C 0x8003BF6C 0x8003CD6C 0x8003DB6C 0x8003E96C 0x8003F76C 0x8004056C 0x8004136C 0x8004216C 0x80042F6C 0x80043D6C 0x80044B6C 0x8004596C 0x8004676C 0x8004756C 0x8004836C 0x8004916C 0x80049F6C 0x8004AD6C 0x8004BB6C 0x8004C96C 0x8004D76C 0x8004E56C /end VAR_ADDRESS
 /end VAR_CHARACTERISTIC
 /begin VAR_CHARACTERISTIC TP_ZS16BTCSCpReserved08 EngCalVariantCriterion
  /begin VAR_ADDRESS 0x8003A36E 0x8003B16E 0x8003BF6E 0x8003CD6E 0x8003DB6E 0x8003E96E 0x8003F76E 0x8004056E 0x8004136E 0x8004216E 0x80042F6E 0x80043D6E 0x80044B6E 0x8004596E 0x8004676E 0x8004756E 0x8004836E 0x8004916E 0x80049F6E 0x8004AD6E 0x8004BB6E 0x8004C96E 0x8004D76E 0x8004E56E /end VAR_ADDRESS
 /end VAR_CHARACTERISTIC
 /begin VAR_CHARACTERISTIC TP_ZS16BTCSCpReserved09 EngCalVariantCriterion
  /begin VAR_ADDRESS 0x8003A370 0x8003B170 0x8003BF70 0x8003CD70 0x8003DB70 0x8003E970 0x8003F770 0x80040570 0x80041370 0x80042170 0x80042F70 0x80043D70 0x80044B70 0x80045970 0x80046770 0x80047570 0x80048370 0x80049170 0x80049F70 0x8004AD70 0x8004BB70 0x8004C970 0x8004D770 0x8004E570 /end VAR_ADDRESS
 /end VAR_CHARACTERISTIC
 /begin VAR_CHARACTERISTIC TP_ZS16BTCSCpReserved10 EngCalVariantCriterion
  /begin VAR_ADDRESS 0x8003A372 0x8003B172 0x8003BF72 0x8003CD72 0x8003DB72 0x8003E972 0x8003F772 0x80040572 0x80041372 0x80042172 0x80042F72 0x80043D72 0x80044B72 0x80045972 0x80046772 0x80047572 0x80048372 0x80049172 0x80049F72 0x8004AD72 0x8004BB72 0x8004C972 0x8004D772 0x8004E572 /end VAR_ADDRESS
 /end VAR_CHARACTERISTIC
 /begin VAR_CHARACTERISTIC TP_ZS16BTCSCpReserved11 EngCalVariantCriterion
  /begin VAR_ADDRESS 0x8003A374 0x8003B174 0x8003BF74 0x8003CD74 0x8003DB74 0x8003E974 0x8003F774 0x80040574 0x80041374 0x80042174 0x80042F74 0x80043D74 0x80044B74 0x80045974 0x80046774 0x80047574 0x80048374 0x80049174 0x80049F74 0x8004AD74 0x8004BB74 0x8004C974 0x8004D774 0x8004E574 /end VAR_ADDRESS
 /end VAR_CHARACTERISTIC
 /begin VAR_CHARACTERISTIC TP_ZS16BTCSCpReserved12 EngCalVariantCriterion
  /begin VAR_ADDRESS 0x8003A376 0x8003B176 0x8003BF76 0x8003CD76 0x8003DB76 0x8003E976 0x8003F776 0x80040576 0x80041376 0x80042176 0x80042F76 0x80043D76 0x80044B76 0x80045976 0x80046776 0x80047576 0x80048376 0x80049176 0x80049F76 0x8004AD76 0x8004BB76 0x8004C976 0x8004D776 0x8004E576 /end VAR_ADDRESS
 /end VAR_CHARACTERISTIC
 /begin VAR_CHARACTERISTIC TP_ZS16BTCSCpReserved13 EngCalVariantCriterion
  /begin VAR_ADDRESS 0x8003A378 0x8003B178 0x8003BF78 0x8003CD78 0x8003DB78 0x8003E978 0x8003F778 0x80040578 0x80041378 0x80042178 0x80042F78 0x80043D78 0x80044B78 0x80045978 0x80046778 0x80047578 0x80048378 0x80049178 0x80049F78 0x8004AD78 0x8004BB78 0x8004C978 0x8004D778 0x8004E578 /end VAR_ADDRESS
 /end VAR_CHARACTERISTIC
 /begin VAR_CHARACTERISTIC TP_ZS16BTCSCpReserved14 EngCalVariantCriterion
  /begin VAR_ADDRESS 0x8003A37A 0x8003B17A 0x8003BF7A 0x8003CD7A 0x8003DB7A 0x8003E97A 0x8003F77A 0x8004057A 0x8004137A 0x8004217A 0x80042F7A 0x80043D7A 0x80044B7A 0x8004597A 0x8004677A 0x8004757A 0x8004837A 0x8004917A 0x80049F7A 0x8004AD7A 0x8004BB7A 0x8004C97A 0x8004D77A 0x8004E57A /end VAR_ADDRESS
 /end VAR_CHARACTERISTIC
 /begin VAR_CHARACTERISTIC TP_ZS16BTCSCpReserved15 EngCalVariantCriterion
  /begin VAR_ADDRESS 0x8003A37C 0x8003B17C 0x8003BF7C 0x8003CD7C 0x8003DB7C 0x8003E97C 0x8003F77C 0x8004057C 0x8004137C 0x8004217C 0x80042F7C 0x80043D7C 0x80044B7C 0x8004597C 0x8004677C 0x8004757C 0x8004837C 0x8004917C 0x80049F7C 0x8004AD7C 0x8004BB7C 0x8004C97C 0x8004D77C 0x8004E57C /end VAR_ADDRESS
 /end VAR_CHARACTERISTIC
 /begin VAR_CHARACTERISTIC TP_ZS16BTCSCpReserved16 EngCalVariantCriterion
  /begin VAR_ADDRESS 0x8003A37E 0x8003B17E 0x8003BF7E 0x8003CD7E 0x8003DB7E 0x8003E97E 0x8003F77E 0x8004057E 0x8004137E 0x8004217E 0x80042F7E 0x80043D7E 0x80044B7E 0x8004597E 0x8004677E 0x8004757E 0x8004837E 0x8004917E 0x80049F7E 0x8004AD7E 0x8004BB7E 0x8004C97E 0x8004D77E 0x8004E57E /end VAR_ADDRESS
 /end VAR_CHARACTERISTIC
 /begin VAR_CHARACTERISTIC TP_ZS16BTCSCpReserved17 EngCalVariantCriterion
  /begin VAR_ADDRESS 0x8003A380 0x8003B180 0x8003BF80 0x8003CD80 0x8003DB80 0x8003E980 0x8003F780 0x80040580 0x80041380 0x80042180 0x80042F80 0x80043D80 0x80044B80 0x80045980 0x80046780 0x80047580 0x80048380 0x80049180 0x80049F80 0x8004AD80 0x8004BB80 0x8004C980 0x8004D780 0x8004E580 /end VAR_ADDRESS
 /end VAR_CHARACTERISTIC
 /begin VAR_CHARACTERISTIC TP_ZS16BTCSCpReserved18 EngCalVariantCriterion
  /begin VAR_ADDRESS 0x8003A382 0x8003B182 0x8003BF82 0x8003CD82 0x8003DB82 0x8003E982 0x8003F782 0x80040582 0x80041382 0x80042182 0x80042F82 0x80043D82 0x80044B82 0x80045982 0x80046782 0x80047582 0x80048382 0x80049182 0x80049F82 0x8004AD82 0x8004BB82 0x8004C982 0x8004D782 0x8004E582 /end VAR_ADDRESS
 /end VAR_CHARACTERISTIC
 /begin VAR_CHARACTERISTIC TP_ZS16BTCSCpReserved19 EngCalVariantCriterion
  /begin VAR_ADDRESS 0x8003A384 0x8003B184 0x8003BF84 0x8003CD84 0x8003DB84 0x8003E984 0x8003F784 0x80040584 0x80041384 0x80042184 0x80042F84 0x80043D84 0x80044B84 0x80045984 0x80046784 0x80047584 0x80048384 0x80049184 0x80049F84 0x8004AD84 0x8004BB84 0x8004C984 0x8004D784 0x8004E584 /end VAR_ADDRESS
 /end VAR_CHARACTERISTIC
 /begin VAR_CHARACTERISTIC TP_ZS16BTCSCpReserved20 EngCalVariantCriterion
  /begin VAR_ADDRESS 0x8003A386 0x8003B186 0x8003BF86 0x8003CD86 0x8003DB86 0x8003E986 0x8003F786 0x80040586 0x80041386 0x80042186 0x80042F86 0x80043D86 0x80044B86 0x80045986 0x80046786 0x80047586 0x80048386 0x80049186 0x80049F86 0x8004AD86 0x8004BB86 0x8004C986 0x8004D786 0x8004E586 /end VAR_ADDRESS
 /end VAR_CHARACTERISTIC
 /begin VAR_CHARACTERISTIC TP_ZS16ETCSCpReserved01 EngCalVariantCriterion
  /begin VAR_ADDRESS 0x8003A67C 0x8003B47C 0x8003C27C 0x8003D07C 0x8003DE7C 0x8003EC7C 0x8003FA7C 0x8004087C 0x8004167C 0x8004247C 0x8004327C 0x8004407C 0x80044E7C 0x80045C7C 0x80046A7C 0x8004787C 0x8004867C 0x8004947C 0x8004A27C 0x8004B07C 0x8004BE7C 0x8004CC7C 0x8004DA7C 0x8004E87C /end VAR_ADDRESS
 /end VAR_CHARACTERISTIC
 /begin VAR_CHARACTERISTIC TP_ZS16ETCSCpReserved02 EngCalVariantCriterion
  /begin VAR_ADDRESS 0x8003A67E 0x8003B47E 0x8003C27E 0x8003D07E 0x8003DE7E 0x8003EC7E 0x8003FA7E 0x8004087E 0x8004167E 0x8004247E 0x8004327E 0x8004407E 0x80044E7E 0x80045C7E 0x80046A7E 0x8004787E 0x8004867E 0x8004947E 0x8004A27E 0x8004B07E 0x8004BE7E 0x8004CC7E 0x8004DA7E 0x8004E87E /end VAR_ADDRESS
 /end VAR_CHARACTERISTIC
 /begin VAR_CHARACTERISTIC TP_ZS16ETCSCpReserved03 EngCalVariantCriterion
  /begin VAR_ADDRESS 0x8003A680 0x8003B480 0x8003C280 0x8003D080 0x8003DE80 0x8003EC80 0x8003FA80 0x80040880 0x80041680 0x80042480 0x80043280 0x80044080 0x80044E80 0x80045C80 0x80046A80 0x80047880 0x80048680 0x80049480 0x8004A280 0x8004B080 0x8004BE80 0x8004CC80 0x8004DA80 0x8004E880 /end VAR_ADDRESS
 /end VAR_CHARACTERISTIC
 /begin VAR_CHARACTERISTIC TP_ZS16ETCSCpReserved04 EngCalVariantCriterion
  /begin VAR_ADDRESS 0x8003A682 0x8003B482 0x8003C282 0x8003D082 0x8003DE82 0x8003EC82 0x8003FA82 0x80040882 0x80041682 0x80042482 0x80043282 0x80044082 0x80044E82 0x80045C82 0x80046A82 0x80047882 0x80048682 0x80049482 0x8004A282 0x8004B082 0x8004BE82 0x8004CC82 0x8004DA82 0x8004E882 /end VAR_ADDRESS
 /end VAR_CHARACTERISTIC
 /begin VAR_CHARACTERISTIC TP_ZS16ETCSCpReserved05 EngCalVariantCriterion
  /begin VAR_ADDRESS 0x8003A684 0x8003B484 0x8003C284 0x8003D084 0x8003DE84 0x8003EC84 0x8003FA84 0x80040884 0x80041684 0x80042484 0x80043284 0x80044084 0x80044E84 0x80045C84 0x80046A84 0x80047884 0x80048684 0x80049484 0x8004A284 0x8004B084 0x8004BE84 0x8004CC84 0x8004DA84 0x8004E884 /end VAR_ADDRESS
 /end VAR_CHARACTERISTIC
 /begin VAR_CHARACTERISTIC TP_ZS16ETCSCpReserved06 EngCalVariantCriterion
  /begin VAR_ADDRESS 0x8003A686 0x8003B486 0x8003C286 0x8003D086 0x8003DE86 0x8003EC86 0x8003FA86 0x80040886 0x80041686 0x80042486 0x80043286 0x80044086 0x80044E86 0x80045C86 0x80046A86 0x80047886 0x80048686 0x80049486 0x8004A286 0x8004B086 0x8004BE86 0x8004CC86 0x8004DA86 0x8004E886 /end VAR_ADDRESS
 /end VAR_CHARACTERISTIC
 /begin VAR_CHARACTERISTIC TP_ZS16ETCSCpReserved07 EngCalVariantCriterion
  /begin VAR_ADDRESS 0x8003A688 0x8003B488 0x8003C288 0x8003D088 0x8003DE88 0x8003EC88 0x8003FA88 0x80040888 0x80041688 0x80042488 0x80043288 0x80044088 0x80044E88 0x80045C88 0x80046A88 0x80047888 0x80048688 0x80049488 0x8004A288 0x8004B088 0x8004BE88 0x8004CC88 0x8004DA88 0x8004E888 /end VAR_ADDRESS
 /end VAR_CHARACTERISTIC
 /begin VAR_CHARACTERISTIC TP_ZS16ETCSCpReserved08 EngCalVariantCriterion
  /begin VAR_ADDRESS 0x8003A68A 0x8003B48A 0x8003C28A 0x8003D08A 0x8003DE8A 0x8003EC8A 0x8003FA8A 0x8004088A 0x8004168A 0x8004248A 0x8004328A 0x8004408A 0x80044E8A 0x80045C8A 0x80046A8A 0x8004788A 0x8004868A 0x8004948A 0x8004A28A 0x8004B08A 0x8004BE8A 0x8004CC8A 0x8004DA8A 0x8004E88A /end VAR_ADDRESS
 /end VAR_CHARACTERISTIC
 /begin VAR_CHARACTERISTIC TP_ZS16ETCSCpReserved09 EngCalVariantCriterion
  /begin VAR_ADDRESS 0x8003A68C 0x8003B48C 0x8003C28C 0x8003D08C 0x8003DE8C 0x8003EC8C 0x8003FA8C 0x8004088C 0x8004168C 0x8004248C 0x8004328C 0x8004408C 0x80044E8C 0x80045C8C 0x80046A8C 0x8004788C 0x8004868C 0x8004948C 0x8004A28C 0x8004B08C 0x8004BE8C 0x8004CC8C 0x8004DA8C 0x8004E88C /end VAR_ADDRESS
 /end VAR_CHARACTERISTIC
 /begin VAR_CHARACTERISTIC TP_ZS16ETCSCpReserved10 EngCalVariantCriterion
  /begin VAR_ADDRESS 0x8003A68E 0x8003B48E 0x8003C28E 0x8003D08E 0x8003DE8E 0x8003EC8E 0x8003FA8E 0x8004088E 0x8004168E 0x8004248E 0x8004328E 0x8004408E 0x80044E8E 0x80045C8E 0x80046A8E 0x8004788E 0x8004868E 0x8004948E 0x8004A28E 0x8004B08E 0x8004BE8E 0x8004CC8E 0x8004DA8E 0x8004E88E /end VAR_ADDRESS
 /end VAR_CHARACTERISTIC
 /begin VAR_CHARACTERISTIC TP_ZS16ETCSCpReserved11 EngCalVariantCriterion
  /begin VAR_ADDRESS 0x8003A690 0x8003B490 0x8003C290 0x8003D090 0x8003DE90 0x8003EC90 0x8003FA90 0x80040890 0x80041690 0x80042490 0x80043290 0x80044090 0x80044E90 0x80045C90 0x80046A90 0x80047890 0x80048690 0x80049490 0x8004A290 0x8004B090 0x8004BE90 0x8004CC90 0x8004DA90 0x8004E890 /end VAR_ADDRESS
 /end VAR_CHARACTERISTIC
 /begin VAR_CHARACTERISTIC TP_ZS16ETCSCpReserved12 EngCalVariantCriterion
  /begin VAR_ADDRESS 0x8003A692 0x8003B492 0x8003C292 0x8003D092 0x8003DE92 0x8003EC92 0x8003FA92 0x80040892 0x80041692 0x80042492 0x80043292 0x80044092 0x80044E92 0x80045C92 0x80046A92 0x80047892 0x80048692 0x80049492 0x8004A292 0x8004B092 0x8004BE92 0x8004CC92 0x8004DA92 0x8004E892 /end VAR_ADDRESS
 /end VAR_CHARACTERISTIC
 /begin VAR_CHARACTERISTIC TP_ZS16ETCSCpReserved13 EngCalVariantCriterion
  /begin VAR_ADDRESS 0x8003A694 0x8003B494 0x8003C294 0x8003D094 0x8003DE94 0x8003EC94 0x8003FA94 0x80040894 0x80041694 0x80042494 0x80043294 0x80044094 0x80044E94 0x80045C94 0x80046A94 0x80047894 0x80048694 0x80049494 0x8004A294 0x8004B094 0x8004BE94 0x8004CC94 0x8004DA94 0x8004E894 /end VAR_ADDRESS
 /end VAR_CHARACTERISTIC
 /begin VAR_CHARACTERISTIC TP_ZS16ETCSCpReserved14 EngCalVariantCriterion
  /begin VAR_ADDRESS 0x8003A696 0x8003B496 0x8003C296 0x8003D096 0x8003DE96 0x8003EC96 0x8003FA96 0x80040896 0x80041696 0x80042496 0x80043296 0x80044096 0x80044E96 0x80045C96 0x80046A96 0x80047896 0x80048696 0x80049496 0x8004A296 0x8004B096 0x8004BE96 0x8004CC96 0x8004DA96 0x8004E896 /end VAR_ADDRESS
 /end VAR_CHARACTERISTIC
 /begin VAR_CHARACTERISTIC TP_ZS16ETCSCpReserved15 EngCalVariantCriterion
  /begin VAR_ADDRESS 0x8003A698 0x8003B498 0x8003C298 0x8003D098 0x8003DE98 0x8003EC98 0x8003FA98 0x80040898 0x80041698 0x80042498 0x80043298 0x80044098 0x80044E98 0x80045C98 0x80046A98 0x80047898 0x80048698 0x80049498 0x8004A298 0x8004B098 0x8004BE98 0x8004CC98 0x8004DA98 0x8004E898 /end VAR_ADDRESS
 /end VAR_CHARACTERISTIC
 /begin VAR_CHARACTERISTIC TP_ZS16ETCSCpReserved16 EngCalVariantCriterion
  /begin VAR_ADDRESS 0x8003A69A 0x8003B49A 0x8003C29A 0x8003D09A 0x8003DE9A 0x8003EC9A 0x8003FA9A 0x8004089A 0x8004169A 0x8004249A 0x8004329A 0x8004409A 0x80044E9A 0x80045C9A 0x80046A9A 0x8004789A 0x8004869A 0x8004949A 0x8004A29A 0x8004B09A 0x8004BE9A 0x8004CC9A 0x8004DA9A 0x8004E89A /end VAR_ADDRESS
 /end VAR_CHARACTERISTIC
 /begin VAR_CHARACTERISTIC TP_ZS16ETCSCpReserved17 EngCalVariantCriterion
  /begin VAR_ADDRESS 0x8003A69C 0x8003B49C 0x8003C29C 0x8003D09C 0x8003DE9C 0x8003EC9C 0x8003FA9C 0x8004089C 0x8004169C 0x8004249C 0x8004329C 0x8004409C 0x80044E9C 0x80045C9C 0x80046A9C 0x8004789C 0x8004869C 0x8004949C 0x8004A29C 0x8004B09C 0x8004BE9C 0x8004CC9C 0x8004DA9C 0x8004E89C /end VAR_ADDRESS
 /end VAR_CHARACTERISTIC
 /begin VAR_CHARACTERISTIC TP_ZS16ETCSCpReserved18 EngCalVariantCriterion
  /begin VAR_ADDRESS 0x8003A69E 0x8003B49E 0x8003C29E 0x8003D09E 0x8003DE9E 0x8003EC9E 0x8003FA9E 0x8004089E 0x8004169E 0x8004249E 0x8004329E 0x8004409E 0x80044E9E 0x80045C9E 0x80046A9E 0x8004789E 0x8004869E 0x8004949E 0x8004A29E 0x8004B09E 0x8004BE9E 0x8004CC9E 0x8004DA9E 0x8004E89E /end VAR_ADDRESS
 /end VAR_CHARACTERISTIC
 /begin VAR_CHARACTERISTIC TP_ZS16ETCSCpReserved19 EngCalVariantCriterion
  /begin VAR_ADDRESS 0x8003A6A0 0x8003B4A0 0x8003C2A0 0x8003D0A0 0x8003DEA0 0x8003ECA0 0x8003FAA0 0x800408A0 0x800416A0 0x800424A0 0x800432A0 0x800440A0 0x80044EA0 0x80045CA0 0x80046AA0 0x800478A0 0x800486A0 0x800494A0 0x8004A2A0 0x8004B0A0 0x8004BEA0 0x8004CCA0 0x8004DAA0 0x8004E8A0 /end VAR_ADDRESS
 /end VAR_CHARACTERISTIC
 /begin VAR_CHARACTERISTIC TP_ZS16ETCSCpReserved20 EngCalVariantCriterion
  /begin VAR_ADDRESS 0x8003A6A2 0x8003B4A2 0x8003C2A2 0x8003D0A2 0x8003DEA2 0x8003ECA2 0x8003FAA2 0x800408A2 0x800416A2 0x800424A2 0x800432A2 0x800440A2 0x80044EA2 0x80045CA2 0x80046AA2 0x800478A2 0x800486A2 0x800494A2 0x8004A2A2 0x8004B0A2 0x8004BEA2 0x8004CCA2 0x8004DAA2 0x8004E8A2 /end VAR_ADDRESS
 /end VAR_CHARACTERISTIC
 /begin VAR_CHARACTERISTIC TP_ZS16ETCSCpReserved21 EngCalVariantCriterion
  /begin VAR_ADDRESS 0x8003A6A4 0x8003B4A4 0x8003C2A4 0x8003D0A4 0x8003DEA4 0x8003ECA4 0x8003FAA4 0x800408A4 0x800416A4 0x800424A4 0x800432A4 0x800440A4 0x80044EA4 0x80045CA4 0x80046AA4 0x800478A4 0x800486A4 0x800494A4 0x8004A2A4 0x8004B0A4 0x8004BEA4 0x8004CCA4 0x8004DAA4 0x8004E8A4 /end VAR_ADDRESS
 /end VAR_CHARACTERISTIC
 /begin VAR_CHARACTERISTIC TP_ZS16ETCSCpReserved22 EngCalVariantCriterion
  /begin VAR_ADDRESS 0x8003A6A6 0x8003B4A6 0x8003C2A6 0x8003D0A6 0x8003DEA6 0x8003ECA6 0x8003FAA6 0x800408A6 0x800416A6 0x800424A6 0x800432A6 0x800440A6 0x80044EA6 0x80045CA6 0x80046AA6 0x800478A6 0x800486A6 0x800494A6 0x8004A2A6 0x8004B0A6 0x8004BEA6 0x8004CCA6 0x8004DAA6 0x8004E8A6 /end VAR_ADDRESS
 /end VAR_CHARACTERISTIC
 /begin VAR_CHARACTERISTIC TQCW_S16_STR_RATIO_10_1st BrkCalVariantCriterion
  /begin VAR_ADDRESS 0x80020086 0x80023486 0x80026886 0x80029C86 0x8002D086 0x80030486 0x80033886 0x80036C86 /end VAR_ADDRESS
 /end VAR_CHARACTERISTIC
 /begin VAR_CHARACTERISTIC TQCW_S16_STR_RATIO_10_2nd BrkCalVariantCriterion
  /begin VAR_ADDRESS 0x80020088 0x80023488 0x80026888 0x80029C88 0x8002D088 0x80030488 0x80033888 0x80036C88 /end VAR_ADDRESS
 /end VAR_CHARACTERISTIC
 /begin VAR_CHARACTERISTIC TQCW_S16_STR_RATIO_10_3rd BrkCalVariantCriterion
  /begin VAR_ADDRESS 0x8002008A 0x8002348A 0x8002688A 0x80029C8A 0x8002D08A 0x8003048A 0x8003388A 0x80036C8A /end VAR_ADDRESS
 /end VAR_CHARACTERISTIC
 /begin VAR_CHARACTERISTIC TQCW_S16_STR_RATIO_10_4th BrkCalVariantCriterion
  /begin VAR_ADDRESS 0x8002008C 0x8002348C 0x8002688C 0x80029C8C 0x8002D08C 0x8003048C 0x8003388C 0x80036C8C /end VAR_ADDRESS
 /end VAR_CHARACTERISTIC
 /begin VAR_CHARACTERISTIC TQCW_S16_STR_RATIO_10_5th BrkCalVariantCriterion
  /begin VAR_ADDRESS 0x8002008E 0x8002348E 0x8002688E 0x80029C8E 0x8002D08E 0x8003048E 0x8003388E 0x80036C8E /end VAR_ADDRESS
 /end VAR_CHARACTERISTIC
 /begin VAR_CHARACTERISTIC TQCW_S16_STR_RATIO_10_MAX BrkCalVariantCriterion
  /begin VAR_ADDRESS 0x80020090 0x80023490 0x80026890 0x80029C90 0x8002D090 0x80030490 0x80033890 0x80036C90 /end VAR_ADDRESS
 /end VAR_CHARACTERISTIC
 /begin VAR_CHARACTERISTIC TQEHC_Select_Yawrate BrkCalVariantCriterion
  /begin VAR_ADDRESS 0x80020EA0 0x800242A0 0x800276A0 0x8002AAA0 0x8002DEA0 0x800312A0 0x800346A0 0x80037AA0 /end VAR_ADDRESS
 /end VAR_CHARACTERISTIC
 /begin VAR_CHARACTERISTIC TQEHCuint8InhibitionFlag BrkCalVariantCriterion
  /begin VAR_ADDRESS 0x80020CDE 0x800240DE 0x800274DE 0x8002A8DE 0x8002DCDE 0x800310DE 0x800344DE 0x800378DE /end VAR_ADDRESS
 /end VAR_CHARACTERISTIC
 /begin VAR_CHARACTERISTIC TQGEAR_POS_TM_R BrkCalVariantCriterion
  /begin VAR_ADDRESS 0x80020D5E 0x8002415E 0x8002755E 0x8002A95E 0x8002DD5E 0x8003115E 0x8003455E 0x8003795E /end VAR_ADDRESS
 /end VAR_CHARACTERISTIC
 /begin VAR_CHARACTERISTIC TQMass_height BrkCalVariantCriterion
  /begin VAR_ADDRESS 0x800209C2 0x80023DC2 0x800271C2 0x8002A5C2 0x8002D9C2 0x80030DC2 0x800341C2 0x800375C2 /end VAR_ADDRESS
 /end VAR_CHARACTERISTIC
 /begin VAR_CHARACTERISTIC TQMuSlipCurve_Alpha_HM_MAX BrkCalVariantCriterion
  /begin VAR_ADDRESS 0x8002097C 0x80023D7C 0x8002717C 0x8002A57C 0x8002D97C 0x80030D7C 0x8003417C 0x8003757C /end VAR_ADDRESS
 /end VAR_CHARACTERISTIC
 /begin VAR_CHARACTERISTIC TQMuSlipCurve_Alpha_HM_MIN BrkCalVariantCriterion
  /begin VAR_ADDRESS 0x8002097A 0x80023D7A 0x8002717A 0x8002A57A 0x8002D97A 0x80030D7A 0x8003417A 0x8003757A /end VAR_ADDRESS
 /end VAR_CHARACTERISTIC
 /begin VAR_CHARACTERISTIC TQMuSlipCurve_Alpha_LM_MAX BrkCalVariantCriterion
  /begin VAR_ADDRESS 0x800209AC 0x80023DAC 0x800271AC 0x8002A5AC 0x8002D9AC 0x80030DAC 0x800341AC 0x800375AC /end VAR_ADDRESS
 /end VAR_CHARACTERISTIC
 /begin VAR_CHARACTERISTIC TQMuSlipCurve_Alpha_LM_MIN BrkCalVariantCriterion
  /begin VAR_ADDRESS 0x800209AA 0x80023DAA 0x800271AA 0x8002A5AA 0x8002D9AA 0x80030DAA 0x800341AA 0x800375AA /end VAR_ADDRESS
 /end VAR_CHARACTERISTIC
 /begin VAR_CHARACTERISTIC TQMuSlipCurve_Alpha_MM_MAX BrkCalVariantCriterion
  /begin VAR_ADDRESS 0x80020994 0x80023D94 0x80027194 0x8002A594 0x8002D994 0x80030D94 0x80034194 0x80037594 /end VAR_ADDRESS
 /end VAR_CHARACTERISTIC
 /begin VAR_CHARACTERISTIC TQMuSlipCurve_Alpha_MM_MIN BrkCalVariantCriterion
  /begin VAR_ADDRESS 0x80020992 0x80023D92 0x80027192 0x8002A592 0x8002D992 0x80030D92 0x80034192 0x80037592 /end VAR_ADDRESS
 /end VAR_CHARACTERISTIC
 /begin VAR_CHARACTERISTIC TQMuSlipCurve_FRICT_H_11 BrkCalVariantCriterion
  /begin VAR_ADDRESS 0x8002097E 0x80023D7E 0x8002717E 0x8002A57E 0x8002D97E 0x80030D7E 0x8003417E 0x8003757E /end VAR_ADDRESS
 /end VAR_CHARACTERISTIC
 /begin VAR_CHARACTERISTIC TQMuSlipCurve_FRICT_H_12 BrkCalVariantCriterion
  /begin VAR_ADDRESS 0x80020980 0x80023D80 0x80027180 0x8002A580 0x8002D980 0x80030D80 0x80034180 0x80037580 /end VAR_ADDRESS
 /end VAR_CHARACTERISTIC
 /begin VAR_CHARACTERISTIC TQMuSlipCurve_FRICT_H_13 BrkCalVariantCriterion
  /begin VAR_ADDRESS 0x80020982 0x80023D82 0x80027182 0x8002A582 0x8002D982 0x80030D82 0x80034182 0x80037582 /end VAR_ADDRESS
 /end VAR_CHARACTERISTIC
 /begin VAR_CHARACTERISTIC TQMuSlipCurve_FRICT_H_14 BrkCalVariantCriterion
  /begin VAR_ADDRESS 0x80020984 0x80023D84 0x80027184 0x8002A584 0x8002D984 0x80030D84 0x80034184 0x80037584 /end VAR_ADDRESS
 /end VAR_CHARACTERISTIC
 /begin VAR_CHARACTERISTIC TQMuSlipCurve_FRICT_H_15 BrkCalVariantCriterion
  /begin VAR_ADDRESS 0x80020986 0x80023D86 0x80027186 0x8002A586 0x8002D986 0x80030D86 0x80034186 0x80037586 /end VAR_ADDRESS
 /end VAR_CHARACTERISTIC
 /begin VAR_CHARACTERISTIC TQMuSlipCurve_FRICT_H_21 BrkCalVariantCriterion
  /begin VAR_ADDRESS 0x80020988 0x80023D88 0x80027188 0x8002A588 0x8002D988 0x80030D88 0x80034188 0x80037588 /end VAR_ADDRESS
 /end VAR_CHARACTERISTIC
 /begin VAR_CHARACTERISTIC TQMuSlipCurve_FRICT_H_22 BrkCalVariantCriterion
  /begin VAR_ADDRESS 0x8002098A 0x80023D8A 0x8002718A 0x8002A58A 0x8002D98A 0x80030D8A 0x8003418A 0x8003758A /end VAR_ADDRESS
 /end VAR_CHARACTERISTIC
 /begin VAR_CHARACTERISTIC TQMuSlipCurve_FRICT_H_23 BrkCalVariantCriterion
  /begin VAR_ADDRESS 0x8002098C 0x80023D8C 0x8002718C 0x8002A58C 0x8002D98C 0x80030D8C 0x8003418C 0x8003758C /end VAR_ADDRESS
 /end VAR_CHARACTERISTIC
 /begin VAR_CHARACTERISTIC TQMuSlipCurve_FRICT_H_24 BrkCalVariantCriterion
  /begin VAR_ADDRESS 0x8002098E 0x80023D8E 0x8002718E 0x8002A58E 0x8002D98E 0x80030D8E 0x8003418E 0x8003758E /end VAR_ADDRESS
 /end VAR_CHARACTERISTIC
 /begin VAR_CHARACTERISTIC TQMuSlipCurve_FRICT_H_25 BrkCalVariantCriterion
  /begin VAR_ADDRESS 0x80020990 0x80023D90 0x80027190 0x8002A590 0x8002D990 0x80030D90 0x80034190 0x80037590 /end VAR_ADDRESS
 /end VAR_CHARACTERISTIC
 /begin VAR_CHARACTERISTIC TQMuSlipCurve_FRICT_L_11 BrkCalVariantCriterion
  /begin VAR_ADDRESS 0x800209AE 0x80023DAE 0x800271AE 0x8002A5AE 0x8002D9AE 0x80030DAE 0x800341AE 0x800375AE /end VAR_ADDRESS
 /end VAR_CHARACTERISTIC
 /begin VAR_CHARACTERISTIC TQMuSlipCurve_FRICT_L_12 BrkCalVariantCriterion
  /begin VAR_ADDRESS 0x800209B0 0x80023DB0 0x800271B0 0x8002A5B0 0x8002D9B0 0x80030DB0 0x800341B0 0x800375B0 /end VAR_ADDRESS
 /end VAR_CHARACTERISTIC
 /begin VAR_CHARACTERISTIC TQMuSlipCurve_FRICT_L_13 BrkCalVariantCriterion
  /begin VAR_ADDRESS 0x800209B2 0x80023DB2 0x800271B2 0x8002A5B2 0x8002D9B2 0x80030DB2 0x800341B2 0x800375B2 /end VAR_ADDRESS
 /end VAR_CHARACTERISTIC
 /begin VAR_CHARACTERISTIC TQMuSlipCurve_FRICT_L_14 BrkCalVariantCriterion
  /begin VAR_ADDRESS 0x800209B4 0x80023DB4 0x800271B4 0x8002A5B4 0x8002D9B4 0x80030DB4 0x800341B4 0x800375B4 /end VAR_ADDRESS
 /end VAR_CHARACTERISTIC
 /begin VAR_CHARACTERISTIC TQMuSlipCurve_FRICT_L_15 BrkCalVariantCriterion
  /begin VAR_ADDRESS 0x800209B6 0x80023DB6 0x800271B6 0x8002A5B6 0x8002D9B6 0x80030DB6 0x800341B6 0x800375B6 /end VAR_ADDRESS
 /end VAR_CHARACTERISTIC
 /begin VAR_CHARACTERISTIC TQMuSlipCurve_FRICT_L_21 BrkCalVariantCriterion
  /begin VAR_ADDRESS 0x800209B8 0x80023DB8 0x800271B8 0x8002A5B8 0x8002D9B8 0x80030DB8 0x800341B8 0x800375B8 /end VAR_ADDRESS
 /end VAR_CHARACTERISTIC
 /begin VAR_CHARACTERISTIC TQMuSlipCurve_FRICT_L_22 BrkCalVariantCriterion
  /begin VAR_ADDRESS 0x800209BA 0x80023DBA 0x800271BA 0x8002A5BA 0x8002D9BA 0x80030DBA 0x800341BA 0x800375BA /end VAR_ADDRESS
 /end VAR_CHARACTERISTIC
 /begin VAR_CHARACTERISTIC TQMuSlipCurve_FRICT_L_23 BrkCalVariantCriterion
  /begin VAR_ADDRESS 0x800209BC 0x80023DBC 0x800271BC 0x8002A5BC 0x8002D9BC 0x80030DBC 0x800341BC 0x800375BC /end VAR_ADDRESS
 /end VAR_CHARACTERISTIC
 /begin VAR_CHARACTERISTIC TQMuSlipCurve_FRICT_L_24 BrkCalVariantCriterion
  /begin VAR_ADDRESS 0x800209BE 0x80023DBE 0x800271BE 0x8002A5BE 0x8002D9BE 0x80030DBE 0x800341BE 0x800375BE /end VAR_ADDRESS
 /end VAR_CHARACTERISTIC
 /begin VAR_CHARACTERISTIC TQMuSlipCurve_FRICT_L_25 BrkCalVariantCriterion
  /begin VAR_ADDRESS 0x800209C0 0x80023DC0 0x800271C0 0x8002A5C0 0x8002D9C0 0x80030DC0 0x800341C0 0x800375C0 /end VAR_ADDRESS
 /end VAR_CHARACTERISTIC
 /begin VAR_CHARACTERISTIC TQMuSlipCurve_FRICT_M_11 BrkCalVariantCriterion
  /begin VAR_ADDRESS 0x80020996 0x80023D96 0x80027196 0x8002A596 0x8002D996 0x80030D96 0x80034196 0x80037596 /end VAR_ADDRESS
 /end VAR_CHARACTERISTIC
 /begin VAR_CHARACTERISTIC TQMuSlipCurve_FRICT_M_12 BrkCalVariantCriterion
  /begin VAR_ADDRESS 0x80020998 0x80023D98 0x80027198 0x8002A598 0x8002D998 0x80030D98 0x80034198 0x80037598 /end VAR_ADDRESS
 /end VAR_CHARACTERISTIC
 /begin VAR_CHARACTERISTIC TQMuSlipCurve_FRICT_M_13 BrkCalVariantCriterion
  /begin VAR_ADDRESS 0x8002099A 0x80023D9A 0x8002719A 0x8002A59A 0x8002D99A 0x80030D9A 0x8003419A 0x8003759A /end VAR_ADDRESS
 /end VAR_CHARACTERISTIC
 /begin VAR_CHARACTERISTIC TQMuSlipCurve_FRICT_M_14 BrkCalVariantCriterion
  /begin VAR_ADDRESS 0x8002099C 0x80023D9C 0x8002719C 0x8002A59C 0x8002D99C 0x80030D9C 0x8003419C 0x8003759C /end VAR_ADDRESS
 /end VAR_CHARACTERISTIC
 /begin VAR_CHARACTERISTIC TQMuSlipCurve_FRICT_M_15 BrkCalVariantCriterion
  /begin VAR_ADDRESS 0x8002099E 0x80023D9E 0x8002719E 0x8002A59E 0x8002D99E 0x80030D9E 0x8003419E 0x8003759E /end VAR_ADDRESS
 /end VAR_CHARACTERISTIC
 /begin VAR_CHARACTERISTIC TQMuSlipCurve_FRICT_M_21 BrkCalVariantCriterion
  /begin VAR_ADDRESS 0x800209A0 0x80023DA0 0x800271A0 0x8002A5A0 0x8002D9A0 0x80030DA0 0x800341A0 0x800375A0 /end VAR_ADDRESS
 /end VAR_CHARACTERISTIC
 /begin VAR_CHARACTERISTIC TQMuSlipCurve_FRICT_M_22 BrkCalVariantCriterion
  /begin VAR_ADDRESS 0x800209A2 0x80023DA2 0x800271A2 0x8002A5A2 0x8002D9A2 0x80030DA2 0x800341A2 0x800375A2 /end VAR_ADDRESS
 /end VAR_CHARACTERISTIC
 /begin VAR_CHARACTERISTIC TQMuSlipCurve_FRICT_M_23 BrkCalVariantCriterion
  /begin VAR_ADDRESS 0x800209A4 0x80023DA4 0x800271A4 0x8002A5A4 0x8002D9A4 0x80030DA4 0x800341A4 0x800375A4 /end VAR_ADDRESS
 /end VAR_CHARACTERISTIC
 /begin VAR_CHARACTERISTIC TQMuSlipCurve_FRICT_M_24 BrkCalVariantCriterion
  /begin VAR_ADDRESS 0x800209A6 0x80023DA6 0x800271A6 0x8002A5A6 0x8002D9A6 0x80030DA6 0x800341A6 0x800375A6 /end VAR_ADDRESS
 /end VAR_CHARACTERISTIC
 /begin VAR_CHARACTERISTIC TQMuSlipCurve_FRICT_M_25 BrkCalVariantCriterion
  /begin VAR_ADDRESS 0x800209A8 0x80023DA8 0x800271A8 0x8002A5A8 0x8002D9A8 0x80030DA8 0x800341A8 0x800375A8 /end VAR_ADDRESS
 /end VAR_CHARACTERISTIC
 /begin VAR_CHARACTERISTIC TQMuSlipCurve_Slip_1 BrkCalVariantCriterion
  /begin VAR_ADDRESS 0x80020970 0x80023D70 0x80027170 0x8002A570 0x8002D970 0x80030D70 0x80034170 0x80037570 /end VAR_ADDRESS
 /end VAR_CHARACTERISTIC
 /begin VAR_CHARACTERISTIC TQMuSlipCurve_Slip_2 BrkCalVariantCriterion
  /begin VAR_ADDRESS 0x80020972 0x80023D72 0x80027172 0x8002A572 0x8002D972 0x80030D72 0x80034172 0x80037572 /end VAR_ADDRESS
 /end VAR_CHARACTERISTIC
 /begin VAR_CHARACTERISTIC TQMuSlipCurve_Slip_3 BrkCalVariantCriterion
  /begin VAR_ADDRESS 0x80020974 0x80023D74 0x80027174 0x8002A574 0x8002D974 0x80030D74 0x80034174 0x80037574 /end VAR_ADDRESS
 /end VAR_CHARACTERISTIC
 /begin VAR_CHARACTERISTIC TQMuSlipCurve_Slip_4 BrkCalVariantCriterion
  /begin VAR_ADDRESS 0x80020976 0x80023D76 0x80027176 0x8002A576 0x8002D976 0x80030D76 0x80034176 0x80037576 /end VAR_ADDRESS
 /end VAR_CHARACTERISTIC
 /begin VAR_CHARACTERISTIC TQMuSlipCurve_Slip_5 BrkCalVariantCriterion
  /begin VAR_ADDRESS 0x80020978 0x80023D78 0x80027178 0x8002A578 0x8002D978 0x80030D78 0x80034178 0x80037578 /end VAR_ADDRESS
 /end VAR_CHARACTERISTIC
 /begin VAR_CHARACTERISTIC TQRadius_Wheel BrkCalVariantCriterion
  /begin VAR_ADDRESS 0x800209C4 0x80023DC4 0x800271C4 0x8002A5C4 0x8002D9C4 0x80030DC4 0x800341C4 0x800375C4 /end VAR_ADDRESS
 /end VAR_CHARACTERISTIC
 /begin VAR_CHARACTERISTIC TQS16_ADM_VCH_NOMINAL BrkCalVariantCriterion
  /begin VAR_ADDRESS 0x8002006C 0x8002346C 0x8002686C 0x80029C6C 0x8002D06C 0x8003046C 0x8003386C 0x80036C6C /end VAR_ADDRESS
 /end VAR_CHARACTERISTIC
 /begin VAR_CHARACTERISTIC TQS16_AYC_1ST_CYCLE_D_IN_WEG BrkCalVariantCriterion
  /begin VAR_ADDRESS 0x80020BCC 0x80023FCC 0x800273CC 0x8002A7CC 0x8002DBCC 0x80030FCC 0x800343CC 0x800377CC /end VAR_ADDRESS
 /end VAR_CHARACTERISTIC
 /begin VAR_CHARACTERISTIC TQS16_AYC_1ST_CYCLE_D_OUT_WEG BrkCalVariantCriterion
  /begin VAR_ADDRESS 0x80020BCE 0x80023FCE 0x800273CE 0x8002A7CE 0x8002DBCE 0x80030FCE 0x800343CE 0x800377CE /end VAR_ADDRESS
 /end VAR_CHARACTERISTIC
 /begin VAR_CHARACTERISTIC TQS16_AYC_1ST_CYCLE_P_IN_WEG BrkCalVariantCriterion
  /begin VAR_ADDRESS 0x80020BD0 0x80023FD0 0x800273D0 0x8002A7D0 0x8002DBD0 0x80030FD0 0x800343D0 0x800377D0 /end VAR_ADDRESS
 /end VAR_CHARACTERISTIC
 /begin VAR_CHARACTERISTIC TQS16_AYC_1ST_CYCLE_P_OUT_WEG BrkCalVariantCriterion
  /begin VAR_ADDRESS 0x80020BD2 0x80023FD2 0x800273D2 0x8002A7D2 0x8002DBD2 0x80030FD2 0x800343D2 0x800377D2 /end VAR_ADDRESS
 /end VAR_CHARACTERISTIC
 /begin VAR_CHARACTERISTIC TQS16_AYC_D_GAIN_INSIDE_DEC BrkCalVariantCriterion
  /begin VAR_ADDRESS 0x80020B7C 0x80023F7C 0x8002737C 0x8002A77C 0x8002DB7C 0x80030F7C 0x8003437C 0x8003777C /end VAR_ADDRESS
 /end VAR_CHARACTERISTIC
 /begin VAR_CHARACTERISTIC TQS16_AYC_D_GAIN_INSIDE_INC BrkCalVariantCriterion
  /begin VAR_ADDRESS 0x80020B7E 0x80023F7E 0x8002737E 0x8002A77E 0x8002DB7E 0x80030F7E 0x8003437E 0x8003777E /end VAR_ADDRESS
 /end VAR_CHARACTERISTIC
 /begin VAR_CHARACTERISTIC TQS16_AYC_D_GAIN_OUTSIDE_DEC BrkCalVariantCriterion
  /begin VAR_ADDRESS 0x80020B74 0x80023F74 0x80027374 0x8002A774 0x8002DB74 0x80030F74 0x80034374 0x80037774 /end VAR_ADDRESS
 /end VAR_CHARACTERISTIC
 /begin VAR_CHARACTERISTIC TQS16_AYC_D_GAIN_OUTSIDE_INC BrkCalVariantCriterion
  /begin VAR_ADDRESS 0x80020B76 0x80023F76 0x80027376 0x8002A776 0x8002DB76 0x80030F76 0x80034376 0x80037776 /end VAR_ADDRESS
 /end VAR_CHARACTERISTIC
 /begin VAR_CHARACTERISTIC TQS16_AYC_MQ_WEG_VEL_100K BrkCalVariantCriterion
  /begin VAR_ADDRESS 0x80020B84 0x80023F84 0x80027384 0x8002A784 0x8002DB84 0x80030F84 0x80034384 0x80037784 /end VAR_ADDRESS
 /end VAR_CHARACTERISTIC
 /begin VAR_CHARACTERISTIC TQS16_AYC_MQ_WEG_VEL_20K BrkCalVariantCriterion
  /begin VAR_ADDRESS 0x80020B86 0x80023F86 0x80027386 0x8002A786 0x8002DB86 0x80030F86 0x80034386 0x80037786 /end VAR_ADDRESS
 /end VAR_CHARACTERISTIC
 /begin VAR_CHARACTERISTIC TQS16_AYC_MQ_WEG_VEL_40K BrkCalVariantCriterion
  /begin VAR_ADDRESS 0x80020B88 0x80023F88 0x80027388 0x8002A788 0x8002DB88 0x80030F88 0x80034388 0x80037788 /end VAR_ADDRESS
 /end VAR_CHARACTERISTIC
 /begin VAR_CHARACTERISTIC TQS16_AYC_MQ_WEG_VEL_60K BrkCalVariantCriterion
  /begin VAR_ADDRESS 0x80020B8A 0x80023F8A 0x8002738A 0x8002A78A 0x8002DB8A 0x80030F8A 0x8003438A 0x8003778A /end VAR_ADDRESS
 /end VAR_CHARACTERISTIC
 /begin VAR_CHARACTERISTIC TQS16_AYC_MQ_WEG_VEL_80K BrkCalVariantCriterion
  /begin VAR_ADDRESS 0x80020B8C 0x80023F8C 0x8002738C 0x8002A78C 0x8002DB8C 0x80030F8C 0x8003438C 0x8003778C /end VAR_ADDRESS
 /end VAR_CHARACTERISTIC
 /begin VAR_CHARACTERISTIC TQS16_AYC_P_GAIN_INSIDE_DEC BrkCalVariantCriterion
  /begin VAR_ADDRESS 0x80020B80 0x80023F80 0x80027380 0x8002A780 0x8002DB80 0x80030F80 0x80034380 0x80037780 /end VAR_ADDRESS
 /end VAR_CHARACTERISTIC
 /begin VAR_CHARACTERISTIC TQS16_AYC_P_GAIN_INSIDE_INC BrkCalVariantCriterion
  /begin VAR_ADDRESS 0x80020B82 0x80023F82 0x80027382 0x8002A782 0x8002DB82 0x80030F82 0x80034382 0x80037782 /end VAR_ADDRESS
 /end VAR_CHARACTERISTIC
 /begin VAR_CHARACTERISTIC TQS16_AYC_P_GAIN_OUTSIDE_DEC BrkCalVariantCriterion
  /begin VAR_ADDRESS 0x80020B78 0x80023F78 0x80027378 0x8002A778 0x8002DB78 0x80030F78 0x80034378 0x80037778 /end VAR_ADDRESS
 /end VAR_CHARACTERISTIC
 /begin VAR_CHARACTERISTIC TQS16_AYC_P_GAIN_OUTSIDE_INC BrkCalVariantCriterion
  /begin VAR_ADDRESS 0x80020B7A 0x80023F7A 0x8002737A 0x8002A77A 0x8002DB7A 0x80030F7A 0x8003437A 0x8003777A /end VAR_ADDRESS
 /end VAR_CHARACTERISTIC
 /begin VAR_CHARACTERISTIC TQS16_AY_P_GAIN_FED_FOWR BrkCalVariantCriterion
  /begin VAR_ADDRESS 0x80020B72 0x80023F72 0x80027372 0x8002A772 0x8002DB72 0x80030F72 0x80034372 0x80037772 /end VAR_ADDRESS
 /end VAR_CHARACTERISTIC
 /begin VAR_CHARACTERISTIC TQS16_AY_REF_DYN_WEG_VEL_100K BrkCalVariantCriterion
  /begin VAR_ADDRESS 0x80020B8E 0x80023F8E 0x8002738E 0x8002A78E 0x8002DB8E 0x80030F8E 0x8003438E 0x8003778E /end VAR_ADDRESS
 /end VAR_CHARACTERISTIC
 /begin VAR_CHARACTERISTIC TQS16_AY_REF_DYN_WEG_VEL_20K BrkCalVariantCriterion
  /begin VAR_ADDRESS 0x80020B90 0x80023F90 0x80027390 0x8002A790 0x8002DB90 0x80030F90 0x80034390 0x80037790 /end VAR_ADDRESS
 /end VAR_CHARACTERISTIC
 /begin VAR_CHARACTERISTIC TQS16_AY_REF_DYN_WEG_VEL_40K BrkCalVariantCriterion
  /begin VAR_ADDRESS 0x80020B92 0x80023F92 0x80027392 0x8002A792 0x8002DB92 0x80030F92 0x80034392 0x80037792 /end VAR_ADDRESS
 /end VAR_CHARACTERISTIC
 /begin VAR_CHARACTERISTIC TQS16_AY_REF_DYN_WEG_VEL_60K BrkCalVariantCriterion
  /begin VAR_ADDRESS 0x80020B94 0x80023F94 0x80027394 0x8002A794 0x8002DB94 0x80030F94 0x80034394 0x80037794 /end VAR_ADDRESS
 /end VAR_CHARACTERISTIC
 /begin VAR_CHARACTERISTIC TQS16_AY_REF_DYN_WEG_VEL_80K BrkCalVariantCriterion
  /begin VAR_ADDRESS 0x80020B96 0x80023F96 0x80027396 0x8002A796 0x8002DB96 0x80030F96 0x80034396 0x80037796 /end VAR_ADDRESS
 /end VAR_CHARACTERISTIC
 /begin VAR_CHARACTERISTIC TQS16_AY_REF_MAX_OFFSET BrkCalVariantCriterion
  /begin VAR_ADDRESS 0x80020B98 0x80023F98 0x80027398 0x8002A798 0x8002DB98 0x80030F98 0x80034398 0x80037798 /end VAR_ADDRESS
 /end VAR_CHARACTERISTIC
 /begin VAR_CHARACTERISTIC TQS16_AY_REF_MIN_OFFSET BrkCalVariantCriterion
  /begin VAR_ADDRESS 0x80020B9A 0x80023F9A 0x8002739A 0x8002A79A 0x8002DB9A 0x80030F9A 0x8003439A 0x8003779A /end VAR_ADDRESS
 /end VAR_CHARACTERISTIC
 /begin VAR_CHARACTERISTIC TQS16_AY_REF_WEG_VEL_100K BrkCalVariantCriterion
  /begin VAR_ADDRESS 0x80020B9C 0x80023F9C 0x8002739C 0x8002A79C 0x8002DB9C 0x80030F9C 0x8003439C 0x8003779C /end VAR_ADDRESS
 /end VAR_CHARACTERISTIC
 /begin VAR_CHARACTERISTIC TQS16_AY_REF_WEG_VEL_20K BrkCalVariantCriterion
  /begin VAR_ADDRESS 0x80020B9E 0x80023F9E 0x8002739E 0x8002A79E 0x8002DB9E 0x80030F9E 0x8003439E 0x8003779E /end VAR_ADDRESS
 /end VAR_CHARACTERISTIC
 /begin VAR_CHARACTERISTIC TQS16_AY_REF_WEG_VEL_40K BrkCalVariantCriterion
  /begin VAR_ADDRESS 0x80020BA0 0x80023FA0 0x800273A0 0x8002A7A0 0x8002DBA0 0x80030FA0 0x800343A0 0x800377A0 /end VAR_ADDRESS
 /end VAR_CHARACTERISTIC
 /begin VAR_CHARACTERISTIC TQS16_AY_REF_WEG_VEL_60K BrkCalVariantCriterion
  /begin VAR_ADDRESS 0x80020BA2 0x80023FA2 0x800273A2 0x8002A7A2 0x8002DBA2 0x80030FA2 0x800343A2 0x800377A2 /end VAR_ADDRESS
 /end VAR_CHARACTERISTIC
 /begin VAR_CHARACTERISTIC TQS16_AY_REF_WEG_VEL_80K BrkCalVariantCriterion
  /begin VAR_ADDRESS 0x80020BA4 0x80023FA4 0x800273A4 0x8002A7A4 0x8002DBA4 0x80030FA4 0x800343A4 0x800377A4 /end VAR_ADDRESS
 /end VAR_CHARACTERISTIC
 /begin VAR_CHARACTERISTIC TQS16_BANK_ALAT_Roll_Gain BrkCalVariantCriterion
  /begin VAR_ADDRESS 0x80020092 0x80023492 0x80026892 0x80029C92 0x8002D092 0x80030492 0x80033892 0x80036C92 /end VAR_ADDRESS
 /end VAR_CHARACTERISTIC
 /begin VAR_CHARACTERISTIC TQS16_BANK_THRES_ADD_ALAT_COND_OF_LOW_SUS BrkCalVariantCriterion
  /begin VAR_ADDRESS 0x800209D6 0x80023DD6 0x800271D6 0x8002A5D6 0x8002D9D6 0x80030DD6 0x800341D6 0x800375D6 /end VAR_ADDRESS
 /end VAR_CHARACTERISTIC
 /begin VAR_CHARACTERISTIC TQS16_BANK_THRES_ADD_VREF_COND_OF_LOW_SUS BrkCalVariantCriterion
  /begin VAR_ADDRESS 0x800209D8 0x80023DD8 0x800271D8 0x8002A5D8 0x8002D9D8 0x80030DD8 0x800341D8 0x800375D8 /end VAR_ADDRESS
 /end VAR_CHARACTERISTIC
 /begin VAR_CHARACTERISTIC TQS16_BRK_LMT_Ax_EST_1ST BrkCalVariantCriterion
  /begin VAR_ADDRESS 0x80020B00 0x80023F00 0x80027300 0x8002A700 0x8002DB00 0x80030F00 0x80034300 0x80037700 /end VAR_ADDRESS
 /end VAR_CHARACTERISTIC
 /begin VAR_CHARACTERISTIC TQS16_BRK_LMT_Ax_EST_2ND BrkCalVariantCriterion
  /begin VAR_ADDRESS 0x80020B02 0x80023F02 0x80027302 0x8002A702 0x8002DB02 0x80030F02 0x80034302 0x80037702 /end VAR_ADDRESS
 /end VAR_CHARACTERISTIC
 /begin VAR_CHARACTERISTIC TQS16_BRK_LMT_Ax_EST_3RD BrkCalVariantCriterion
  /begin VAR_ADDRESS 0x80020B04 0x80023F04 0x80027304 0x8002A704 0x8002DB04 0x80030F04 0x80034304 0x80037704 /end VAR_ADDRESS
 /end VAR_CHARACTERISTIC
 /begin VAR_CHARACTERISTIC TQS16_BRK_LMT_Ax_EST_4TH BrkCalVariantCriterion
  /begin VAR_ADDRESS 0x80020B06 0x80023F06 0x80027306 0x8002A706 0x8002DB06 0x80030F06 0x80034306 0x80037706 /end VAR_ADDRESS
 /end VAR_CHARACTERISTIC
 /begin VAR_CHARACTERISTIC TQS16_BRK_LMT_Ay_VALUE_1ST BrkCalVariantCriterion
  /begin VAR_ADDRESS 0x80020B08 0x80023F08 0x80027308 0x8002A708 0x8002DB08 0x80030F08 0x80034308 0x80037708 /end VAR_ADDRESS
 /end VAR_CHARACTERISTIC
 /begin VAR_CHARACTERISTIC TQS16_BRK_LMT_Ay_VALUE_2ND BrkCalVariantCriterion
  /begin VAR_ADDRESS 0x80020B0A 0x80023F0A 0x8002730A 0x8002A70A 0x8002DB0A 0x80030F0A 0x8003430A 0x8003770A /end VAR_ADDRESS
 /end VAR_CHARACTERISTIC
 /begin VAR_CHARACTERISTIC TQS16_BRK_LMT_Ay_VALUE_3RD BrkCalVariantCriterion
  /begin VAR_ADDRESS 0x80020B0C 0x80023F0C 0x8002730C 0x8002A70C 0x8002DB0C 0x80030F0C 0x8003430C 0x8003770C /end VAR_ADDRESS
 /end VAR_CHARACTERISTIC
 /begin VAR_CHARACTERISTIC TQS16_BRK_LMT_Ay_VALUE_4TH BrkCalVariantCriterion
  /begin VAR_ADDRESS 0x80020B0E 0x80023F0E 0x8002730E 0x8002A70E 0x8002DB0E 0x80030F0E 0x8003430E 0x8003770E /end VAR_ADDRESS
 /end VAR_CHARACTERISTIC
 /begin VAR_CHARACTERISTIC TQS16_BRK_TORQ_D_GAIN BrkCalVariantCriterion
  /begin VAR_ADDRESS 0x8002081C 0x80023C1C 0x8002701C 0x8002A41C 0x8002D81C 0x80030C1C 0x8003401C 0x8003741C /end VAR_ADDRESS
 /end VAR_CHARACTERISTIC
 /begin VAR_CHARACTERISTIC TQS16_BRK_TORQ_P_GAIN BrkCalVariantCriterion
  /begin VAR_ADDRESS 0x8002081A 0x80023C1A 0x8002701A 0x8002A41A 0x8002D81A 0x80030C1A 0x8003401A 0x8003741A /end VAR_ADDRESS
 /end VAR_CHARACTERISTIC
 /begin VAR_CHARACTERISTIC TQS16_BRK_TORQ_P_GAIN_SLIP_X1_HMU BrkCalVariantCriterion
  /begin VAR_ADDRESS 0x80020E64 0x80024264 0x80027664 0x8002AA64 0x8002DE64 0x80031264 0x80034664 0x80037A64 /end VAR_ADDRESS
 /end VAR_CHARACTERISTIC
 /begin VAR_CHARACTERISTIC TQS16_BRK_TORQ_P_GAIN_SLIP_X1_LMU BrkCalVariantCriterion
  /begin VAR_ADDRESS 0x80020E58 0x80024258 0x80027658 0x8002AA58 0x8002DE58 0x80031258 0x80034658 0x80037A58 /end VAR_ADDRESS
 /end VAR_CHARACTERISTIC
 /begin VAR_CHARACTERISTIC TQS16_BRK_TORQ_P_GAIN_SLIP_X1_MMU BrkCalVariantCriterion
  /begin VAR_ADDRESS 0x80020E5E 0x8002425E 0x8002765E 0x8002AA5E 0x8002DE5E 0x8003125E 0x8003465E 0x80037A5E /end VAR_ADDRESS
 /end VAR_CHARACTERISTIC
 /begin VAR_CHARACTERISTIC TQS16_BRK_TORQ_P_GAIN_SLIP_X2_HMU BrkCalVariantCriterion
  /begin VAR_ADDRESS 0x80020E66 0x80024266 0x80027666 0x8002AA66 0x8002DE66 0x80031266 0x80034666 0x80037A66 /end VAR_ADDRESS
 /end VAR_CHARACTERISTIC
 /begin VAR_CHARACTERISTIC TQS16_BRK_TORQ_P_GAIN_SLIP_X2_LMU BrkCalVariantCriterion
  /begin VAR_ADDRESS 0x80020E5A 0x8002425A 0x8002765A 0x8002AA5A 0x8002DE5A 0x8003125A 0x8003465A 0x80037A5A /end VAR_ADDRESS
 /end VAR_CHARACTERISTIC
 /begin VAR_CHARACTERISTIC TQS16_BRK_TORQ_P_GAIN_SLIP_X2_MMU BrkCalVariantCriterion
  /begin VAR_ADDRESS 0x80020E60 0x80024260 0x80027660 0x8002AA60 0x8002DE60 0x80031260 0x80034660 0x80037A60 /end VAR_ADDRESS
 /end VAR_CHARACTERISTIC
 /begin VAR_CHARACTERISTIC TQS16_BRK_TORQ_P_GAIN_SLIP_X3_HMU BrkCalVariantCriterion
  /begin VAR_ADDRESS 0x80020E68 0x80024268 0x80027668 0x8002AA68 0x8002DE68 0x80031268 0x80034668 0x80037A68 /end VAR_ADDRESS
 /end VAR_CHARACTERISTIC
 /begin VAR_CHARACTERISTIC TQS16_BRK_TORQ_P_GAIN_SLIP_X3_LMU BrkCalVariantCriterion
  /begin VAR_ADDRESS 0x80020E5C 0x8002425C 0x8002765C 0x8002AA5C 0x8002DE5C 0x8003125C 0x8003465C 0x80037A5C /end VAR_ADDRESS
 /end VAR_CHARACTERISTIC
 /begin VAR_CHARACTERISTIC TQS16_BRK_TORQ_P_GAIN_SLIP_X3_MMU BrkCalVariantCriterion
  /begin VAR_ADDRESS 0x80020E62 0x80024262 0x80027662 0x8002AA62 0x8002DE62 0x80031262 0x80034662 0x80037A62 /end VAR_ADDRESS
 /end VAR_CHARACTERISTIC
 /begin VAR_CHARACTERISTIC TQS16_BRK_TORQ_P_HV_HMU BrkCalVariantCriterion
  /begin VAR_ADDRESS 0x80020E44 0x80024244 0x80027644 0x8002AA44 0x8002DE44 0x80031244 0x80034644 0x80037A44 /end VAR_ADDRESS
 /end VAR_CHARACTERISTIC
 /begin VAR_CHARACTERISTIC TQS16_BRK_TORQ_P_HV_LMU BrkCalVariantCriterion
  /begin VAR_ADDRESS 0x80020E38 0x80024238 0x80027638 0x8002AA38 0x8002DE38 0x80031238 0x80034638 0x80037A38 /end VAR_ADDRESS
 /end VAR_CHARACTERISTIC
 /begin VAR_CHARACTERISTIC TQS16_BRK_TORQ_P_HV_MMU BrkCalVariantCriterion
  /begin VAR_ADDRESS 0x80020E3E 0x8002423E 0x8002763E 0x8002AA3E 0x8002DE3E 0x8003123E 0x8003463E 0x80037A3E /end VAR_ADDRESS
 /end VAR_CHARACTERISTIC
 /begin VAR_CHARACTERISTIC TQS16_BRK_TORQ_P_LV_HMU BrkCalVariantCriterion
  /begin VAR_ADDRESS 0x80020E40 0x80024240 0x80027640 0x8002AA40 0x8002DE40 0x80031240 0x80034640 0x80037A40 /end VAR_ADDRESS
 /end VAR_CHARACTERISTIC
 /begin VAR_CHARACTERISTIC TQS16_BRK_TORQ_P_LV_LMU BrkCalVariantCriterion
  /begin VAR_ADDRESS 0x80020E34 0x80024234 0x80027634 0x8002AA34 0x8002DE34 0x80031234 0x80034634 0x80037A34 /end VAR_ADDRESS
 /end VAR_CHARACTERISTIC
 /begin VAR_CHARACTERISTIC TQS16_BRK_TORQ_P_LV_MMU BrkCalVariantCriterion
  /begin VAR_ADDRESS 0x80020E3A 0x8002423A 0x8002763A 0x8002AA3A 0x8002DE3A 0x8003123A 0x8003463A 0x80037A3A /end VAR_ADDRESS
 /end VAR_CHARACTERISTIC
 /begin VAR_CHARACTERISTIC TQS16_BRK_TORQ_P_MV_HMU BrkCalVariantCriterion
  /begin VAR_ADDRESS 0x80020E42 0x80024242 0x80027642 0x8002AA42 0x8002DE42 0x80031242 0x80034642 0x80037A42 /end VAR_ADDRESS
 /end VAR_CHARACTERISTIC
 /begin VAR_CHARACTERISTIC TQS16_BRK_TORQ_P_MV_LMU BrkCalVariantCriterion
  /begin VAR_ADDRESS 0x80020E36 0x80024236 0x80027636 0x8002AA36 0x8002DE36 0x80031236 0x80034636 0x80037A36 /end VAR_ADDRESS
 /end VAR_CHARACTERISTIC
 /begin VAR_CHARACTERISTIC TQS16_BRK_TORQ_P_MV_MMU BrkCalVariantCriterion
  /begin VAR_ADDRESS 0x80020E3C 0x8002423C 0x8002763C 0x8002AA3C 0x8002DE3C 0x8003123C 0x8003463C 0x80037A3C /end VAR_ADDRESS
 /end VAR_CHARACTERISTIC
 /begin VAR_CHARACTERISTIC TQS16_CORNER_STIFF_FRONT BrkCalVariantCriterion
  /begin VAR_ADDRESS 0x80020044 0x80023444 0x80026844 0x80029C44 0x8002D044 0x80030444 0x80033844 0x80036C44 /end VAR_ADDRESS
 /end VAR_CHARACTERISTIC
 /begin VAR_CHARACTERISTIC TQS16_CORNER_STIFF_REAR BrkCalVariantCriterion
  /begin VAR_ADDRESS 0x80020046 0x80023446 0x80026846 0x80029C46 0x8002D046 0x80030446 0x80033846 0x80036C46 /end VAR_ADDRESS
 /end VAR_CHARACTERISTIC
 /begin VAR_CHARACTERISTIC TQS16_DELM_ADD_TH_X1 BrkCalVariantCriterion
  /begin VAR_ADDRESS 0x80020CCA 0x800240CA 0x800274CA 0x8002A8CA 0x8002DCCA 0x800310CA 0x800344CA 0x800378CA /end VAR_ADDRESS
 /end VAR_CHARACTERISTIC
 /begin VAR_CHARACTERISTIC TQS16_DELM_ADD_TH_X2 BrkCalVariantCriterion
  /begin VAR_ADDRESS 0x80020CCC 0x800240CC 0x800274CC 0x8002A8CC 0x8002DCCC 0x800310CC 0x800344CC 0x800378CC /end VAR_ADDRESS
 /end VAR_CHARACTERISTIC
 /begin VAR_CHARACTERISTIC TQS16_DELM_ADD_TH_X3 BrkCalVariantCriterion
  /begin VAR_ADDRESS 0x80020CCE 0x800240CE 0x800274CE 0x8002A8CE 0x8002DCCE 0x800310CE 0x800344CE 0x800378CE /end VAR_ADDRESS
 /end VAR_CHARACTERISTIC
 /begin VAR_CHARACTERISTIC TQS16_DELTA_STEER_FOR_BANK BrkCalVariantCriterion
  /begin VAR_ADDRESS 0x8002005E 0x8002345E 0x8002685E 0x80029C5E 0x8002D05E 0x8003045E 0x8003385E 0x80036C5E /end VAR_ADDRESS
 /end VAR_CHARACTERISTIC
 /begin VAR_CHARACTERISTIC TQS16_DELYAW_OFFSET_TH_HMU BrkCalVariantCriterion
  /begin VAR_ADDRESS 0x80020CBE 0x800240BE 0x800274BE 0x8002A8BE 0x8002DCBE 0x800310BE 0x800344BE 0x800378BE /end VAR_ADDRESS
 /end VAR_CHARACTERISTIC
 /begin VAR_CHARACTERISTIC TQS16_DELYAW_OFFSET_TH_LMU BrkCalVariantCriterion
  /begin VAR_ADDRESS 0x80020CBA 0x800240BA 0x800274BA 0x8002A8BA 0x8002DCBA 0x800310BA 0x800344BA 0x800378BA /end VAR_ADDRESS
 /end VAR_CHARACTERISTIC
 /begin VAR_CHARACTERISTIC TQS16_DELYAW_OFFSET_TH_MMU BrkCalVariantCriterion
  /begin VAR_ADDRESS 0x80020CBC 0x800240BC 0x800274BC 0x8002A8BC 0x8002DCBC 0x800310BC 0x800344BC 0x800378BC /end VAR_ADDRESS
 /end VAR_CHARACTERISTIC
 /begin VAR_CHARACTERISTIC TQS16_DELYAW_TH_ADD_ABS BrkCalVariantCriterion
  /begin VAR_ADDRESS 0x80020CDA 0x800240DA 0x800274DA 0x8002A8DA 0x8002DCDA 0x800310DA 0x800344DA 0x800378DA /end VAR_ADDRESS
 /end VAR_CHARACTERISTIC
 /begin VAR_CHARACTERISTIC TQS16_DELYAW_TH_ADD_BY_SPLIT BrkCalVariantCriterion
  /begin VAR_ADDRESS 0x80020CC0 0x800240C0 0x800274C0 0x8002A8C0 0x8002DCC0 0x800310C0 0x800344C0 0x800378C0 /end VAR_ADDRESS
 /end VAR_CHARACTERISTIC
 /begin VAR_CHARACTERISTIC TQS16_DEL_YAW_THR_SPD_0 BrkCalVariantCriterion
  /begin VAR_ADDRESS 0x800209E0 0x80023DE0 0x800271E0 0x8002A5E0 0x8002D9E0 0x80030DE0 0x800341E0 0x800375E0 /end VAR_ADDRESS
 /end VAR_CHARACTERISTIC
 /begin VAR_CHARACTERISTIC TQS16_DEL_YAW_THR_SPD_HIG BrkCalVariantCriterion
  /begin VAR_ADDRESS 0x800209E6 0x80023DE6 0x800271E6 0x8002A5E6 0x8002D9E6 0x80030DE6 0x800341E6 0x800375E6 /end VAR_ADDRESS
 /end VAR_CHARACTERISTIC
 /begin VAR_CHARACTERISTIC TQS16_DEL_YAW_THR_SPD_LOW BrkCalVariantCriterion
  /begin VAR_ADDRESS 0x800209E2 0x80023DE2 0x800271E2 0x8002A5E2 0x8002D9E2 0x80030DE2 0x800341E2 0x800375E2 /end VAR_ADDRESS
 /end VAR_CHARACTERISTIC
 /begin VAR_CHARACTERISTIC TQS16_DEL_YAW_THR_SPD_MED BrkCalVariantCriterion
  /begin VAR_ADDRESS 0x800209E4 0x80023DE4 0x800271E4 0x8002A5E4 0x8002D9E4 0x80030DE4 0x800341E4 0x800375E4 /end VAR_ADDRESS
 /end VAR_CHARACTERISTIC
 /begin VAR_CHARACTERISTIC TQS16_DEL_YAW_THR_WSTR_LARGE_VAL BrkCalVariantCriterion
  /begin VAR_ADDRESS 0x800209EE 0x80023DEE 0x800271EE 0x8002A5EE 0x8002D9EE 0x80030DEE 0x800341EE 0x800375EE /end VAR_ADDRESS
 /end VAR_CHARACTERISTIC
 /begin VAR_CHARACTERISTIC TQS16_DYN_PHI_DOT_TH_1st BrkCalVariantCriterion
  /begin VAR_ADDRESS 0x80020B38 0x80023F38 0x80027338 0x8002A738 0x8002DB38 0x80030F38 0x80034338 0x80037738 /end VAR_ADDRESS
 /end VAR_CHARACTERISTIC
 /begin VAR_CHARACTERISTIC TQS16_DYN_PHI_DOT_TH_2nd BrkCalVariantCriterion
  /begin VAR_ADDRESS 0x80020B3A 0x80023F3A 0x8002733A 0x8002A73A 0x8002DB3A 0x80030F3A 0x8003433A 0x8003773A /end VAR_ADDRESS
 /end VAR_CHARACTERISTIC
 /begin VAR_CHARACTERISTIC TQS16_DYN_PHI_DOT_TH_3rd BrkCalVariantCriterion
  /begin VAR_ADDRESS 0x80020B3C 0x80023F3C 0x8002733C 0x8002A73C 0x8002DB3C 0x80030F3C 0x8003433C 0x8003773C /end VAR_ADDRESS
 /end VAR_CHARACTERISTIC
 /begin VAR_CHARACTERISTIC TQS16_DYN_PHI_DOT_TH_4th BrkCalVariantCriterion
  /begin VAR_ADDRESS 0x80020B3E 0x80023F3E 0x8002733E 0x8002A73E 0x8002DB3E 0x80030F3E 0x8003433E 0x8003773E /end VAR_ADDRESS
 /end VAR_CHARACTERISTIC
 /begin VAR_CHARACTERISTIC TQS16_DYN_PHI_TH_1st BrkCalVariantCriterion
  /begin VAR_ADDRESS 0x80020B40 0x80023F40 0x80027340 0x8002A740 0x8002DB40 0x80030F40 0x80034340 0x80037740 /end VAR_ADDRESS
 /end VAR_CHARACTERISTIC
 /begin VAR_CHARACTERISTIC TQS16_DYN_PHI_TH_2nd BrkCalVariantCriterion
  /begin VAR_ADDRESS 0x80020B42 0x80023F42 0x80027342 0x8002A742 0x8002DB42 0x80030F42 0x80034342 0x80037742 /end VAR_ADDRESS
 /end VAR_CHARACTERISTIC
 /begin VAR_CHARACTERISTIC TQS16_DYN_PHI_TH_3rd BrkCalVariantCriterion
  /begin VAR_ADDRESS 0x80020B44 0x80023F44 0x80027344 0x8002A744 0x8002DB44 0x80030F44 0x80034344 0x80037744 /end VAR_ADDRESS
 /end VAR_CHARACTERISTIC
 /begin VAR_CHARACTERISTIC TQS16_DYN_PHI_TH_4th BrkCalVariantCriterion
  /begin VAR_ADDRESS 0x80020B46 0x80023F46 0x80027346 0x8002A746 0x8002DB46 0x80030F46 0x80034346 0x80037746 /end VAR_ADDRESS
 /end VAR_CHARACTERISTIC
 /begin VAR_CHARACTERISTIC TQS16_DYN_WSTR_DOT_MIN BrkCalVariantCriterion
  /begin VAR_ADDRESS 0x80020B5C 0x80023F5C 0x8002735C 0x8002A75C 0x8002DB5C 0x80030F5C 0x8003435C 0x8003775C /end VAR_ADDRESS
 /end VAR_CHARACTERISTIC
 /begin VAR_CHARACTERISTIC TQS16_EHC_Alatm_Enter BrkCalVariantCriterion
  /begin VAR_ADDRESS 0x80020CE8 0x800240E8 0x800274E8 0x8002A8E8 0x8002DCE8 0x800310E8 0x800344E8 0x800378E8 /end VAR_ADDRESS
 /end VAR_CHARACTERISTIC
 /begin VAR_CHARACTERISTIC TQS16_EHC_Alatm_Exit BrkCalVariantCriterion
  /begin VAR_ADDRESS 0x80020CEA 0x800240EA 0x800274EA 0x8002A8EA 0x8002DCEA 0x800310EA 0x800344EA 0x800378EA /end VAR_ADDRESS
 /end VAR_CHARACTERISTIC
 /begin VAR_CHARACTERISTIC TQS16_EHC_CAL_TQ_MAX_HM BrkCalVariantCriterion
  /begin VAR_ADDRESS 0x80020F1A 0x8002431A 0x8002771A 0x8002AB1A 0x8002DF1A 0x8003131A 0x8003471A 0x80037B1A /end VAR_ADDRESS
 /end VAR_CHARACTERISTIC
 /begin VAR_CHARACTERISTIC TQS16_EHC_CAL_TQ_MAX_MM BrkCalVariantCriterion
  /begin VAR_ADDRESS 0x80020F18 0x80024318 0x80027718 0x8002AB18 0x8002DF18 0x80031318 0x80034718 0x80037B18 /end VAR_ADDRESS
 /end VAR_CHARACTERISTIC
 /begin VAR_CHARACTERISTIC TQS16_EHC_CAL_TQ_MIN_HM BrkCalVariantCriterion
  /begin VAR_ADDRESS 0x80020F1E 0x8002431E 0x8002771E 0x8002AB1E 0x8002DF1E 0x8003131E 0x8003471E 0x80037B1E /end VAR_ADDRESS
 /end VAR_CHARACTERISTIC
 /begin VAR_CHARACTERISTIC TQS16_EHC_CAL_TQ_MIN_MM BrkCalVariantCriterion
  /begin VAR_ADDRESS 0x80020F1C 0x8002431C 0x8002771C 0x8002AB1C 0x8002DF1C 0x8003131C 0x8003471C 0x80037B1C /end VAR_ADDRESS
 /end VAR_CHARACTERISTIC
 /begin VAR_CHARACTERISTIC TQS16_EHC_DYaw1st_Enter_SPD BrkCalVariantCriterion
  /begin VAR_ADDRESS 0x80020CE4 0x800240E4 0x800274E4 0x8002A8E4 0x8002DCE4 0x800310E4 0x800344E4 0x800378E4 /end VAR_ADDRESS
 /end VAR_CHARACTERISTIC
 /begin VAR_CHARACTERISTIC TQS16_EHC_DYaw1st_Exit_SPD BrkCalVariantCriterion
  /begin VAR_ADDRESS 0x80020CE6 0x800240E6 0x800274E6 0x8002A8E6 0x8002DCE6 0x800310E6 0x800344E6 0x800378E6 /end VAR_ADDRESS
 /end VAR_CHARACTERISTIC
 /begin VAR_CHARACTERISTIC TQS16_EHC_ENTER_STEER BrkCalVariantCriterion
  /begin VAR_ADDRESS 0x80020CEC 0x800240EC 0x800274EC 0x8002A8EC 0x8002DCEC 0x800310EC 0x800344EC 0x800378EC /end VAR_ADDRESS
 /end VAR_CHARACTERISTIC
 /begin VAR_CHARACTERISTIC TQS16_EHC_ENTER_STEER_HM_100K BrkCalVariantCriterion
  /begin VAR_ADDRESS 0x80020F08 0x80024308 0x80027708 0x8002AB08 0x8002DF08 0x80031308 0x80034708 0x80037B08 /end VAR_ADDRESS
 /end VAR_CHARACTERISTIC
 /begin VAR_CHARACTERISTIC TQS16_EHC_ENTER_STEER_HM_40K BrkCalVariantCriterion
  /begin VAR_ADDRESS 0x80020F02 0x80024302 0x80027702 0x8002AB02 0x8002DF02 0x80031302 0x80034702 0x80037B02 /end VAR_ADDRESS
 /end VAR_CHARACTERISTIC
 /begin VAR_CHARACTERISTIC TQS16_EHC_ENTER_STEER_HM_60K BrkCalVariantCriterion
  /begin VAR_ADDRESS 0x80020F04 0x80024304 0x80027704 0x8002AB04 0x8002DF04 0x80031304 0x80034704 0x80037B04 /end VAR_ADDRESS
 /end VAR_CHARACTERISTIC
 /begin VAR_CHARACTERISTIC TQS16_EHC_ENTER_STEER_HM_80K BrkCalVariantCriterion
  /begin VAR_ADDRESS 0x80020F06 0x80024306 0x80027706 0x8002AB06 0x8002DF06 0x80031306 0x80034706 0x80037B06 /end VAR_ADDRESS
 /end VAR_CHARACTERISTIC
 /begin VAR_CHARACTERISTIC TQS16_EHC_ENTER_STEER_MM_100K BrkCalVariantCriterion
  /begin VAR_ADDRESS 0x80020F00 0x80024300 0x80027700 0x8002AB00 0x8002DF00 0x80031300 0x80034700 0x80037B00 /end VAR_ADDRESS
 /end VAR_CHARACTERISTIC
 /begin VAR_CHARACTERISTIC TQS16_EHC_ENTER_STEER_MM_40K BrkCalVariantCriterion
  /begin VAR_ADDRESS 0x80020EFA 0x800242FA 0x800276FA 0x8002AAFA 0x8002DEFA 0x800312FA 0x800346FA 0x80037AFA /end VAR_ADDRESS
 /end VAR_CHARACTERISTIC
 /begin VAR_CHARACTERISTIC TQS16_EHC_ENTER_STEER_MM_60K BrkCalVariantCriterion
  /begin VAR_ADDRESS 0x80020EFC 0x800242FC 0x800276FC 0x8002AAFC 0x8002DEFC 0x800312FC 0x800346FC 0x80037AFC /end VAR_ADDRESS
 /end VAR_CHARACTERISTIC
 /begin VAR_CHARACTERISTIC TQS16_EHC_ENTER_STEER_MM_80K BrkCalVariantCriterion
  /begin VAR_ADDRESS 0x80020EFE 0x800242FE 0x800276FE 0x8002AAFE 0x8002DEFE 0x800312FE 0x800346FE 0x80037AFE /end VAR_ADDRESS
 /end VAR_CHARACTERISTIC
 /begin VAR_CHARACTERISTIC TQS16_EHC_Enter_SPD BrkCalVariantCriterion
  /begin VAR_ADDRESS 0x80020CE0 0x800240E0 0x800274E0 0x8002A8E0 0x8002DCE0 0x800310E0 0x800344E0 0x800378E0 /end VAR_ADDRESS
 /end VAR_CHARACTERISTIC
 /begin VAR_CHARACTERISTIC TQS16_EHC_Exit_SPD BrkCalVariantCriterion
  /begin VAR_ADDRESS 0x80020CE2 0x800240E2 0x800274E2 0x8002A8E2 0x8002DCE2 0x800310E2 0x800344E2 0x800378E2 /end VAR_ADDRESS
 /end VAR_CHARACTERISTIC
 /begin VAR_CHARACTERISTIC TQS16_EHC_TORQ_DEC_100K BrkCalVariantCriterion
  /begin VAR_ADDRESS 0x80020D14 0x80024114 0x80027514 0x8002A914 0x8002DD14 0x80031114 0x80034514 0x80037914 /end VAR_ADDRESS
 /end VAR_CHARACTERISTIC
 /begin VAR_CHARACTERISTIC TQS16_EHC_TORQ_DEC_40K BrkCalVariantCriterion
  /begin VAR_ADDRESS 0x80020D0E 0x8002410E 0x8002750E 0x8002A90E 0x8002DD0E 0x8003110E 0x8003450E 0x8003790E /end VAR_ADDRESS
 /end VAR_CHARACTERISTIC
 /begin VAR_CHARACTERISTIC TQS16_EHC_TORQ_DEC_60K BrkCalVariantCriterion
  /begin VAR_ADDRESS 0x80020D10 0x80024110 0x80027510 0x8002A910 0x8002DD10 0x80031110 0x80034510 0x80037910 /end VAR_ADDRESS
 /end VAR_CHARACTERISTIC
 /begin VAR_CHARACTERISTIC TQS16_EHC_TORQ_DEC_80K BrkCalVariantCriterion
  /begin VAR_ADDRESS 0x80020D12 0x80024112 0x80027512 0x8002A912 0x8002DD12 0x80031112 0x80034512 0x80037912 /end VAR_ADDRESS
 /end VAR_CHARACTERISTIC
 /begin VAR_CHARACTERISTIC TQS16_EHC_TORQ_INC_100K BrkCalVariantCriterion
  /begin VAR_ADDRESS 0x80020D1C 0x8002411C 0x8002751C 0x8002A91C 0x8002DD1C 0x8003111C 0x8003451C 0x8003791C /end VAR_ADDRESS
 /end VAR_CHARACTERISTIC
 /begin VAR_CHARACTERISTIC TQS16_EHC_TORQ_INC_40K BrkCalVariantCriterion
  /begin VAR_ADDRESS 0x80020D16 0x80024116 0x80027516 0x8002A916 0x8002DD16 0x80031116 0x80034516 0x80037916 /end VAR_ADDRESS
 /end VAR_CHARACTERISTIC
 /begin VAR_CHARACTERISTIC TQS16_EHC_TORQ_INC_60K BrkCalVariantCriterion
  /begin VAR_ADDRESS 0x80020D18 0x80024118 0x80027518 0x8002A918 0x8002DD18 0x80031118 0x80034518 0x80037918 /end VAR_ADDRESS
 /end VAR_CHARACTERISTIC
 /begin VAR_CHARACTERISTIC TQS16_EHC_TORQ_INC_80K BrkCalVariantCriterion
  /begin VAR_ADDRESS 0x80020D1A 0x8002411A 0x8002751A 0x8002A91A 0x8002DD1A 0x8003111A 0x8003451A 0x8003791A /end VAR_ADDRESS
 /end VAR_CHARACTERISTIC
 /begin VAR_CHARACTERISTIC TQS16_EHC_TORQ_INC_MM_100K BrkCalVariantCriterion
  /begin VAR_ADDRESS 0x80020EE8 0x800242E8 0x800276E8 0x8002AAE8 0x8002DEE8 0x800312E8 0x800346E8 0x80037AE8 /end VAR_ADDRESS
 /end VAR_CHARACTERISTIC
 /begin VAR_CHARACTERISTIC TQS16_EHC_TORQ_INC_MM_40K BrkCalVariantCriterion
  /begin VAR_ADDRESS 0x80020EE2 0x800242E2 0x800276E2 0x8002AAE2 0x8002DEE2 0x800312E2 0x800346E2 0x80037AE2 /end VAR_ADDRESS
 /end VAR_CHARACTERISTIC
 /begin VAR_CHARACTERISTIC TQS16_EHC_TORQ_INC_MM_60K BrkCalVariantCriterion
  /begin VAR_ADDRESS 0x80020EE4 0x800242E4 0x800276E4 0x8002AAE4 0x8002DEE4 0x800312E4 0x800346E4 0x80037AE4 /end VAR_ADDRESS
 /end VAR_CHARACTERISTIC
 /begin VAR_CHARACTERISTIC TQS16_EHC_TORQ_INC_MM_80K BrkCalVariantCriterion
  /begin VAR_ADDRESS 0x80020EE6 0x800242E6 0x800276E6 0x8002AAE6 0x8002DEE6 0x800312E6 0x800346E6 0x80037AE6 /end VAR_ADDRESS
 /end VAR_CHARACTERISTIC
 /begin VAR_CHARACTERISTIC TQS16_EHC_TORQ_MAX BrkCalVariantCriterion
  /begin VAR_ADDRESS 0x80020CDC 0x800240DC 0x800274DC 0x8002A8DC 0x8002DCDC 0x800310DC 0x800344DC 0x800378DC /end VAR_ADDRESS
 /end VAR_CHARACTERISTIC
 /begin VAR_CHARACTERISTIC TQS16_EHC_TORQ_WEG_WSTRD BrkCalVariantCriterion
  /begin VAR_ADDRESS 0x80020D20 0x80024120 0x80027520 0x8002A920 0x8002DD20 0x80031120 0x80034520 0x80037920 /end VAR_ADDRESS
 /end VAR_CHARACTERISTIC
 /begin VAR_CHARACTERISTIC TQS16_EHC_TORQ_WEG_YAWD BrkCalVariantCriterion
  /begin VAR_ADDRESS 0x80020D1E 0x8002411E 0x8002751E 0x8002A91E 0x8002DD1E 0x8003111E 0x8003451E 0x8003791E /end VAR_ADDRESS
 /end VAR_CHARACTERISTIC
 /begin VAR_CHARACTERISTIC TQS16_EHC_TORQ_WSTR_WEG_HM_100K BrkCalVariantCriterion
  /begin VAR_ADDRESS 0x80020EF0 0x800242F0 0x800276F0 0x8002AAF0 0x8002DEF0 0x800312F0 0x800346F0 0x80037AF0 /end VAR_ADDRESS
 /end VAR_CHARACTERISTIC
 /begin VAR_CHARACTERISTIC TQS16_EHC_TORQ_WSTR_WEG_HM_40K BrkCalVariantCriterion
  /begin VAR_ADDRESS 0x80020EEA 0x800242EA 0x800276EA 0x8002AAEA 0x8002DEEA 0x800312EA 0x800346EA 0x80037AEA /end VAR_ADDRESS
 /end VAR_CHARACTERISTIC
 /begin VAR_CHARACTERISTIC TQS16_EHC_TORQ_WSTR_WEG_HM_60K BrkCalVariantCriterion
  /begin VAR_ADDRESS 0x80020EEC 0x800242EC 0x800276EC 0x8002AAEC 0x8002DEEC 0x800312EC 0x800346EC 0x80037AEC /end VAR_ADDRESS
 /end VAR_CHARACTERISTIC
 /begin VAR_CHARACTERISTIC TQS16_EHC_TORQ_WSTR_WEG_HM_80K BrkCalVariantCriterion
  /begin VAR_ADDRESS 0x80020EEE 0x800242EE 0x800276EE 0x8002AAEE 0x8002DEEE 0x800312EE 0x800346EE 0x80037AEE /end VAR_ADDRESS
 /end VAR_CHARACTERISTIC
 /begin VAR_CHARACTERISTIC TQS16_EHC_TORQ_WSTR_WEG_MM_100K BrkCalVariantCriterion
  /begin VAR_ADDRESS 0x80020EF8 0x800242F8 0x800276F8 0x8002AAF8 0x8002DEF8 0x800312F8 0x800346F8 0x80037AF8 /end VAR_ADDRESS
 /end VAR_CHARACTERISTIC
 /begin VAR_CHARACTERISTIC TQS16_EHC_TORQ_WSTR_WEG_MM_40K BrkCalVariantCriterion
  /begin VAR_ADDRESS 0x80020EF2 0x800242F2 0x800276F2 0x8002AAF2 0x8002DEF2 0x800312F2 0x800346F2 0x80037AF2 /end VAR_ADDRESS
 /end VAR_CHARACTERISTIC
 /begin VAR_CHARACTERISTIC TQS16_EHC_TORQ_WSTR_WEG_MM_60K BrkCalVariantCriterion
  /begin VAR_ADDRESS 0x80020EF4 0x800242F4 0x800276F4 0x8002AAF4 0x8002DEF4 0x800312F4 0x800346F4 0x80037AF4 /end VAR_ADDRESS
 /end VAR_CHARACTERISTIC
 /begin VAR_CHARACTERISTIC TQS16_EHC_TORQ_WSTR_WEG_MM_80K BrkCalVariantCriterion
  /begin VAR_ADDRESS 0x80020EF6 0x800242F6 0x800276F6 0x8002AAF6 0x8002DEF6 0x800312F6 0x800346F6 0x80037AF6 /end VAR_ADDRESS
 /end VAR_CHARACTERISTIC
 /begin VAR_CHARACTERISTIC TQS16_EHC_TQ_DEC_RATE_1 BrkCalVariantCriterion
  /begin VAR_ADDRESS 0x80020F10 0x80024310 0x80027710 0x8002AB10 0x8002DF10 0x80031310 0x80034710 0x80037B10 /end VAR_ADDRESS
 /end VAR_CHARACTERISTIC
 /begin VAR_CHARACTERISTIC TQS16_EHC_TQ_DEC_RATE_2 BrkCalVariantCriterion
  /begin VAR_ADDRESS 0x80020F12 0x80024312 0x80027712 0x8002AB12 0x8002DF12 0x80031312 0x80034712 0x80037B12 /end VAR_ADDRESS
 /end VAR_CHARACTERISTIC
 /begin VAR_CHARACTERISTIC TQS16_EHC_TQ_DEC_RATE_3 BrkCalVariantCriterion
  /begin VAR_ADDRESS 0x80020F14 0x80024314 0x80027714 0x8002AB14 0x8002DF14 0x80031314 0x80034714 0x80037B14 /end VAR_ADDRESS
 /end VAR_CHARACTERISTIC
 /begin VAR_CHARACTERISTIC TQS16_EHC_TQ_DEC_YAW_TH_1 BrkCalVariantCriterion
  /begin VAR_ADDRESS 0x80020F0A 0x8002430A 0x8002770A 0x8002AB0A 0x8002DF0A 0x8003130A 0x8003470A 0x80037B0A /end VAR_ADDRESS
 /end VAR_CHARACTERISTIC
 /begin VAR_CHARACTERISTIC TQS16_EHC_TQ_DEC_YAW_TH_2 BrkCalVariantCriterion
  /begin VAR_ADDRESS 0x80020F0C 0x8002430C 0x8002770C 0x8002AB0C 0x8002DF0C 0x8003130C 0x8003470C 0x80037B0C /end VAR_ADDRESS
 /end VAR_CHARACTERISTIC
 /begin VAR_CHARACTERISTIC TQS16_EHC_TQ_DEC_YAW_TH_3 BrkCalVariantCriterion
  /begin VAR_ADDRESS 0x80020F0E 0x8002430E 0x8002770E 0x8002AB0E 0x8002DF0E 0x8003130E 0x8003470E 0x80037B0E /end VAR_ADDRESS
 /end VAR_CHARACTERISTIC
 /begin VAR_CHARACTERISTIC TQS16_EHC_WSTR_DOT_ENT_100K BrkCalVariantCriterion
  /begin VAR_ADDRESS 0x80020CF4 0x800240F4 0x800274F4 0x8002A8F4 0x8002DCF4 0x800310F4 0x800344F4 0x800378F4 /end VAR_ADDRESS
 /end VAR_CHARACTERISTIC
 /begin VAR_CHARACTERISTIC TQS16_EHC_WSTR_DOT_ENT_40K BrkCalVariantCriterion
  /begin VAR_ADDRESS 0x80020CEE 0x800240EE 0x800274EE 0x8002A8EE 0x8002DCEE 0x800310EE 0x800344EE 0x800378EE /end VAR_ADDRESS
 /end VAR_CHARACTERISTIC
 /begin VAR_CHARACTERISTIC TQS16_EHC_WSTR_DOT_ENT_60K BrkCalVariantCriterion
  /begin VAR_ADDRESS 0x80020CF0 0x800240F0 0x800274F0 0x8002A8F0 0x8002DCF0 0x800310F0 0x800344F0 0x800378F0 /end VAR_ADDRESS
 /end VAR_CHARACTERISTIC
 /begin VAR_CHARACTERISTIC TQS16_EHC_WSTR_DOT_ENT_80K BrkCalVariantCriterion
  /begin VAR_ADDRESS 0x80020CF2 0x800240F2 0x800274F2 0x8002A8F2 0x8002DCF2 0x800310F2 0x800344F2 0x800378F2 /end VAR_ADDRESS
 /end VAR_CHARACTERISTIC
 /begin VAR_CHARACTERISTIC TQS16_EHC_WSTR_DOT_ENT_MM_100K BrkCalVariantCriterion
  /begin VAR_ADDRESS 0x80020EA8 0x800242A8 0x800276A8 0x8002AAA8 0x8002DEA8 0x800312A8 0x800346A8 0x80037AA8 /end VAR_ADDRESS
 /end VAR_CHARACTERISTIC
 /begin VAR_CHARACTERISTIC TQS16_EHC_WSTR_DOT_ENT_MM_40K BrkCalVariantCriterion
  /begin VAR_ADDRESS 0x80020EA2 0x800242A2 0x800276A2 0x8002AAA2 0x8002DEA2 0x800312A2 0x800346A2 0x80037AA2 /end VAR_ADDRESS
 /end VAR_CHARACTERISTIC
 /begin VAR_CHARACTERISTIC TQS16_EHC_WSTR_DOT_ENT_MM_60K BrkCalVariantCriterion
  /begin VAR_ADDRESS 0x80020EA4 0x800242A4 0x800276A4 0x8002AAA4 0x8002DEA4 0x800312A4 0x800346A4 0x80037AA4 /end VAR_ADDRESS
 /end VAR_CHARACTERISTIC
 /begin VAR_CHARACTERISTIC TQS16_EHC_WSTR_DOT_ENT_MM_80K BrkCalVariantCriterion
  /begin VAR_ADDRESS 0x80020EA6 0x800242A6 0x800276A6 0x8002AAA6 0x8002DEA6 0x800312A6 0x800346A6 0x80037AA6 /end VAR_ADDRESS
 /end VAR_CHARACTERISTIC
 /begin VAR_CHARACTERISTIC TQS16_EHC_WSTR_DOT_EXT_100K BrkCalVariantCriterion
  /begin VAR_ADDRESS 0x80020CFC 0x800240FC 0x800274FC 0x8002A8FC 0x8002DCFC 0x800310FC 0x800344FC 0x800378FC /end VAR_ADDRESS
 /end VAR_CHARACTERISTIC
 /begin VAR_CHARACTERISTIC TQS16_EHC_WSTR_DOT_EXT_40K BrkCalVariantCriterion
  /begin VAR_ADDRESS 0x80020CF6 0x800240F6 0x800274F6 0x8002A8F6 0x8002DCF6 0x800310F6 0x800344F6 0x800378F6 /end VAR_ADDRESS
 /end VAR_CHARACTERISTIC
 /begin VAR_CHARACTERISTIC TQS16_EHC_WSTR_DOT_EXT_60K BrkCalVariantCriterion
  /begin VAR_ADDRESS 0x80020CF8 0x800240F8 0x800274F8 0x8002A8F8 0x8002DCF8 0x800310F8 0x800344F8 0x800378F8 /end VAR_ADDRESS
 /end VAR_CHARACTERISTIC
 /begin VAR_CHARACTERISTIC TQS16_EHC_WSTR_DOT_EXT_80K BrkCalVariantCriterion
  /begin VAR_ADDRESS 0x80020CFA 0x800240FA 0x800274FA 0x8002A8FA 0x8002DCFA 0x800310FA 0x800344FA 0x800378FA /end VAR_ADDRESS
 /end VAR_CHARACTERISTIC
 /begin VAR_CHARACTERISTIC TQS16_EHC_WSTR_DOT_EXT_MM_100K BrkCalVariantCriterion
  /begin VAR_ADDRESS 0x80020EB0 0x800242B0 0x800276B0 0x8002AAB0 0x8002DEB0 0x800312B0 0x800346B0 0x80037AB0 /end VAR_ADDRESS
 /end VAR_CHARACTERISTIC
 /begin VAR_CHARACTERISTIC TQS16_EHC_WSTR_DOT_EXT_MM_40K BrkCalVariantCriterion
  /begin VAR_ADDRESS 0x80020EAA 0x800242AA 0x800276AA 0x8002AAAA 0x8002DEAA 0x800312AA 0x800346AA 0x80037AAA /end VAR_ADDRESS
 /end VAR_CHARACTERISTIC
 /begin VAR_CHARACTERISTIC TQS16_EHC_WSTR_DOT_EXT_MM_60K BrkCalVariantCriterion
  /begin VAR_ADDRESS 0x80020EAC 0x800242AC 0x800276AC 0x8002AAAC 0x8002DEAC 0x800312AC 0x800346AC 0x80037AAC /end VAR_ADDRESS
 /end VAR_CHARACTERISTIC
 /begin VAR_CHARACTERISTIC TQS16_EHC_WSTR_DOT_EXT_MM_80K BrkCalVariantCriterion
  /begin VAR_ADDRESS 0x80020EAE 0x800242AE 0x800276AE 0x8002AAAE 0x8002DEAE 0x800312AE 0x800346AE 0x80037AAE /end VAR_ADDRESS
 /end VAR_CHARACTERISTIC
 /begin VAR_CHARACTERISTIC TQS16_EHC_WSTR_MAX_ALAT_G BrkCalVariantCriterion
  /begin VAR_ADDRESS 0x80020F16 0x80024316 0x80027716 0x8002AB16 0x8002DF16 0x80031316 0x80034716 0x80037B16 /end VAR_ADDRESS
 /end VAR_CHARACTERISTIC
 /begin VAR_CHARACTERISTIC TQS16_EHC_WSTR_PEAK_HM_100K BrkCalVariantCriterion
  /begin VAR_ADDRESS 0x80020EC8 0x800242C8 0x800276C8 0x8002AAC8 0x8002DEC8 0x800312C8 0x800346C8 0x80037AC8 /end VAR_ADDRESS
 /end VAR_CHARACTERISTIC
 /begin VAR_CHARACTERISTIC TQS16_EHC_WSTR_PEAK_HM_40K BrkCalVariantCriterion
  /begin VAR_ADDRESS 0x80020EC2 0x800242C2 0x800276C2 0x8002AAC2 0x8002DEC2 0x800312C2 0x800346C2 0x80037AC2 /end VAR_ADDRESS
 /end VAR_CHARACTERISTIC
 /begin VAR_CHARACTERISTIC TQS16_EHC_WSTR_PEAK_HM_60K BrkCalVariantCriterion
  /begin VAR_ADDRESS 0x80020EC4 0x800242C4 0x800276C4 0x8002AAC4 0x8002DEC4 0x800312C4 0x800346C4 0x80037AC4 /end VAR_ADDRESS
 /end VAR_CHARACTERISTIC
 /begin VAR_CHARACTERISTIC TQS16_EHC_WSTR_PEAK_HM_80K BrkCalVariantCriterion
  /begin VAR_ADDRESS 0x80020EC6 0x800242C6 0x800276C6 0x8002AAC6 0x8002DEC6 0x800312C6 0x800346C6 0x80037AC6 /end VAR_ADDRESS
 /end VAR_CHARACTERISTIC
 /begin VAR_CHARACTERISTIC TQS16_EHC_WSTR_PEAK_MM_100K BrkCalVariantCriterion
  /begin VAR_ADDRESS 0x80020ED0 0x800242D0 0x800276D0 0x8002AAD0 0x8002DED0 0x800312D0 0x800346D0 0x80037AD0 /end VAR_ADDRESS
 /end VAR_CHARACTERISTIC
 /begin VAR_CHARACTERISTIC TQS16_EHC_WSTR_PEAK_MM_40K BrkCalVariantCriterion
  /begin VAR_ADDRESS 0x80020ECA 0x800242CA 0x800276CA 0x8002AACA 0x8002DECA 0x800312CA 0x800346CA 0x80037ACA /end VAR_ADDRESS
 /end VAR_CHARACTERISTIC
 /begin VAR_CHARACTERISTIC TQS16_EHC_WSTR_PEAK_MM_60K BrkCalVariantCriterion
  /begin VAR_ADDRESS 0x80020ECC 0x800242CC 0x800276CC 0x8002AACC 0x8002DECC 0x800312CC 0x800346CC 0x80037ACC /end VAR_ADDRESS
 /end VAR_CHARACTERISTIC
 /begin VAR_CHARACTERISTIC TQS16_EHC_WSTR_PEAK_MM_80K BrkCalVariantCriterion
  /begin VAR_ADDRESS 0x80020ECE 0x800242CE 0x800276CE 0x8002AACE 0x8002DECE 0x800312CE 0x800346CE 0x80037ACE /end VAR_ADDRESS
 /end VAR_CHARACTERISTIC
 /begin VAR_CHARACTERISTIC TQS16_EHC_YAW_DOT_ENT_100K BrkCalVariantCriterion
  /begin VAR_ADDRESS 0x80020D04 0x80024104 0x80027504 0x8002A904 0x8002DD04 0x80031104 0x80034504 0x80037904 /end VAR_ADDRESS
 /end VAR_CHARACTERISTIC
 /begin VAR_CHARACTERISTIC TQS16_EHC_YAW_DOT_ENT_40K BrkCalVariantCriterion
  /begin VAR_ADDRESS 0x80020CFE 0x800240FE 0x800274FE 0x8002A8FE 0x8002DCFE 0x800310FE 0x800344FE 0x800378FE /end VAR_ADDRESS
 /end VAR_CHARACTERISTIC
 /begin VAR_CHARACTERISTIC TQS16_EHC_YAW_DOT_ENT_60K BrkCalVariantCriterion
  /begin VAR_ADDRESS 0x80020D00 0x80024100 0x80027500 0x8002A900 0x8002DD00 0x80031100 0x80034500 0x80037900 /end VAR_ADDRESS
 /end VAR_CHARACTERISTIC
 /begin VAR_CHARACTERISTIC TQS16_EHC_YAW_DOT_ENT_80K BrkCalVariantCriterion
  /begin VAR_ADDRESS 0x80020D02 0x80024102 0x80027502 0x8002A902 0x8002DD02 0x80031102 0x80034502 0x80037902 /end VAR_ADDRESS
 /end VAR_CHARACTERISTIC
 /begin VAR_CHARACTERISTIC TQS16_EHC_YAW_DOT_ENT_MM_100K BrkCalVariantCriterion
  /begin VAR_ADDRESS 0x80020EB8 0x800242B8 0x800276B8 0x8002AAB8 0x8002DEB8 0x800312B8 0x800346B8 0x80037AB8 /end VAR_ADDRESS
 /end VAR_CHARACTERISTIC
 /begin VAR_CHARACTERISTIC TQS16_EHC_YAW_DOT_ENT_MM_40K BrkCalVariantCriterion
  /begin VAR_ADDRESS 0x80020EB2 0x800242B2 0x800276B2 0x8002AAB2 0x8002DEB2 0x800312B2 0x800346B2 0x80037AB2 /end VAR_ADDRESS
 /end VAR_CHARACTERISTIC
 /begin VAR_CHARACTERISTIC TQS16_EHC_YAW_DOT_ENT_MM_60K BrkCalVariantCriterion
  /begin VAR_ADDRESS 0x80020EB4 0x800242B4 0x800276B4 0x8002AAB4 0x8002DEB4 0x800312B4 0x800346B4 0x80037AB4 /end VAR_ADDRESS
 /end VAR_CHARACTERISTIC
 /begin VAR_CHARACTERISTIC TQS16_EHC_YAW_DOT_ENT_MM_80K BrkCalVariantCriterion
  /begin VAR_ADDRESS 0x80020EB6 0x800242B6 0x800276B6 0x8002AAB6 0x8002DEB6 0x800312B6 0x800346B6 0x80037AB6 /end VAR_ADDRESS
 /end VAR_CHARACTERISTIC
 /begin VAR_CHARACTERISTIC TQS16_EHC_YAW_DOT_EXT_100K BrkCalVariantCriterion
  /begin VAR_ADDRESS 0x80020D0C 0x8002410C 0x8002750C 0x8002A90C 0x8002DD0C 0x8003110C 0x8003450C 0x8003790C /end VAR_ADDRESS
 /end VAR_CHARACTERISTIC
 /begin VAR_CHARACTERISTIC TQS16_EHC_YAW_DOT_EXT_40K BrkCalVariantCriterion
  /begin VAR_ADDRESS 0x80020D06 0x80024106 0x80027506 0x8002A906 0x8002DD06 0x80031106 0x80034506 0x80037906 /end VAR_ADDRESS
 /end VAR_CHARACTERISTIC
 /begin VAR_CHARACTERISTIC TQS16_EHC_YAW_DOT_EXT_60K BrkCalVariantCriterion
  /begin VAR_ADDRESS 0x80020D08 0x80024108 0x80027508 0x8002A908 0x8002DD08 0x80031108 0x80034508 0x80037908 /end VAR_ADDRESS
 /end VAR_CHARACTERISTIC
 /begin VAR_CHARACTERISTIC TQS16_EHC_YAW_DOT_EXT_80K BrkCalVariantCriterion
  /begin VAR_ADDRESS 0x80020D0A 0x8002410A 0x8002750A 0x8002A90A 0x8002DD0A 0x8003110A 0x8003450A 0x8003790A /end VAR_ADDRESS
 /end VAR_CHARACTERISTIC
 /begin VAR_CHARACTERISTIC TQS16_EHC_YAW_DOT_EXT_MM_100K BrkCalVariantCriterion
  /begin VAR_ADDRESS 0x80020EC0 0x800242C0 0x800276C0 0x8002AAC0 0x8002DEC0 0x800312C0 0x800346C0 0x80037AC0 /end VAR_ADDRESS
 /end VAR_CHARACTERISTIC
 /begin VAR_CHARACTERISTIC TQS16_EHC_YAW_DOT_EXT_MM_40K BrkCalVariantCriterion
  /begin VAR_ADDRESS 0x80020EBA 0x800242BA 0x800276BA 0x8002AABA 0x8002DEBA 0x800312BA 0x800346BA 0x80037ABA /end VAR_ADDRESS
 /end VAR_CHARACTERISTIC
 /begin VAR_CHARACTERISTIC TQS16_EHC_YAW_DOT_EXT_MM_60K BrkCalVariantCriterion
  /begin VAR_ADDRESS 0x80020EBC 0x800242BC 0x800276BC 0x8002AABC 0x8002DEBC 0x800312BC 0x800346BC 0x80037ABC /end VAR_ADDRESS
 /end VAR_CHARACTERISTIC
 /begin VAR_CHARACTERISTIC TQS16_EHC_YAW_DOT_EXT_MM_80K BrkCalVariantCriterion
  /begin VAR_ADDRESS 0x80020EBE 0x800242BE 0x800276BE 0x8002AABE 0x8002DEBE 0x800312BE 0x800346BE 0x80037ABE /end VAR_ADDRESS
 /end VAR_CHARACTERISTIC
 /begin VAR_CHARACTERISTIC TQS16_EHC_YAW_PEAK_HM_100K BrkCalVariantCriterion
  /begin VAR_ADDRESS 0x80020ED8 0x800242D8 0x800276D8 0x8002AAD8 0x8002DED8 0x800312D8 0x800346D8 0x80037AD8 /end VAR_ADDRESS
 /end VAR_CHARACTERISTIC
 /begin VAR_CHARACTERISTIC TQS16_EHC_YAW_PEAK_HM_40K BrkCalVariantCriterion
  /begin VAR_ADDRESS 0x80020ED2 0x800242D2 0x800276D2 0x8002AAD2 0x8002DED2 0x800312D2 0x800346D2 0x80037AD2 /end VAR_ADDRESS
 /end VAR_CHARACTERISTIC
 /begin VAR_CHARACTERISTIC TQS16_EHC_YAW_PEAK_HM_60K BrkCalVariantCriterion
  /begin VAR_ADDRESS 0x80020ED4 0x800242D4 0x800276D4 0x8002AAD4 0x8002DED4 0x800312D4 0x800346D4 0x80037AD4 /end VAR_ADDRESS
 /end VAR_CHARACTERISTIC
 /begin VAR_CHARACTERISTIC TQS16_EHC_YAW_PEAK_HM_80K BrkCalVariantCriterion
  /begin VAR_ADDRESS 0x80020ED6 0x800242D6 0x800276D6 0x8002AAD6 0x8002DED6 0x800312D6 0x800346D6 0x80037AD6 /end VAR_ADDRESS
 /end VAR_CHARACTERISTIC
 /begin VAR_CHARACTERISTIC TQS16_EHC_YAW_PEAK_MM_100K BrkCalVariantCriterion
  /begin VAR_ADDRESS 0x80020EE0 0x800242E0 0x800276E0 0x8002AAE0 0x8002DEE0 0x800312E0 0x800346E0 0x80037AE0 /end VAR_ADDRESS
 /end VAR_CHARACTERISTIC
 /begin VAR_CHARACTERISTIC TQS16_EHC_YAW_PEAK_MM_40K BrkCalVariantCriterion
  /begin VAR_ADDRESS 0x80020EDA 0x800242DA 0x800276DA 0x8002AADA 0x8002DEDA 0x800312DA 0x800346DA 0x80037ADA /end VAR_ADDRESS
 /end VAR_CHARACTERISTIC
 /begin VAR_CHARACTERISTIC TQS16_EHC_YAW_PEAK_MM_60K BrkCalVariantCriterion
  /begin VAR_ADDRESS 0x80020EDC 0x800242DC 0x800276DC 0x8002AADC 0x8002DEDC 0x800312DC 0x800346DC 0x80037ADC /end VAR_ADDRESS
 /end VAR_CHARACTERISTIC
 /begin VAR_CHARACTERISTIC TQS16_EHC_YAW_PEAK_MM_80K BrkCalVariantCriterion
  /begin VAR_ADDRESS 0x80020EDE 0x800242DE 0x800276DE 0x8002AADE 0x8002DEDE 0x800312DE 0x800346DE 0x80037ADE /end VAR_ADDRESS
 /end VAR_CHARACTERISTIC
 /begin VAR_CHARACTERISTIC TQS16_ESC_SPLIT_ENT_FRT_WHEEL_TH BrkCalVariantCriterion
  /begin VAR_ADDRESS 0x80020B10 0x80023F10 0x80027310 0x8002A710 0x8002DB10 0x80030F10 0x80034310 0x80037710 /end VAR_ADDRESS
 /end VAR_CHARACTERISTIC
 /begin VAR_CHARACTERISTIC TQS16_ESC_SPLIT_ENT_REAR_WHEEL_TH BrkCalVariantCriterion
  /begin VAR_ADDRESS 0x80020B12 0x80023F12 0x80027312 0x8002A712 0x8002DB12 0x80030F12 0x80034312 0x80037712 /end VAR_ADDRESS
 /end VAR_CHARACTERISTIC
 /begin VAR_CHARACTERISTIC TQS16_ESC_SPLIT_EXIT_ALAT_TH BrkCalVariantCriterion
  /begin VAR_ADDRESS 0x80020B14 0x80023F14 0x80027314 0x8002A714 0x8002DB14 0x80030F14 0x80034314 0x80037714 /end VAR_ADDRESS
 /end VAR_CHARACTERISTIC
 /begin VAR_CHARACTERISTIC TQS16_ESC_SPLIT_HOMO_DET_DIFF_TH BrkCalVariantCriterion
  /begin VAR_ADDRESS 0x80020B16 0x80023F16 0x80027316 0x8002A716 0x8002DB16 0x80030F16 0x80034316 0x80037716 /end VAR_ADDRESS
 /end VAR_CHARACTERISTIC
 /begin VAR_CHARACTERISTIC TQS16_ESC_SPLIT_MU_TRANS_WHEEL_TH BrkCalVariantCriterion
  /begin VAR_ADDRESS 0x80020B18 0x80023F18 0x80027318 0x8002A718 0x8002DB18 0x80030F18 0x80034318 0x80037718 /end VAR_ADDRESS
 /end VAR_CHARACTERISTIC
 /begin VAR_CHARACTERISTIC TQS16_FADE_OUT_THRES_CNT BrkCalVariantCriterion
  /begin VAR_ADDRESS 0x80020828 0x80023C28 0x80027028 0x8002A428 0x8002D828 0x80030C28 0x80034028 0x80037428 /end VAR_ADDRESS
 /end VAR_CHARACTERISTIC
 /begin VAR_CHARACTERISTIC TQS16_FADE_OUT_THRES_CNT_REAR BrkCalVariantCriterion
  /begin VAR_ADDRESS 0x80020C62 0x80024062 0x80027462 0x8002A862 0x8002DC62 0x80031062 0x80034462 0x80037862 /end VAR_ADDRESS
 /end VAR_CHARACTERISTIC
 /begin VAR_CHARACTERISTIC TQS16_FADE_OUT_THRES_TAR_TORQ BrkCalVariantCriterion
  /begin VAR_ADDRESS 0x8002082C 0x80023C2C 0x8002702C 0x8002A42C 0x8002D82C 0x80030C2C 0x8003402C 0x8003742C /end VAR_ADDRESS
 /end VAR_CHARACTERISTIC
 /begin VAR_CHARACTERISTIC TQS16_FADE_OUT_THRES_TAR_TORQ_REAR BrkCalVariantCriterion
  /begin VAR_ADDRESS 0x80020C66 0x80024066 0x80027466 0x8002A866 0x8002DC66 0x80031066 0x80034466 0x80037866 /end VAR_ADDRESS
 /end VAR_CHARACTERISTIC
 /begin VAR_CHARACTERISTIC TQS16_FADE_OUT_THRES_YAW BrkCalVariantCriterion
  /begin VAR_ADDRESS 0x8002082A 0x80023C2A 0x8002702A 0x8002A42A 0x8002D82A 0x80030C2A 0x8003402A 0x8003742A /end VAR_ADDRESS
 /end VAR_CHARACTERISTIC
 /begin VAR_CHARACTERISTIC TQS16_FADE_OUT_THRES_YAW_REAR BrkCalVariantCriterion
  /begin VAR_ADDRESS 0x80020C64 0x80024064 0x80027464 0x8002A864 0x8002DC64 0x80031064 0x80034464 0x80037864 /end VAR_ADDRESS
 /end VAR_CHARACTERISTIC
 /begin VAR_CHARACTERISTIC TQS16_FadeOut_DelYaw_H_WEG BrkCalVariantCriterion
  /begin VAR_ADDRESS 0x80020E9C 0x8002429C 0x8002769C 0x8002AA9C 0x8002DE9C 0x8003129C 0x8003469C 0x80037A9C /end VAR_ADDRESS
 /end VAR_CHARACTERISTIC
 /begin VAR_CHARACTERISTIC TQS16_FadeOut_DelYaw_L_WEG BrkCalVariantCriterion
  /begin VAR_ADDRESS 0x80020E98 0x80024298 0x80027698 0x8002AA98 0x8002DE98 0x80031298 0x80034698 0x80037A98 /end VAR_ADDRESS
 /end VAR_CHARACTERISTIC
 /begin VAR_CHARACTERISTIC TQS16_FadeOut_DelYaw_M_WEG BrkCalVariantCriterion
  /begin VAR_ADDRESS 0x80020E9A 0x8002429A 0x8002769A 0x8002AA9A 0x8002DE9A 0x8003129A 0x8003469A 0x80037A9A /end VAR_ADDRESS
 /end VAR_CHARACTERISTIC
 /begin VAR_CHARACTERISTIC TQS16_FadeOut_DelYaw_Thres_H BrkCalVariantCriterion
  /begin VAR_ADDRESS 0x80020E94 0x80024294 0x80027694 0x8002AA94 0x8002DE94 0x80031294 0x80034694 0x80037A94 /end VAR_ADDRESS
 /end VAR_CHARACTERISTIC
 /begin VAR_CHARACTERISTIC TQS16_FadeOut_DelYaw_Thres_L BrkCalVariantCriterion
  /begin VAR_ADDRESS 0x80020E90 0x80024290 0x80027690 0x8002AA90 0x8002DE90 0x80031290 0x80034690 0x80037A90 /end VAR_ADDRESS
 /end VAR_CHARACTERISTIC
 /begin VAR_CHARACTERISTIC TQS16_FadeOut_DelYaw_Thres_M BrkCalVariantCriterion
  /begin VAR_ADDRESS 0x80020E92 0x80024292 0x80027692 0x8002AA92 0x8002DE92 0x80031292 0x80034692 0x80037A92 /end VAR_ADDRESS
 /end VAR_CHARACTERISTIC
 /begin VAR_CHARACTERISTIC TQS16_FadeOut_DelYaw_Thres_VH BrkCalVariantCriterion
  /begin VAR_ADDRESS 0x80020E96 0x80024296 0x80027696 0x8002AA96 0x8002DE96 0x80031296 0x80034696 0x80037A96 /end VAR_ADDRESS
 /end VAR_CHARACTERISTIC
 /begin VAR_CHARACTERISTIC TQS16_FadeOut_DelYaw_VH_WEG BrkCalVariantCriterion
  /begin VAR_ADDRESS 0x80020E9E 0x8002429E 0x8002769E 0x8002AA9E 0x8002DE9E 0x8003129E 0x8003469E 0x80037A9E /end VAR_ADDRESS
 /end VAR_CHARACTERISTIC
 /begin VAR_CHARACTERISTIC TQS16_GAIN_BETA_D_BETA BrkCalVariantCriterion
  /begin VAR_ADDRESS 0x80020020 0x80023420 0x80026820 0x80029C20 0x8002D020 0x80030420 0x80033820 0x80036C20 /end VAR_ADDRESS
 /end VAR_CHARACTERISTIC
 /begin VAR_CHARACTERISTIC TQS16_GAIN_BETA_D_DELTA BrkCalVariantCriterion
  /begin VAR_ADDRESS 0x80020024 0x80023424 0x80026824 0x80029C24 0x8002D024 0x80030424 0x80033824 0x80036C24 /end VAR_ADDRESS
 /end VAR_CHARACTERISTIC
 /begin VAR_CHARACTERISTIC TQS16_GAIN_YAW_D_BETA BrkCalVariantCriterion
  /begin VAR_ADDRESS 0x80020026 0x80023426 0x80026826 0x80029C26 0x8002D026 0x80030426 0x80033826 0x80036C26 /end VAR_ADDRESS
 /end VAR_CHARACTERISTIC
 /begin VAR_CHARACTERISTIC TQS16_GAIN_YAW_D_DELTA BrkCalVariantCriterion
  /begin VAR_ADDRESS 0x8002002A 0x8002342A 0x8002682A 0x80029C2A 0x8002D02A 0x8003042A 0x8003382A 0x80036C2A /end VAR_ADDRESS
 /end VAR_CHARACTERISTIC
 /begin VAR_CHARACTERISTIC TQS16_GAIN_YAW_D_YAW BrkCalVariantCriterion
  /begin VAR_ADDRESS 0x80020028 0x80023428 0x80026828 0x80029C28 0x8002D028 0x80030428 0x80033828 0x80036C28 /end VAR_ADDRESS
 /end VAR_CHARACTERISTIC
 /begin VAR_CHARACTERISTIC TQS16_LAT_G_CAL_SCALE BrkCalVariantCriterion
  /begin VAR_ADDRESS 0x8002002C 0x8002342C 0x8002682C 0x80029C2C 0x8002D02C 0x8003042C 0x8003382C 0x80036C2C /end VAR_ADDRESS
 /end VAR_CHARACTERISTIC
 /begin VAR_CHARACTERISTIC TQS16_LAT_G_EXTRA_100 BrkCalVariantCriterion
  /begin VAR_ADDRESS 0x80020066 0x80023466 0x80026866 0x80029C66 0x8002D066 0x80030466 0x80033866 0x80036C66 /end VAR_ADDRESS
 /end VAR_CHARACTERISTIC
 /begin VAR_CHARACTERISTIC TQS16_LAT_G_EXTRA_120 BrkCalVariantCriterion
  /begin VAR_ADDRESS 0x80020068 0x80023468 0x80026868 0x80029C68 0x8002D068 0x80030468 0x80033868 0x80036C68 /end VAR_ADDRESS
 /end VAR_CHARACTERISTIC
 /begin VAR_CHARACTERISTIC TQS16_LAT_G_EXTRA_150 BrkCalVariantCriterion
  /begin VAR_ADDRESS 0x8002006A 0x8002346A 0x8002686A 0x80029C6A 0x8002D06A 0x8003046A 0x8003386A 0x80036C6A /end VAR_ADDRESS
 /end VAR_CHARACTERISTIC
 /begin VAR_CHARACTERISTIC TQS16_LAT_G_EXTRA_40 BrkCalVariantCriterion
  /begin VAR_ADDRESS 0x80020060 0x80023460 0x80026860 0x80029C60 0x8002D060 0x80030460 0x80033860 0x80036C60 /end VAR_ADDRESS
 /end VAR_CHARACTERISTIC
 /begin VAR_CHARACTERISTIC TQS16_LAT_G_EXTRA_60 BrkCalVariantCriterion
  /begin VAR_ADDRESS 0x80020062 0x80023462 0x80026862 0x80029C62 0x8002D062 0x80030462 0x80033862 0x80036C62 /end VAR_ADDRESS
 /end VAR_CHARACTERISTIC
 /begin VAR_CHARACTERISTIC TQS16_LAT_G_EXTRA_80 BrkCalVariantCriterion
  /begin VAR_ADDRESS 0x80020064 0x80023464 0x80026864 0x80029C64 0x8002D064 0x80030464 0x80033864 0x80036C64 /end VAR_ADDRESS
 /end VAR_CHARACTERISTIC
 /begin VAR_CHARACTERISTIC TQS16_LAT_G_FILTER_100 BrkCalVariantCriterion
  /begin VAR_ADDRESS 0x8002003C 0x8002343C 0x8002683C 0x80029C3C 0x8002D03C 0x8003043C 0x8003383C 0x80036C3C /end VAR_ADDRESS
 /end VAR_CHARACTERISTIC
 /begin VAR_CHARACTERISTIC TQS16_LAT_G_FILTER_120 BrkCalVariantCriterion
  /begin VAR_ADDRESS 0x8002003E 0x8002343E 0x8002683E 0x80029C3E 0x8002D03E 0x8003043E 0x8003383E 0x80036C3E /end VAR_ADDRESS
 /end VAR_CHARACTERISTIC
 /begin VAR_CHARACTERISTIC TQS16_LAT_G_FILTER_150 BrkCalVariantCriterion
  /begin VAR_ADDRESS 0x80020040 0x80023440 0x80026840 0x80029C40 0x8002D040 0x80030440 0x80033840 0x80036C40 /end VAR_ADDRESS
 /end VAR_CHARACTERISTIC
 /begin VAR_CHARACTERISTIC TQS16_LAT_G_FILTER_20 BrkCalVariantCriterion
  /begin VAR_ADDRESS 0x80020034 0x80023434 0x80026834 0x80029C34 0x8002D034 0x80030434 0x80033834 0x80036C34 /end VAR_ADDRESS
 /end VAR_CHARACTERISTIC
 /begin VAR_CHARACTERISTIC TQS16_LAT_G_FILTER_40 BrkCalVariantCriterion
  /begin VAR_ADDRESS 0x80020036 0x80023436 0x80026836 0x80029C36 0x8002D036 0x80030436 0x80033836 0x80036C36 /end VAR_ADDRESS
 /end VAR_CHARACTERISTIC
 /begin VAR_CHARACTERISTIC TQS16_LAT_G_FILTER_60 BrkCalVariantCriterion
  /begin VAR_ADDRESS 0x80020038 0x80023438 0x80026838 0x80029C38 0x8002D038 0x80030438 0x80033838 0x80036C38 /end VAR_ADDRESS
 /end VAR_CHARACTERISTIC
 /begin VAR_CHARACTERISTIC TQS16_LAT_G_FILTER_80 BrkCalVariantCriterion
  /begin VAR_ADDRESS 0x8002003A 0x8002343A 0x8002683A 0x80029C3A 0x8002D03A 0x8003043A 0x8003383A 0x80036C3A /end VAR_ADDRESS
 /end VAR_CHARACTERISTIC
 /begin VAR_CHARACTERISTIC TQS16_LENGTH_CG_TO_FRONT BrkCalVariantCriterion
  /begin VAR_ADDRESS 0x80020048 0x80023448 0x80026848 0x80029C48 0x8002D048 0x80030448 0x80033848 0x80036C48 /end VAR_ADDRESS
 /end VAR_CHARACTERISTIC
 /begin VAR_CHARACTERISTIC TQS16_LENGTH_CG_TO_REAR BrkCalVariantCriterion
  /begin VAR_ADDRESS 0x8002004A 0x8002344A 0x8002684A 0x80029C4A 0x8002D04A 0x8003044A 0x8003384A 0x80036C4A /end VAR_ADDRESS
 /end VAR_CHARACTERISTIC
 /begin VAR_CHARACTERISTIC TQS16_LIMIT_WEIGHT_H BrkCalVariantCriterion
  /begin VAR_ADDRESS 0x80020A86 0x80023E86 0x80027286 0x8002A686 0x8002DA86 0x80030E86 0x80034286 0x80037686 /end VAR_ADDRESS
 /end VAR_CHARACTERISTIC
 /begin VAR_CHARACTERISTIC TQS16_LIMIT_WEIGHT_L BrkCalVariantCriterion
  /begin VAR_ADDRESS 0x80020A9C 0x80023E9C 0x8002729C 0x8002A69C 0x8002DA9C 0x80030E9C 0x8003429C 0x8003769C /end VAR_ADDRESS
 /end VAR_CHARACTERISTIC
 /begin VAR_CHARACTERISTIC TQS16_LIMIT_WEIGHT_M BrkCalVariantCriterion
  /begin VAR_ADDRESS 0x80020A88 0x80023E88 0x80027288 0x8002A688 0x8002DA88 0x80030E88 0x80034288 0x80037688 /end VAR_ADDRESS
 /end VAR_CHARACTERISTIC
 /begin VAR_CHARACTERISTIC TQS16_MAX_ROAD_ADHESION BrkCalVariantCriterion
  /begin VAR_ADDRESS 0x8002005C 0x8002345C 0x8002685C 0x80029C5C 0x8002D05C 0x8003045C 0x8003385C 0x80036C5C /end VAR_ADDRESS
 /end VAR_CHARACTERISTIC
 /begin VAR_CHARACTERISTIC TQS16_MOMENT_OF_INERTIA BrkCalVariantCriterion
  /begin VAR_ADDRESS 0x80020054 0x80023454 0x80026854 0x80029C54 0x8002D054 0x80030454 0x80033854 0x80036C54 /end VAR_ADDRESS
 /end VAR_CHARACTERISTIC
 /begin VAR_CHARACTERISTIC TQS16_MP_X1 BrkCalVariantCriterion
  /begin VAR_ADDRESS 0x80020E70 0x80024270 0x80027670 0x8002AA70 0x8002DE70 0x80031270 0x80034670 0x80037A70 /end VAR_ADDRESS
 /end VAR_CHARACTERISTIC
 /begin VAR_CHARACTERISTIC TQS16_MP_X2 BrkCalVariantCriterion
  /begin VAR_ADDRESS 0x80020E72 0x80024272 0x80027672 0x8002AA72 0x8002DE72 0x80031272 0x80034672 0x80037A72 /end VAR_ADDRESS
 /end VAR_CHARACTERISTIC
 /begin VAR_CHARACTERISTIC TQS16_MP_X3 BrkCalVariantCriterion
  /begin VAR_ADDRESS 0x80020E74 0x80024274 0x80027674 0x8002AA74 0x8002DE74 0x80031274 0x80034674 0x80037A74 /end VAR_ADDRESS
 /end VAR_CHARACTERISTIC
 /begin VAR_CHARACTERISTIC TQS16_MP_X4 BrkCalVariantCriterion
  /begin VAR_ADDRESS 0x80020E76 0x80024276 0x80027676 0x8002AA76 0x8002DE76 0x80031276 0x80034676 0x80037A76 /end VAR_ADDRESS
 /end VAR_CHARACTERISTIC
 /begin VAR_CHARACTERISTIC TQS16_MU_HIGH BrkCalVariantCriterion
  /begin VAR_ADDRESS 0x80020A1E 0x80023E1E 0x8002721E 0x8002A61E 0x8002DA1E 0x80030E1E 0x8003421E 0x8003761E /end VAR_ADDRESS
 /end VAR_CHARACTERISTIC
 /begin VAR_CHARACTERISTIC TQS16_MU_LOW BrkCalVariantCriterion
  /begin VAR_ADDRESS 0x80020A18 0x80023E18 0x80027218 0x8002A618 0x8002DA18 0x80030E18 0x80034218 0x80037618 /end VAR_ADDRESS
 /end VAR_CHARACTERISTIC
 /begin VAR_CHARACTERISTIC TQS16_MU_MED BrkCalVariantCriterion
  /begin VAR_ADDRESS 0x80020A1A 0x80023E1A 0x8002721A 0x8002A61A 0x8002DA1A 0x80030E1A 0x8003421A 0x8003761A /end VAR_ADDRESS
 /end VAR_CHARACTERISTIC
 /begin VAR_CHARACTERISTIC TQS16_MU_MED_HIGH BrkCalVariantCriterion
  /begin VAR_ADDRESS 0x80020A1C 0x80023E1C 0x8002721C 0x8002A61C 0x8002DA1C 0x80030E1C 0x8003421C 0x8003761C /end VAR_ADDRESS
 /end VAR_CHARACTERISTIC
 /begin VAR_CHARACTERISTIC TQS16_OS2W_CTRL_ENTER_TH BrkCalVariantCriterion
  /begin VAR_ADDRESS 0x80020D52 0x80024152 0x80027552 0x8002A952 0x8002DD52 0x80031152 0x80034552 0x80037952 /end VAR_ADDRESS
 /end VAR_CHARACTERISTIC
 /begin VAR_CHARACTERISTIC TQS16_OS2W_CTRL_EXIT_TH BrkCalVariantCriterion
  /begin VAR_ADDRESS 0x80020D54 0x80024154 0x80027554 0x8002A954 0x8002DD54 0x80031154 0x80034554 0x80037954 /end VAR_ADDRESS
 /end VAR_CHARACTERISTIC
 /begin VAR_CHARACTERISTIC TQS16_OS2W_CTRL_NEG_OFFSET BrkCalVariantCriterion
  /begin VAR_ADDRESS 0x80020D22 0x80024122 0x80027522 0x8002A922 0x8002DD22 0x80031122 0x80034522 0x80037922 /end VAR_ADDRESS
 /end VAR_CHARACTERISTIC
 /begin VAR_CHARACTERISTIC TQS16_OS2W_CTRL_SLIP_WEG BrkCalVariantCriterion
  /begin VAR_ADDRESS 0x80020D4E 0x8002414E 0x8002754E 0x8002A94E 0x8002DD4E 0x8003114E 0x8003454E 0x8003794E /end VAR_ADDRESS
 /end VAR_CHARACTERISTIC
 /begin VAR_CHARACTERISTIC TQS16_OS2W_ENTER_TAR_FX_OFFSET BrkCalVariantCriterion
  /begin VAR_ADDRESS 0x80020816 0x80023C16 0x80027016 0x8002A416 0x8002D816 0x80030C16 0x80034016 0x80037416 /end VAR_ADDRESS
 /end VAR_CHARACTERISTIC
 /begin VAR_CHARACTERISTIC TQS16_OS_FRT_TAR_PRESS_MIN_HMU BrkCalVariantCriterion
  /begin VAR_ADDRESS 0x80020E6E 0x8002426E 0x8002766E 0x8002AA6E 0x8002DE6E 0x8003126E 0x8003466E 0x80037A6E /end VAR_ADDRESS
 /end VAR_CHARACTERISTIC
 /begin VAR_CHARACTERISTIC TQS16_OS_FRT_TAR_PRESS_MIN_LMU BrkCalVariantCriterion
  /begin VAR_ADDRESS 0x80020E6A 0x8002426A 0x8002766A 0x8002AA6A 0x8002DE6A 0x8003126A 0x8003466A 0x80037A6A /end VAR_ADDRESS
 /end VAR_CHARACTERISTIC
 /begin VAR_CHARACTERISTIC TQS16_OS_FRT_TAR_PRESS_MIN_MMU BrkCalVariantCriterion
  /begin VAR_ADDRESS 0x80020E6C 0x8002426C 0x8002766C 0x8002AA6C 0x8002DE6C 0x8003126C 0x8003466C 0x80037A6C /end VAR_ADDRESS
 /end VAR_CHARACTERISTIC
 /begin VAR_CHARACTERISTIC TQS16_REAR_FadeOut_TorqDec_HM BrkCalVariantCriterion
  /begin VAR_ADDRESS 0x80020C6C 0x8002406C 0x8002746C 0x8002A86C 0x8002DC6C 0x8003106C 0x8003446C 0x8003786C /end VAR_ADDRESS
 /end VAR_CHARACTERISTIC
 /begin VAR_CHARACTERISTIC TQS16_REAR_FadeOut_TorqDec_LM BrkCalVariantCriterion
  /begin VAR_ADDRESS 0x80020C68 0x80024068 0x80027468 0x8002A868 0x8002DC68 0x80031068 0x80034468 0x80037868 /end VAR_ADDRESS
 /end VAR_CHARACTERISTIC
 /begin VAR_CHARACTERISTIC TQS16_REAR_FadeOut_TorqDec_MM BrkCalVariantCriterion
  /begin VAR_ADDRESS 0x80020C6A 0x8002406A 0x8002746A 0x8002A86A 0x8002DC6A 0x8003106A 0x8003446A 0x8003786A /end VAR_ADDRESS
 /end VAR_CHARACTERISTIC
 /begin VAR_CHARACTERISTIC TQS16_RI_THRES BrkCalVariantCriterion
  /begin VAR_ADDRESS 0x80020B1A 0x80023F1A 0x8002731A 0x8002A71A 0x8002DB1A 0x80030F1A 0x8003431A 0x8003771A /end VAR_ADDRESS
 /end VAR_CHARACTERISTIC
 /begin VAR_CHARACTERISTIC TQS16_RI_THRES_WEG_IN_ESC_OFF BrkCalVariantCriterion
  /begin VAR_ADDRESS 0x80020C48 0x80024048 0x80027448 0x8002A848 0x8002DC48 0x80031048 0x80034448 0x80037848 /end VAR_ADDRESS
 /end VAR_CHARACTERISTIC
 /begin VAR_CHARACTERISTIC TQS16_ROP_2ND_ENGAGE_SPEED_V1 BrkCalVariantCriterion
  /begin VAR_ADDRESS 0x80020C54 0x80024054 0x80027454 0x8002A854 0x8002DC54 0x80031054 0x80034454 0x80037854 /end VAR_ADDRESS
 /end VAR_CHARACTERISTIC
 /begin VAR_CHARACTERISTIC TQS16_ROP_2ND_ENGAGE_SPEED_V2 BrkCalVariantCriterion
  /begin VAR_ADDRESS 0x80020C56 0x80024056 0x80027456 0x8002A856 0x8002DC56 0x80031056 0x80034456 0x80037856 /end VAR_ADDRESS
 /end VAR_CHARACTERISTIC
 /begin VAR_CHARACTERISTIC TQS16_ROP_AY_DOT_TH_1st BrkCalVariantCriterion
  /begin VAR_ADDRESS 0x80020C16 0x80024016 0x80027416 0x8002A816 0x8002DC16 0x80031016 0x80034416 0x80037816 /end VAR_ADDRESS
 /end VAR_CHARACTERISTIC
 /begin VAR_CHARACTERISTIC TQS16_ROP_AY_DOT_TH_2nd BrkCalVariantCriterion
  /begin VAR_ADDRESS 0x80020C18 0x80024018 0x80027418 0x8002A818 0x8002DC18 0x80031018 0x80034418 0x80037818 /end VAR_ADDRESS
 /end VAR_CHARACTERISTIC
 /begin VAR_CHARACTERISTIC TQS16_ROP_BANK_DET_RI_WEG BrkCalVariantCriterion
  /begin VAR_ADDRESS 0x80020B1C 0x80023F1C 0x8002731C 0x8002A71C 0x8002DB1C 0x80030F1C 0x8003431C 0x8003771C /end VAR_ADDRESS
 /end VAR_CHARACTERISTIC
 /begin VAR_CHARACTERISTIC TQS16_ROP_BANK_SUS_RI_WEG BrkCalVariantCriterion
  /begin VAR_ADDRESS 0x80020B1E 0x80023F1E 0x8002731E 0x8002A71E 0x8002DB1E 0x80030F1E 0x8003431E 0x8003771E /end VAR_ADDRESS
 /end VAR_CHARACTERISTIC
 /begin VAR_CHARACTERISTIC TQS16_ROP_DUMP_ALAT_1st BrkCalVariantCriterion
  /begin VAR_ADDRESS 0x80020BA6 0x80023FA6 0x800273A6 0x8002A7A6 0x8002DBA6 0x80030FA6 0x800343A6 0x800377A6 /end VAR_ADDRESS
 /end VAR_CHARACTERISTIC
 /begin VAR_CHARACTERISTIC TQS16_ROP_DUMP_ALAT_2nd BrkCalVariantCriterion
  /begin VAR_ADDRESS 0x80020BA8 0x80023FA8 0x800273A8 0x8002A7A8 0x8002DBA8 0x80030FA8 0x800343A8 0x800377A8 /end VAR_ADDRESS
 /end VAR_CHARACTERISTIC
 /begin VAR_CHARACTERISTIC TQS16_ROP_DUMP_ALAT_3rd BrkCalVariantCriterion
  /begin VAR_ADDRESS 0x80020BAA 0x80023FAA 0x800273AA 0x8002A7AA 0x8002DBAA 0x80030FAA 0x800343AA 0x800377AA /end VAR_ADDRESS
 /end VAR_CHARACTERISTIC
 /begin VAR_CHARACTERISTIC TQS16_ROP_DUMP_DYN_WEG_VEL_100K BrkCalVariantCriterion
  /begin VAR_ADDRESS 0x80020BB8 0x80023FB8 0x800273B8 0x8002A7B8 0x8002DBB8 0x80030FB8 0x800343B8 0x800377B8 /end VAR_ADDRESS
 /end VAR_CHARACTERISTIC
 /begin VAR_CHARACTERISTIC TQS16_ROP_DUMP_DYN_WEG_VEL_20K BrkCalVariantCriterion
  /begin VAR_ADDRESS 0x80020BBA 0x80023FBA 0x800273BA 0x8002A7BA 0x8002DBBA 0x80030FBA 0x800343BA 0x800377BA /end VAR_ADDRESS
 /end VAR_CHARACTERISTIC
 /begin VAR_CHARACTERISTIC TQS16_ROP_DUMP_DYN_WEG_VEL_40K BrkCalVariantCriterion
  /begin VAR_ADDRESS 0x80020BBC 0x80023FBC 0x800273BC 0x8002A7BC 0x8002DBBC 0x80030FBC 0x800343BC 0x800377BC /end VAR_ADDRESS
 /end VAR_CHARACTERISTIC
 /begin VAR_CHARACTERISTIC TQS16_ROP_DUMP_DYN_WEG_VEL_60K BrkCalVariantCriterion
  /begin VAR_ADDRESS 0x80020BBE 0x80023FBE 0x800273BE 0x8002A7BE 0x8002DBBE 0x80030FBE 0x800343BE 0x800377BE /end VAR_ADDRESS
 /end VAR_CHARACTERISTIC
 /begin VAR_CHARACTERISTIC TQS16_ROP_DUMP_DYN_WEG_VEL_80K BrkCalVariantCriterion
  /begin VAR_ADDRESS 0x80020BC0 0x80023FC0 0x800273C0 0x8002A7C0 0x8002DBC0 0x80030FC0 0x800343C0 0x800377C0 /end VAR_ADDRESS
 /end VAR_CHARACTERISTIC
 /begin VAR_CHARACTERISTIC TQS16_ROP_DUMP_RATE_1st BrkCalVariantCriterion
  /begin VAR_ADDRESS 0x80020BAC 0x80023FAC 0x800273AC 0x8002A7AC 0x8002DBAC 0x80030FAC 0x800343AC 0x800377AC /end VAR_ADDRESS
 /end VAR_CHARACTERISTIC
 /begin VAR_CHARACTERISTIC TQS16_ROP_DUMP_RATE_2nd BrkCalVariantCriterion
  /begin VAR_ADDRESS 0x80020BAE 0x80023FAE 0x800273AE 0x8002A7AE 0x8002DBAE 0x80030FAE 0x800343AE 0x800377AE /end VAR_ADDRESS
 /end VAR_CHARACTERISTIC
 /begin VAR_CHARACTERISTIC TQS16_ROP_DUMP_RATE_3rd BrkCalVariantCriterion
  /begin VAR_ADDRESS 0x80020BB0 0x80023FB0 0x800273B0 0x8002A7B0 0x8002DBB0 0x80030FB0 0x800343B0 0x800377B0 /end VAR_ADDRESS
 /end VAR_CHARACTERISTIC
 /begin VAR_CHARACTERISTIC TQS16_ROP_DUMP_RATE_ADD BrkCalVariantCriterion
  /begin VAR_ADDRESS 0x80020BB2 0x80023FB2 0x800273B2 0x8002A7B2 0x8002DBB2 0x80030FB2 0x800343B2 0x800377B2 /end VAR_ADDRESS
 /end VAR_CHARACTERISTIC
 /begin VAR_CHARACTERISTIC TQS16_ROP_DUMP_RATE_SLIP_MAX BrkCalVariantCriterion
  /begin VAR_ADDRESS 0x80020BB4 0x80023FB4 0x800273B4 0x8002A7B4 0x8002DBB4 0x80030FB4 0x800343B4 0x800377B4 /end VAR_ADDRESS
 /end VAR_CHARACTERISTIC
 /begin VAR_CHARACTERISTIC TQS16_ROP_DUMP_RATE_SLIP_MIN BrkCalVariantCriterion
  /begin VAR_ADDRESS 0x80020BB6 0x80023FB6 0x800273B6 0x8002A7B6 0x8002DBB6 0x80030FB6 0x800343B6 0x800377B6 /end VAR_ADDRESS
 /end VAR_CHARACTERISTIC
 /begin VAR_CHARACTERISTIC TQS16_ROP_DUMP_WEG_VEL_100K BrkCalVariantCriterion
  /begin VAR_ADDRESS 0x80020BC2 0x80023FC2 0x800273C2 0x8002A7C2 0x8002DBC2 0x80030FC2 0x800343C2 0x800377C2 /end VAR_ADDRESS
 /end VAR_CHARACTERISTIC
 /begin VAR_CHARACTERISTIC TQS16_ROP_DUMP_WEG_VEL_20K BrkCalVariantCriterion
  /begin VAR_ADDRESS 0x80020BC4 0x80023FC4 0x800273C4 0x8002A7C4 0x8002DBC4 0x80030FC4 0x800343C4 0x800377C4 /end VAR_ADDRESS
 /end VAR_CHARACTERISTIC
 /begin VAR_CHARACTERISTIC TQS16_ROP_DUMP_WEG_VEL_40K BrkCalVariantCriterion
  /begin VAR_ADDRESS 0x80020BC6 0x80023FC6 0x800273C6 0x8002A7C6 0x8002DBC6 0x80030FC6 0x800343C6 0x800377C6 /end VAR_ADDRESS
 /end VAR_CHARACTERISTIC
 /begin VAR_CHARACTERISTIC TQS16_ROP_DUMP_WEG_VEL_60K BrkCalVariantCriterion
  /begin VAR_ADDRESS 0x80020BC8 0x80023FC8 0x800273C8 0x8002A7C8 0x8002DBC8 0x80030FC8 0x800343C8 0x800377C8 /end VAR_ADDRESS
 /end VAR_CHARACTERISTIC
 /begin VAR_CHARACTERISTIC TQS16_ROP_DUMP_WEG_VEL_80K BrkCalVariantCriterion
  /begin VAR_ADDRESS 0x80020BCA 0x80023FCA 0x800273CA 0x8002A7CA 0x8002DBCA 0x80030FCA 0x800343CA 0x800377CA /end VAR_ADDRESS
 /end VAR_CHARACTERISTIC
 /begin VAR_CHARACTERISTIC TQS16_ROP_ENTER_ALAT_TH_1st BrkCalVariantCriterion
  /begin VAR_ADDRESS 0x80020B48 0x80023F48 0x80027348 0x8002A748 0x8002DB48 0x80030F48 0x80034348 0x80037748 /end VAR_ADDRESS
 /end VAR_CHARACTERISTIC
 /begin VAR_CHARACTERISTIC TQS16_ROP_ENTER_ALAT_TH_2nd BrkCalVariantCriterion
  /begin VAR_ADDRESS 0x80020B4A 0x80023F4A 0x8002734A 0x8002A74A 0x8002DB4A 0x80030F4A 0x8003434A 0x8003774A /end VAR_ADDRESS
 /end VAR_CHARACTERISTIC
 /begin VAR_CHARACTERISTIC TQS16_ROP_ENTER_ALAT_TH_3rd BrkCalVariantCriterion
  /begin VAR_ADDRESS 0x80020B4C 0x80023F4C 0x8002734C 0x8002A74C 0x8002DB4C 0x80030F4C 0x8003434C 0x8003774C /end VAR_ADDRESS
 /end VAR_CHARACTERISTIC
 /begin VAR_CHARACTERISTIC TQS16_ROP_ENTER_ALAT_TH_4th BrkCalVariantCriterion
  /begin VAR_ADDRESS 0x80020B4E 0x80023F4E 0x8002734E 0x8002A74E 0x8002DB4E 0x80030F4E 0x8003434E 0x8003774E /end VAR_ADDRESS
 /end VAR_CHARACTERISTIC
 /begin VAR_CHARACTERISTIC TQS16_ROP_ENTER_ALAT_TH_5th BrkCalVariantCriterion
  /begin VAR_ADDRESS 0x80020B50 0x80023F50 0x80027350 0x8002A750 0x8002DB50 0x80030F50 0x80034350 0x80037750 /end VAR_ADDRESS
 /end VAR_CHARACTERISTIC
 /begin VAR_CHARACTERISTIC TQS16_ROP_ENTER_ALAT_WEG_1st BrkCalVariantCriterion
  /begin VAR_ADDRESS 0x80020B52 0x80023F52 0x80027352 0x8002A752 0x8002DB52 0x80030F52 0x80034352 0x80037752 /end VAR_ADDRESS
 /end VAR_CHARACTERISTIC
 /begin VAR_CHARACTERISTIC TQS16_ROP_ENTER_ALAT_WEG_2nd BrkCalVariantCriterion
  /begin VAR_ADDRESS 0x80020B54 0x80023F54 0x80027354 0x8002A754 0x8002DB54 0x80030F54 0x80034354 0x80037754 /end VAR_ADDRESS
 /end VAR_CHARACTERISTIC
 /begin VAR_CHARACTERISTIC TQS16_ROP_ENTER_ALAT_WEG_3rd BrkCalVariantCriterion
  /begin VAR_ADDRESS 0x80020B56 0x80023F56 0x80027356 0x8002A756 0x8002DB56 0x80030F56 0x80034356 0x80037756 /end VAR_ADDRESS
 /end VAR_CHARACTERISTIC
 /begin VAR_CHARACTERISTIC TQS16_ROP_ENTER_ALAT_WEG_4th BrkCalVariantCriterion
  /begin VAR_ADDRESS 0x80020B58 0x80023F58 0x80027358 0x8002A758 0x8002DB58 0x80030F58 0x80034358 0x80037758 /end VAR_ADDRESS
 /end VAR_CHARACTERISTIC
 /begin VAR_CHARACTERISTIC TQS16_ROP_ENTER_ALAT_WEG_5th BrkCalVariantCriterion
  /begin VAR_ADDRESS 0x80020B5A 0x80023F5A 0x8002735A 0x8002A75A 0x8002DB5A 0x80030F5A 0x8003435A 0x8003775A /end VAR_ADDRESS
 /end VAR_CHARACTERISTIC
 /begin VAR_CHARACTERISTIC TQS16_ROP_FRT_PRESS_MIN BrkCalVariantCriterion
  /begin VAR_ADDRESS 0x80020C3A 0x8002403A 0x8002743A 0x8002A83A 0x8002DC3A 0x8003103A 0x8003443A 0x8003783A /end VAR_ADDRESS
 /end VAR_CHARACTERISTIC
 /begin VAR_CHARACTERISTIC TQS16_ROP_IN_ESC_OFF_D_GAIN_WEG BrkCalVariantCriterion
  /begin VAR_ADDRESS 0x80020C4A 0x8002404A 0x8002744A 0x8002A84A 0x8002DC4A 0x8003104A 0x8003444A 0x8003784A /end VAR_ADDRESS
 /end VAR_CHARACTERISTIC
 /begin VAR_CHARACTERISTIC TQS16_ROP_IN_ESC_OFF_P_GAIN_WEG BrkCalVariantCriterion
  /begin VAR_ADDRESS 0x80020C4C 0x8002404C 0x8002744C 0x8002A84C 0x8002DC4C 0x8003104C 0x8003444C 0x8003784C /end VAR_ADDRESS
 /end VAR_CHARACTERISTIC
 /begin VAR_CHARACTERISTIC TQS16_ROP_IN_ESC_OFF_VEL_ENT_TH BrkCalVariantCriterion
  /begin VAR_ADDRESS 0x80020C4E 0x8002404E 0x8002744E 0x8002A84E 0x8002DC4E 0x8003104E 0x8003444E 0x8003784E /end VAR_ADDRESS
 /end VAR_CHARACTERISTIC
 /begin VAR_CHARACTERISTIC TQS16_ROP_MODEL_MU_LEVEL BrkCalVariantCriterion
  /begin VAR_ADDRESS 0x80020B6E 0x80023F6E 0x8002736E 0x8002A76E 0x8002DB6E 0x80030F6E 0x8003436E 0x8003776E /end VAR_ADDRESS
 /end VAR_CHARACTERISTIC
 /begin VAR_CHARACTERISTIC TQS16_ROP_MU_LEVEL_AY BrkCalVariantCriterion
  /begin VAR_ADDRESS 0x80020B70 0x80023F70 0x80027370 0x8002A770 0x8002DB70 0x80030F70 0x80034370 0x80037770 /end VAR_ADDRESS
 /end VAR_CHARACTERISTIC
 /begin VAR_CHARACTERISTIC TQS16_ROP_PREFILL_MPRESS_TH BrkCalVariantCriterion
  /begin VAR_ADDRESS 0x80020C1A 0x8002401A 0x8002741A 0x8002A81A 0x8002DC1A 0x8003101A 0x8003441A 0x8003781A /end VAR_ADDRESS
 /end VAR_CHARACTERISTIC
 /begin VAR_CHARACTERISTIC TQS16_ROP_PREFILL_MQ_WEG_VEL_100K BrkCalVariantCriterion
  /begin VAR_ADDRESS 0x80020C0C 0x8002400C 0x8002740C 0x8002A80C 0x8002DC0C 0x8003100C 0x8003440C 0x8003780C /end VAR_ADDRESS
 /end VAR_CHARACTERISTIC
 /begin VAR_CHARACTERISTIC TQS16_ROP_PREFILL_MQ_WEG_VEL_20K BrkCalVariantCriterion
  /begin VAR_ADDRESS 0x80020C0E 0x8002400E 0x8002740E 0x8002A80E 0x8002DC0E 0x8003100E 0x8003440E 0x8003780E /end VAR_ADDRESS
 /end VAR_CHARACTERISTIC
 /begin VAR_CHARACTERISTIC TQS16_ROP_PREFILL_MQ_WEG_VEL_40K BrkCalVariantCriterion
  /begin VAR_ADDRESS 0x80020C10 0x80024010 0x80027410 0x8002A810 0x8002DC10 0x80031010 0x80034410 0x80037810 /end VAR_ADDRESS
 /end VAR_CHARACTERISTIC
 /begin VAR_CHARACTERISTIC TQS16_ROP_PREFILL_MQ_WEG_VEL_60K BrkCalVariantCriterion
  /begin VAR_ADDRESS 0x80020C12 0x80024012 0x80027412 0x8002A812 0x8002DC12 0x80031012 0x80034412 0x80037812 /end VAR_ADDRESS
 /end VAR_CHARACTERISTIC
 /begin VAR_CHARACTERISTIC TQS16_ROP_PREFILL_MQ_WEG_VEL_80K BrkCalVariantCriterion
  /begin VAR_ADDRESS 0x80020C14 0x80024014 0x80027414 0x8002A814 0x8002DC14 0x80031014 0x80034414 0x80037814 /end VAR_ADDRESS
 /end VAR_CHARACTERISTIC
 /begin VAR_CHARACTERISTIC TQS16_ROP_PRESS_RISE_1ST_LMT BrkCalVariantCriterion
  /begin VAR_ADDRESS 0x80020C3C 0x8002403C 0x8002743C 0x8002A83C 0x8002DC3C 0x8003103C 0x8003443C 0x8003783C /end VAR_ADDRESS
 /end VAR_CHARACTERISTIC
 /begin VAR_CHARACTERISTIC TQS16_ROP_PRESS_RISE_2ND_LMT BrkCalVariantCriterion
  /begin VAR_ADDRESS 0x80020C3E 0x8002403E 0x8002743E 0x8002A83E 0x8002DC3E 0x8003103E 0x8003443E 0x8003783E /end VAR_ADDRESS
 /end VAR_CHARACTERISTIC
 /begin VAR_CHARACTERISTIC TQS16_ROP_PRE_FRT_CTRL_MIN BrkCalVariantCriterion
  /begin VAR_ADDRESS 0x80020C40 0x80024040 0x80027440 0x8002A840 0x8002DC40 0x80031040 0x80034440 0x80037840 /end VAR_ADDRESS
 /end VAR_CHARACTERISTIC
 /begin VAR_CHARACTERISTIC TQS16_ROP_PRE_FRT_ENT_WSTR_TH BrkCalVariantCriterion
  /begin VAR_ADDRESS 0x80020B20 0x80023F20 0x80027320 0x8002A720 0x8002DB20 0x80030F20 0x80034320 0x80037720 /end VAR_ADDRESS
 /end VAR_CHARACTERISTIC
 /begin VAR_CHARACTERISTIC TQS16_ROP_PRE_FRT_ENT_WSTR_TH_V1 BrkCalVariantCriterion
  /begin VAR_ADDRESS 0x80020C58 0x80024058 0x80027458 0x8002A858 0x8002DC58 0x80031058 0x80034458 0x80037858 /end VAR_ADDRESS
 /end VAR_CHARACTERISTIC
 /begin VAR_CHARACTERISTIC TQS16_ROP_PRE_FRT_ENT_WSTR_TH_V2 BrkCalVariantCriterion
  /begin VAR_ADDRESS 0x80020C5A 0x8002405A 0x8002745A 0x8002A85A 0x8002DC5A 0x8003105A 0x8003445A 0x8003785A /end VAR_ADDRESS
 /end VAR_CHARACTERISTIC
 /begin VAR_CHARACTERISTIC TQS16_ROP_PROACTIVE_DEL_SLIP_R BrkCalVariantCriterion
  /begin VAR_ADDRESS 0x80020C42 0x80024042 0x80027442 0x8002A842 0x8002DC42 0x80031042 0x80034442 0x80037842 /end VAR_ADDRESS
 /end VAR_CHARACTERISTIC
 /begin VAR_CHARACTERISTIC TQS16_ROP_PULSE_UP_INI_DUTY_REAR BrkCalVariantCriterion
  /begin VAR_ADDRESS 0x80020C44 0x80024044 0x80027444 0x8002A844 0x8002DC44 0x80031044 0x80034444 0x80037844 /end VAR_ADDRESS
 /end VAR_CHARACTERISTIC
 /begin VAR_CHARACTERISTIC TQS16_ROP_Pre_Frt_Alatm_TH BrkCalVariantCriterion
  /begin VAR_ADDRESS 0x80020C1C 0x8002401C 0x8002741C 0x8002A81C 0x8002DC1C 0x8003101C 0x8003441C 0x8003781C /end VAR_ADDRESS
 /end VAR_CHARACTERISTIC
 /begin VAR_CHARACTERISTIC TQS16_ROP_Pre_Frt_Vel_TH BrkCalVariantCriterion
  /begin VAR_ADDRESS 0x80020C1E 0x8002401E 0x8002741E 0x8002A81E 0x8002DC1E 0x8003101E 0x8003441E 0x8003781E /end VAR_ADDRESS
 /end VAR_CHARACTERISTIC
 /begin VAR_CHARACTERISTIC TQS16_ROP_REAR_RISE_PRESS_BAR BrkCalVariantCriterion
  /begin VAR_ADDRESS 0x80020C46 0x80024046 0x80027446 0x8002A846 0x8002DC46 0x80031046 0x80034446 0x80037846 /end VAR_ADDRESS
 /end VAR_CHARACTERISTIC
 /begin VAR_CHARACTERISTIC TQS16_ROP_RI_THRES_VEL_100K BrkCalVariantCriterion
  /begin VAR_ADDRESS 0x80020B60 0x80023F60 0x80027360 0x8002A760 0x8002DB60 0x80030F60 0x80034360 0x80037760 /end VAR_ADDRESS
 /end VAR_CHARACTERISTIC
 /begin VAR_CHARACTERISTIC TQS16_ROP_RI_THRES_VEL_20K BrkCalVariantCriterion
  /begin VAR_ADDRESS 0x80020B62 0x80023F62 0x80027362 0x8002A762 0x8002DB62 0x80030F62 0x80034362 0x80037762 /end VAR_ADDRESS
 /end VAR_CHARACTERISTIC
 /begin VAR_CHARACTERISTIC TQS16_ROP_RI_THRES_VEL_40K BrkCalVariantCriterion
  /begin VAR_ADDRESS 0x80020B64 0x80023F64 0x80027364 0x8002A764 0x8002DB64 0x80030F64 0x80034364 0x80037764 /end VAR_ADDRESS
 /end VAR_CHARACTERISTIC
 /begin VAR_CHARACTERISTIC TQS16_ROP_RI_THRES_VEL_60K BrkCalVariantCriterion
  /begin VAR_ADDRESS 0x80020B66 0x80023F66 0x80027366 0x8002A766 0x8002DB66 0x80030F66 0x80034366 0x80037766 /end VAR_ADDRESS
 /end VAR_CHARACTERISTIC
 /begin VAR_CHARACTERISTIC TQS16_ROP_RI_THRES_VEL_80K BrkCalVariantCriterion
  /begin VAR_ADDRESS 0x80020B68 0x80023F68 0x80027368 0x8002A768 0x8002DB68 0x80030F68 0x80034368 0x80037768 /end VAR_ADDRESS
 /end VAR_CHARACTERISTIC
 /begin VAR_CHARACTERISTIC TQS16_ROP_TTP_FAST_VEL_DELAY BrkCalVariantCriterion
  /begin VAR_ADDRESS 0x80020C20 0x80024020 0x80027420 0x8002A820 0x8002DC20 0x80031020 0x80034420 0x80037820 /end VAR_ADDRESS
 /end VAR_CHARACTERISTIC
 /begin VAR_CHARACTERISTIC TQS16_ROP_TTP_FAST_WSTR_DOT_DELAY BrkCalVariantCriterion
  /begin VAR_ADDRESS 0x80020C22 0x80024022 0x80027422 0x8002A822 0x8002DC22 0x80031022 0x80034422 0x80037822 /end VAR_ADDRESS
 /end VAR_CHARACTERISTIC
 /begin VAR_CHARACTERISTIC TQS16_ROP_TTP_SLOW_VEL_DELAY BrkCalVariantCriterion
  /begin VAR_ADDRESS 0x80020C24 0x80024024 0x80027424 0x8002A824 0x8002DC24 0x80031024 0x80034424 0x80037824 /end VAR_ADDRESS
 /end VAR_CHARACTERISTIC
 /begin VAR_CHARACTERISTIC TQS16_ROP_TTP_SLOW_WSTR_DOT_DELAY BrkCalVariantCriterion
  /begin VAR_ADDRESS 0x80020C26 0x80024026 0x80027426 0x8002A826 0x8002DC26 0x80031026 0x80034426 0x80037826 /end VAR_ADDRESS
 /end VAR_CHARACTERISTIC
 /begin VAR_CHARACTERISTIC TQS16_ROP_TTP_VEL_FAST BrkCalVariantCriterion
  /begin VAR_ADDRESS 0x80020C28 0x80024028 0x80027428 0x8002A828 0x8002DC28 0x80031028 0x80034428 0x80037828 /end VAR_ADDRESS
 /end VAR_CHARACTERISTIC
 /begin VAR_CHARACTERISTIC TQS16_ROP_TTP_VEL_SLOW BrkCalVariantCriterion
  /begin VAR_ADDRESS 0x80020C2A 0x8002402A 0x8002742A 0x8002A82A 0x8002DC2A 0x8003102A 0x8003442A 0x8003782A /end VAR_ADDRESS
 /end VAR_CHARACTERISTIC
 /begin VAR_CHARACTERISTIC TQS16_ROP_TTP_WSTR_DOT_FAST BrkCalVariantCriterion
  /begin VAR_ADDRESS 0x80020C2C 0x8002402C 0x8002742C 0x8002A82C 0x8002DC2C 0x8003102C 0x8003442C 0x8003782C /end VAR_ADDRESS
 /end VAR_CHARACTERISTIC
 /begin VAR_CHARACTERISTIC TQS16_ROP_TTP_WSTR_DOT_SLOW BrkCalVariantCriterion
  /begin VAR_ADDRESS 0x80020C2E 0x8002402E 0x8002742E 0x8002A82E 0x8002DC2E 0x8003102E 0x8003442E 0x8003782E /end VAR_ADDRESS
 /end VAR_CHARACTERISTIC
 /begin VAR_CHARACTERISTIC TQS16_ROP_WSTR_DOT_ENT_100K BrkCalVariantCriterion
  /begin VAR_ADDRESS 0x80020BF0 0x80023FF0 0x800273F0 0x8002A7F0 0x8002DBF0 0x80030FF0 0x800343F0 0x800377F0 /end VAR_ADDRESS
 /end VAR_CHARACTERISTIC
 /begin VAR_CHARACTERISTIC TQS16_ROP_WSTR_DOT_ENT_120K BrkCalVariantCriterion
  /begin VAR_ADDRESS 0x80020BF2 0x80023FF2 0x800273F2 0x8002A7F2 0x8002DBF2 0x80030FF2 0x800343F2 0x800377F2 /end VAR_ADDRESS
 /end VAR_CHARACTERISTIC
 /begin VAR_CHARACTERISTIC TQS16_ROP_WSTR_DOT_ENT_40K BrkCalVariantCriterion
  /begin VAR_ADDRESS 0x80020BF4 0x80023FF4 0x800273F4 0x8002A7F4 0x8002DBF4 0x80030FF4 0x800343F4 0x800377F4 /end VAR_ADDRESS
 /end VAR_CHARACTERISTIC
 /begin VAR_CHARACTERISTIC TQS16_ROP_WSTR_DOT_ENT_50K BrkCalVariantCriterion
  /begin VAR_ADDRESS 0x80020BF6 0x80023FF6 0x800273F6 0x8002A7F6 0x8002DBF6 0x80030FF6 0x800343F6 0x800377F6 /end VAR_ADDRESS
 /end VAR_CHARACTERISTIC
/end VARIANT_CODING
/end MODULE
/end PROJECT
